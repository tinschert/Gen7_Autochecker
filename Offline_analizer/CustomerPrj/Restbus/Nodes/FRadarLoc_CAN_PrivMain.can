/*@!Encoding:1252*/
/**
 * @file FRadarLoc_CAN_PrivMain.can
 * @author ADAS_HIL_TEAM
 * @date 10-04-2022
 * @brief 
 *
 * ################################################################
 * C O P Y R I G H T S
 * ----------------------------------------------------------------
 * Copyright (c) 2022-2023 by Robert Bosch GmbH. All rights reserved.
 
 * The reproduction, distribution and utilization of this file as
 * well as the communication of its contents to others without express
 * authorization is prohibited. Offenders will be held liable for the
 * payment of damages. All rights reserved in the event of the grant
 * of a patent, utility model or design.
 *
 * ################################################################
*/

// Autogenerated by -> Platform\Classe\Scripts\Rbs_Scripts\create_nodes.py
includes
{
  #pragma library ("C:\ProgramData\Vector\AddOn Packages\Vector AddOn\vModules\CANoeILNLVector.vmodule")
  #include "CAPL\DataHandling.cin" /*DataHandling for IL*/
  #include "CAPL\E2E.cin" /*OD Specific for CRC calculation */
}

variables {
  message RFC_LocationHdrA Msg_RFC_LocationHdrA;
  message RFC_LocationHdrB Msg_RFC_LocationHdrB;
  message RFC_Location_000_002 Msg_RFC_Location_000_002;
  message RFC_Location_003_005 Msg_RFC_Location_003_005;
  message RFC_Location_006_008 Msg_RFC_Location_006_008;
  message RFC_Location_009_011 Msg_RFC_Location_009_011;
  message RFC_Location_012_014 Msg_RFC_Location_012_014;
  message RFC_Location_015_017 Msg_RFC_Location_015_017;
  message RFC_Location_018_020 Msg_RFC_Location_018_020;
  message RFC_Location_021_023 Msg_RFC_Location_021_023;
  message RFC_Location_024_026 Msg_RFC_Location_024_026;
  message RFC_Location_027_029 Msg_RFC_Location_027_029;
  message RFC_Location_030_032 Msg_RFC_Location_030_032;
  message RFC_Location_033_035 Msg_RFC_Location_033_035;
  message RFC_Location_036_038 Msg_RFC_Location_036_038;
  message RFC_Location_039_041 Msg_RFC_Location_039_041;
  message RFC_Location_042_044 Msg_RFC_Location_042_044;
  message RFC_Location_045_047 Msg_RFC_Location_045_047;
  message RFC_Location_048_050 Msg_RFC_Location_048_050;
  message RFC_Location_051_053 Msg_RFC_Location_051_053;
  message RFC_Location_054_056 Msg_RFC_Location_054_056;
  message RFC_Location_057_059 Msg_RFC_Location_057_059;
  message RFC_Location_060_062 Msg_RFC_Location_060_062;
  message RFC_Location_063_065 Msg_RFC_Location_063_065;
  message RFC_Location_066_068 Msg_RFC_Location_066_068;
  message RFC_Location_069_071 Msg_RFC_Location_069_071;
  message RFC_Location_072_074 Msg_RFC_Location_072_074;
  message RFC_Location_075_077 Msg_RFC_Location_075_077;
  message RFC_Location_078_080 Msg_RFC_Location_078_080;
  message RFC_Location_081_083 Msg_RFC_Location_081_083;
  message RFC_Location_084_086 Msg_RFC_Location_084_086;
  message RFC_Location_087_089 Msg_RFC_Location_087_089;
  message RFC_Location_090_092 Msg_RFC_Location_090_092;
  message RFC_Location_093_095 Msg_RFC_Location_093_095;
  message RFC_Location_096_098 Msg_RFC_Location_096_098;
  message RFC_Location_099_101 Msg_RFC_Location_099_101;
  message RFC_Location_102_104 Msg_RFC_Location_102_104;
  message RFC_Location_105_107 Msg_RFC_Location_105_107;
  message RFC_Location_108_110 Msg_RFC_Location_108_110;
  message RFC_Location_111_113 Msg_RFC_Location_111_113;
  message RFC_Location_114_116 Msg_RFC_Location_114_116;
  message RFC_Location_117_119 Msg_RFC_Location_117_119;
  message RFC_Location_120_122 Msg_RFC_Location_120_122;
  message RFC_Location_123_125 Msg_RFC_Location_123_125;
  message RFC_Location_126_128 Msg_RFC_Location_126_128;
  message RFC_Location_129_131 Msg_RFC_Location_129_131;
  message RFC_Location_132_134 Msg_RFC_Location_132_134;
  message RFC_Location_135_137 Msg_RFC_Location_135_137;
  message RFC_Location_138_140 Msg_RFC_Location_138_140;
  message RFC_Location_141_143 Msg_RFC_Location_141_143;
  message RFC_Location_144_146 Msg_RFC_Location_144_146;
  message RFC_Location_147_149 Msg_RFC_Location_147_149;
  message RFC_Location_150_152 Msg_RFC_Location_150_152;
  message RFC_Location_153_155 Msg_RFC_Location_153_155;
  message RFC_Location_156_158 Msg_RFC_Location_156_158;
  message RFC_Location_159_161 Msg_RFC_Location_159_161;
  message RFC_Location_162_164 Msg_RFC_Location_162_164;
  message RFC_Location_165_167 Msg_RFC_Location_165_167;
  message RFC_Location_168_170 Msg_RFC_Location_168_170;
  message RFC_Location_171_173 Msg_RFC_Location_171_173;
  message RFC_Location_174_176 Msg_RFC_Location_174_176;
  message RFC_Location_177_179 Msg_RFC_Location_177_179;
  message RFC_Location_180_182 Msg_RFC_Location_180_182;
  message RFC_Location_183_185 Msg_RFC_Location_183_185;
  message RFC_Location_186_188 Msg_RFC_Location_186_188;
  message RFC_Location_189_191 Msg_RFC_Location_189_191;
  message RFC_Location_192_194 Msg_RFC_Location_192_194;
  message RFC_Location_195_197 Msg_RFC_Location_195_197;
  message RFC_Location_198_200 Msg_RFC_Location_198_200;
  message RFC_Location_201_203 Msg_RFC_Location_201_203;
  message RFC_Location_204_206 Msg_RFC_Location_204_206;
  message RFC_Location_207_209 Msg_RFC_Location_207_209;
  message RFC_Location_210_212 Msg_RFC_Location_210_212;
  message RFC_Location_213_215 Msg_RFC_Location_213_215;
  message RFC_Location_216_218 Msg_RFC_Location_216_218;
  message RFC_Location_219_221 Msg_RFC_Location_219_221;
  message RFC_Location_222_224 Msg_RFC_Location_222_224;
  message RFC_Location_225_227 Msg_RFC_Location_225_227;
  message RFC_Location_228_230 Msg_RFC_Location_228_230;
  message RFC_Location_231_233 Msg_RFC_Location_231_233;
  message RFC_Location_234_236 Msg_RFC_Location_234_236;
  message RFC_Location_237_239 Msg_RFC_Location_237_239;
  message RFC_Location_240_242 Msg_RFC_Location_240_242;
  message RFC_Location_243_245 Msg_RFC_Location_243_245;
  message RFC_Location_246_248 Msg_RFC_Location_246_248;
  message RFC_Location_249_251 Msg_RFC_Location_249_251;
  message RFC_Location_252_254 Msg_RFC_Location_252_254;
  message RFC_Status Msg_RFC_Status;

  word counter_RFC_LocationHdrA_RFC_LocHdrA_AliveCtr;
  word counter_RFC_LocationHdrB_RFC_LocHdrB_AliveCtr;
  word counter_RFC_Location_000_002_RFC_Loc000_002_AliveCtr;
  word counter_RFC_Location_003_005_RFC_Loc003_005_AliveCtr;
  word counter_RFC_Location_006_008_RFC_Loc006_008_AliveCtr;
  word counter_RFC_Location_009_011_RFC_Loc009_011_AliveCtr;
  word counter_RFC_Location_012_014_RFC_Loc012_014_AliveCtr;
  word counter_RFC_Location_015_017_RFC_Loc015_017_AliveCtr;
  word counter_RFC_Location_018_020_RFC_Loc018_020_AliveCtr;
  word counter_RFC_Location_021_023_RFC_Loc021_023_AliveCtr;
  word counter_RFC_Location_024_026_RFC_Loc024_026_AliveCtr;
  word counter_RFC_Location_027_029_RFC_Loc027_029_AliveCtr;
  word counter_RFC_Location_030_032_RFC_Loc030_032_AliveCtr;
  word counter_RFC_Location_033_035_RFC_Loc033_035_AliveCtr;
  word counter_RFC_Location_036_038_RFC_Loc036_038_AliveCtr;
  word counter_RFC_Location_039_041_RFC_Loc039_041_AliveCtr;
  word counter_RFC_Location_042_044_RFC_Loc042_044_AliveCtr;
  word counter_RFC_Location_045_047_RFC_Loc045_047_AliveCtr;
  word counter_RFC_Location_048_050_RFC_Loc048_050_AliveCtr;
  word counter_RFC_Location_051_053_RFC_Loc051_053_AliveCtr;
  word counter_RFC_Location_054_056_RFC_Loc054_056_AliveCtr;
  word counter_RFC_Location_057_059_RFC_Loc057_059_AliveCtr;
  word counter_RFC_Location_060_062_RFC_Loc060_062_AliveCtr;
  word counter_RFC_Location_063_065_RFC_Loc063_065_AliveCtr;
  word counter_RFC_Location_066_068_RFC_Loc066_068_AliveCtr;
  word counter_RFC_Location_069_071_RFC_Loc069_071_AliveCtr;
  word counter_RFC_Location_072_074_RFC_Loc072_074_AliveCtr;
  word counter_RFC_Location_075_077_RFC_Loc075_077_AliveCtr;
  word counter_RFC_Location_078_080_RFC_Loc078_080_AliveCtr;
  word counter_RFC_Location_081_083_RFC_Loc081_083_AliveCtr;
  word counter_RFC_Location_084_086_RFC_Loc084_086_AliveCtr;
  word counter_RFC_Location_087_089_RFC_Loc087_089_AliveCtr;
  word counter_RFC_Location_090_092_RFC_Loc090_092_AliveCtr;
  word counter_RFC_Location_093_095_RFC_Loc093_095_AliveCtr;
  word counter_RFC_Location_096_098_RFC_Loc096_098_AliveCtr;
  word counter_RFC_Location_099_101_RFC_Loc099_101_AliveCtr;
  word counter_RFC_Location_102_104_RFC_Loc102_104_AliveCtr;
  word counter_RFC_Location_105_107_RFC_Loc105_107_AliveCtr;
  word counter_RFC_Location_108_110_RFC_Loc108_110_AliveCtr;
  word counter_RFC_Location_111_113_RFC_Loc111_113_AliveCtr;
  word counter_RFC_Location_114_116_RFC_Loc114_116_AliveCtr;
  word counter_RFC_Location_117_119_RFC_Loc117_119_AliveCtr;
  word counter_RFC_Location_120_122_RFC_Loc120_122_AliveCtr;
  word counter_RFC_Location_123_125_RFC_Loc123_125_AliveCtr;
  word counter_RFC_Location_126_128_RFC_Loc126_128_AliveCtr;
  word counter_RFC_Location_129_131_RFC_Loc129_131_AliveCtr;
  word counter_RFC_Location_132_134_RFC_Loc132_134_AliveCtr;
  word counter_RFC_Location_135_137_RFC_Loc135_137_AliveCtr;
  word counter_RFC_Location_138_140_RFC_Loc138_140_AliveCtr;
  word counter_RFC_Location_141_143_RFC_Loc141_143_AliveCtr;
  word counter_RFC_Location_144_146_RFC_Loc144_146_AliveCtr;
  word counter_RFC_Location_147_149_RFC_Loc147_149_AliveCtr;
  word counter_RFC_Location_150_152_RFC_Loc150_152_AliveCtr;
  word counter_RFC_Location_153_155_RFC_Loc153_155_AliveCtr;
  word counter_RFC_Location_156_158_RFC_Loc156_158_AliveCtr;
  word counter_RFC_Location_159_161_RFC_Loc159_161_AliveCtr;
  word counter_RFC_Location_162_164_RFC_Loc162_164_AliveCtr;
  word counter_RFC_Location_165_167_RFC_Loc165_167_AliveCtr;
  word counter_RFC_Location_168_170_RFC_Loc168_170_AliveCtr;
  word counter_RFC_Location_171_173_RFC_Loc171_173_AliveCtr;
  word counter_RFC_Location_174_176_RFC_Loc174_176_AliveCtr;
  word counter_RFC_Location_177_179_RFC_Loc177_179_AliveCtr;
  word counter_RFC_Location_180_182_RFC_Loc180_182_AliveCtr;
  word counter_RFC_Location_183_185_RFC_Loc183_185_AliveCtr;
  word counter_RFC_Location_186_188_RFC_Loc186_188_AliveCtr;
  word counter_RFC_Location_189_191_RFC_Loc189_191_AliveCtr;
  word counter_RFC_Location_192_194_RFC_Loc192_194_AliveCtr;
  word counter_RFC_Location_195_197_RFC_Loc195_197_AliveCtr;
  word counter_RFC_Location_198_200_RFC_Loc198_200_AliveCtr;
  word counter_RFC_Location_201_203_RFC_Loc201_203_AliveCtr;
  word counter_RFC_Location_204_206_RFC_Loc204_206_AliveCtr;
  word counter_RFC_Location_207_209_RFC_Loc207_209_AliveCtr;
  word counter_RFC_Location_210_212_RFC_Loc210_212_AliveCtr;
  word counter_RFC_Location_213_215_RFC_Loc213_215_AliveCtr;
  word counter_RFC_Location_216_218_RFC_Loc216_218_AliveCtr;
  word counter_RFC_Location_219_221_RFC_Loc219_221_AliveCtr;
  word counter_RFC_Location_222_224_RFC_Loc222_224_AliveCtr;
  word counter_RFC_Location_225_227_RFC_Loc225_227_AliveCtr;
  word counter_RFC_Location_228_230_RFC_Loc228_230_AliveCtr;
  word counter_RFC_Location_231_233_RFC_Loc231_233_AliveCtr;
  word counter_RFC_Location_234_236_RFC_Loc234_236_AliveCtr;
  word counter_RFC_Location_237_239_RFC_Loc237_239_AliveCtr;
  word counter_RFC_Location_240_242_RFC_Loc240_242_AliveCtr;
  word counter_RFC_Location_243_245_RFC_Loc243_245_AliveCtr;
  word counter_RFC_Location_246_248_RFC_Loc246_248_AliveCtr;
  word counter_RFC_Location_249_251_RFC_Loc249_251_AliveCtr;
  word counter_RFC_Location_252_254_RFC_Loc252_254_AliveCtr;
  word counter_RFC_Status_RFC_Status_AliveCtr;

  dword bc_RFC_LocationHdrA_RFC_LocHdrA_ProtBlockCtr;
  dword bc_RFC_Location_ProtBlockCtr;
  dword bc_RFC_LocationHdrB_RFC_LocHdrB_ProtBlockCtr;
  dword bc_RFC_Location_000_002_RFC_Loc000_002_ProtBlockCtr;
  dword bc_RFC_Location_003_005_RFC_Loc003_005_ProtBlockCtr;
  dword bc_RFC_Location_006_008_RFC_Loc006_008_ProtBlockCtr;
  dword bc_RFC_Location_009_011_RFC_Loc009_011_ProtBlockCtr;
  dword bc_RFC_Location_012_014_RFC_Loc012_014_ProtBlockCtr;
  dword bc_RFC_Location_015_017_RFC_Loc015_017_ProtBlockCtr;
  dword bc_RFC_Location_018_020_RFC_Loc018_020_ProtBlockCtr;
  dword bc_RFC_Location_021_023_RFC_Loc021_023_ProtBlockCtr;
  dword bc_RFC_Location_024_026_RFC_Loc024_026_ProtBlockCtr;
  dword bc_RFC_Location_027_029_RFC_Loc027_029_ProtBlockCtr;
  dword bc_RFC_Location_030_032_RFC_Loc030_032_ProtBlockCtr;
  dword bc_RFC_Location_033_035_RFC_Loc033_035_ProtBlockCtr;
  dword bc_RFC_Location_036_038_RFC_Loc036_038_ProtBlockCtr;
  dword bc_RFC_Location_039_041_RFC_Loc039_041_ProtBlockCtr;
  dword bc_RFC_Location_042_044_RFC_Loc042_044_ProtBlockCtr;
  dword bc_RFC_Location_045_047_RFC_Loc045_047_ProtBlockCtr;
  dword bc_RFC_Location_048_050_RFC_Loc048_050_ProtBlockCtr;
  dword bc_RFC_Location_051_053_RFC_Loc051_053_ProtBlockCtr;
  dword bc_RFC_Location_054_056_RFC_Loc054_056_ProtBlockCtr;
  dword bc_RFC_Location_057_059_RFC_Loc057_059_ProtBlockCtr;
  dword bc_RFC_Location_060_062_RFC_Loc060_062_ProtBlockCtr;
  dword bc_RFC_Location_063_065_RFC_Loc063_065_ProtBlockCtr;
  dword bc_RFC_Location_066_068_RFC_Loc066_068_ProtBlockCtr;
  dword bc_RFC_Location_069_071_RFC_Loc069_071_ProtBlockCtr;
  dword bc_RFC_Location_072_074_RFC_Loc072_074_ProtBlockCtr;
  dword bc_RFC_Location_075_077_RFC_Loc075_077_ProtBlockCtr;
  dword bc_RFC_Location_078_080_RFC_Loc078_080_ProtBlockCtr;
  dword bc_RFC_Location_081_083_RFC_Loc081_083_ProtBlockCtr;
  dword bc_RFC_Location_084_086_RFC_Loc084_086_ProtBlockCtr;
  dword bc_RFC_Location_087_089_RFC_Loc087_089_ProtBlockCtr;
  dword bc_RFC_Location_090_092_RFC_Loc090_092_ProtBlockCtr;
  dword bc_RFC_Location_093_095_RFC_Loc093_095_ProtBlockCtr;
  dword bc_RFC_Location_096_098_RFC_Loc096_098_ProtBlockCtr;
  dword bc_RFC_Location_099_101_RFC_Loc099_101_ProtBlockCtr;
  dword bc_RFC_Location_102_104_RFC_Loc102_104_ProtBlockCtr;
  dword bc_RFC_Location_105_107_RFC_Loc105_107_ProtBlockCtr;
  dword bc_RFC_Location_108_110_RFC_Loc108_110_ProtBlockCtr;
  dword bc_RFC_Location_111_113_RFC_Loc111_113_ProtBlockCtr;
  dword bc_RFC_Location_114_116_RFC_Loc114_116_ProtBlockCtr;
  dword bc_RFC_Location_117_119_RFC_Loc117_119_ProtBlockCtr;
  dword bc_RFC_Location_120_122_RFC_Loc120_122_ProtBlockCtr;
  dword bc_RFC_Location_123_125_RFC_Loc123_125_ProtBlockCtr;
  dword bc_RFC_Location_126_128_RFC_Loc126_128_ProtBlockCtr;
  dword bc_RFC_Location_129_131_RFC_Loc129_131_ProtBlockCtr;
  dword bc_RFC_Location_132_134_RFC_Loc132_134_ProtBlockCtr;
  dword bc_RFC_Location_135_137_RFC_Loc135_137_ProtBlockCtr;
  dword bc_RFC_Location_138_140_RFC_Loc138_140_ProtBlockCtr;
  dword bc_RFC_Location_141_143_RFC_Loc141_143_ProtBlockCtr;
  dword bc_RFC_Location_144_146_RFC_Loc144_146_ProtBlockCtr;
  dword bc_RFC_Location_147_149_RFC_Loc147_149_ProtBlockCtr;
  dword bc_RFC_Location_150_152_RFC_Loc150_152_ProtBlockCtr;
  dword bc_RFC_Location_153_155_RFC_Loc153_155_ProtBlockCtr;
  dword bc_RFC_Location_156_158_RFC_Loc156_158_ProtBlockCtr;
  dword bc_RFC_Location_159_161_RFC_Loc159_161_ProtBlockCtr;
  dword bc_RFC_Location_162_164_RFC_Loc162_164_ProtBlockCtr;
  dword bc_RFC_Location_165_167_RFC_Loc165_167_ProtBlockCtr;
  dword bc_RFC_Location_168_170_RFC_Loc168_170_ProtBlockCtr;
  dword bc_RFC_Location_171_173_RFC_Loc171_173_ProtBlockCtr;
  dword bc_RFC_Location_174_176_RFC_Loc174_176_ProtBlockCtr;
  dword bc_RFC_Location_177_179_RFC_Loc177_179_ProtBlockCtr;
  dword bc_RFC_Location_180_182_RFC_Loc180_182_ProtBlockCtr;
  dword bc_RFC_Location_183_185_RFC_Loc183_185_ProtBlockCtr;
  dword bc_RFC_Location_186_188_RFC_Loc186_188_ProtBlockCtr;
  dword bc_RFC_Location_189_191_RFC_Loc189_191_ProtBlockCtr;
  dword bc_RFC_Location_192_194_RFC_Loc192_194_ProtBlockCtr;
  dword bc_RFC_Location_195_197_RFC_Loc195_197_ProtBlockCtr;
  dword bc_RFC_Location_198_200_RFC_Loc198_200_ProtBlockCtr;
  dword bc_RFC_Location_201_203_RFC_Loc201_203_ProtBlockCtr;
  dword bc_RFC_Location_204_206_RFC_Loc204_206_ProtBlockCtr;
  dword bc_RFC_Location_207_209_RFC_Loc207_209_ProtBlockCtr;
  dword bc_RFC_Location_210_212_RFC_Loc210_212_ProtBlockCtr;
  dword bc_RFC_Location_213_215_RFC_Loc213_215_ProtBlockCtr;
  dword bc_RFC_Location_216_218_RFC_Loc216_218_ProtBlockCtr;
  dword bc_RFC_Location_219_221_RFC_Loc219_221_ProtBlockCtr;
  dword bc_RFC_Location_222_224_RFC_Loc222_224_ProtBlockCtr;
  dword bc_RFC_Location_225_227_RFC_Loc225_227_ProtBlockCtr;
  dword bc_RFC_Location_228_230_RFC_Loc228_230_ProtBlockCtr;
  dword bc_RFC_Location_231_233_RFC_Loc231_233_ProtBlockCtr;
  dword bc_RFC_Location_234_236_RFC_Loc234_236_ProtBlockCtr;
  dword bc_RFC_Location_237_239_RFC_Loc237_239_ProtBlockCtr;
  dword bc_RFC_Location_240_242_RFC_Loc240_242_ProtBlockCtr;
  dword bc_RFC_Location_243_245_RFC_Loc243_245_ProtBlockCtr;
  dword bc_RFC_Location_246_248_RFC_Loc246_248_ProtBlockCtr;
  dword bc_RFC_Location_249_251_RFC_Loc249_251_ProtBlockCtr;
  dword bc_RFC_Location_252_254_RFC_Loc252_254_ProtBlockCtr;

  dword crc_RFC_LocationHdrA_RFC_LocHdrA_CRC;
  dword crc_RFC_LocationHdrB_RFC_LocHdrB_CRC;
  dword crc_RFC_Location_000_002_RFC_Loc000_002_CRC;
  dword crc_RFC_Location_003_005_RFC_Loc003_005_CRC;
  dword crc_RFC_Location_006_008_RFC_Loc006_008_CRC;
  dword crc_RFC_Location_009_011_RFC_Loc009_011_CRC;
  dword crc_RFC_Location_012_014_RFC_Loc012_014_CRC;
  dword crc_RFC_Location_015_017_RFC_Loc015_017_CRC;
  dword crc_RFC_Location_018_020_RFC_Loc018_020_CRC;
  dword crc_RFC_Location_021_023_RFC_Loc021_023_CRC;
  dword crc_RFC_Location_024_026_RFC_Loc024_026_CRC;
  dword crc_RFC_Location_027_029_RFC_Loc027_029_CRC;
  dword crc_RFC_Location_030_032_RFC_Loc030_032_CRC;
  dword crc_RFC_Location_033_035_RFC_Loc033_035_CRC;
  dword crc_RFC_Location_036_038_RFC_Loc036_038_CRC;
  dword crc_RFC_Location_039_041_RFC_Loc039_041_CRC;
  dword crc_RFC_Location_042_044_RFC_Loc042_044_CRC;
  dword crc_RFC_Location_045_047_RFC_Loc045_047_CRC;
  dword crc_RFC_Location_048_050_RFC_Loc048_050_CRC;
  dword crc_RFC_Location_051_053_RFC_Loc051_053_CRC;
  dword crc_RFC_Location_054_056_RFC_Loc054_056_CRC;
  dword crc_RFC_Location_057_059_RFC_Loc057_059_CRC;
  dword crc_RFC_Location_060_062_RFC_Loc060_062_CRC;
  dword crc_RFC_Location_063_065_RFC_Loc063_065_CRC;
  dword crc_RFC_Location_066_068_RFC_Loc066_068_CRC;
  dword crc_RFC_Location_069_071_RFC_Loc069_071_CRC;
  dword crc_RFC_Location_072_074_RFC_Loc072_074_CRC;
  dword crc_RFC_Location_075_077_RFC_Loc075_077_CRC;
  dword crc_RFC_Location_078_080_RFC_Loc078_080_CRC;
  dword crc_RFC_Location_081_083_RFC_Loc081_083_CRC;
  dword crc_RFC_Location_084_086_RFC_Loc084_086_CRC;
  dword crc_RFC_Location_087_089_RFC_Loc087_089_CRC;
  dword crc_RFC_Location_090_092_RFC_Loc090_092_CRC;
  dword crc_RFC_Location_093_095_RFC_Loc093_095_CRC;
  dword crc_RFC_Location_096_098_RFC_Loc096_098_CRC;
  dword crc_RFC_Location_099_101_RFC_Loc099_101_CRC;
  dword crc_RFC_Location_102_104_RFC_Loc102_104_CRC;
  dword crc_RFC_Location_105_107_RFC_Loc105_107_CRC;
  dword crc_RFC_Location_108_110_RFC_Loc108_110_CRC;
  dword crc_RFC_Location_111_113_RFC_Loc111_113_CRC;
  dword crc_RFC_Location_114_116_RFC_Loc114_116_CRC;
  dword crc_RFC_Location_117_119_RFC_Loc117_119_CRC;
  dword crc_RFC_Location_120_122_RFC_Loc120_122_CRC;
  dword crc_RFC_Location_123_125_RFC_Loc123_125_CRC;
  dword crc_RFC_Location_126_128_RFC_Loc126_128_CRC;
  dword crc_RFC_Location_129_131_RFC_Loc129_131_CRC;
  dword crc_RFC_Location_132_134_RFC_Loc132_134_CRC;
  dword crc_RFC_Location_135_137_RFC_Loc135_137_CRC;
  dword crc_RFC_Location_138_140_RFC_Loc138_140_CRC;
  dword crc_RFC_Location_141_143_RFC_Loc141_143_CRC;
  dword crc_RFC_Location_144_146_RFC_Loc144_146_CRC;
  dword crc_RFC_Location_147_149_RFC_Loc147_149_CRC;
  dword crc_RFC_Location_150_152_RFC_Loc150_152_CRC;
  dword crc_RFC_Location_153_155_RFC_Loc153_155_CRC;
  dword crc_RFC_Location_156_158_RFC_Loc156_158_CRC;
  dword crc_RFC_Location_159_161_RFC_Loc159_161_CRC;
  dword crc_RFC_Location_162_164_RFC_Loc162_164_CRC;
  dword crc_RFC_Location_165_167_RFC_Loc165_167_CRC;
  dword crc_RFC_Location_168_170_RFC_Loc168_170_CRC;
  dword crc_RFC_Location_171_173_RFC_Loc171_173_CRC;
  dword crc_RFC_Location_174_176_RFC_Loc174_176_CRC;
  dword crc_RFC_Location_177_179_RFC_Loc177_179_CRC;
  dword crc_RFC_Location_180_182_RFC_Loc180_182_CRC;
  dword crc_RFC_Location_183_185_RFC_Loc183_185_CRC;
  dword crc_RFC_Location_186_188_RFC_Loc186_188_CRC;
  dword crc_RFC_Location_189_191_RFC_Loc189_191_CRC;
  dword crc_RFC_Location_192_194_RFC_Loc192_194_CRC;
  dword crc_RFC_Location_195_197_RFC_Loc195_197_CRC;
  dword crc_RFC_Location_198_200_RFC_Loc198_200_CRC;
  dword crc_RFC_Location_201_203_RFC_Loc201_203_CRC;
  dword crc_RFC_Location_204_206_RFC_Loc204_206_CRC;
  dword crc_RFC_Location_207_209_RFC_Loc207_209_CRC;
  dword crc_RFC_Location_210_212_RFC_Loc210_212_CRC;
  dword crc_RFC_Location_213_215_RFC_Loc213_215_CRC;
  dword crc_RFC_Location_216_218_RFC_Loc216_218_CRC;
  dword crc_RFC_Location_219_221_RFC_Loc219_221_CRC;
  dword crc_RFC_Location_222_224_RFC_Loc222_224_CRC;
  dword crc_RFC_Location_225_227_RFC_Loc225_227_CRC;
  dword crc_RFC_Location_228_230_RFC_Loc228_230_CRC;
  dword crc_RFC_Location_231_233_RFC_Loc231_233_CRC;
  dword crc_RFC_Location_234_236_RFC_Loc234_236_CRC;
  dword crc_RFC_Location_237_239_RFC_Loc237_239_CRC;
  dword crc_RFC_Location_240_242_RFC_Loc240_242_CRC;
  dword crc_RFC_Location_243_245_RFC_Loc243_245_CRC;
  dword crc_RFC_Location_246_248_RFC_Loc246_248_CRC;
  dword crc_RFC_Location_249_251_RFC_Loc249_251_CRC;
  dword crc_RFC_Location_252_254_RFC_Loc252_254_CRC;
  byte crc_RFC_Status_RFC_Status_CRC;

}

on preStart {
  long result;
  result=ILControlInit ();//Initialization of CANoe IL,to prevent the IL autostart function.
  switch(result)
  {
    case  0   : write("ILControlInit :: FRadarLoc :: No error."); break;
    case -1   : write("ILControlInit :: FRadarLoc :: Momentary state of the IL does not permit this query."); break;
    case -50  : write("ILControlInit :: FRadarLoc :: Nodelayer is inactive - possibly deactivated in the nodes configuration dialog.");  break;
   }

  FRadarLoc_sim_Disable();
  FRadarLoc_sim_SetCycleTimeOffset();
}

on start {

  ILControlSimulationOn();//Starts the simulation of the IL.
  FRadarLoc_sim_SetCANFDParameter();
  ILControlStart ();//Cyclical sending starts; setting signals is now possible.
  FRadarLoc_sim_Reset();
}

on stopMeasurement {

  FRadarLoc_sim_DisableMsg();
  FRadarLoc_sim_Disable();
  ILControlStop();//Cyclical sending is stopped; setting signals is now no longer possible.
  ILControlSimulationOff();//Stops the simulation of the IL. After that no other function to control the IL has an effect to the IL.

}

on sysvar_update hil_ctrl::radar_fc_loc_sim
{
  FRadarLoc_sim_Reset();
}

on sysvar_update hil_ctrl::variant
{
  FRadarLoc_sim_Reset();
}

on sysvar_update Cus_bus::bus_CAN_PrivMain_ON_OFF
{
  FRadarLoc_sim_Reset();
}

void FRadarLoc_sim_Reset()
{

  FRadarLoc_sim_DisableMsg();
  FRadarLoc_sim_Disable();

  if ((@Cus_bus::bus_CAN_PrivMain_ON_OFF == 1) && (@hil_ctrl::radar_fc_loc_sim == 1))
  {
    switch(@hil_ctrl::variant)
    {
      case a_variant:FRadarLoc_sim_start_a_variant();break;
      case b_variant:FRadarLoc_sim_start_b_variant();break;
    }
    if (@hil_ctrl::hil_mode == @hil_ctrl::hil_mode::Restbus) 
    {
       FRadarLoc_sim_EnableEventMsg();
    }
    else
    {
       FRadarLoc_sim_DisableEventMsg();
    }
  }
}

void FRadarLoc_sim_start_a_variant()
{
  @CAN_PrivMain::RFC_Status::RFC_Status_ON_OFF = 1;
}

void FRadarLoc_sim_start_b_variant()
{
  @CAN_PrivMain::RFC_Status::RFC_Status_ON_OFF = 1;
}

void FRadarLoc_sim_Disable()
{
  @CAN_PrivMain::RFC_LocationHdrA::RFC_LocationHdrA_ON_OFF = 0;
  @CAN_PrivMain::RFC_LocationHdrB::RFC_LocationHdrB_ON_OFF = 0;
  @CAN_PrivMain::RFC_Location_000_002::RFC_Location_000_002_ON_OFF = 0;
  @CAN_PrivMain::RFC_Location_003_005::RFC_Location_003_005_ON_OFF = 0;
  @CAN_PrivMain::RFC_Location_006_008::RFC_Location_006_008_ON_OFF = 0;
  @CAN_PrivMain::RFC_Location_009_011::RFC_Location_009_011_ON_OFF = 0;
  @CAN_PrivMain::RFC_Location_012_014::RFC_Location_012_014_ON_OFF = 0;
  @CAN_PrivMain::RFC_Location_015_017::RFC_Location_015_017_ON_OFF = 0;
  @CAN_PrivMain::RFC_Location_018_020::RFC_Location_018_020_ON_OFF = 0;
  @CAN_PrivMain::RFC_Location_021_023::RFC_Location_021_023_ON_OFF = 0;
  @CAN_PrivMain::RFC_Location_024_026::RFC_Location_024_026_ON_OFF = 0;
  @CAN_PrivMain::RFC_Location_027_029::RFC_Location_027_029_ON_OFF = 0;
  @CAN_PrivMain::RFC_Location_030_032::RFC_Location_030_032_ON_OFF = 0;
  @CAN_PrivMain::RFC_Location_033_035::RFC_Location_033_035_ON_OFF = 0;
  @CAN_PrivMain::RFC_Location_036_038::RFC_Location_036_038_ON_OFF = 0;
  @CAN_PrivMain::RFC_Location_039_041::RFC_Location_039_041_ON_OFF = 0;
  @CAN_PrivMain::RFC_Location_042_044::RFC_Location_042_044_ON_OFF = 0;
  @CAN_PrivMain::RFC_Location_045_047::RFC_Location_045_047_ON_OFF = 0;
  @CAN_PrivMain::RFC_Location_048_050::RFC_Location_048_050_ON_OFF = 0;
  @CAN_PrivMain::RFC_Location_051_053::RFC_Location_051_053_ON_OFF = 0;
  @CAN_PrivMain::RFC_Location_054_056::RFC_Location_054_056_ON_OFF = 0;
  @CAN_PrivMain::RFC_Location_057_059::RFC_Location_057_059_ON_OFF = 0;
  @CAN_PrivMain::RFC_Location_060_062::RFC_Location_060_062_ON_OFF = 0;
  @CAN_PrivMain::RFC_Location_063_065::RFC_Location_063_065_ON_OFF = 0;
  @CAN_PrivMain::RFC_Location_066_068::RFC_Location_066_068_ON_OFF = 0;
  @CAN_PrivMain::RFC_Location_069_071::RFC_Location_069_071_ON_OFF = 0;
  @CAN_PrivMain::RFC_Location_072_074::RFC_Location_072_074_ON_OFF = 0;
  @CAN_PrivMain::RFC_Location_075_077::RFC_Location_075_077_ON_OFF = 0;
  @CAN_PrivMain::RFC_Location_078_080::RFC_Location_078_080_ON_OFF = 0;
  @CAN_PrivMain::RFC_Location_081_083::RFC_Location_081_083_ON_OFF = 0;
  @CAN_PrivMain::RFC_Location_084_086::RFC_Location_084_086_ON_OFF = 0;
  @CAN_PrivMain::RFC_Location_087_089::RFC_Location_087_089_ON_OFF = 0;
  @CAN_PrivMain::RFC_Location_090_092::RFC_Location_090_092_ON_OFF = 0;
  @CAN_PrivMain::RFC_Location_093_095::RFC_Location_093_095_ON_OFF = 0;
  @CAN_PrivMain::RFC_Location_096_098::RFC_Location_096_098_ON_OFF = 0;
  @CAN_PrivMain::RFC_Location_099_101::RFC_Location_099_101_ON_OFF = 0;
  @CAN_PrivMain::RFC_Location_102_104::RFC_Location_102_104_ON_OFF = 0;
  @CAN_PrivMain::RFC_Location_105_107::RFC_Location_105_107_ON_OFF = 0;
  @CAN_PrivMain::RFC_Location_108_110::RFC_Location_108_110_ON_OFF = 0;
  @CAN_PrivMain::RFC_Location_111_113::RFC_Location_111_113_ON_OFF = 0;
  @CAN_PrivMain::RFC_Location_114_116::RFC_Location_114_116_ON_OFF = 0;
  @CAN_PrivMain::RFC_Location_117_119::RFC_Location_117_119_ON_OFF = 0;
  @CAN_PrivMain::RFC_Location_120_122::RFC_Location_120_122_ON_OFF = 0;
  @CAN_PrivMain::RFC_Location_123_125::RFC_Location_123_125_ON_OFF = 0;
  @CAN_PrivMain::RFC_Location_126_128::RFC_Location_126_128_ON_OFF = 0;
  @CAN_PrivMain::RFC_Location_129_131::RFC_Location_129_131_ON_OFF = 0;
  @CAN_PrivMain::RFC_Location_132_134::RFC_Location_132_134_ON_OFF = 0;
  @CAN_PrivMain::RFC_Location_135_137::RFC_Location_135_137_ON_OFF = 0;
  @CAN_PrivMain::RFC_Location_138_140::RFC_Location_138_140_ON_OFF = 0;
  @CAN_PrivMain::RFC_Location_141_143::RFC_Location_141_143_ON_OFF = 0;
  @CAN_PrivMain::RFC_Location_144_146::RFC_Location_144_146_ON_OFF = 0;
  @CAN_PrivMain::RFC_Location_147_149::RFC_Location_147_149_ON_OFF = 0;
  @CAN_PrivMain::RFC_Location_150_152::RFC_Location_150_152_ON_OFF = 0;
  @CAN_PrivMain::RFC_Location_153_155::RFC_Location_153_155_ON_OFF = 0;
  @CAN_PrivMain::RFC_Location_156_158::RFC_Location_156_158_ON_OFF = 0;
  @CAN_PrivMain::RFC_Location_159_161::RFC_Location_159_161_ON_OFF = 0;
  @CAN_PrivMain::RFC_Location_162_164::RFC_Location_162_164_ON_OFF = 0;
  @CAN_PrivMain::RFC_Location_165_167::RFC_Location_165_167_ON_OFF = 0;
  @CAN_PrivMain::RFC_Location_168_170::RFC_Location_168_170_ON_OFF = 0;
  @CAN_PrivMain::RFC_Location_171_173::RFC_Location_171_173_ON_OFF = 0;
  @CAN_PrivMain::RFC_Location_174_176::RFC_Location_174_176_ON_OFF = 0;
  @CAN_PrivMain::RFC_Location_177_179::RFC_Location_177_179_ON_OFF = 0;
  @CAN_PrivMain::RFC_Location_180_182::RFC_Location_180_182_ON_OFF = 0;
  @CAN_PrivMain::RFC_Location_183_185::RFC_Location_183_185_ON_OFF = 0;
  @CAN_PrivMain::RFC_Location_186_188::RFC_Location_186_188_ON_OFF = 0;
  @CAN_PrivMain::RFC_Location_189_191::RFC_Location_189_191_ON_OFF = 0;
  @CAN_PrivMain::RFC_Location_192_194::RFC_Location_192_194_ON_OFF = 0;
  @CAN_PrivMain::RFC_Location_195_197::RFC_Location_195_197_ON_OFF = 0;
  @CAN_PrivMain::RFC_Location_198_200::RFC_Location_198_200_ON_OFF = 0;
  @CAN_PrivMain::RFC_Location_201_203::RFC_Location_201_203_ON_OFF = 0;
  @CAN_PrivMain::RFC_Location_204_206::RFC_Location_204_206_ON_OFF = 0;
  @CAN_PrivMain::RFC_Location_207_209::RFC_Location_207_209_ON_OFF = 0;
  @CAN_PrivMain::RFC_Location_210_212::RFC_Location_210_212_ON_OFF = 0;
  @CAN_PrivMain::RFC_Location_213_215::RFC_Location_213_215_ON_OFF = 0;
  @CAN_PrivMain::RFC_Location_216_218::RFC_Location_216_218_ON_OFF = 0;
  @CAN_PrivMain::RFC_Location_219_221::RFC_Location_219_221_ON_OFF = 0;
  @CAN_PrivMain::RFC_Location_222_224::RFC_Location_222_224_ON_OFF = 0;
  @CAN_PrivMain::RFC_Location_225_227::RFC_Location_225_227_ON_OFF = 0;
  @CAN_PrivMain::RFC_Location_228_230::RFC_Location_228_230_ON_OFF = 0;
  @CAN_PrivMain::RFC_Location_231_233::RFC_Location_231_233_ON_OFF = 0;
  @CAN_PrivMain::RFC_Location_234_236::RFC_Location_234_236_ON_OFF = 0;
  @CAN_PrivMain::RFC_Location_237_239::RFC_Location_237_239_ON_OFF = 0;
  @CAN_PrivMain::RFC_Location_240_242::RFC_Location_240_242_ON_OFF = 0;
  @CAN_PrivMain::RFC_Location_243_245::RFC_Location_243_245_ON_OFF = 0;
  @CAN_PrivMain::RFC_Location_246_248::RFC_Location_246_248_ON_OFF = 0;
  @CAN_PrivMain::RFC_Location_249_251::RFC_Location_249_251_ON_OFF = 0;
  @CAN_PrivMain::RFC_Location_252_254::RFC_Location_252_254_ON_OFF = 0;
  @CAN_PrivMain::RFC_Status::RFC_Status_ON_OFF = 0;
}

void FRadarLoc_sim_DisableMsg()
{
   ILFaultInjectionDisableMsg(RFC_LocationHdrA);
   ILFaultInjectionDisableMsg(RFC_LocationHdrB);
   ILFaultInjectionDisableMsg(RFC_Location_000_002);
   ILFaultInjectionDisableMsg(RFC_Location_003_005);
   ILFaultInjectionDisableMsg(RFC_Location_006_008);
   ILFaultInjectionDisableMsg(RFC_Location_009_011);
   ILFaultInjectionDisableMsg(RFC_Location_012_014);
   ILFaultInjectionDisableMsg(RFC_Location_015_017);
   ILFaultInjectionDisableMsg(RFC_Location_018_020);
   ILFaultInjectionDisableMsg(RFC_Location_021_023);
   ILFaultInjectionDisableMsg(RFC_Location_024_026);
   ILFaultInjectionDisableMsg(RFC_Location_027_029);
   ILFaultInjectionDisableMsg(RFC_Location_030_032);
   ILFaultInjectionDisableMsg(RFC_Location_033_035);
   ILFaultInjectionDisableMsg(RFC_Location_036_038);
   ILFaultInjectionDisableMsg(RFC_Location_039_041);
   ILFaultInjectionDisableMsg(RFC_Location_042_044);
   ILFaultInjectionDisableMsg(RFC_Location_045_047);
   ILFaultInjectionDisableMsg(RFC_Location_048_050);
   ILFaultInjectionDisableMsg(RFC_Location_051_053);
   ILFaultInjectionDisableMsg(RFC_Location_054_056);
   ILFaultInjectionDisableMsg(RFC_Location_057_059);
   ILFaultInjectionDisableMsg(RFC_Location_060_062);
   ILFaultInjectionDisableMsg(RFC_Location_063_065);
   ILFaultInjectionDisableMsg(RFC_Location_066_068);
   ILFaultInjectionDisableMsg(RFC_Location_069_071);
   ILFaultInjectionDisableMsg(RFC_Location_072_074);
   ILFaultInjectionDisableMsg(RFC_Location_075_077);
   ILFaultInjectionDisableMsg(RFC_Location_078_080);
   ILFaultInjectionDisableMsg(RFC_Location_081_083);
   ILFaultInjectionDisableMsg(RFC_Location_084_086);
   ILFaultInjectionDisableMsg(RFC_Location_087_089);
   ILFaultInjectionDisableMsg(RFC_Location_090_092);
   ILFaultInjectionDisableMsg(RFC_Location_093_095);
   ILFaultInjectionDisableMsg(RFC_Location_096_098);
   ILFaultInjectionDisableMsg(RFC_Location_099_101);
   ILFaultInjectionDisableMsg(RFC_Location_102_104);
   ILFaultInjectionDisableMsg(RFC_Location_105_107);
   ILFaultInjectionDisableMsg(RFC_Location_108_110);
   ILFaultInjectionDisableMsg(RFC_Location_111_113);
   ILFaultInjectionDisableMsg(RFC_Location_114_116);
   ILFaultInjectionDisableMsg(RFC_Location_117_119);
   ILFaultInjectionDisableMsg(RFC_Location_120_122);
   ILFaultInjectionDisableMsg(RFC_Location_123_125);
   ILFaultInjectionDisableMsg(RFC_Location_126_128);
   ILFaultInjectionDisableMsg(RFC_Location_129_131);
   ILFaultInjectionDisableMsg(RFC_Location_132_134);
   ILFaultInjectionDisableMsg(RFC_Location_135_137);
   ILFaultInjectionDisableMsg(RFC_Location_138_140);
   ILFaultInjectionDisableMsg(RFC_Location_141_143);
   ILFaultInjectionDisableMsg(RFC_Location_144_146);
   ILFaultInjectionDisableMsg(RFC_Location_147_149);
   ILFaultInjectionDisableMsg(RFC_Location_150_152);
   ILFaultInjectionDisableMsg(RFC_Location_153_155);
   ILFaultInjectionDisableMsg(RFC_Location_156_158);
   ILFaultInjectionDisableMsg(RFC_Location_159_161);
   ILFaultInjectionDisableMsg(RFC_Location_162_164);
   ILFaultInjectionDisableMsg(RFC_Location_165_167);
   ILFaultInjectionDisableMsg(RFC_Location_168_170);
   ILFaultInjectionDisableMsg(RFC_Location_171_173);
   ILFaultInjectionDisableMsg(RFC_Location_174_176);
   ILFaultInjectionDisableMsg(RFC_Location_177_179);
   ILFaultInjectionDisableMsg(RFC_Location_180_182);
   ILFaultInjectionDisableMsg(RFC_Location_183_185);
   ILFaultInjectionDisableMsg(RFC_Location_186_188);
   ILFaultInjectionDisableMsg(RFC_Location_189_191);
   ILFaultInjectionDisableMsg(RFC_Location_192_194);
   ILFaultInjectionDisableMsg(RFC_Location_195_197);
   ILFaultInjectionDisableMsg(RFC_Location_198_200);
   ILFaultInjectionDisableMsg(RFC_Location_201_203);
   ILFaultInjectionDisableMsg(RFC_Location_204_206);
   ILFaultInjectionDisableMsg(RFC_Location_207_209);
   ILFaultInjectionDisableMsg(RFC_Location_210_212);
   ILFaultInjectionDisableMsg(RFC_Location_213_215);
   ILFaultInjectionDisableMsg(RFC_Location_216_218);
   ILFaultInjectionDisableMsg(RFC_Location_219_221);
   ILFaultInjectionDisableMsg(RFC_Location_222_224);
   ILFaultInjectionDisableMsg(RFC_Location_225_227);
   ILFaultInjectionDisableMsg(RFC_Location_228_230);
   ILFaultInjectionDisableMsg(RFC_Location_231_233);
   ILFaultInjectionDisableMsg(RFC_Location_234_236);
   ILFaultInjectionDisableMsg(RFC_Location_237_239);
   ILFaultInjectionDisableMsg(RFC_Location_240_242);
   ILFaultInjectionDisableMsg(RFC_Location_243_245);
   ILFaultInjectionDisableMsg(RFC_Location_246_248);
   ILFaultInjectionDisableMsg(RFC_Location_249_251);
   ILFaultInjectionDisableMsg(RFC_Location_252_254);
   ILFaultInjectionDisableMsg(RFC_Status);
}
on sysvar hil_ctrl::hil_mode
{
  FRadarLoc_sim_Reset();
}

void FRadarLoc_sim_DisableEventMsg()
{
   ILFaultInjectionDisableMsg(RFC_LocationHdrA);
   ILFaultInjectionDisableMsg(RFC_LocationHdrB);
   ILFaultInjectionDisableMsg(RFC_Location_000_002);
   ILFaultInjectionDisableMsg(RFC_Location_003_005);
   ILFaultInjectionDisableMsg(RFC_Location_006_008);
   ILFaultInjectionDisableMsg(RFC_Location_009_011);
   ILFaultInjectionDisableMsg(RFC_Location_012_014);
   ILFaultInjectionDisableMsg(RFC_Location_015_017);
   ILFaultInjectionDisableMsg(RFC_Location_018_020);
   ILFaultInjectionDisableMsg(RFC_Location_021_023);
   ILFaultInjectionDisableMsg(RFC_Location_024_026);
   ILFaultInjectionDisableMsg(RFC_Location_027_029);
   ILFaultInjectionDisableMsg(RFC_Location_030_032);
   ILFaultInjectionDisableMsg(RFC_Location_033_035);
   ILFaultInjectionDisableMsg(RFC_Location_036_038);
   ILFaultInjectionDisableMsg(RFC_Location_039_041);
   ILFaultInjectionDisableMsg(RFC_Location_042_044);
   ILFaultInjectionDisableMsg(RFC_Location_045_047);
   ILFaultInjectionDisableMsg(RFC_Location_048_050);
   ILFaultInjectionDisableMsg(RFC_Location_051_053);
   ILFaultInjectionDisableMsg(RFC_Location_054_056);
   ILFaultInjectionDisableMsg(RFC_Location_057_059);
   ILFaultInjectionDisableMsg(RFC_Location_060_062);
   ILFaultInjectionDisableMsg(RFC_Location_063_065);
   ILFaultInjectionDisableMsg(RFC_Location_066_068);
   ILFaultInjectionDisableMsg(RFC_Location_069_071);
   ILFaultInjectionDisableMsg(RFC_Location_072_074);
   ILFaultInjectionDisableMsg(RFC_Location_075_077);
   ILFaultInjectionDisableMsg(RFC_Location_078_080);
   ILFaultInjectionDisableMsg(RFC_Location_081_083);
   ILFaultInjectionDisableMsg(RFC_Location_084_086);
   ILFaultInjectionDisableMsg(RFC_Location_087_089);
   ILFaultInjectionDisableMsg(RFC_Location_090_092);
   ILFaultInjectionDisableMsg(RFC_Location_093_095);
   ILFaultInjectionDisableMsg(RFC_Location_096_098);
   ILFaultInjectionDisableMsg(RFC_Location_099_101);
   ILFaultInjectionDisableMsg(RFC_Location_102_104);
   ILFaultInjectionDisableMsg(RFC_Location_105_107);
   ILFaultInjectionDisableMsg(RFC_Location_108_110);
   ILFaultInjectionDisableMsg(RFC_Location_111_113);
   ILFaultInjectionDisableMsg(RFC_Location_114_116);
   ILFaultInjectionDisableMsg(RFC_Location_117_119);
   ILFaultInjectionDisableMsg(RFC_Location_120_122);
   ILFaultInjectionDisableMsg(RFC_Location_123_125);
   ILFaultInjectionDisableMsg(RFC_Location_126_128);
   ILFaultInjectionDisableMsg(RFC_Location_129_131);
   ILFaultInjectionDisableMsg(RFC_Location_132_134);
   ILFaultInjectionDisableMsg(RFC_Location_135_137);
   ILFaultInjectionDisableMsg(RFC_Location_138_140);
   ILFaultInjectionDisableMsg(RFC_Location_141_143);
   ILFaultInjectionDisableMsg(RFC_Location_144_146);
   ILFaultInjectionDisableMsg(RFC_Location_147_149);
   ILFaultInjectionDisableMsg(RFC_Location_150_152);
   ILFaultInjectionDisableMsg(RFC_Location_153_155);
   ILFaultInjectionDisableMsg(RFC_Location_156_158);
   ILFaultInjectionDisableMsg(RFC_Location_159_161);
   ILFaultInjectionDisableMsg(RFC_Location_162_164);
   ILFaultInjectionDisableMsg(RFC_Location_165_167);
   ILFaultInjectionDisableMsg(RFC_Location_168_170);
   ILFaultInjectionDisableMsg(RFC_Location_171_173);
   ILFaultInjectionDisableMsg(RFC_Location_174_176);
   ILFaultInjectionDisableMsg(RFC_Location_177_179);
   ILFaultInjectionDisableMsg(RFC_Location_180_182);
   ILFaultInjectionDisableMsg(RFC_Location_183_185);
   ILFaultInjectionDisableMsg(RFC_Location_186_188);
   ILFaultInjectionDisableMsg(RFC_Location_189_191);
   ILFaultInjectionDisableMsg(RFC_Location_192_194);
   ILFaultInjectionDisableMsg(RFC_Location_195_197);
   ILFaultInjectionDisableMsg(RFC_Location_198_200);
   ILFaultInjectionDisableMsg(RFC_Location_201_203);
   ILFaultInjectionDisableMsg(RFC_Location_204_206);
   ILFaultInjectionDisableMsg(RFC_Location_207_209);
   ILFaultInjectionDisableMsg(RFC_Location_210_212);
   ILFaultInjectionDisableMsg(RFC_Location_213_215);
   ILFaultInjectionDisableMsg(RFC_Location_216_218);
   ILFaultInjectionDisableMsg(RFC_Location_219_221);
   ILFaultInjectionDisableMsg(RFC_Location_222_224);
   ILFaultInjectionDisableMsg(RFC_Location_225_227);
   ILFaultInjectionDisableMsg(RFC_Location_228_230);
   ILFaultInjectionDisableMsg(RFC_Location_231_233);
   ILFaultInjectionDisableMsg(RFC_Location_234_236);
   ILFaultInjectionDisableMsg(RFC_Location_237_239);
   ILFaultInjectionDisableMsg(RFC_Location_240_242);
   ILFaultInjectionDisableMsg(RFC_Location_243_245);
   ILFaultInjectionDisableMsg(RFC_Location_246_248);
   ILFaultInjectionDisableMsg(RFC_Location_249_251);
   ILFaultInjectionDisableMsg(RFC_Location_252_254);

}

void FRadarLoc_sim_EnableEventMsg()
{
   ILFaultInjectionEnableMsg(RFC_LocationHdrA);
   ILFaultInjectionEnableMsg(RFC_LocationHdrB);
   ILFaultInjectionEnableMsg(RFC_Location_000_002);
   ILFaultInjectionEnableMsg(RFC_Location_003_005);
   ILFaultInjectionEnableMsg(RFC_Location_006_008);
   ILFaultInjectionEnableMsg(RFC_Location_009_011);
   ILFaultInjectionEnableMsg(RFC_Location_012_014);
   ILFaultInjectionEnableMsg(RFC_Location_015_017);
   ILFaultInjectionEnableMsg(RFC_Location_018_020);
   ILFaultInjectionEnableMsg(RFC_Location_021_023);
   ILFaultInjectionEnableMsg(RFC_Location_024_026);
   ILFaultInjectionEnableMsg(RFC_Location_027_029);
   ILFaultInjectionEnableMsg(RFC_Location_030_032);
   ILFaultInjectionEnableMsg(RFC_Location_033_035);
   ILFaultInjectionEnableMsg(RFC_Location_036_038);
   ILFaultInjectionEnableMsg(RFC_Location_039_041);
   ILFaultInjectionEnableMsg(RFC_Location_042_044);
   ILFaultInjectionEnableMsg(RFC_Location_045_047);
   ILFaultInjectionEnableMsg(RFC_Location_048_050);
   ILFaultInjectionEnableMsg(RFC_Location_051_053);
   ILFaultInjectionEnableMsg(RFC_Location_054_056);
   ILFaultInjectionEnableMsg(RFC_Location_057_059);
   ILFaultInjectionEnableMsg(RFC_Location_060_062);
   ILFaultInjectionEnableMsg(RFC_Location_063_065);
   ILFaultInjectionEnableMsg(RFC_Location_066_068);
   ILFaultInjectionEnableMsg(RFC_Location_069_071);
   ILFaultInjectionEnableMsg(RFC_Location_072_074);
   ILFaultInjectionEnableMsg(RFC_Location_075_077);
   ILFaultInjectionEnableMsg(RFC_Location_078_080);
   ILFaultInjectionEnableMsg(RFC_Location_081_083);
   ILFaultInjectionEnableMsg(RFC_Location_084_086);
   ILFaultInjectionEnableMsg(RFC_Location_087_089);
   ILFaultInjectionEnableMsg(RFC_Location_090_092);
   ILFaultInjectionEnableMsg(RFC_Location_093_095);
   ILFaultInjectionEnableMsg(RFC_Location_096_098);
   ILFaultInjectionEnableMsg(RFC_Location_099_101);
   ILFaultInjectionEnableMsg(RFC_Location_102_104);
   ILFaultInjectionEnableMsg(RFC_Location_105_107);
   ILFaultInjectionEnableMsg(RFC_Location_108_110);
   ILFaultInjectionEnableMsg(RFC_Location_111_113);
   ILFaultInjectionEnableMsg(RFC_Location_114_116);
   ILFaultInjectionEnableMsg(RFC_Location_117_119);
   ILFaultInjectionEnableMsg(RFC_Location_120_122);
   ILFaultInjectionEnableMsg(RFC_Location_123_125);
   ILFaultInjectionEnableMsg(RFC_Location_126_128);
   ILFaultInjectionEnableMsg(RFC_Location_129_131);
   ILFaultInjectionEnableMsg(RFC_Location_132_134);
   ILFaultInjectionEnableMsg(RFC_Location_135_137);
   ILFaultInjectionEnableMsg(RFC_Location_138_140);
   ILFaultInjectionEnableMsg(RFC_Location_141_143);
   ILFaultInjectionEnableMsg(RFC_Location_144_146);
   ILFaultInjectionEnableMsg(RFC_Location_147_149);
   ILFaultInjectionEnableMsg(RFC_Location_150_152);
   ILFaultInjectionEnableMsg(RFC_Location_153_155);
   ILFaultInjectionEnableMsg(RFC_Location_156_158);
   ILFaultInjectionEnableMsg(RFC_Location_159_161);
   ILFaultInjectionEnableMsg(RFC_Location_162_164);
   ILFaultInjectionEnableMsg(RFC_Location_165_167);
   ILFaultInjectionEnableMsg(RFC_Location_168_170);
   ILFaultInjectionEnableMsg(RFC_Location_171_173);
   ILFaultInjectionEnableMsg(RFC_Location_174_176);
   ILFaultInjectionEnableMsg(RFC_Location_177_179);
   ILFaultInjectionEnableMsg(RFC_Location_180_182);
   ILFaultInjectionEnableMsg(RFC_Location_183_185);
   ILFaultInjectionEnableMsg(RFC_Location_186_188);
   ILFaultInjectionEnableMsg(RFC_Location_189_191);
   ILFaultInjectionEnableMsg(RFC_Location_192_194);
   ILFaultInjectionEnableMsg(RFC_Location_195_197);
   ILFaultInjectionEnableMsg(RFC_Location_198_200);
   ILFaultInjectionEnableMsg(RFC_Location_201_203);
   ILFaultInjectionEnableMsg(RFC_Location_204_206);
   ILFaultInjectionEnableMsg(RFC_Location_207_209);
   ILFaultInjectionEnableMsg(RFC_Location_210_212);
   ILFaultInjectionEnableMsg(RFC_Location_213_215);
   ILFaultInjectionEnableMsg(RFC_Location_216_218);
   ILFaultInjectionEnableMsg(RFC_Location_219_221);
   ILFaultInjectionEnableMsg(RFC_Location_222_224);
   ILFaultInjectionEnableMsg(RFC_Location_225_227);
   ILFaultInjectionEnableMsg(RFC_Location_228_230);
   ILFaultInjectionEnableMsg(RFC_Location_231_233);
   ILFaultInjectionEnableMsg(RFC_Location_234_236);
   ILFaultInjectionEnableMsg(RFC_Location_237_239);
   ILFaultInjectionEnableMsg(RFC_Location_240_242);
   ILFaultInjectionEnableMsg(RFC_Location_243_245);
   ILFaultInjectionEnableMsg(RFC_Location_246_248);
   ILFaultInjectionEnableMsg(RFC_Location_249_251);
   ILFaultInjectionEnableMsg(RFC_Location_252_254);

}
void FRadarLoc_sim_SetCANParameter()
{
  //For future purpose
  //ILFaultInjectionSetMsgDlc(dbMsg msg, dword dlc)
  //ILFaultInjectionSetMsgLength(dbMsg msg, dword msgLength)
  //ILFaultInjectionResetMsgDlc(dbMsg msg)
  //ILFaultInjectionResetMsgLength (dbMsg msg)
}

void FRadarLoc_sim_SetCANFDParameter()
{
   //CAN FD Parameter Setting
   int FDF =1;
   int BRS =1;
   ILSetCANFDParam(RFC_LocationHdrA,FDF,BRS,RFC_LocationHdrA.dlc);
   ILSetCANFDParam(RFC_LocationHdrB,FDF,BRS,RFC_LocationHdrB.dlc);
   ILSetCANFDParam(RFC_Location_000_002,FDF,BRS,RFC_Location_000_002.dlc);
   ILSetCANFDParam(RFC_Location_003_005,FDF,BRS,RFC_Location_003_005.dlc);
   ILSetCANFDParam(RFC_Location_006_008,FDF,BRS,RFC_Location_006_008.dlc);
   ILSetCANFDParam(RFC_Location_009_011,FDF,BRS,RFC_Location_009_011.dlc);
   ILSetCANFDParam(RFC_Location_012_014,FDF,BRS,RFC_Location_012_014.dlc);
   ILSetCANFDParam(RFC_Location_015_017,FDF,BRS,RFC_Location_015_017.dlc);
   ILSetCANFDParam(RFC_Location_018_020,FDF,BRS,RFC_Location_018_020.dlc);
   ILSetCANFDParam(RFC_Location_021_023,FDF,BRS,RFC_Location_021_023.dlc);
   ILSetCANFDParam(RFC_Location_024_026,FDF,BRS,RFC_Location_024_026.dlc);
   ILSetCANFDParam(RFC_Location_027_029,FDF,BRS,RFC_Location_027_029.dlc);
   ILSetCANFDParam(RFC_Location_030_032,FDF,BRS,RFC_Location_030_032.dlc);
   ILSetCANFDParam(RFC_Location_033_035,FDF,BRS,RFC_Location_033_035.dlc);
   ILSetCANFDParam(RFC_Location_036_038,FDF,BRS,RFC_Location_036_038.dlc);
   ILSetCANFDParam(RFC_Location_039_041,FDF,BRS,RFC_Location_039_041.dlc);
   ILSetCANFDParam(RFC_Location_042_044,FDF,BRS,RFC_Location_042_044.dlc);
   ILSetCANFDParam(RFC_Location_045_047,FDF,BRS,RFC_Location_045_047.dlc);
   ILSetCANFDParam(RFC_Location_048_050,FDF,BRS,RFC_Location_048_050.dlc);
   ILSetCANFDParam(RFC_Location_051_053,FDF,BRS,RFC_Location_051_053.dlc);
   ILSetCANFDParam(RFC_Location_054_056,FDF,BRS,RFC_Location_054_056.dlc);
   ILSetCANFDParam(RFC_Location_057_059,FDF,BRS,RFC_Location_057_059.dlc);
   ILSetCANFDParam(RFC_Location_060_062,FDF,BRS,RFC_Location_060_062.dlc);
   ILSetCANFDParam(RFC_Location_063_065,FDF,BRS,RFC_Location_063_065.dlc);
   ILSetCANFDParam(RFC_Location_066_068,FDF,BRS,RFC_Location_066_068.dlc);
   ILSetCANFDParam(RFC_Location_069_071,FDF,BRS,RFC_Location_069_071.dlc);
   ILSetCANFDParam(RFC_Location_072_074,FDF,BRS,RFC_Location_072_074.dlc);
   ILSetCANFDParam(RFC_Location_075_077,FDF,BRS,RFC_Location_075_077.dlc);
   ILSetCANFDParam(RFC_Location_078_080,FDF,BRS,RFC_Location_078_080.dlc);
   ILSetCANFDParam(RFC_Location_081_083,FDF,BRS,RFC_Location_081_083.dlc);
   ILSetCANFDParam(RFC_Location_084_086,FDF,BRS,RFC_Location_084_086.dlc);
   ILSetCANFDParam(RFC_Location_087_089,FDF,BRS,RFC_Location_087_089.dlc);
   ILSetCANFDParam(RFC_Location_090_092,FDF,BRS,RFC_Location_090_092.dlc);
   ILSetCANFDParam(RFC_Location_093_095,FDF,BRS,RFC_Location_093_095.dlc);
   ILSetCANFDParam(RFC_Location_096_098,FDF,BRS,RFC_Location_096_098.dlc);
   ILSetCANFDParam(RFC_Location_099_101,FDF,BRS,RFC_Location_099_101.dlc);
   ILSetCANFDParam(RFC_Location_102_104,FDF,BRS,RFC_Location_102_104.dlc);
   ILSetCANFDParam(RFC_Location_105_107,FDF,BRS,RFC_Location_105_107.dlc);
   ILSetCANFDParam(RFC_Location_108_110,FDF,BRS,RFC_Location_108_110.dlc);
   ILSetCANFDParam(RFC_Location_111_113,FDF,BRS,RFC_Location_111_113.dlc);
   ILSetCANFDParam(RFC_Location_114_116,FDF,BRS,RFC_Location_114_116.dlc);
   ILSetCANFDParam(RFC_Location_117_119,FDF,BRS,RFC_Location_117_119.dlc);
   ILSetCANFDParam(RFC_Location_120_122,FDF,BRS,RFC_Location_120_122.dlc);
   ILSetCANFDParam(RFC_Location_123_125,FDF,BRS,RFC_Location_123_125.dlc);
   ILSetCANFDParam(RFC_Location_126_128,FDF,BRS,RFC_Location_126_128.dlc);
   ILSetCANFDParam(RFC_Location_129_131,FDF,BRS,RFC_Location_129_131.dlc);
   ILSetCANFDParam(RFC_Location_132_134,FDF,BRS,RFC_Location_132_134.dlc);
   ILSetCANFDParam(RFC_Location_135_137,FDF,BRS,RFC_Location_135_137.dlc);
   ILSetCANFDParam(RFC_Location_138_140,FDF,BRS,RFC_Location_138_140.dlc);
   ILSetCANFDParam(RFC_Location_141_143,FDF,BRS,RFC_Location_141_143.dlc);
   ILSetCANFDParam(RFC_Location_144_146,FDF,BRS,RFC_Location_144_146.dlc);
   ILSetCANFDParam(RFC_Location_147_149,FDF,BRS,RFC_Location_147_149.dlc);
   ILSetCANFDParam(RFC_Location_150_152,FDF,BRS,RFC_Location_150_152.dlc);
   ILSetCANFDParam(RFC_Location_153_155,FDF,BRS,RFC_Location_153_155.dlc);
   ILSetCANFDParam(RFC_Location_156_158,FDF,BRS,RFC_Location_156_158.dlc);
   ILSetCANFDParam(RFC_Location_159_161,FDF,BRS,RFC_Location_159_161.dlc);
   ILSetCANFDParam(RFC_Location_162_164,FDF,BRS,RFC_Location_162_164.dlc);
   ILSetCANFDParam(RFC_Location_165_167,FDF,BRS,RFC_Location_165_167.dlc);
   ILSetCANFDParam(RFC_Location_168_170,FDF,BRS,RFC_Location_168_170.dlc);
   ILSetCANFDParam(RFC_Location_171_173,FDF,BRS,RFC_Location_171_173.dlc);
   ILSetCANFDParam(RFC_Location_174_176,FDF,BRS,RFC_Location_174_176.dlc);
   ILSetCANFDParam(RFC_Location_177_179,FDF,BRS,RFC_Location_177_179.dlc);
   ILSetCANFDParam(RFC_Location_180_182,FDF,BRS,RFC_Location_180_182.dlc);
   ILSetCANFDParam(RFC_Location_183_185,FDF,BRS,RFC_Location_183_185.dlc);
   ILSetCANFDParam(RFC_Location_186_188,FDF,BRS,RFC_Location_186_188.dlc);
   ILSetCANFDParam(RFC_Location_189_191,FDF,BRS,RFC_Location_189_191.dlc);
   ILSetCANFDParam(RFC_Location_192_194,FDF,BRS,RFC_Location_192_194.dlc);
   ILSetCANFDParam(RFC_Location_195_197,FDF,BRS,RFC_Location_195_197.dlc);
   ILSetCANFDParam(RFC_Location_198_200,FDF,BRS,RFC_Location_198_200.dlc);
   ILSetCANFDParam(RFC_Location_201_203,FDF,BRS,RFC_Location_201_203.dlc);
   ILSetCANFDParam(RFC_Location_204_206,FDF,BRS,RFC_Location_204_206.dlc);
   ILSetCANFDParam(RFC_Location_207_209,FDF,BRS,RFC_Location_207_209.dlc);
   ILSetCANFDParam(RFC_Location_210_212,FDF,BRS,RFC_Location_210_212.dlc);
   ILSetCANFDParam(RFC_Location_213_215,FDF,BRS,RFC_Location_213_215.dlc);
   ILSetCANFDParam(RFC_Location_216_218,FDF,BRS,RFC_Location_216_218.dlc);
   ILSetCANFDParam(RFC_Location_219_221,FDF,BRS,RFC_Location_219_221.dlc);
   ILSetCANFDParam(RFC_Location_222_224,FDF,BRS,RFC_Location_222_224.dlc);
   ILSetCANFDParam(RFC_Location_225_227,FDF,BRS,RFC_Location_225_227.dlc);
   ILSetCANFDParam(RFC_Location_228_230,FDF,BRS,RFC_Location_228_230.dlc);
   ILSetCANFDParam(RFC_Location_231_233,FDF,BRS,RFC_Location_231_233.dlc);
   ILSetCANFDParam(RFC_Location_234_236,FDF,BRS,RFC_Location_234_236.dlc);
   ILSetCANFDParam(RFC_Location_237_239,FDF,BRS,RFC_Location_237_239.dlc);
   ILSetCANFDParam(RFC_Location_240_242,FDF,BRS,RFC_Location_240_242.dlc);
   ILSetCANFDParam(RFC_Location_243_245,FDF,BRS,RFC_Location_243_245.dlc);
   ILSetCANFDParam(RFC_Location_246_248,FDF,BRS,RFC_Location_246_248.dlc);
   ILSetCANFDParam(RFC_Location_249_251,FDF,BRS,RFC_Location_249_251.dlc);
   ILSetCANFDParam(RFC_Location_252_254,FDF,BRS,RFC_Location_252_254.dlc);
   ILSetCANFDParam(RFC_Status,FDF,BRS,RFC_Status.dlc);
}

dword applILTxPending (long aId, dword aDlc, byte data[])//This callback is being called before the IL sends a message to the bus
{
  switch(aId)
  {
    case RFC_LocationHdrA.id:cfg_Msg_RFC_LocationHdrA(aDlc, data);break;
    case RFC_LocationHdrB.id:cfg_Msg_RFC_LocationHdrB(aDlc, data);break;
    case RFC_Location_000_002.id:cfg_Msg_RFC_Location_000_002(aDlc, data);break;
    case RFC_Location_003_005.id:cfg_Msg_RFC_Location_003_005(aDlc, data);break;
    case RFC_Location_006_008.id:cfg_Msg_RFC_Location_006_008(aDlc, data);break;
    case RFC_Location_009_011.id:cfg_Msg_RFC_Location_009_011(aDlc, data);break;
    case RFC_Location_012_014.id:cfg_Msg_RFC_Location_012_014(aDlc, data);break;
    case RFC_Location_015_017.id:cfg_Msg_RFC_Location_015_017(aDlc, data);break;
    case RFC_Location_018_020.id:cfg_Msg_RFC_Location_018_020(aDlc, data);break;
    case RFC_Location_021_023.id:cfg_Msg_RFC_Location_021_023(aDlc, data);break;
    case RFC_Location_024_026.id:cfg_Msg_RFC_Location_024_026(aDlc, data);break;
    case RFC_Location_027_029.id:cfg_Msg_RFC_Location_027_029(aDlc, data);break;
    case RFC_Location_030_032.id:cfg_Msg_RFC_Location_030_032(aDlc, data);break;
    case RFC_Location_033_035.id:cfg_Msg_RFC_Location_033_035(aDlc, data);break;
    case RFC_Location_036_038.id:cfg_Msg_RFC_Location_036_038(aDlc, data);break;
    case RFC_Location_039_041.id:cfg_Msg_RFC_Location_039_041(aDlc, data);break;
    case RFC_Location_042_044.id:cfg_Msg_RFC_Location_042_044(aDlc, data);break;
    case RFC_Location_045_047.id:cfg_Msg_RFC_Location_045_047(aDlc, data);break;
    case RFC_Location_048_050.id:cfg_Msg_RFC_Location_048_050(aDlc, data);break;
    case RFC_Location_051_053.id:cfg_Msg_RFC_Location_051_053(aDlc, data);break;
    case RFC_Location_054_056.id:cfg_Msg_RFC_Location_054_056(aDlc, data);break;
    case RFC_Location_057_059.id:cfg_Msg_RFC_Location_057_059(aDlc, data);break;
    case RFC_Location_060_062.id:cfg_Msg_RFC_Location_060_062(aDlc, data);break;
    case RFC_Location_063_065.id:cfg_Msg_RFC_Location_063_065(aDlc, data);break;
    case RFC_Location_066_068.id:cfg_Msg_RFC_Location_066_068(aDlc, data);break;
    case RFC_Location_069_071.id:cfg_Msg_RFC_Location_069_071(aDlc, data);break;
    case RFC_Location_072_074.id:cfg_Msg_RFC_Location_072_074(aDlc, data);break;
    case RFC_Location_075_077.id:cfg_Msg_RFC_Location_075_077(aDlc, data);break;
    case RFC_Location_078_080.id:cfg_Msg_RFC_Location_078_080(aDlc, data);break;
    case RFC_Location_081_083.id:cfg_Msg_RFC_Location_081_083(aDlc, data);break;
    case RFC_Location_084_086.id:cfg_Msg_RFC_Location_084_086(aDlc, data);break;
    case RFC_Location_087_089.id:cfg_Msg_RFC_Location_087_089(aDlc, data);break;
    case RFC_Location_090_092.id:cfg_Msg_RFC_Location_090_092(aDlc, data);break;
    case RFC_Location_093_095.id:cfg_Msg_RFC_Location_093_095(aDlc, data);break;
    case RFC_Location_096_098.id:cfg_Msg_RFC_Location_096_098(aDlc, data);break;
    case RFC_Location_099_101.id:cfg_Msg_RFC_Location_099_101(aDlc, data);break;
    case RFC_Location_102_104.id:cfg_Msg_RFC_Location_102_104(aDlc, data);break;
    case RFC_Location_105_107.id:cfg_Msg_RFC_Location_105_107(aDlc, data);break;
    case RFC_Location_108_110.id:cfg_Msg_RFC_Location_108_110(aDlc, data);break;
    case RFC_Location_111_113.id:cfg_Msg_RFC_Location_111_113(aDlc, data);break;
    case RFC_Location_114_116.id:cfg_Msg_RFC_Location_114_116(aDlc, data);break;
    case RFC_Location_117_119.id:cfg_Msg_RFC_Location_117_119(aDlc, data);break;
    case RFC_Location_120_122.id:cfg_Msg_RFC_Location_120_122(aDlc, data);break;
    case RFC_Location_123_125.id:cfg_Msg_RFC_Location_123_125(aDlc, data);break;
    case RFC_Location_126_128.id:cfg_Msg_RFC_Location_126_128(aDlc, data);break;
    case RFC_Location_129_131.id:cfg_Msg_RFC_Location_129_131(aDlc, data);break;
    case RFC_Location_132_134.id:cfg_Msg_RFC_Location_132_134(aDlc, data);break;
    case RFC_Location_135_137.id:cfg_Msg_RFC_Location_135_137(aDlc, data);break;
    case RFC_Location_138_140.id:cfg_Msg_RFC_Location_138_140(aDlc, data);break;
    case RFC_Location_141_143.id:cfg_Msg_RFC_Location_141_143(aDlc, data);break;
    case RFC_Location_144_146.id:cfg_Msg_RFC_Location_144_146(aDlc, data);break;
    case RFC_Location_147_149.id:cfg_Msg_RFC_Location_147_149(aDlc, data);break;
    case RFC_Location_150_152.id:cfg_Msg_RFC_Location_150_152(aDlc, data);break;
    case RFC_Location_153_155.id:cfg_Msg_RFC_Location_153_155(aDlc, data);break;
    case RFC_Location_156_158.id:cfg_Msg_RFC_Location_156_158(aDlc, data);break;
    case RFC_Location_159_161.id:cfg_Msg_RFC_Location_159_161(aDlc, data);break;
    case RFC_Location_162_164.id:cfg_Msg_RFC_Location_162_164(aDlc, data);break;
    case RFC_Location_165_167.id:cfg_Msg_RFC_Location_165_167(aDlc, data);break;
    case RFC_Location_168_170.id:cfg_Msg_RFC_Location_168_170(aDlc, data);break;
    case RFC_Location_171_173.id:cfg_Msg_RFC_Location_171_173(aDlc, data);break;
    case RFC_Location_174_176.id:cfg_Msg_RFC_Location_174_176(aDlc, data);break;
    case RFC_Location_177_179.id:cfg_Msg_RFC_Location_177_179(aDlc, data);break;
    case RFC_Location_180_182.id:cfg_Msg_RFC_Location_180_182(aDlc, data);break;
    case RFC_Location_183_185.id:cfg_Msg_RFC_Location_183_185(aDlc, data);break;
    case RFC_Location_186_188.id:cfg_Msg_RFC_Location_186_188(aDlc, data);break;
    case RFC_Location_189_191.id:cfg_Msg_RFC_Location_189_191(aDlc, data);break;
    case RFC_Location_192_194.id:cfg_Msg_RFC_Location_192_194(aDlc, data);break;
    case RFC_Location_195_197.id:cfg_Msg_RFC_Location_195_197(aDlc, data);break;
    case RFC_Location_198_200.id:cfg_Msg_RFC_Location_198_200(aDlc, data);break;
    case RFC_Location_201_203.id:cfg_Msg_RFC_Location_201_203(aDlc, data);break;
    case RFC_Location_204_206.id:cfg_Msg_RFC_Location_204_206(aDlc, data);break;
    case RFC_Location_207_209.id:cfg_Msg_RFC_Location_207_209(aDlc, data);break;
    case RFC_Location_210_212.id:cfg_Msg_RFC_Location_210_212(aDlc, data);break;
    case RFC_Location_213_215.id:cfg_Msg_RFC_Location_213_215(aDlc, data);break;
    case RFC_Location_216_218.id:cfg_Msg_RFC_Location_216_218(aDlc, data);break;
    case RFC_Location_219_221.id:cfg_Msg_RFC_Location_219_221(aDlc, data);break;
    case RFC_Location_222_224.id:cfg_Msg_RFC_Location_222_224(aDlc, data);break;
    case RFC_Location_225_227.id:cfg_Msg_RFC_Location_225_227(aDlc, data);break;
    case RFC_Location_228_230.id:cfg_Msg_RFC_Location_228_230(aDlc, data);break;
    case RFC_Location_231_233.id:cfg_Msg_RFC_Location_231_233(aDlc, data);break;
    case RFC_Location_234_236.id:cfg_Msg_RFC_Location_234_236(aDlc, data);break;
    case RFC_Location_237_239.id:cfg_Msg_RFC_Location_237_239(aDlc, data);break;
    case RFC_Location_240_242.id:cfg_Msg_RFC_Location_240_242(aDlc, data);break;
    case RFC_Location_243_245.id:cfg_Msg_RFC_Location_243_245(aDlc, data);break;
    case RFC_Location_246_248.id:cfg_Msg_RFC_Location_246_248(aDlc, data);break;
    case RFC_Location_249_251.id:cfg_Msg_RFC_Location_249_251(aDlc, data);break;
    case RFC_Location_252_254.id:cfg_Msg_RFC_Location_252_254(aDlc, data);break;
    case RFC_Status.id:cfg_Msg_RFC_Status(aDlc, data);break;
    default :;//write("Node:FRadarLoc ::No Cyclic event");
           break;
  }
  return 1; // don't prevent sending of the message
}

on sysvar CAN_PrivMain::RFC_LocationHdrA::RFC_LocationHdrA_ON_OFF
{
  if (@this == 1)
  {
     ILSetMsgEvent(RFC_LocationHdrA);
     @CAN_PrivMain::RFC_LocationHdrA::RFC_LocationHdrA_ON_OFF = 0;
  }
}

void cfg_Msg_RFC_LocationHdrA(dword aDlc, byte data[])
{
   int64 i,k;//For looping
   byte xor,data_byte;
   dword crcTemp;
   byte DataLength;
   dword Msg_id;
   
   DataLength = Msg_RFC_LocationHdrA.DataLength;//Message Data Length
   Msg_id  = Msg_RFC_LocationHdrA.id;//Message ID
   
    if (@CAN_PrivMain::RFC_LocationHdrA::RFC_LocHdrA_AliveCtr_FaultInject != 3)//AC: user defined value
    {

    clearBitsInByteArrayLE(data,16,8); //Intel / little-endian

    }
    if (@CAN_PrivMain::RFC_LocationHdrA::RFC_LocHdrA_AliveCtr_FaultInject == 0)//AC: No Error, calculate AC
    {
      ++counter_RFC_LocationHdrA_RFC_LocHdrA_AliveCtr;
      counter_RFC_LocationHdrA_RFC_LocHdrA_AliveCtr %=256;

      copyBitsToByteArrayLE(counter_RFC_LocationHdrA_RFC_LocHdrA_AliveCtr,data,16,8); //Intel / little-endian;
    }
    else if (@CAN_PrivMain::RFC_LocationHdrA::RFC_LocHdrA_AliveCtr_FaultInject == 1)//AC: Error sequence: set AC = 0
    {

      copyBitsToByteArrayLE(0,data,16,8); //Intel / little-endian;
    }
    else if (@CAN_PrivMain::RFC_LocationHdrA::RFC_LocHdrA_AliveCtr_FaultInject == 2)//AC: Error sequence: Freeze last valid value
    {

      copyBitsToByteArrayLE(counter_RFC_LocationHdrA_RFC_LocHdrA_AliveCtr,data,16,8); //Intel / little-endian;
    }
    if (@CAN_PrivMain::RFC_LocationHdrA::RFC_LocHdrA_ProtBlockCtr_FaultInject != 3)//BC: user defined value
    {

    clearBitsInByteArrayLE(data,24,4); //Intel / little-endian

    }
    if (@CAN_PrivMain::RFC_LocationHdrA::RFC_LocHdrA_ProtBlockCtr_FaultInject == 0)//BC: No Error, calculate BC
    {
      ++bc_RFC_LocationHdrA_RFC_LocHdrA_ProtBlockCtr;
      bc_RFC_LocationHdrA_RFC_LocHdrA_ProtBlockCtr %=256;
      bc_RFC_Location_ProtBlockCtr = bc_RFC_LocationHdrA_RFC_LocHdrA_ProtBlockCtr ;

      copyBitsToByteArrayLE(bc_RFC_LocationHdrA_RFC_LocHdrA_ProtBlockCtr,data,24,4); //Intel / little-endian;
    }
    else if (@CAN_PrivMain::RFC_LocationHdrA::RFC_LocHdrA_ProtBlockCtr_FaultInject == 1)//BC: Error sequence: set BC = 0
    {

      copyBitsToByteArrayLE(0,data,24,4); //Intel / little-endian;
    }
    else if (@CAN_PrivMain::RFC_LocationHdrA::RFC_LocHdrA_ProtBlockCtr_FaultInject == 2)//BC: Error sequence: Freeze last valid value
    {

      copyBitsToByteArrayLE(bc_RFC_LocationHdrA_RFC_LocHdrA_ProtBlockCtr,data,24,4); //Intel / little-endian;
    }

    clearBitsInByteArrayLE(data,64,26); //Intel / little-endian

    //Msg_RFC_LocationHdrA.RFC_LocHdr_TimeStamp = @CAN_PrivMain::RFC_LocationHdrA::RFC_LocHdr_TimeStamp_FaultInject +(timeNowNS()/1000000);

      copyBitsToByteArrayLE(@CAN_PrivMain::RFC_LocationHdrA::RFC_LocHdr_TimeStamp_FaultInject +(timeNowNS()/1000000),data,64,26); //Intel / little-endian;
    if (@CAN_PrivMain::RFC_LocationHdrA::RFC_LocHdrA_CRC_FaultInject != 3)//CRC: user defined value
    {

    clearBitsInByteArrayLE(data,0,16); //Intel / little-endian

    }
    if(@CAN_PrivMain::RFC_LocationHdrA::RFC_LocHdrA_CRC_FaultInject == 0)//CRC: No Error, calculate CRC
    {
      crcTemp = CRC16_INIT;
      for(i = 2; i < (DataLength+2); i++)
      {
        if(i < DataLength)
          data_byte = data[i] ;
        else if(i == DataLength)
          data_byte = (0x2104 & 0x00FF);
        else if(i == (DataLength+1))
          data_byte = (0x2104 & 0xFF00) >> 8;
        else
          write("Error: DLC exceeded in CRC calculation");
        crcTemp ^= data_byte << 8;
        crcTemp = (crcTemp << (8)) ^ CRC16_CCITT_FALSE_POLY_1021H_Lookup[(crcTemp >> (8)) & (0xFF)];
      }
      crcTemp ^= CRC16_XOR;
      crc_RFC_LocationHdrA_RFC_LocHdrA_CRC = crcTemp;

      copyBitsToByteArrayLE(crc_RFC_LocationHdrA_RFC_LocHdrA_CRC,data,0,16); //Intel / little-endian;
    }
    else if(@CAN_PrivMain::RFC_LocationHdrA::RFC_LocHdrA_CRC_FaultInject == 1)//CRC: Error, set to Zero
    {

      copyBitsToByteArrayLE(0,data,0,16); //Intel / little-endian;
    }
    else if(@CAN_PrivMain::RFC_LocationHdrA::RFC_LocHdrA_CRC_FaultInject == 2)//CRC: Error, Freeze last valid value
    {

      copyBitsToByteArrayLE(crc_RFC_LocationHdrA_RFC_LocHdrA_CRC,data,0,16); //Intel / little-endian;
    }
}


on sysvar CAN_PrivMain::RFC_LocationHdrB::RFC_LocationHdrB_ON_OFF
{
  if (@this == 1)
  {
     ILSetMsgEvent(RFC_LocationHdrB);
     @CAN_PrivMain::RFC_LocationHdrB::RFC_LocationHdrB_ON_OFF = 0;
  }
}

void cfg_Msg_RFC_LocationHdrB(dword aDlc, byte data[])
{
   int64 i,k;//For looping
   byte xor,data_byte;
   dword crcTemp;
   byte DataLength;
   dword Msg_id;
   
   DataLength = Msg_RFC_LocationHdrB.DataLength;//Message Data Length
   Msg_id  = Msg_RFC_LocationHdrB.id;//Message ID
   
    if (@CAN_PrivMain::RFC_LocationHdrB::RFC_LocHdrB_AliveCtr_FaultInject != 3)//AC: user defined value
    {

    clearBitsInByteArrayLE(data,16,8); //Intel / little-endian

    }
    if (@CAN_PrivMain::RFC_LocationHdrB::RFC_LocHdrB_AliveCtr_FaultInject == 0)//AC: No Error, calculate AC
    {
      ++counter_RFC_LocationHdrB_RFC_LocHdrB_AliveCtr;
      counter_RFC_LocationHdrB_RFC_LocHdrB_AliveCtr %=256;

      copyBitsToByteArrayLE(counter_RFC_LocationHdrB_RFC_LocHdrB_AliveCtr,data,16,8); //Intel / little-endian;
    }
    else if (@CAN_PrivMain::RFC_LocationHdrB::RFC_LocHdrB_AliveCtr_FaultInject == 1)//AC: Error sequence: set AC = 0
    {

      copyBitsToByteArrayLE(0,data,16,8); //Intel / little-endian;
    }
    else if (@CAN_PrivMain::RFC_LocationHdrB::RFC_LocHdrB_AliveCtr_FaultInject == 2)//AC: Error sequence: Freeze last valid value
    {

      copyBitsToByteArrayLE(counter_RFC_LocationHdrB_RFC_LocHdrB_AliveCtr,data,16,8); //Intel / little-endian;
    }
    if (@CAN_PrivMain::RFC_LocationHdrB::RFC_LocHdrB_ProtBlockCtr_FaultInject != 3)//BC: user defined value
    {

    clearBitsInByteArrayLE(data,24,4); //Intel / little-endian

    }
    if (@CAN_PrivMain::RFC_LocationHdrB::RFC_LocHdrB_ProtBlockCtr_FaultInject == 0)//BC: No Error, calculate BC
    {
      bc_RFC_LocationHdrB_RFC_LocHdrB_ProtBlockCtr = bc_RFC_Location_ProtBlockCtr ;

      copyBitsToByteArrayLE(bc_RFC_LocationHdrB_RFC_LocHdrB_ProtBlockCtr,data,24,4); //Intel / little-endian;
    }
    else if (@CAN_PrivMain::RFC_LocationHdrB::RFC_LocHdrB_ProtBlockCtr_FaultInject == 1)//BC: Error sequence: set BC = 0
    {

      copyBitsToByteArrayLE(0,data,24,4); //Intel / little-endian;
    }
    else if (@CAN_PrivMain::RFC_LocationHdrB::RFC_LocHdrB_ProtBlockCtr_FaultInject == 2)//BC: Error sequence: Freeze last valid value
    {

      copyBitsToByteArrayLE(bc_RFC_LocationHdrB_RFC_LocHdrB_ProtBlockCtr,data,24,4); //Intel / little-endian;
    }
    if (@CAN_PrivMain::RFC_LocationHdrB::RFC_LocHdrB_CRC_FaultInject != 3)//CRC: user defined value
    {

    clearBitsInByteArrayLE(data,0,16); //Intel / little-endian

    }
    if(@CAN_PrivMain::RFC_LocationHdrB::RFC_LocHdrB_CRC_FaultInject == 0)//CRC: No Error, calculate CRC
    {
      crcTemp = CRC16_INIT;
      for(i = 2; i < (DataLength+2); i++)
      {
        if(i < DataLength)
          data_byte = data[i] ;
        else if(i == DataLength)
          data_byte = (0x2105 & 0x00FF);
        else if(i == (DataLength+1))
          data_byte = (0x2105 & 0xFF00) >> 8;
        else
          write("Error: DLC exceeded in CRC calculation");
        crcTemp ^= data_byte << 8;
        crcTemp = (crcTemp << (8)) ^ CRC16_CCITT_FALSE_POLY_1021H_Lookup[(crcTemp >> (8)) & (0xFF)];
      }
      crcTemp ^= CRC16_XOR;
      crc_RFC_LocationHdrB_RFC_LocHdrB_CRC = crcTemp;

      copyBitsToByteArrayLE(crc_RFC_LocationHdrB_RFC_LocHdrB_CRC,data,0,16); //Intel / little-endian;
    }
    else if(@CAN_PrivMain::RFC_LocationHdrB::RFC_LocHdrB_CRC_FaultInject == 1)//CRC: Error, set to Zero
    {

      copyBitsToByteArrayLE(0,data,0,16); //Intel / little-endian;
    }
    else if(@CAN_PrivMain::RFC_LocationHdrB::RFC_LocHdrB_CRC_FaultInject == 2)//CRC: Error, Freeze last valid value
    {

      copyBitsToByteArrayLE(crc_RFC_LocationHdrB_RFC_LocHdrB_CRC,data,0,16); //Intel / little-endian;
    }
}


on sysvar CAN_PrivMain::RFC_Location_000_002::RFC_Location_000_002_ON_OFF
{
  if (@this == 1)
  {
     ILSetMsgEvent(RFC_Location_000_002);
     @CAN_PrivMain::RFC_Location_000_002::RFC_Location_000_002_ON_OFF = 0;
  }
}

void cfg_Msg_RFC_Location_000_002(dword aDlc, byte data[])
{
   int64 i,k;//For looping
   byte xor,data_byte;
   dword crcTemp;
   byte DataLength;
   dword Msg_id;
   
   DataLength = Msg_RFC_Location_000_002.DataLength;//Message Data Length
   Msg_id  = Msg_RFC_Location_000_002.id;//Message ID
   
    if (@CAN_PrivMain::RFC_Location_000_002::RFC_Loc000_002_AliveCtr_FaultInject != 3)//AC: user defined value
    {

    clearBitsInByteArrayLE(data,16,8); //Intel / little-endian

    }
    if (@CAN_PrivMain::RFC_Location_000_002::RFC_Loc000_002_AliveCtr_FaultInject == 0)//AC: No Error, calculate AC
    {
      ++counter_RFC_Location_000_002_RFC_Loc000_002_AliveCtr;
      counter_RFC_Location_000_002_RFC_Loc000_002_AliveCtr %=256;

      copyBitsToByteArrayLE(counter_RFC_Location_000_002_RFC_Loc000_002_AliveCtr,data,16,8); //Intel / little-endian;
    }
    else if (@CAN_PrivMain::RFC_Location_000_002::RFC_Loc000_002_AliveCtr_FaultInject == 1)//AC: Error sequence: set AC = 0
    {

      copyBitsToByteArrayLE(0,data,16,8); //Intel / little-endian;
    }
    else if (@CAN_PrivMain::RFC_Location_000_002::RFC_Loc000_002_AliveCtr_FaultInject == 2)//AC: Error sequence: Freeze last valid value
    {

      copyBitsToByteArrayLE(counter_RFC_Location_000_002_RFC_Loc000_002_AliveCtr,data,16,8); //Intel / little-endian;
    }
    if (@CAN_PrivMain::RFC_Location_000_002::RFC_Loc000_002_ProtBlockCtr_FaultInject != 3)//BC: user defined value
    {

    clearBitsInByteArrayLE(data,24,4); //Intel / little-endian

    }
    if (@CAN_PrivMain::RFC_Location_000_002::RFC_Loc000_002_ProtBlockCtr_FaultInject == 0)//BC: No Error, calculate BC
    {
      bc_RFC_Location_000_002_RFC_Loc000_002_ProtBlockCtr = bc_RFC_Location_ProtBlockCtr ;

      copyBitsToByteArrayLE(bc_RFC_Location_000_002_RFC_Loc000_002_ProtBlockCtr,data,24,4); //Intel / little-endian;
    }
    else if (@CAN_PrivMain::RFC_Location_000_002::RFC_Loc000_002_ProtBlockCtr_FaultInject == 1)//BC: Error sequence: set BC = 0
    {

      copyBitsToByteArrayLE(0,data,24,4); //Intel / little-endian;
    }
    else if (@CAN_PrivMain::RFC_Location_000_002::RFC_Loc000_002_ProtBlockCtr_FaultInject == 2)//BC: Error sequence: Freeze last valid value
    {

      copyBitsToByteArrayLE(bc_RFC_Location_000_002_RFC_Loc000_002_ProtBlockCtr,data,24,4); //Intel / little-endian;
    }
    if (@CAN_PrivMain::RFC_Location_000_002::RFC_Loc000_002_CRC_FaultInject != 3)//CRC: user defined value
    {

    clearBitsInByteArrayLE(data,0,16); //Intel / little-endian

    }
    if(@CAN_PrivMain::RFC_Location_000_002::RFC_Loc000_002_CRC_FaultInject == 0)//CRC: No Error, calculate CRC
    {
      crcTemp = CRC16_INIT;
      for(i = 2; i < (DataLength+2); i++)
      {
        if(i < DataLength)
          data_byte = data[i] ;
        else if(i == DataLength)
          data_byte = (0x2108 & 0x00FF);
        else if(i == (DataLength+1))
          data_byte = (0x2108 & 0xFF00) >> 8;
        else
          write("Error: DLC exceeded in CRC calculation");
        crcTemp ^= data_byte << 8;
        crcTemp = (crcTemp << (8)) ^ CRC16_CCITT_FALSE_POLY_1021H_Lookup[(crcTemp >> (8)) & (0xFF)];
      }
      crcTemp ^= CRC16_XOR;
      crc_RFC_Location_000_002_RFC_Loc000_002_CRC = crcTemp;

      copyBitsToByteArrayLE(crc_RFC_Location_000_002_RFC_Loc000_002_CRC,data,0,16); //Intel / little-endian;
    }
    else if(@CAN_PrivMain::RFC_Location_000_002::RFC_Loc000_002_CRC_FaultInject == 1)//CRC: Error, set to Zero
    {

      copyBitsToByteArrayLE(0,data,0,16); //Intel / little-endian;
    }
    else if(@CAN_PrivMain::RFC_Location_000_002::RFC_Loc000_002_CRC_FaultInject == 2)//CRC: Error, Freeze last valid value
    {

      copyBitsToByteArrayLE(crc_RFC_Location_000_002_RFC_Loc000_002_CRC,data,0,16); //Intel / little-endian;
    }
}


on sysvar CAN_PrivMain::RFC_Location_003_005::RFC_Location_003_005_ON_OFF
{
  if (@this == 1)
  {
     ILSetMsgEvent(RFC_Location_003_005);
     @CAN_PrivMain::RFC_Location_003_005::RFC_Location_003_005_ON_OFF = 0;
  }
}

void cfg_Msg_RFC_Location_003_005(dword aDlc, byte data[])
{
   int64 i,k;//For looping
   byte xor,data_byte;
   dword crcTemp;
   byte DataLength;
   dword Msg_id;
   
   DataLength = Msg_RFC_Location_003_005.DataLength;//Message Data Length
   Msg_id  = Msg_RFC_Location_003_005.id;//Message ID
   
    if (@CAN_PrivMain::RFC_Location_003_005::RFC_Loc003_005_AliveCtr_FaultInject != 3)//AC: user defined value
    {

    clearBitsInByteArrayLE(data,16,8); //Intel / little-endian

    }
    if (@CAN_PrivMain::RFC_Location_003_005::RFC_Loc003_005_AliveCtr_FaultInject == 0)//AC: No Error, calculate AC
    {
      ++counter_RFC_Location_003_005_RFC_Loc003_005_AliveCtr;
      counter_RFC_Location_003_005_RFC_Loc003_005_AliveCtr %=256;

      copyBitsToByteArrayLE(counter_RFC_Location_003_005_RFC_Loc003_005_AliveCtr,data,16,8); //Intel / little-endian;
    }
    else if (@CAN_PrivMain::RFC_Location_003_005::RFC_Loc003_005_AliveCtr_FaultInject == 1)//AC: Error sequence: set AC = 0
    {

      copyBitsToByteArrayLE(0,data,16,8); //Intel / little-endian;
    }
    else if (@CAN_PrivMain::RFC_Location_003_005::RFC_Loc003_005_AliveCtr_FaultInject == 2)//AC: Error sequence: Freeze last valid value
    {

      copyBitsToByteArrayLE(counter_RFC_Location_003_005_RFC_Loc003_005_AliveCtr,data,16,8); //Intel / little-endian;
    }
    if (@CAN_PrivMain::RFC_Location_003_005::RFC_Loc003_005_ProtBlockCtr_FaultInject != 3)//BC: user defined value
    {

    clearBitsInByteArrayLE(data,24,4); //Intel / little-endian

    }
    if (@CAN_PrivMain::RFC_Location_003_005::RFC_Loc003_005_ProtBlockCtr_FaultInject == 0)//BC: No Error, calculate BC
    {
      bc_RFC_Location_003_005_RFC_Loc003_005_ProtBlockCtr = bc_RFC_Location_ProtBlockCtr ;

      copyBitsToByteArrayLE(bc_RFC_Location_003_005_RFC_Loc003_005_ProtBlockCtr,data,24,4); //Intel / little-endian;
    }
    else if (@CAN_PrivMain::RFC_Location_003_005::RFC_Loc003_005_ProtBlockCtr_FaultInject == 1)//BC: Error sequence: set BC = 0
    {

      copyBitsToByteArrayLE(0,data,24,4); //Intel / little-endian;
    }
    else if (@CAN_PrivMain::RFC_Location_003_005::RFC_Loc003_005_ProtBlockCtr_FaultInject == 2)//BC: Error sequence: Freeze last valid value
    {

      copyBitsToByteArrayLE(bc_RFC_Location_003_005_RFC_Loc003_005_ProtBlockCtr,data,24,4); //Intel / little-endian;
    }
    if (@CAN_PrivMain::RFC_Location_003_005::RFC_Loc003_005_CRC_FaultInject != 3)//CRC: user defined value
    {

    clearBitsInByteArrayLE(data,0,16); //Intel / little-endian

    }
    if(@CAN_PrivMain::RFC_Location_003_005::RFC_Loc003_005_CRC_FaultInject == 0)//CRC: No Error, calculate CRC
    {
      crcTemp = CRC16_INIT;
      for(i = 2; i < (DataLength+2); i++)
      {
        if(i < DataLength)
          data_byte = data[i] ;
        else if(i == DataLength)
          data_byte = (0x2109 & 0x00FF);
        else if(i == (DataLength+1))
          data_byte = (0x2109 & 0xFF00) >> 8;
        else
          write("Error: DLC exceeded in CRC calculation");
        crcTemp ^= data_byte << 8;
        crcTemp = (crcTemp << (8)) ^ CRC16_CCITT_FALSE_POLY_1021H_Lookup[(crcTemp >> (8)) & (0xFF)];
      }
      crcTemp ^= CRC16_XOR;
      crc_RFC_Location_003_005_RFC_Loc003_005_CRC = crcTemp;

      copyBitsToByteArrayLE(crc_RFC_Location_003_005_RFC_Loc003_005_CRC,data,0,16); //Intel / little-endian;
    }
    else if(@CAN_PrivMain::RFC_Location_003_005::RFC_Loc003_005_CRC_FaultInject == 1)//CRC: Error, set to Zero
    {

      copyBitsToByteArrayLE(0,data,0,16); //Intel / little-endian;
    }
    else if(@CAN_PrivMain::RFC_Location_003_005::RFC_Loc003_005_CRC_FaultInject == 2)//CRC: Error, Freeze last valid value
    {

      copyBitsToByteArrayLE(crc_RFC_Location_003_005_RFC_Loc003_005_CRC,data,0,16); //Intel / little-endian;
    }
}


on sysvar CAN_PrivMain::RFC_Location_006_008::RFC_Location_006_008_ON_OFF
{
  if (@this == 1)
  {
     ILSetMsgEvent(RFC_Location_006_008);
     @CAN_PrivMain::RFC_Location_006_008::RFC_Location_006_008_ON_OFF = 0;
  }
}

void cfg_Msg_RFC_Location_006_008(dword aDlc, byte data[])
{
   int64 i,k;//For looping
   byte xor,data_byte;
   dword crcTemp;
   byte DataLength;
   dword Msg_id;
   
   DataLength = Msg_RFC_Location_006_008.DataLength;//Message Data Length
   Msg_id  = Msg_RFC_Location_006_008.id;//Message ID
   
    if (@CAN_PrivMain::RFC_Location_006_008::RFC_Loc006_008_AliveCtr_FaultInject != 3)//AC: user defined value
    {

    clearBitsInByteArrayLE(data,16,8); //Intel / little-endian

    }
    if (@CAN_PrivMain::RFC_Location_006_008::RFC_Loc006_008_AliveCtr_FaultInject == 0)//AC: No Error, calculate AC
    {
      ++counter_RFC_Location_006_008_RFC_Loc006_008_AliveCtr;
      counter_RFC_Location_006_008_RFC_Loc006_008_AliveCtr %=256;

      copyBitsToByteArrayLE(counter_RFC_Location_006_008_RFC_Loc006_008_AliveCtr,data,16,8); //Intel / little-endian;
    }
    else if (@CAN_PrivMain::RFC_Location_006_008::RFC_Loc006_008_AliveCtr_FaultInject == 1)//AC: Error sequence: set AC = 0
    {

      copyBitsToByteArrayLE(0,data,16,8); //Intel / little-endian;
    }
    else if (@CAN_PrivMain::RFC_Location_006_008::RFC_Loc006_008_AliveCtr_FaultInject == 2)//AC: Error sequence: Freeze last valid value
    {

      copyBitsToByteArrayLE(counter_RFC_Location_006_008_RFC_Loc006_008_AliveCtr,data,16,8); //Intel / little-endian;
    }
    if (@CAN_PrivMain::RFC_Location_006_008::RFC_Loc006_008_ProtBlockCtr_FaultInject != 3)//BC: user defined value
    {

    clearBitsInByteArrayLE(data,24,4); //Intel / little-endian

    }
    if (@CAN_PrivMain::RFC_Location_006_008::RFC_Loc006_008_ProtBlockCtr_FaultInject == 0)//BC: No Error, calculate BC
    {
      bc_RFC_Location_006_008_RFC_Loc006_008_ProtBlockCtr = bc_RFC_Location_ProtBlockCtr ;

      copyBitsToByteArrayLE(bc_RFC_Location_006_008_RFC_Loc006_008_ProtBlockCtr,data,24,4); //Intel / little-endian;
    }
    else if (@CAN_PrivMain::RFC_Location_006_008::RFC_Loc006_008_ProtBlockCtr_FaultInject == 1)//BC: Error sequence: set BC = 0
    {

      copyBitsToByteArrayLE(0,data,24,4); //Intel / little-endian;
    }
    else if (@CAN_PrivMain::RFC_Location_006_008::RFC_Loc006_008_ProtBlockCtr_FaultInject == 2)//BC: Error sequence: Freeze last valid value
    {

      copyBitsToByteArrayLE(bc_RFC_Location_006_008_RFC_Loc006_008_ProtBlockCtr,data,24,4); //Intel / little-endian;
    }
    if (@CAN_PrivMain::RFC_Location_006_008::RFC_Loc006_008_CRC_FaultInject != 3)//CRC: user defined value
    {

    clearBitsInByteArrayLE(data,0,16); //Intel / little-endian

    }
    if(@CAN_PrivMain::RFC_Location_006_008::RFC_Loc006_008_CRC_FaultInject == 0)//CRC: No Error, calculate CRC
    {
      crcTemp = CRC16_INIT;
      for(i = 2; i < (DataLength+2); i++)
      {
        if(i < DataLength)
          data_byte = data[i] ;
        else if(i == DataLength)
          data_byte = (0x210a & 0x00FF);
        else if(i == (DataLength+1))
          data_byte = (0x210a & 0xFF00) >> 8;
        else
          write("Error: DLC exceeded in CRC calculation");
        crcTemp ^= data_byte << 8;
        crcTemp = (crcTemp << (8)) ^ CRC16_CCITT_FALSE_POLY_1021H_Lookup[(crcTemp >> (8)) & (0xFF)];
      }
      crcTemp ^= CRC16_XOR;
      crc_RFC_Location_006_008_RFC_Loc006_008_CRC = crcTemp;

      copyBitsToByteArrayLE(crc_RFC_Location_006_008_RFC_Loc006_008_CRC,data,0,16); //Intel / little-endian;
    }
    else if(@CAN_PrivMain::RFC_Location_006_008::RFC_Loc006_008_CRC_FaultInject == 1)//CRC: Error, set to Zero
    {

      copyBitsToByteArrayLE(0,data,0,16); //Intel / little-endian;
    }
    else if(@CAN_PrivMain::RFC_Location_006_008::RFC_Loc006_008_CRC_FaultInject == 2)//CRC: Error, Freeze last valid value
    {

      copyBitsToByteArrayLE(crc_RFC_Location_006_008_RFC_Loc006_008_CRC,data,0,16); //Intel / little-endian;
    }
}


on sysvar CAN_PrivMain::RFC_Location_009_011::RFC_Location_009_011_ON_OFF
{
  if (@this == 1)
  {
     ILSetMsgEvent(RFC_Location_009_011);
     @CAN_PrivMain::RFC_Location_009_011::RFC_Location_009_011_ON_OFF = 0;
  }
}

void cfg_Msg_RFC_Location_009_011(dword aDlc, byte data[])
{
   int64 i,k;//For looping
   byte xor,data_byte;
   dword crcTemp;
   byte DataLength;
   dword Msg_id;
   
   DataLength = Msg_RFC_Location_009_011.DataLength;//Message Data Length
   Msg_id  = Msg_RFC_Location_009_011.id;//Message ID
   
    if (@CAN_PrivMain::RFC_Location_009_011::RFC_Loc009_011_AliveCtr_FaultInject != 3)//AC: user defined value
    {

    clearBitsInByteArrayLE(data,16,8); //Intel / little-endian

    }
    if (@CAN_PrivMain::RFC_Location_009_011::RFC_Loc009_011_AliveCtr_FaultInject == 0)//AC: No Error, calculate AC
    {
      ++counter_RFC_Location_009_011_RFC_Loc009_011_AliveCtr;
      counter_RFC_Location_009_011_RFC_Loc009_011_AliveCtr %=256;

      copyBitsToByteArrayLE(counter_RFC_Location_009_011_RFC_Loc009_011_AliveCtr,data,16,8); //Intel / little-endian;
    }
    else if (@CAN_PrivMain::RFC_Location_009_011::RFC_Loc009_011_AliveCtr_FaultInject == 1)//AC: Error sequence: set AC = 0
    {

      copyBitsToByteArrayLE(0,data,16,8); //Intel / little-endian;
    }
    else if (@CAN_PrivMain::RFC_Location_009_011::RFC_Loc009_011_AliveCtr_FaultInject == 2)//AC: Error sequence: Freeze last valid value
    {

      copyBitsToByteArrayLE(counter_RFC_Location_009_011_RFC_Loc009_011_AliveCtr,data,16,8); //Intel / little-endian;
    }
    if (@CAN_PrivMain::RFC_Location_009_011::RFC_Loc009_011_ProtBlockCtr_FaultInject != 3)//BC: user defined value
    {

    clearBitsInByteArrayLE(data,24,4); //Intel / little-endian

    }
    if (@CAN_PrivMain::RFC_Location_009_011::RFC_Loc009_011_ProtBlockCtr_FaultInject == 0)//BC: No Error, calculate BC
    {
      bc_RFC_Location_009_011_RFC_Loc009_011_ProtBlockCtr = bc_RFC_Location_ProtBlockCtr ;

      copyBitsToByteArrayLE(bc_RFC_Location_009_011_RFC_Loc009_011_ProtBlockCtr,data,24,4); //Intel / little-endian;
    }
    else if (@CAN_PrivMain::RFC_Location_009_011::RFC_Loc009_011_ProtBlockCtr_FaultInject == 1)//BC: Error sequence: set BC = 0
    {

      copyBitsToByteArrayLE(0,data,24,4); //Intel / little-endian;
    }
    else if (@CAN_PrivMain::RFC_Location_009_011::RFC_Loc009_011_ProtBlockCtr_FaultInject == 2)//BC: Error sequence: Freeze last valid value
    {

      copyBitsToByteArrayLE(bc_RFC_Location_009_011_RFC_Loc009_011_ProtBlockCtr,data,24,4); //Intel / little-endian;
    }
    if (@CAN_PrivMain::RFC_Location_009_011::RFC_Loc009_011_CRC_FaultInject != 3)//CRC: user defined value
    {

    clearBitsInByteArrayLE(data,0,16); //Intel / little-endian

    }
    if(@CAN_PrivMain::RFC_Location_009_011::RFC_Loc009_011_CRC_FaultInject == 0)//CRC: No Error, calculate CRC
    {
      crcTemp = CRC16_INIT;
      for(i = 2; i < (DataLength+2); i++)
      {
        if(i < DataLength)
          data_byte = data[i] ;
        else if(i == DataLength)
          data_byte = (0x210b & 0x00FF);
        else if(i == (DataLength+1))
          data_byte = (0x210b & 0xFF00) >> 8;
        else
          write("Error: DLC exceeded in CRC calculation");
        crcTemp ^= data_byte << 8;
        crcTemp = (crcTemp << (8)) ^ CRC16_CCITT_FALSE_POLY_1021H_Lookup[(crcTemp >> (8)) & (0xFF)];
      }
      crcTemp ^= CRC16_XOR;
      crc_RFC_Location_009_011_RFC_Loc009_011_CRC = crcTemp;

      copyBitsToByteArrayLE(crc_RFC_Location_009_011_RFC_Loc009_011_CRC,data,0,16); //Intel / little-endian;
    }
    else if(@CAN_PrivMain::RFC_Location_009_011::RFC_Loc009_011_CRC_FaultInject == 1)//CRC: Error, set to Zero
    {

      copyBitsToByteArrayLE(0,data,0,16); //Intel / little-endian;
    }
    else if(@CAN_PrivMain::RFC_Location_009_011::RFC_Loc009_011_CRC_FaultInject == 2)//CRC: Error, Freeze last valid value
    {

      copyBitsToByteArrayLE(crc_RFC_Location_009_011_RFC_Loc009_011_CRC,data,0,16); //Intel / little-endian;
    }
}


on sysvar CAN_PrivMain::RFC_Location_012_014::RFC_Location_012_014_ON_OFF
{
  if (@this == 1)
  {
     ILSetMsgEvent(RFC_Location_012_014);
     @CAN_PrivMain::RFC_Location_012_014::RFC_Location_012_014_ON_OFF = 0;
  }
}

void cfg_Msg_RFC_Location_012_014(dword aDlc, byte data[])
{
   int64 i,k;//For looping
   byte xor,data_byte;
   dword crcTemp;
   byte DataLength;
   dword Msg_id;
   
   DataLength = Msg_RFC_Location_012_014.DataLength;//Message Data Length
   Msg_id  = Msg_RFC_Location_012_014.id;//Message ID
   
    if (@CAN_PrivMain::RFC_Location_012_014::RFC_Loc012_014_AliveCtr_FaultInject != 3)//AC: user defined value
    {

    clearBitsInByteArrayLE(data,16,8); //Intel / little-endian

    }
    if (@CAN_PrivMain::RFC_Location_012_014::RFC_Loc012_014_AliveCtr_FaultInject == 0)//AC: No Error, calculate AC
    {
      ++counter_RFC_Location_012_014_RFC_Loc012_014_AliveCtr;
      counter_RFC_Location_012_014_RFC_Loc012_014_AliveCtr %=256;

      copyBitsToByteArrayLE(counter_RFC_Location_012_014_RFC_Loc012_014_AliveCtr,data,16,8); //Intel / little-endian;
    }
    else if (@CAN_PrivMain::RFC_Location_012_014::RFC_Loc012_014_AliveCtr_FaultInject == 1)//AC: Error sequence: set AC = 0
    {

      copyBitsToByteArrayLE(0,data,16,8); //Intel / little-endian;
    }
    else if (@CAN_PrivMain::RFC_Location_012_014::RFC_Loc012_014_AliveCtr_FaultInject == 2)//AC: Error sequence: Freeze last valid value
    {

      copyBitsToByteArrayLE(counter_RFC_Location_012_014_RFC_Loc012_014_AliveCtr,data,16,8); //Intel / little-endian;
    }
    if (@CAN_PrivMain::RFC_Location_012_014::RFC_Loc012_014_ProtBlockCtr_FaultInject != 3)//BC: user defined value
    {

    clearBitsInByteArrayLE(data,24,4); //Intel / little-endian

    }
    if (@CAN_PrivMain::RFC_Location_012_014::RFC_Loc012_014_ProtBlockCtr_FaultInject == 0)//BC: No Error, calculate BC
    {
      bc_RFC_Location_012_014_RFC_Loc012_014_ProtBlockCtr = bc_RFC_Location_ProtBlockCtr ;

      copyBitsToByteArrayLE(bc_RFC_Location_012_014_RFC_Loc012_014_ProtBlockCtr,data,24,4); //Intel / little-endian;
    }
    else if (@CAN_PrivMain::RFC_Location_012_014::RFC_Loc012_014_ProtBlockCtr_FaultInject == 1)//BC: Error sequence: set BC = 0
    {

      copyBitsToByteArrayLE(0,data,24,4); //Intel / little-endian;
    }
    else if (@CAN_PrivMain::RFC_Location_012_014::RFC_Loc012_014_ProtBlockCtr_FaultInject == 2)//BC: Error sequence: Freeze last valid value
    {

      copyBitsToByteArrayLE(bc_RFC_Location_012_014_RFC_Loc012_014_ProtBlockCtr,data,24,4); //Intel / little-endian;
    }
    if (@CAN_PrivMain::RFC_Location_012_014::RFC_Loc012_014_CRC_FaultInject != 3)//CRC: user defined value
    {

    clearBitsInByteArrayLE(data,0,16); //Intel / little-endian

    }
    if(@CAN_PrivMain::RFC_Location_012_014::RFC_Loc012_014_CRC_FaultInject == 0)//CRC: No Error, calculate CRC
    {
      crcTemp = CRC16_INIT;
      for(i = 2; i < (DataLength+2); i++)
      {
        if(i < DataLength)
          data_byte = data[i] ;
        else if(i == DataLength)
          data_byte = (0x210c & 0x00FF);
        else if(i == (DataLength+1))
          data_byte = (0x210c & 0xFF00) >> 8;
        else
          write("Error: DLC exceeded in CRC calculation");
        crcTemp ^= data_byte << 8;
        crcTemp = (crcTemp << (8)) ^ CRC16_CCITT_FALSE_POLY_1021H_Lookup[(crcTemp >> (8)) & (0xFF)];
      }
      crcTemp ^= CRC16_XOR;
      crc_RFC_Location_012_014_RFC_Loc012_014_CRC = crcTemp;

      copyBitsToByteArrayLE(crc_RFC_Location_012_014_RFC_Loc012_014_CRC,data,0,16); //Intel / little-endian;
    }
    else if(@CAN_PrivMain::RFC_Location_012_014::RFC_Loc012_014_CRC_FaultInject == 1)//CRC: Error, set to Zero
    {

      copyBitsToByteArrayLE(0,data,0,16); //Intel / little-endian;
    }
    else if(@CAN_PrivMain::RFC_Location_012_014::RFC_Loc012_014_CRC_FaultInject == 2)//CRC: Error, Freeze last valid value
    {

      copyBitsToByteArrayLE(crc_RFC_Location_012_014_RFC_Loc012_014_CRC,data,0,16); //Intel / little-endian;
    }
}


on sysvar CAN_PrivMain::RFC_Location_015_017::RFC_Location_015_017_ON_OFF
{
  if (@this == 1)
  {
     ILSetMsgEvent(RFC_Location_015_017);
     @CAN_PrivMain::RFC_Location_015_017::RFC_Location_015_017_ON_OFF = 0;
  }
}

void cfg_Msg_RFC_Location_015_017(dword aDlc, byte data[])
{
   int64 i,k;//For looping
   byte xor,data_byte;
   dword crcTemp;
   byte DataLength;
   dword Msg_id;
   
   DataLength = Msg_RFC_Location_015_017.DataLength;//Message Data Length
   Msg_id  = Msg_RFC_Location_015_017.id;//Message ID
   
    if (@CAN_PrivMain::RFC_Location_015_017::RFC_Loc015_017_AliveCtr_FaultInject != 3)//AC: user defined value
    {

    clearBitsInByteArrayLE(data,16,8); //Intel / little-endian

    }
    if (@CAN_PrivMain::RFC_Location_015_017::RFC_Loc015_017_AliveCtr_FaultInject == 0)//AC: No Error, calculate AC
    {
      ++counter_RFC_Location_015_017_RFC_Loc015_017_AliveCtr;
      counter_RFC_Location_015_017_RFC_Loc015_017_AliveCtr %=256;

      copyBitsToByteArrayLE(counter_RFC_Location_015_017_RFC_Loc015_017_AliveCtr,data,16,8); //Intel / little-endian;
    }
    else if (@CAN_PrivMain::RFC_Location_015_017::RFC_Loc015_017_AliveCtr_FaultInject == 1)//AC: Error sequence: set AC = 0
    {

      copyBitsToByteArrayLE(0,data,16,8); //Intel / little-endian;
    }
    else if (@CAN_PrivMain::RFC_Location_015_017::RFC_Loc015_017_AliveCtr_FaultInject == 2)//AC: Error sequence: Freeze last valid value
    {

      copyBitsToByteArrayLE(counter_RFC_Location_015_017_RFC_Loc015_017_AliveCtr,data,16,8); //Intel / little-endian;
    }
    if (@CAN_PrivMain::RFC_Location_015_017::RFC_Loc015_017_ProtBlockCtr_FaultInject != 3)//BC: user defined value
    {

    clearBitsInByteArrayLE(data,24,4); //Intel / little-endian

    }
    if (@CAN_PrivMain::RFC_Location_015_017::RFC_Loc015_017_ProtBlockCtr_FaultInject == 0)//BC: No Error, calculate BC
    {
      bc_RFC_Location_015_017_RFC_Loc015_017_ProtBlockCtr = bc_RFC_Location_ProtBlockCtr ;

      copyBitsToByteArrayLE(bc_RFC_Location_015_017_RFC_Loc015_017_ProtBlockCtr,data,24,4); //Intel / little-endian;
    }
    else if (@CAN_PrivMain::RFC_Location_015_017::RFC_Loc015_017_ProtBlockCtr_FaultInject == 1)//BC: Error sequence: set BC = 0
    {

      copyBitsToByteArrayLE(0,data,24,4); //Intel / little-endian;
    }
    else if (@CAN_PrivMain::RFC_Location_015_017::RFC_Loc015_017_ProtBlockCtr_FaultInject == 2)//BC: Error sequence: Freeze last valid value
    {

      copyBitsToByteArrayLE(bc_RFC_Location_015_017_RFC_Loc015_017_ProtBlockCtr,data,24,4); //Intel / little-endian;
    }
    if (@CAN_PrivMain::RFC_Location_015_017::RFC_Loc015_017_CRC_FaultInject != 3)//CRC: user defined value
    {

    clearBitsInByteArrayLE(data,0,16); //Intel / little-endian

    }
    if(@CAN_PrivMain::RFC_Location_015_017::RFC_Loc015_017_CRC_FaultInject == 0)//CRC: No Error, calculate CRC
    {
      crcTemp = CRC16_INIT;
      for(i = 2; i < (DataLength+2); i++)
      {
        if(i < DataLength)
          data_byte = data[i] ;
        else if(i == DataLength)
          data_byte = (0x210d & 0x00FF);
        else if(i == (DataLength+1))
          data_byte = (0x210d & 0xFF00) >> 8;
        else
          write("Error: DLC exceeded in CRC calculation");
        crcTemp ^= data_byte << 8;
        crcTemp = (crcTemp << (8)) ^ CRC16_CCITT_FALSE_POLY_1021H_Lookup[(crcTemp >> (8)) & (0xFF)];
      }
      crcTemp ^= CRC16_XOR;
      crc_RFC_Location_015_017_RFC_Loc015_017_CRC = crcTemp;

      copyBitsToByteArrayLE(crc_RFC_Location_015_017_RFC_Loc015_017_CRC,data,0,16); //Intel / little-endian;
    }
    else if(@CAN_PrivMain::RFC_Location_015_017::RFC_Loc015_017_CRC_FaultInject == 1)//CRC: Error, set to Zero
    {

      copyBitsToByteArrayLE(0,data,0,16); //Intel / little-endian;
    }
    else if(@CAN_PrivMain::RFC_Location_015_017::RFC_Loc015_017_CRC_FaultInject == 2)//CRC: Error, Freeze last valid value
    {

      copyBitsToByteArrayLE(crc_RFC_Location_015_017_RFC_Loc015_017_CRC,data,0,16); //Intel / little-endian;
    }
}


on sysvar CAN_PrivMain::RFC_Location_018_020::RFC_Location_018_020_ON_OFF
{
  if (@this == 1)
  {
     ILSetMsgEvent(RFC_Location_018_020);
     @CAN_PrivMain::RFC_Location_018_020::RFC_Location_018_020_ON_OFF = 0;
  }
}

void cfg_Msg_RFC_Location_018_020(dword aDlc, byte data[])
{
   int64 i,k;//For looping
   byte xor,data_byte;
   dword crcTemp;
   byte DataLength;
   dword Msg_id;
   
   DataLength = Msg_RFC_Location_018_020.DataLength;//Message Data Length
   Msg_id  = Msg_RFC_Location_018_020.id;//Message ID
   
    if (@CAN_PrivMain::RFC_Location_018_020::RFC_Loc018_020_AliveCtr_FaultInject != 3)//AC: user defined value
    {

    clearBitsInByteArrayLE(data,16,8); //Intel / little-endian

    }
    if (@CAN_PrivMain::RFC_Location_018_020::RFC_Loc018_020_AliveCtr_FaultInject == 0)//AC: No Error, calculate AC
    {
      ++counter_RFC_Location_018_020_RFC_Loc018_020_AliveCtr;
      counter_RFC_Location_018_020_RFC_Loc018_020_AliveCtr %=256;

      copyBitsToByteArrayLE(counter_RFC_Location_018_020_RFC_Loc018_020_AliveCtr,data,16,8); //Intel / little-endian;
    }
    else if (@CAN_PrivMain::RFC_Location_018_020::RFC_Loc018_020_AliveCtr_FaultInject == 1)//AC: Error sequence: set AC = 0
    {

      copyBitsToByteArrayLE(0,data,16,8); //Intel / little-endian;
    }
    else if (@CAN_PrivMain::RFC_Location_018_020::RFC_Loc018_020_AliveCtr_FaultInject == 2)//AC: Error sequence: Freeze last valid value
    {

      copyBitsToByteArrayLE(counter_RFC_Location_018_020_RFC_Loc018_020_AliveCtr,data,16,8); //Intel / little-endian;
    }
    if (@CAN_PrivMain::RFC_Location_018_020::RFC_Loc018_020_ProtBlockCtr_FaultInject != 3)//BC: user defined value
    {

    clearBitsInByteArrayLE(data,24,4); //Intel / little-endian

    }
    if (@CAN_PrivMain::RFC_Location_018_020::RFC_Loc018_020_ProtBlockCtr_FaultInject == 0)//BC: No Error, calculate BC
    {
      bc_RFC_Location_018_020_RFC_Loc018_020_ProtBlockCtr = bc_RFC_Location_ProtBlockCtr ;

      copyBitsToByteArrayLE(bc_RFC_Location_018_020_RFC_Loc018_020_ProtBlockCtr,data,24,4); //Intel / little-endian;
    }
    else if (@CAN_PrivMain::RFC_Location_018_020::RFC_Loc018_020_ProtBlockCtr_FaultInject == 1)//BC: Error sequence: set BC = 0
    {

      copyBitsToByteArrayLE(0,data,24,4); //Intel / little-endian;
    }
    else if (@CAN_PrivMain::RFC_Location_018_020::RFC_Loc018_020_ProtBlockCtr_FaultInject == 2)//BC: Error sequence: Freeze last valid value
    {

      copyBitsToByteArrayLE(bc_RFC_Location_018_020_RFC_Loc018_020_ProtBlockCtr,data,24,4); //Intel / little-endian;
    }
    if (@CAN_PrivMain::RFC_Location_018_020::RFC_Loc018_020_CRC_FaultInject != 3)//CRC: user defined value
    {

    clearBitsInByteArrayLE(data,0,16); //Intel / little-endian

    }
    if(@CAN_PrivMain::RFC_Location_018_020::RFC_Loc018_020_CRC_FaultInject == 0)//CRC: No Error, calculate CRC
    {
      crcTemp = CRC16_INIT;
      for(i = 2; i < (DataLength+2); i++)
      {
        if(i < DataLength)
          data_byte = data[i] ;
        else if(i == DataLength)
          data_byte = (0x210e & 0x00FF);
        else if(i == (DataLength+1))
          data_byte = (0x210e & 0xFF00) >> 8;
        else
          write("Error: DLC exceeded in CRC calculation");
        crcTemp ^= data_byte << 8;
        crcTemp = (crcTemp << (8)) ^ CRC16_CCITT_FALSE_POLY_1021H_Lookup[(crcTemp >> (8)) & (0xFF)];
      }
      crcTemp ^= CRC16_XOR;
      crc_RFC_Location_018_020_RFC_Loc018_020_CRC = crcTemp;

      copyBitsToByteArrayLE(crc_RFC_Location_018_020_RFC_Loc018_020_CRC,data,0,16); //Intel / little-endian;
    }
    else if(@CAN_PrivMain::RFC_Location_018_020::RFC_Loc018_020_CRC_FaultInject == 1)//CRC: Error, set to Zero
    {

      copyBitsToByteArrayLE(0,data,0,16); //Intel / little-endian;
    }
    else if(@CAN_PrivMain::RFC_Location_018_020::RFC_Loc018_020_CRC_FaultInject == 2)//CRC: Error, Freeze last valid value
    {

      copyBitsToByteArrayLE(crc_RFC_Location_018_020_RFC_Loc018_020_CRC,data,0,16); //Intel / little-endian;
    }
}


on sysvar CAN_PrivMain::RFC_Location_021_023::RFC_Location_021_023_ON_OFF
{
  if (@this == 1)
  {
     ILSetMsgEvent(RFC_Location_021_023);
     @CAN_PrivMain::RFC_Location_021_023::RFC_Location_021_023_ON_OFF = 0;
  }
}

void cfg_Msg_RFC_Location_021_023(dword aDlc, byte data[])
{
   int64 i,k;//For looping
   byte xor,data_byte;
   dword crcTemp;
   byte DataLength;
   dword Msg_id;
   
   DataLength = Msg_RFC_Location_021_023.DataLength;//Message Data Length
   Msg_id  = Msg_RFC_Location_021_023.id;//Message ID
   
    if (@CAN_PrivMain::RFC_Location_021_023::RFC_Loc021_023_AliveCtr_FaultInject != 3)//AC: user defined value
    {

    clearBitsInByteArrayLE(data,16,8); //Intel / little-endian

    }
    if (@CAN_PrivMain::RFC_Location_021_023::RFC_Loc021_023_AliveCtr_FaultInject == 0)//AC: No Error, calculate AC
    {
      ++counter_RFC_Location_021_023_RFC_Loc021_023_AliveCtr;
      counter_RFC_Location_021_023_RFC_Loc021_023_AliveCtr %=256;

      copyBitsToByteArrayLE(counter_RFC_Location_021_023_RFC_Loc021_023_AliveCtr,data,16,8); //Intel / little-endian;
    }
    else if (@CAN_PrivMain::RFC_Location_021_023::RFC_Loc021_023_AliveCtr_FaultInject == 1)//AC: Error sequence: set AC = 0
    {

      copyBitsToByteArrayLE(0,data,16,8); //Intel / little-endian;
    }
    else if (@CAN_PrivMain::RFC_Location_021_023::RFC_Loc021_023_AliveCtr_FaultInject == 2)//AC: Error sequence: Freeze last valid value
    {

      copyBitsToByteArrayLE(counter_RFC_Location_021_023_RFC_Loc021_023_AliveCtr,data,16,8); //Intel / little-endian;
    }
    if (@CAN_PrivMain::RFC_Location_021_023::RFC_Loc021_023_ProtBlockCtr_FaultInject != 3)//BC: user defined value
    {

    clearBitsInByteArrayLE(data,24,4); //Intel / little-endian

    }
    if (@CAN_PrivMain::RFC_Location_021_023::RFC_Loc021_023_ProtBlockCtr_FaultInject == 0)//BC: No Error, calculate BC
    {
      bc_RFC_Location_021_023_RFC_Loc021_023_ProtBlockCtr = bc_RFC_Location_ProtBlockCtr ;

      copyBitsToByteArrayLE(bc_RFC_Location_021_023_RFC_Loc021_023_ProtBlockCtr,data,24,4); //Intel / little-endian;
    }
    else if (@CAN_PrivMain::RFC_Location_021_023::RFC_Loc021_023_ProtBlockCtr_FaultInject == 1)//BC: Error sequence: set BC = 0
    {

      copyBitsToByteArrayLE(0,data,24,4); //Intel / little-endian;
    }
    else if (@CAN_PrivMain::RFC_Location_021_023::RFC_Loc021_023_ProtBlockCtr_FaultInject == 2)//BC: Error sequence: Freeze last valid value
    {

      copyBitsToByteArrayLE(bc_RFC_Location_021_023_RFC_Loc021_023_ProtBlockCtr,data,24,4); //Intel / little-endian;
    }
    if (@CAN_PrivMain::RFC_Location_021_023::RFC_Loc021_023_CRC_FaultInject != 3)//CRC: user defined value
    {

    clearBitsInByteArrayLE(data,0,16); //Intel / little-endian

    }
    if(@CAN_PrivMain::RFC_Location_021_023::RFC_Loc021_023_CRC_FaultInject == 0)//CRC: No Error, calculate CRC
    {
      crcTemp = CRC16_INIT;
      for(i = 2; i < (DataLength+2); i++)
      {
        if(i < DataLength)
          data_byte = data[i] ;
        else if(i == DataLength)
          data_byte = (0x210f & 0x00FF);
        else if(i == (DataLength+1))
          data_byte = (0x210f & 0xFF00) >> 8;
        else
          write("Error: DLC exceeded in CRC calculation");
        crcTemp ^= data_byte << 8;
        crcTemp = (crcTemp << (8)) ^ CRC16_CCITT_FALSE_POLY_1021H_Lookup[(crcTemp >> (8)) & (0xFF)];
      }
      crcTemp ^= CRC16_XOR;
      crc_RFC_Location_021_023_RFC_Loc021_023_CRC = crcTemp;

      copyBitsToByteArrayLE(crc_RFC_Location_021_023_RFC_Loc021_023_CRC,data,0,16); //Intel / little-endian;
    }
    else if(@CAN_PrivMain::RFC_Location_021_023::RFC_Loc021_023_CRC_FaultInject == 1)//CRC: Error, set to Zero
    {

      copyBitsToByteArrayLE(0,data,0,16); //Intel / little-endian;
    }
    else if(@CAN_PrivMain::RFC_Location_021_023::RFC_Loc021_023_CRC_FaultInject == 2)//CRC: Error, Freeze last valid value
    {

      copyBitsToByteArrayLE(crc_RFC_Location_021_023_RFC_Loc021_023_CRC,data,0,16); //Intel / little-endian;
    }
}


on sysvar CAN_PrivMain::RFC_Location_024_026::RFC_Location_024_026_ON_OFF
{
  if (@this == 1)
  {
     ILSetMsgEvent(RFC_Location_024_026);
     @CAN_PrivMain::RFC_Location_024_026::RFC_Location_024_026_ON_OFF = 0;
  }
}

void cfg_Msg_RFC_Location_024_026(dword aDlc, byte data[])
{
   int64 i,k;//For looping
   byte xor,data_byte;
   dword crcTemp;
   byte DataLength;
   dword Msg_id;
   
   DataLength = Msg_RFC_Location_024_026.DataLength;//Message Data Length
   Msg_id  = Msg_RFC_Location_024_026.id;//Message ID
   
    if (@CAN_PrivMain::RFC_Location_024_026::RFC_Loc024_026_AliveCtr_FaultInject != 3)//AC: user defined value
    {

    clearBitsInByteArrayLE(data,16,8); //Intel / little-endian

    }
    if (@CAN_PrivMain::RFC_Location_024_026::RFC_Loc024_026_AliveCtr_FaultInject == 0)//AC: No Error, calculate AC
    {
      ++counter_RFC_Location_024_026_RFC_Loc024_026_AliveCtr;
      counter_RFC_Location_024_026_RFC_Loc024_026_AliveCtr %=256;

      copyBitsToByteArrayLE(counter_RFC_Location_024_026_RFC_Loc024_026_AliveCtr,data,16,8); //Intel / little-endian;
    }
    else if (@CAN_PrivMain::RFC_Location_024_026::RFC_Loc024_026_AliveCtr_FaultInject == 1)//AC: Error sequence: set AC = 0
    {

      copyBitsToByteArrayLE(0,data,16,8); //Intel / little-endian;
    }
    else if (@CAN_PrivMain::RFC_Location_024_026::RFC_Loc024_026_AliveCtr_FaultInject == 2)//AC: Error sequence: Freeze last valid value
    {

      copyBitsToByteArrayLE(counter_RFC_Location_024_026_RFC_Loc024_026_AliveCtr,data,16,8); //Intel / little-endian;
    }
    if (@CAN_PrivMain::RFC_Location_024_026::RFC_Loc024_026_ProtBlockCtr_FaultInject != 3)//BC: user defined value
    {

    clearBitsInByteArrayLE(data,24,4); //Intel / little-endian

    }
    if (@CAN_PrivMain::RFC_Location_024_026::RFC_Loc024_026_ProtBlockCtr_FaultInject == 0)//BC: No Error, calculate BC
    {
      bc_RFC_Location_024_026_RFC_Loc024_026_ProtBlockCtr = bc_RFC_Location_ProtBlockCtr ;

      copyBitsToByteArrayLE(bc_RFC_Location_024_026_RFC_Loc024_026_ProtBlockCtr,data,24,4); //Intel / little-endian;
    }
    else if (@CAN_PrivMain::RFC_Location_024_026::RFC_Loc024_026_ProtBlockCtr_FaultInject == 1)//BC: Error sequence: set BC = 0
    {

      copyBitsToByteArrayLE(0,data,24,4); //Intel / little-endian;
    }
    else if (@CAN_PrivMain::RFC_Location_024_026::RFC_Loc024_026_ProtBlockCtr_FaultInject == 2)//BC: Error sequence: Freeze last valid value
    {

      copyBitsToByteArrayLE(bc_RFC_Location_024_026_RFC_Loc024_026_ProtBlockCtr,data,24,4); //Intel / little-endian;
    }
    if (@CAN_PrivMain::RFC_Location_024_026::RFC_Loc024_026_CRC_FaultInject != 3)//CRC: user defined value
    {

    clearBitsInByteArrayLE(data,0,16); //Intel / little-endian

    }
    if(@CAN_PrivMain::RFC_Location_024_026::RFC_Loc024_026_CRC_FaultInject == 0)//CRC: No Error, calculate CRC
    {
      crcTemp = CRC16_INIT;
      for(i = 2; i < (DataLength+2); i++)
      {
        if(i < DataLength)
          data_byte = data[i] ;
        else if(i == DataLength)
          data_byte = (0x2110 & 0x00FF);
        else if(i == (DataLength+1))
          data_byte = (0x2110 & 0xFF00) >> 8;
        else
          write("Error: DLC exceeded in CRC calculation");
        crcTemp ^= data_byte << 8;
        crcTemp = (crcTemp << (8)) ^ CRC16_CCITT_FALSE_POLY_1021H_Lookup[(crcTemp >> (8)) & (0xFF)];
      }
      crcTemp ^= CRC16_XOR;
      crc_RFC_Location_024_026_RFC_Loc024_026_CRC = crcTemp;

      copyBitsToByteArrayLE(crc_RFC_Location_024_026_RFC_Loc024_026_CRC,data,0,16); //Intel / little-endian;
    }
    else if(@CAN_PrivMain::RFC_Location_024_026::RFC_Loc024_026_CRC_FaultInject == 1)//CRC: Error, set to Zero
    {

      copyBitsToByteArrayLE(0,data,0,16); //Intel / little-endian;
    }
    else if(@CAN_PrivMain::RFC_Location_024_026::RFC_Loc024_026_CRC_FaultInject == 2)//CRC: Error, Freeze last valid value
    {

      copyBitsToByteArrayLE(crc_RFC_Location_024_026_RFC_Loc024_026_CRC,data,0,16); //Intel / little-endian;
    }
}


on sysvar CAN_PrivMain::RFC_Location_027_029::RFC_Location_027_029_ON_OFF
{
  if (@this == 1)
  {
     ILSetMsgEvent(RFC_Location_027_029);
     @CAN_PrivMain::RFC_Location_027_029::RFC_Location_027_029_ON_OFF = 0;
  }
}

void cfg_Msg_RFC_Location_027_029(dword aDlc, byte data[])
{
   int64 i,k;//For looping
   byte xor,data_byte;
   dword crcTemp;
   byte DataLength;
   dword Msg_id;
   
   DataLength = Msg_RFC_Location_027_029.DataLength;//Message Data Length
   Msg_id  = Msg_RFC_Location_027_029.id;//Message ID
   
    if (@CAN_PrivMain::RFC_Location_027_029::RFC_Loc027_029_AliveCtr_FaultInject != 3)//AC: user defined value
    {

    clearBitsInByteArrayLE(data,16,8); //Intel / little-endian

    }
    if (@CAN_PrivMain::RFC_Location_027_029::RFC_Loc027_029_AliveCtr_FaultInject == 0)//AC: No Error, calculate AC
    {
      ++counter_RFC_Location_027_029_RFC_Loc027_029_AliveCtr;
      counter_RFC_Location_027_029_RFC_Loc027_029_AliveCtr %=256;

      copyBitsToByteArrayLE(counter_RFC_Location_027_029_RFC_Loc027_029_AliveCtr,data,16,8); //Intel / little-endian;
    }
    else if (@CAN_PrivMain::RFC_Location_027_029::RFC_Loc027_029_AliveCtr_FaultInject == 1)//AC: Error sequence: set AC = 0
    {

      copyBitsToByteArrayLE(0,data,16,8); //Intel / little-endian;
    }
    else if (@CAN_PrivMain::RFC_Location_027_029::RFC_Loc027_029_AliveCtr_FaultInject == 2)//AC: Error sequence: Freeze last valid value
    {

      copyBitsToByteArrayLE(counter_RFC_Location_027_029_RFC_Loc027_029_AliveCtr,data,16,8); //Intel / little-endian;
    }
    if (@CAN_PrivMain::RFC_Location_027_029::RFC_Loc027_029_ProtBlockCtr_FaultInject != 3)//BC: user defined value
    {

    clearBitsInByteArrayLE(data,24,4); //Intel / little-endian

    }
    if (@CAN_PrivMain::RFC_Location_027_029::RFC_Loc027_029_ProtBlockCtr_FaultInject == 0)//BC: No Error, calculate BC
    {
      bc_RFC_Location_027_029_RFC_Loc027_029_ProtBlockCtr = bc_RFC_Location_ProtBlockCtr ;

      copyBitsToByteArrayLE(bc_RFC_Location_027_029_RFC_Loc027_029_ProtBlockCtr,data,24,4); //Intel / little-endian;
    }
    else if (@CAN_PrivMain::RFC_Location_027_029::RFC_Loc027_029_ProtBlockCtr_FaultInject == 1)//BC: Error sequence: set BC = 0
    {

      copyBitsToByteArrayLE(0,data,24,4); //Intel / little-endian;
    }
    else if (@CAN_PrivMain::RFC_Location_027_029::RFC_Loc027_029_ProtBlockCtr_FaultInject == 2)//BC: Error sequence: Freeze last valid value
    {

      copyBitsToByteArrayLE(bc_RFC_Location_027_029_RFC_Loc027_029_ProtBlockCtr,data,24,4); //Intel / little-endian;
    }
    if (@CAN_PrivMain::RFC_Location_027_029::RFC_Loc027_029_CRC_FaultInject != 3)//CRC: user defined value
    {

    clearBitsInByteArrayLE(data,0,16); //Intel / little-endian

    }
    if(@CAN_PrivMain::RFC_Location_027_029::RFC_Loc027_029_CRC_FaultInject == 0)//CRC: No Error, calculate CRC
    {
      crcTemp = CRC16_INIT;
      for(i = 2; i < (DataLength+2); i++)
      {
        if(i < DataLength)
          data_byte = data[i] ;
        else if(i == DataLength)
          data_byte = (0x2111 & 0x00FF);
        else if(i == (DataLength+1))
          data_byte = (0x2111 & 0xFF00) >> 8;
        else
          write("Error: DLC exceeded in CRC calculation");
        crcTemp ^= data_byte << 8;
        crcTemp = (crcTemp << (8)) ^ CRC16_CCITT_FALSE_POLY_1021H_Lookup[(crcTemp >> (8)) & (0xFF)];
      }
      crcTemp ^= CRC16_XOR;
      crc_RFC_Location_027_029_RFC_Loc027_029_CRC = crcTemp;

      copyBitsToByteArrayLE(crc_RFC_Location_027_029_RFC_Loc027_029_CRC,data,0,16); //Intel / little-endian;
    }
    else if(@CAN_PrivMain::RFC_Location_027_029::RFC_Loc027_029_CRC_FaultInject == 1)//CRC: Error, set to Zero
    {

      copyBitsToByteArrayLE(0,data,0,16); //Intel / little-endian;
    }
    else if(@CAN_PrivMain::RFC_Location_027_029::RFC_Loc027_029_CRC_FaultInject == 2)//CRC: Error, Freeze last valid value
    {

      copyBitsToByteArrayLE(crc_RFC_Location_027_029_RFC_Loc027_029_CRC,data,0,16); //Intel / little-endian;
    }
}


on sysvar CAN_PrivMain::RFC_Location_030_032::RFC_Location_030_032_ON_OFF
{
  if (@this == 1)
  {
     ILSetMsgEvent(RFC_Location_030_032);
     @CAN_PrivMain::RFC_Location_030_032::RFC_Location_030_032_ON_OFF = 0;
  }
}

void cfg_Msg_RFC_Location_030_032(dword aDlc, byte data[])
{
   int64 i,k;//For looping
   byte xor,data_byte;
   dword crcTemp;
   byte DataLength;
   dword Msg_id;
   
   DataLength = Msg_RFC_Location_030_032.DataLength;//Message Data Length
   Msg_id  = Msg_RFC_Location_030_032.id;//Message ID
   
    if (@CAN_PrivMain::RFC_Location_030_032::RFC_Loc030_032_AliveCtr_FaultInject != 3)//AC: user defined value
    {

    clearBitsInByteArrayLE(data,16,8); //Intel / little-endian

    }
    if (@CAN_PrivMain::RFC_Location_030_032::RFC_Loc030_032_AliveCtr_FaultInject == 0)//AC: No Error, calculate AC
    {
      ++counter_RFC_Location_030_032_RFC_Loc030_032_AliveCtr;
      counter_RFC_Location_030_032_RFC_Loc030_032_AliveCtr %=256;

      copyBitsToByteArrayLE(counter_RFC_Location_030_032_RFC_Loc030_032_AliveCtr,data,16,8); //Intel / little-endian;
    }
    else if (@CAN_PrivMain::RFC_Location_030_032::RFC_Loc030_032_AliveCtr_FaultInject == 1)//AC: Error sequence: set AC = 0
    {

      copyBitsToByteArrayLE(0,data,16,8); //Intel / little-endian;
    }
    else if (@CAN_PrivMain::RFC_Location_030_032::RFC_Loc030_032_AliveCtr_FaultInject == 2)//AC: Error sequence: Freeze last valid value
    {

      copyBitsToByteArrayLE(counter_RFC_Location_030_032_RFC_Loc030_032_AliveCtr,data,16,8); //Intel / little-endian;
    }
    if (@CAN_PrivMain::RFC_Location_030_032::RFC_Loc030_032_ProtBlockCtr_FaultInject != 3)//BC: user defined value
    {

    clearBitsInByteArrayLE(data,24,4); //Intel / little-endian

    }
    if (@CAN_PrivMain::RFC_Location_030_032::RFC_Loc030_032_ProtBlockCtr_FaultInject == 0)//BC: No Error, calculate BC
    {
      bc_RFC_Location_030_032_RFC_Loc030_032_ProtBlockCtr = bc_RFC_Location_ProtBlockCtr ;

      copyBitsToByteArrayLE(bc_RFC_Location_030_032_RFC_Loc030_032_ProtBlockCtr,data,24,4); //Intel / little-endian;
    }
    else if (@CAN_PrivMain::RFC_Location_030_032::RFC_Loc030_032_ProtBlockCtr_FaultInject == 1)//BC: Error sequence: set BC = 0
    {

      copyBitsToByteArrayLE(0,data,24,4); //Intel / little-endian;
    }
    else if (@CAN_PrivMain::RFC_Location_030_032::RFC_Loc030_032_ProtBlockCtr_FaultInject == 2)//BC: Error sequence: Freeze last valid value
    {

      copyBitsToByteArrayLE(bc_RFC_Location_030_032_RFC_Loc030_032_ProtBlockCtr,data,24,4); //Intel / little-endian;
    }
    if (@CAN_PrivMain::RFC_Location_030_032::RFC_Loc030_032_CRC_FaultInject != 3)//CRC: user defined value
    {

    clearBitsInByteArrayLE(data,0,16); //Intel / little-endian

    }
    if(@CAN_PrivMain::RFC_Location_030_032::RFC_Loc030_032_CRC_FaultInject == 0)//CRC: No Error, calculate CRC
    {
      crcTemp = CRC16_INIT;
      for(i = 2; i < (DataLength+2); i++)
      {
        if(i < DataLength)
          data_byte = data[i] ;
        else if(i == DataLength)
          data_byte = (0x2112 & 0x00FF);
        else if(i == (DataLength+1))
          data_byte = (0x2112 & 0xFF00) >> 8;
        else
          write("Error: DLC exceeded in CRC calculation");
        crcTemp ^= data_byte << 8;
        crcTemp = (crcTemp << (8)) ^ CRC16_CCITT_FALSE_POLY_1021H_Lookup[(crcTemp >> (8)) & (0xFF)];
      }
      crcTemp ^= CRC16_XOR;
      crc_RFC_Location_030_032_RFC_Loc030_032_CRC = crcTemp;

      copyBitsToByteArrayLE(crc_RFC_Location_030_032_RFC_Loc030_032_CRC,data,0,16); //Intel / little-endian;
    }
    else if(@CAN_PrivMain::RFC_Location_030_032::RFC_Loc030_032_CRC_FaultInject == 1)//CRC: Error, set to Zero
    {

      copyBitsToByteArrayLE(0,data,0,16); //Intel / little-endian;
    }
    else if(@CAN_PrivMain::RFC_Location_030_032::RFC_Loc030_032_CRC_FaultInject == 2)//CRC: Error, Freeze last valid value
    {

      copyBitsToByteArrayLE(crc_RFC_Location_030_032_RFC_Loc030_032_CRC,data,0,16); //Intel / little-endian;
    }
}


on sysvar CAN_PrivMain::RFC_Location_033_035::RFC_Location_033_035_ON_OFF
{
  if (@this == 1)
  {
     ILSetMsgEvent(RFC_Location_033_035);
     @CAN_PrivMain::RFC_Location_033_035::RFC_Location_033_035_ON_OFF = 0;
  }
}

void cfg_Msg_RFC_Location_033_035(dword aDlc, byte data[])
{
   int64 i,k;//For looping
   byte xor,data_byte;
   dword crcTemp;
   byte DataLength;
   dword Msg_id;
   
   DataLength = Msg_RFC_Location_033_035.DataLength;//Message Data Length
   Msg_id  = Msg_RFC_Location_033_035.id;//Message ID
   
    if (@CAN_PrivMain::RFC_Location_033_035::RFC_Loc033_035_AliveCtr_FaultInject != 3)//AC: user defined value
    {

    clearBitsInByteArrayLE(data,16,8); //Intel / little-endian

    }
    if (@CAN_PrivMain::RFC_Location_033_035::RFC_Loc033_035_AliveCtr_FaultInject == 0)//AC: No Error, calculate AC
    {
      ++counter_RFC_Location_033_035_RFC_Loc033_035_AliveCtr;
      counter_RFC_Location_033_035_RFC_Loc033_035_AliveCtr %=256;

      copyBitsToByteArrayLE(counter_RFC_Location_033_035_RFC_Loc033_035_AliveCtr,data,16,8); //Intel / little-endian;
    }
    else if (@CAN_PrivMain::RFC_Location_033_035::RFC_Loc033_035_AliveCtr_FaultInject == 1)//AC: Error sequence: set AC = 0
    {

      copyBitsToByteArrayLE(0,data,16,8); //Intel / little-endian;
    }
    else if (@CAN_PrivMain::RFC_Location_033_035::RFC_Loc033_035_AliveCtr_FaultInject == 2)//AC: Error sequence: Freeze last valid value
    {

      copyBitsToByteArrayLE(counter_RFC_Location_033_035_RFC_Loc033_035_AliveCtr,data,16,8); //Intel / little-endian;
    }
    if (@CAN_PrivMain::RFC_Location_033_035::RFC_Loc033_035_ProtBlockCtr_FaultInject != 3)//BC: user defined value
    {

    clearBitsInByteArrayLE(data,24,4); //Intel / little-endian

    }
    if (@CAN_PrivMain::RFC_Location_033_035::RFC_Loc033_035_ProtBlockCtr_FaultInject == 0)//BC: No Error, calculate BC
    {
      bc_RFC_Location_033_035_RFC_Loc033_035_ProtBlockCtr = bc_RFC_Location_ProtBlockCtr ;

      copyBitsToByteArrayLE(bc_RFC_Location_033_035_RFC_Loc033_035_ProtBlockCtr,data,24,4); //Intel / little-endian;
    }
    else if (@CAN_PrivMain::RFC_Location_033_035::RFC_Loc033_035_ProtBlockCtr_FaultInject == 1)//BC: Error sequence: set BC = 0
    {

      copyBitsToByteArrayLE(0,data,24,4); //Intel / little-endian;
    }
    else if (@CAN_PrivMain::RFC_Location_033_035::RFC_Loc033_035_ProtBlockCtr_FaultInject == 2)//BC: Error sequence: Freeze last valid value
    {

      copyBitsToByteArrayLE(bc_RFC_Location_033_035_RFC_Loc033_035_ProtBlockCtr,data,24,4); //Intel / little-endian;
    }
    if (@CAN_PrivMain::RFC_Location_033_035::RFC_Loc033_035_CRC_FaultInject != 3)//CRC: user defined value
    {

    clearBitsInByteArrayLE(data,0,16); //Intel / little-endian

    }
    if(@CAN_PrivMain::RFC_Location_033_035::RFC_Loc033_035_CRC_FaultInject == 0)//CRC: No Error, calculate CRC
    {
      crcTemp = CRC16_INIT;
      for(i = 2; i < (DataLength+2); i++)
      {
        if(i < DataLength)
          data_byte = data[i] ;
        else if(i == DataLength)
          data_byte = (0x2113 & 0x00FF);
        else if(i == (DataLength+1))
          data_byte = (0x2113 & 0xFF00) >> 8;
        else
          write("Error: DLC exceeded in CRC calculation");
        crcTemp ^= data_byte << 8;
        crcTemp = (crcTemp << (8)) ^ CRC16_CCITT_FALSE_POLY_1021H_Lookup[(crcTemp >> (8)) & (0xFF)];
      }
      crcTemp ^= CRC16_XOR;
      crc_RFC_Location_033_035_RFC_Loc033_035_CRC = crcTemp;

      copyBitsToByteArrayLE(crc_RFC_Location_033_035_RFC_Loc033_035_CRC,data,0,16); //Intel / little-endian;
    }
    else if(@CAN_PrivMain::RFC_Location_033_035::RFC_Loc033_035_CRC_FaultInject == 1)//CRC: Error, set to Zero
    {

      copyBitsToByteArrayLE(0,data,0,16); //Intel / little-endian;
    }
    else if(@CAN_PrivMain::RFC_Location_033_035::RFC_Loc033_035_CRC_FaultInject == 2)//CRC: Error, Freeze last valid value
    {

      copyBitsToByteArrayLE(crc_RFC_Location_033_035_RFC_Loc033_035_CRC,data,0,16); //Intel / little-endian;
    }
}


on sysvar CAN_PrivMain::RFC_Location_036_038::RFC_Location_036_038_ON_OFF
{
  if (@this == 1)
  {
     ILSetMsgEvent(RFC_Location_036_038);
     @CAN_PrivMain::RFC_Location_036_038::RFC_Location_036_038_ON_OFF = 0;
  }
}

void cfg_Msg_RFC_Location_036_038(dword aDlc, byte data[])
{
   int64 i,k;//For looping
   byte xor,data_byte;
   dword crcTemp;
   byte DataLength;
   dword Msg_id;
   
   DataLength = Msg_RFC_Location_036_038.DataLength;//Message Data Length
   Msg_id  = Msg_RFC_Location_036_038.id;//Message ID
   
    if (@CAN_PrivMain::RFC_Location_036_038::RFC_Loc036_038_AliveCtr_FaultInject != 3)//AC: user defined value
    {

    clearBitsInByteArrayLE(data,16,8); //Intel / little-endian

    }
    if (@CAN_PrivMain::RFC_Location_036_038::RFC_Loc036_038_AliveCtr_FaultInject == 0)//AC: No Error, calculate AC
    {
      ++counter_RFC_Location_036_038_RFC_Loc036_038_AliveCtr;
      counter_RFC_Location_036_038_RFC_Loc036_038_AliveCtr %=256;

      copyBitsToByteArrayLE(counter_RFC_Location_036_038_RFC_Loc036_038_AliveCtr,data,16,8); //Intel / little-endian;
    }
    else if (@CAN_PrivMain::RFC_Location_036_038::RFC_Loc036_038_AliveCtr_FaultInject == 1)//AC: Error sequence: set AC = 0
    {

      copyBitsToByteArrayLE(0,data,16,8); //Intel / little-endian;
    }
    else if (@CAN_PrivMain::RFC_Location_036_038::RFC_Loc036_038_AliveCtr_FaultInject == 2)//AC: Error sequence: Freeze last valid value
    {

      copyBitsToByteArrayLE(counter_RFC_Location_036_038_RFC_Loc036_038_AliveCtr,data,16,8); //Intel / little-endian;
    }
    if (@CAN_PrivMain::RFC_Location_036_038::RFC_Loc036_038_ProtBlockCtr_FaultInject != 3)//BC: user defined value
    {

    clearBitsInByteArrayLE(data,24,4); //Intel / little-endian

    }
    if (@CAN_PrivMain::RFC_Location_036_038::RFC_Loc036_038_ProtBlockCtr_FaultInject == 0)//BC: No Error, calculate BC
    {
      bc_RFC_Location_036_038_RFC_Loc036_038_ProtBlockCtr = bc_RFC_Location_ProtBlockCtr ;

      copyBitsToByteArrayLE(bc_RFC_Location_036_038_RFC_Loc036_038_ProtBlockCtr,data,24,4); //Intel / little-endian;
    }
    else if (@CAN_PrivMain::RFC_Location_036_038::RFC_Loc036_038_ProtBlockCtr_FaultInject == 1)//BC: Error sequence: set BC = 0
    {

      copyBitsToByteArrayLE(0,data,24,4); //Intel / little-endian;
    }
    else if (@CAN_PrivMain::RFC_Location_036_038::RFC_Loc036_038_ProtBlockCtr_FaultInject == 2)//BC: Error sequence: Freeze last valid value
    {

      copyBitsToByteArrayLE(bc_RFC_Location_036_038_RFC_Loc036_038_ProtBlockCtr,data,24,4); //Intel / little-endian;
    }
    if (@CAN_PrivMain::RFC_Location_036_038::RFC_Loc036_038_CRC_FaultInject != 3)//CRC: user defined value
    {

    clearBitsInByteArrayLE(data,0,16); //Intel / little-endian

    }
    if(@CAN_PrivMain::RFC_Location_036_038::RFC_Loc036_038_CRC_FaultInject == 0)//CRC: No Error, calculate CRC
    {
      crcTemp = CRC16_INIT;
      for(i = 2; i < (DataLength+2); i++)
      {
        if(i < DataLength)
          data_byte = data[i] ;
        else if(i == DataLength)
          data_byte = (0x2114 & 0x00FF);
        else if(i == (DataLength+1))
          data_byte = (0x2114 & 0xFF00) >> 8;
        else
          write("Error: DLC exceeded in CRC calculation");
        crcTemp ^= data_byte << 8;
        crcTemp = (crcTemp << (8)) ^ CRC16_CCITT_FALSE_POLY_1021H_Lookup[(crcTemp >> (8)) & (0xFF)];
      }
      crcTemp ^= CRC16_XOR;
      crc_RFC_Location_036_038_RFC_Loc036_038_CRC = crcTemp;

      copyBitsToByteArrayLE(crc_RFC_Location_036_038_RFC_Loc036_038_CRC,data,0,16); //Intel / little-endian;
    }
    else if(@CAN_PrivMain::RFC_Location_036_038::RFC_Loc036_038_CRC_FaultInject == 1)//CRC: Error, set to Zero
    {

      copyBitsToByteArrayLE(0,data,0,16); //Intel / little-endian;
    }
    else if(@CAN_PrivMain::RFC_Location_036_038::RFC_Loc036_038_CRC_FaultInject == 2)//CRC: Error, Freeze last valid value
    {

      copyBitsToByteArrayLE(crc_RFC_Location_036_038_RFC_Loc036_038_CRC,data,0,16); //Intel / little-endian;
    }
}


on sysvar CAN_PrivMain::RFC_Location_039_041::RFC_Location_039_041_ON_OFF
{
  if (@this == 1)
  {
     ILSetMsgEvent(RFC_Location_039_041);
     @CAN_PrivMain::RFC_Location_039_041::RFC_Location_039_041_ON_OFF = 0;
  }
}

void cfg_Msg_RFC_Location_039_041(dword aDlc, byte data[])
{
   int64 i,k;//For looping
   byte xor,data_byte;
   dword crcTemp;
   byte DataLength;
   dword Msg_id;
   
   DataLength = Msg_RFC_Location_039_041.DataLength;//Message Data Length
   Msg_id  = Msg_RFC_Location_039_041.id;//Message ID
   
    if (@CAN_PrivMain::RFC_Location_039_041::RFC_Loc039_041_AliveCtr_FaultInject != 3)//AC: user defined value
    {

    clearBitsInByteArrayLE(data,16,8); //Intel / little-endian

    }
    if (@CAN_PrivMain::RFC_Location_039_041::RFC_Loc039_041_AliveCtr_FaultInject == 0)//AC: No Error, calculate AC
    {
      ++counter_RFC_Location_039_041_RFC_Loc039_041_AliveCtr;
      counter_RFC_Location_039_041_RFC_Loc039_041_AliveCtr %=256;

      copyBitsToByteArrayLE(counter_RFC_Location_039_041_RFC_Loc039_041_AliveCtr,data,16,8); //Intel / little-endian;
    }
    else if (@CAN_PrivMain::RFC_Location_039_041::RFC_Loc039_041_AliveCtr_FaultInject == 1)//AC: Error sequence: set AC = 0
    {

      copyBitsToByteArrayLE(0,data,16,8); //Intel / little-endian;
    }
    else if (@CAN_PrivMain::RFC_Location_039_041::RFC_Loc039_041_AliveCtr_FaultInject == 2)//AC: Error sequence: Freeze last valid value
    {

      copyBitsToByteArrayLE(counter_RFC_Location_039_041_RFC_Loc039_041_AliveCtr,data,16,8); //Intel / little-endian;
    }
    if (@CAN_PrivMain::RFC_Location_039_041::RFC_Loc039_041_ProtBlockCtr_FaultInject != 3)//BC: user defined value
    {

    clearBitsInByteArrayLE(data,24,4); //Intel / little-endian

    }
    if (@CAN_PrivMain::RFC_Location_039_041::RFC_Loc039_041_ProtBlockCtr_FaultInject == 0)//BC: No Error, calculate BC
    {
      bc_RFC_Location_039_041_RFC_Loc039_041_ProtBlockCtr = bc_RFC_Location_ProtBlockCtr ;

      copyBitsToByteArrayLE(bc_RFC_Location_039_041_RFC_Loc039_041_ProtBlockCtr,data,24,4); //Intel / little-endian;
    }
    else if (@CAN_PrivMain::RFC_Location_039_041::RFC_Loc039_041_ProtBlockCtr_FaultInject == 1)//BC: Error sequence: set BC = 0
    {

      copyBitsToByteArrayLE(0,data,24,4); //Intel / little-endian;
    }
    else if (@CAN_PrivMain::RFC_Location_039_041::RFC_Loc039_041_ProtBlockCtr_FaultInject == 2)//BC: Error sequence: Freeze last valid value
    {

      copyBitsToByteArrayLE(bc_RFC_Location_039_041_RFC_Loc039_041_ProtBlockCtr,data,24,4); //Intel / little-endian;
    }
    if (@CAN_PrivMain::RFC_Location_039_041::RFC_Loc039_041_CRC_FaultInject != 3)//CRC: user defined value
    {

    clearBitsInByteArrayLE(data,0,16); //Intel / little-endian

    }
    if(@CAN_PrivMain::RFC_Location_039_041::RFC_Loc039_041_CRC_FaultInject == 0)//CRC: No Error, calculate CRC
    {
      crcTemp = CRC16_INIT;
      for(i = 2; i < (DataLength+2); i++)
      {
        if(i < DataLength)
          data_byte = data[i] ;
        else if(i == DataLength)
          data_byte = (0x2115 & 0x00FF);
        else if(i == (DataLength+1))
          data_byte = (0x2115 & 0xFF00) >> 8;
        else
          write("Error: DLC exceeded in CRC calculation");
        crcTemp ^= data_byte << 8;
        crcTemp = (crcTemp << (8)) ^ CRC16_CCITT_FALSE_POLY_1021H_Lookup[(crcTemp >> (8)) & (0xFF)];
      }
      crcTemp ^= CRC16_XOR;
      crc_RFC_Location_039_041_RFC_Loc039_041_CRC = crcTemp;

      copyBitsToByteArrayLE(crc_RFC_Location_039_041_RFC_Loc039_041_CRC,data,0,16); //Intel / little-endian;
    }
    else if(@CAN_PrivMain::RFC_Location_039_041::RFC_Loc039_041_CRC_FaultInject == 1)//CRC: Error, set to Zero
    {

      copyBitsToByteArrayLE(0,data,0,16); //Intel / little-endian;
    }
    else if(@CAN_PrivMain::RFC_Location_039_041::RFC_Loc039_041_CRC_FaultInject == 2)//CRC: Error, Freeze last valid value
    {

      copyBitsToByteArrayLE(crc_RFC_Location_039_041_RFC_Loc039_041_CRC,data,0,16); //Intel / little-endian;
    }
}


on sysvar CAN_PrivMain::RFC_Location_042_044::RFC_Location_042_044_ON_OFF
{
  if (@this == 1)
  {
     ILSetMsgEvent(RFC_Location_042_044);
     @CAN_PrivMain::RFC_Location_042_044::RFC_Location_042_044_ON_OFF = 0;
  }
}

void cfg_Msg_RFC_Location_042_044(dword aDlc, byte data[])
{
   int64 i,k;//For looping
   byte xor,data_byte;
   dword crcTemp;
   byte DataLength;
   dword Msg_id;
   
   DataLength = Msg_RFC_Location_042_044.DataLength;//Message Data Length
   Msg_id  = Msg_RFC_Location_042_044.id;//Message ID
   
    if (@CAN_PrivMain::RFC_Location_042_044::RFC_Loc042_044_AliveCtr_FaultInject != 3)//AC: user defined value
    {

    clearBitsInByteArrayLE(data,16,8); //Intel / little-endian

    }
    if (@CAN_PrivMain::RFC_Location_042_044::RFC_Loc042_044_AliveCtr_FaultInject == 0)//AC: No Error, calculate AC
    {
      ++counter_RFC_Location_042_044_RFC_Loc042_044_AliveCtr;
      counter_RFC_Location_042_044_RFC_Loc042_044_AliveCtr %=256;

      copyBitsToByteArrayLE(counter_RFC_Location_042_044_RFC_Loc042_044_AliveCtr,data,16,8); //Intel / little-endian;
    }
    else if (@CAN_PrivMain::RFC_Location_042_044::RFC_Loc042_044_AliveCtr_FaultInject == 1)//AC: Error sequence: set AC = 0
    {

      copyBitsToByteArrayLE(0,data,16,8); //Intel / little-endian;
    }
    else if (@CAN_PrivMain::RFC_Location_042_044::RFC_Loc042_044_AliveCtr_FaultInject == 2)//AC: Error sequence: Freeze last valid value
    {

      copyBitsToByteArrayLE(counter_RFC_Location_042_044_RFC_Loc042_044_AliveCtr,data,16,8); //Intel / little-endian;
    }
    if (@CAN_PrivMain::RFC_Location_042_044::RFC_Loc042_044_ProtBlockCtr_FaultInject != 3)//BC: user defined value
    {

    clearBitsInByteArrayLE(data,24,4); //Intel / little-endian

    }
    if (@CAN_PrivMain::RFC_Location_042_044::RFC_Loc042_044_ProtBlockCtr_FaultInject == 0)//BC: No Error, calculate BC
    {
      bc_RFC_Location_042_044_RFC_Loc042_044_ProtBlockCtr = bc_RFC_Location_ProtBlockCtr ;

      copyBitsToByteArrayLE(bc_RFC_Location_042_044_RFC_Loc042_044_ProtBlockCtr,data,24,4); //Intel / little-endian;
    }
    else if (@CAN_PrivMain::RFC_Location_042_044::RFC_Loc042_044_ProtBlockCtr_FaultInject == 1)//BC: Error sequence: set BC = 0
    {

      copyBitsToByteArrayLE(0,data,24,4); //Intel / little-endian;
    }
    else if (@CAN_PrivMain::RFC_Location_042_044::RFC_Loc042_044_ProtBlockCtr_FaultInject == 2)//BC: Error sequence: Freeze last valid value
    {

      copyBitsToByteArrayLE(bc_RFC_Location_042_044_RFC_Loc042_044_ProtBlockCtr,data,24,4); //Intel / little-endian;
    }
    if (@CAN_PrivMain::RFC_Location_042_044::RFC_Loc042_044_CRC_FaultInject != 3)//CRC: user defined value
    {

    clearBitsInByteArrayLE(data,0,16); //Intel / little-endian

    }
    if(@CAN_PrivMain::RFC_Location_042_044::RFC_Loc042_044_CRC_FaultInject == 0)//CRC: No Error, calculate CRC
    {
      crcTemp = CRC16_INIT;
      for(i = 2; i < (DataLength+2); i++)
      {
        if(i < DataLength)
          data_byte = data[i] ;
        else if(i == DataLength)
          data_byte = (0x2116 & 0x00FF);
        else if(i == (DataLength+1))
          data_byte = (0x2116 & 0xFF00) >> 8;
        else
          write("Error: DLC exceeded in CRC calculation");
        crcTemp ^= data_byte << 8;
        crcTemp = (crcTemp << (8)) ^ CRC16_CCITT_FALSE_POLY_1021H_Lookup[(crcTemp >> (8)) & (0xFF)];
      }
      crcTemp ^= CRC16_XOR;
      crc_RFC_Location_042_044_RFC_Loc042_044_CRC = crcTemp;

      copyBitsToByteArrayLE(crc_RFC_Location_042_044_RFC_Loc042_044_CRC,data,0,16); //Intel / little-endian;
    }
    else if(@CAN_PrivMain::RFC_Location_042_044::RFC_Loc042_044_CRC_FaultInject == 1)//CRC: Error, set to Zero
    {

      copyBitsToByteArrayLE(0,data,0,16); //Intel / little-endian;
    }
    else if(@CAN_PrivMain::RFC_Location_042_044::RFC_Loc042_044_CRC_FaultInject == 2)//CRC: Error, Freeze last valid value
    {

      copyBitsToByteArrayLE(crc_RFC_Location_042_044_RFC_Loc042_044_CRC,data,0,16); //Intel / little-endian;
    }
}


on sysvar CAN_PrivMain::RFC_Location_045_047::RFC_Location_045_047_ON_OFF
{
  if (@this == 1)
  {
     ILSetMsgEvent(RFC_Location_045_047);
     @CAN_PrivMain::RFC_Location_045_047::RFC_Location_045_047_ON_OFF = 0;
  }
}

void cfg_Msg_RFC_Location_045_047(dword aDlc, byte data[])
{
   int64 i,k;//For looping
   byte xor,data_byte;
   dword crcTemp;
   byte DataLength;
   dword Msg_id;
   
   DataLength = Msg_RFC_Location_045_047.DataLength;//Message Data Length
   Msg_id  = Msg_RFC_Location_045_047.id;//Message ID
   
    if (@CAN_PrivMain::RFC_Location_045_047::RFC_Loc045_047_AliveCtr_FaultInject != 3)//AC: user defined value
    {

    clearBitsInByteArrayLE(data,16,8); //Intel / little-endian

    }
    if (@CAN_PrivMain::RFC_Location_045_047::RFC_Loc045_047_AliveCtr_FaultInject == 0)//AC: No Error, calculate AC
    {
      ++counter_RFC_Location_045_047_RFC_Loc045_047_AliveCtr;
      counter_RFC_Location_045_047_RFC_Loc045_047_AliveCtr %=256;

      copyBitsToByteArrayLE(counter_RFC_Location_045_047_RFC_Loc045_047_AliveCtr,data,16,8); //Intel / little-endian;
    }
    else if (@CAN_PrivMain::RFC_Location_045_047::RFC_Loc045_047_AliveCtr_FaultInject == 1)//AC: Error sequence: set AC = 0
    {

      copyBitsToByteArrayLE(0,data,16,8); //Intel / little-endian;
    }
    else if (@CAN_PrivMain::RFC_Location_045_047::RFC_Loc045_047_AliveCtr_FaultInject == 2)//AC: Error sequence: Freeze last valid value
    {

      copyBitsToByteArrayLE(counter_RFC_Location_045_047_RFC_Loc045_047_AliveCtr,data,16,8); //Intel / little-endian;
    }
    if (@CAN_PrivMain::RFC_Location_045_047::RFC_Loc045_047_ProtBlockCtr_FaultInject != 3)//BC: user defined value
    {

    clearBitsInByteArrayLE(data,24,4); //Intel / little-endian

    }
    if (@CAN_PrivMain::RFC_Location_045_047::RFC_Loc045_047_ProtBlockCtr_FaultInject == 0)//BC: No Error, calculate BC
    {
      bc_RFC_Location_045_047_RFC_Loc045_047_ProtBlockCtr = bc_RFC_Location_ProtBlockCtr ;

      copyBitsToByteArrayLE(bc_RFC_Location_045_047_RFC_Loc045_047_ProtBlockCtr,data,24,4); //Intel / little-endian;
    }
    else if (@CAN_PrivMain::RFC_Location_045_047::RFC_Loc045_047_ProtBlockCtr_FaultInject == 1)//BC: Error sequence: set BC = 0
    {

      copyBitsToByteArrayLE(0,data,24,4); //Intel / little-endian;
    }
    else if (@CAN_PrivMain::RFC_Location_045_047::RFC_Loc045_047_ProtBlockCtr_FaultInject == 2)//BC: Error sequence: Freeze last valid value
    {

      copyBitsToByteArrayLE(bc_RFC_Location_045_047_RFC_Loc045_047_ProtBlockCtr,data,24,4); //Intel / little-endian;
    }
    if (@CAN_PrivMain::RFC_Location_045_047::RFC_Loc045_047_CRC_FaultInject != 3)//CRC: user defined value
    {

    clearBitsInByteArrayLE(data,0,16); //Intel / little-endian

    }
    if(@CAN_PrivMain::RFC_Location_045_047::RFC_Loc045_047_CRC_FaultInject == 0)//CRC: No Error, calculate CRC
    {
      crcTemp = CRC16_INIT;
      for(i = 2; i < (DataLength+2); i++)
      {
        if(i < DataLength)
          data_byte = data[i] ;
        else if(i == DataLength)
          data_byte = (0x2117 & 0x00FF);
        else if(i == (DataLength+1))
          data_byte = (0x2117 & 0xFF00) >> 8;
        else
          write("Error: DLC exceeded in CRC calculation");
        crcTemp ^= data_byte << 8;
        crcTemp = (crcTemp << (8)) ^ CRC16_CCITT_FALSE_POLY_1021H_Lookup[(crcTemp >> (8)) & (0xFF)];
      }
      crcTemp ^= CRC16_XOR;
      crc_RFC_Location_045_047_RFC_Loc045_047_CRC = crcTemp;

      copyBitsToByteArrayLE(crc_RFC_Location_045_047_RFC_Loc045_047_CRC,data,0,16); //Intel / little-endian;
    }
    else if(@CAN_PrivMain::RFC_Location_045_047::RFC_Loc045_047_CRC_FaultInject == 1)//CRC: Error, set to Zero
    {

      copyBitsToByteArrayLE(0,data,0,16); //Intel / little-endian;
    }
    else if(@CAN_PrivMain::RFC_Location_045_047::RFC_Loc045_047_CRC_FaultInject == 2)//CRC: Error, Freeze last valid value
    {

      copyBitsToByteArrayLE(crc_RFC_Location_045_047_RFC_Loc045_047_CRC,data,0,16); //Intel / little-endian;
    }
}


on sysvar CAN_PrivMain::RFC_Location_048_050::RFC_Location_048_050_ON_OFF
{
  if (@this == 1)
  {
     ILSetMsgEvent(RFC_Location_048_050);
     @CAN_PrivMain::RFC_Location_048_050::RFC_Location_048_050_ON_OFF = 0;
  }
}

void cfg_Msg_RFC_Location_048_050(dword aDlc, byte data[])
{
   int64 i,k;//For looping
   byte xor,data_byte;
   dword crcTemp;
   byte DataLength;
   dword Msg_id;
   
   DataLength = Msg_RFC_Location_048_050.DataLength;//Message Data Length
   Msg_id  = Msg_RFC_Location_048_050.id;//Message ID
   
    if (@CAN_PrivMain::RFC_Location_048_050::RFC_Loc048_050_AliveCtr_FaultInject != 3)//AC: user defined value
    {

    clearBitsInByteArrayLE(data,16,8); //Intel / little-endian

    }
    if (@CAN_PrivMain::RFC_Location_048_050::RFC_Loc048_050_AliveCtr_FaultInject == 0)//AC: No Error, calculate AC
    {
      ++counter_RFC_Location_048_050_RFC_Loc048_050_AliveCtr;
      counter_RFC_Location_048_050_RFC_Loc048_050_AliveCtr %=256;

      copyBitsToByteArrayLE(counter_RFC_Location_048_050_RFC_Loc048_050_AliveCtr,data,16,8); //Intel / little-endian;
    }
    else if (@CAN_PrivMain::RFC_Location_048_050::RFC_Loc048_050_AliveCtr_FaultInject == 1)//AC: Error sequence: set AC = 0
    {

      copyBitsToByteArrayLE(0,data,16,8); //Intel / little-endian;
    }
    else if (@CAN_PrivMain::RFC_Location_048_050::RFC_Loc048_050_AliveCtr_FaultInject == 2)//AC: Error sequence: Freeze last valid value
    {

      copyBitsToByteArrayLE(counter_RFC_Location_048_050_RFC_Loc048_050_AliveCtr,data,16,8); //Intel / little-endian;
    }
    if (@CAN_PrivMain::RFC_Location_048_050::RFC_Loc048_050_ProtBlockCtr_FaultInject != 3)//BC: user defined value
    {

    clearBitsInByteArrayLE(data,24,4); //Intel / little-endian

    }
    if (@CAN_PrivMain::RFC_Location_048_050::RFC_Loc048_050_ProtBlockCtr_FaultInject == 0)//BC: No Error, calculate BC
    {
      bc_RFC_Location_048_050_RFC_Loc048_050_ProtBlockCtr = bc_RFC_Location_ProtBlockCtr ;

      copyBitsToByteArrayLE(bc_RFC_Location_048_050_RFC_Loc048_050_ProtBlockCtr,data,24,4); //Intel / little-endian;
    }
    else if (@CAN_PrivMain::RFC_Location_048_050::RFC_Loc048_050_ProtBlockCtr_FaultInject == 1)//BC: Error sequence: set BC = 0
    {

      copyBitsToByteArrayLE(0,data,24,4); //Intel / little-endian;
    }
    else if (@CAN_PrivMain::RFC_Location_048_050::RFC_Loc048_050_ProtBlockCtr_FaultInject == 2)//BC: Error sequence: Freeze last valid value
    {

      copyBitsToByteArrayLE(bc_RFC_Location_048_050_RFC_Loc048_050_ProtBlockCtr,data,24,4); //Intel / little-endian;
    }
    if (@CAN_PrivMain::RFC_Location_048_050::RFC_Loc048_050_CRC_FaultInject != 3)//CRC: user defined value
    {

    clearBitsInByteArrayLE(data,0,16); //Intel / little-endian

    }
    if(@CAN_PrivMain::RFC_Location_048_050::RFC_Loc048_050_CRC_FaultInject == 0)//CRC: No Error, calculate CRC
    {
      crcTemp = CRC16_INIT;
      for(i = 2; i < (DataLength+2); i++)
      {
        if(i < DataLength)
          data_byte = data[i] ;
        else if(i == DataLength)
          data_byte = (0x2118 & 0x00FF);
        else if(i == (DataLength+1))
          data_byte = (0x2118 & 0xFF00) >> 8;
        else
          write("Error: DLC exceeded in CRC calculation");
        crcTemp ^= data_byte << 8;
        crcTemp = (crcTemp << (8)) ^ CRC16_CCITT_FALSE_POLY_1021H_Lookup[(crcTemp >> (8)) & (0xFF)];
      }
      crcTemp ^= CRC16_XOR;
      crc_RFC_Location_048_050_RFC_Loc048_050_CRC = crcTemp;

      copyBitsToByteArrayLE(crc_RFC_Location_048_050_RFC_Loc048_050_CRC,data,0,16); //Intel / little-endian;
    }
    else if(@CAN_PrivMain::RFC_Location_048_050::RFC_Loc048_050_CRC_FaultInject == 1)//CRC: Error, set to Zero
    {

      copyBitsToByteArrayLE(0,data,0,16); //Intel / little-endian;
    }
    else if(@CAN_PrivMain::RFC_Location_048_050::RFC_Loc048_050_CRC_FaultInject == 2)//CRC: Error, Freeze last valid value
    {

      copyBitsToByteArrayLE(crc_RFC_Location_048_050_RFC_Loc048_050_CRC,data,0,16); //Intel / little-endian;
    }
}


on sysvar CAN_PrivMain::RFC_Location_051_053::RFC_Location_051_053_ON_OFF
{
  if (@this == 1)
  {
     ILSetMsgEvent(RFC_Location_051_053);
     @CAN_PrivMain::RFC_Location_051_053::RFC_Location_051_053_ON_OFF = 0;
  }
}

void cfg_Msg_RFC_Location_051_053(dword aDlc, byte data[])
{
   int64 i,k;//For looping
   byte xor,data_byte;
   dword crcTemp;
   byte DataLength;
   dword Msg_id;
   
   DataLength = Msg_RFC_Location_051_053.DataLength;//Message Data Length
   Msg_id  = Msg_RFC_Location_051_053.id;//Message ID
   
    if (@CAN_PrivMain::RFC_Location_051_053::RFC_Loc051_053_AliveCtr_FaultInject != 3)//AC: user defined value
    {

    clearBitsInByteArrayLE(data,16,8); //Intel / little-endian

    }
    if (@CAN_PrivMain::RFC_Location_051_053::RFC_Loc051_053_AliveCtr_FaultInject == 0)//AC: No Error, calculate AC
    {
      ++counter_RFC_Location_051_053_RFC_Loc051_053_AliveCtr;
      counter_RFC_Location_051_053_RFC_Loc051_053_AliveCtr %=256;

      copyBitsToByteArrayLE(counter_RFC_Location_051_053_RFC_Loc051_053_AliveCtr,data,16,8); //Intel / little-endian;
    }
    else if (@CAN_PrivMain::RFC_Location_051_053::RFC_Loc051_053_AliveCtr_FaultInject == 1)//AC: Error sequence: set AC = 0
    {

      copyBitsToByteArrayLE(0,data,16,8); //Intel / little-endian;
    }
    else if (@CAN_PrivMain::RFC_Location_051_053::RFC_Loc051_053_AliveCtr_FaultInject == 2)//AC: Error sequence: Freeze last valid value
    {

      copyBitsToByteArrayLE(counter_RFC_Location_051_053_RFC_Loc051_053_AliveCtr,data,16,8); //Intel / little-endian;
    }
    if (@CAN_PrivMain::RFC_Location_051_053::RFC_Loc051_053_ProtBlockCtr_FaultInject != 3)//BC: user defined value
    {

    clearBitsInByteArrayLE(data,24,4); //Intel / little-endian

    }
    if (@CAN_PrivMain::RFC_Location_051_053::RFC_Loc051_053_ProtBlockCtr_FaultInject == 0)//BC: No Error, calculate BC
    {
      bc_RFC_Location_051_053_RFC_Loc051_053_ProtBlockCtr = bc_RFC_Location_ProtBlockCtr ;

      copyBitsToByteArrayLE(bc_RFC_Location_051_053_RFC_Loc051_053_ProtBlockCtr,data,24,4); //Intel / little-endian;
    }
    else if (@CAN_PrivMain::RFC_Location_051_053::RFC_Loc051_053_ProtBlockCtr_FaultInject == 1)//BC: Error sequence: set BC = 0
    {

      copyBitsToByteArrayLE(0,data,24,4); //Intel / little-endian;
    }
    else if (@CAN_PrivMain::RFC_Location_051_053::RFC_Loc051_053_ProtBlockCtr_FaultInject == 2)//BC: Error sequence: Freeze last valid value
    {

      copyBitsToByteArrayLE(bc_RFC_Location_051_053_RFC_Loc051_053_ProtBlockCtr,data,24,4); //Intel / little-endian;
    }
    if (@CAN_PrivMain::RFC_Location_051_053::RFC_Loc051_053_CRC_FaultInject != 3)//CRC: user defined value
    {

    clearBitsInByteArrayLE(data,0,16); //Intel / little-endian

    }
    if(@CAN_PrivMain::RFC_Location_051_053::RFC_Loc051_053_CRC_FaultInject == 0)//CRC: No Error, calculate CRC
    {
      crcTemp = CRC16_INIT;
      for(i = 2; i < (DataLength+2); i++)
      {
        if(i < DataLength)
          data_byte = data[i] ;
        else if(i == DataLength)
          data_byte = (0x2119 & 0x00FF);
        else if(i == (DataLength+1))
          data_byte = (0x2119 & 0xFF00) >> 8;
        else
          write("Error: DLC exceeded in CRC calculation");
        crcTemp ^= data_byte << 8;
        crcTemp = (crcTemp << (8)) ^ CRC16_CCITT_FALSE_POLY_1021H_Lookup[(crcTemp >> (8)) & (0xFF)];
      }
      crcTemp ^= CRC16_XOR;
      crc_RFC_Location_051_053_RFC_Loc051_053_CRC = crcTemp;

      copyBitsToByteArrayLE(crc_RFC_Location_051_053_RFC_Loc051_053_CRC,data,0,16); //Intel / little-endian;
    }
    else if(@CAN_PrivMain::RFC_Location_051_053::RFC_Loc051_053_CRC_FaultInject == 1)//CRC: Error, set to Zero
    {

      copyBitsToByteArrayLE(0,data,0,16); //Intel / little-endian;
    }
    else if(@CAN_PrivMain::RFC_Location_051_053::RFC_Loc051_053_CRC_FaultInject == 2)//CRC: Error, Freeze last valid value
    {

      copyBitsToByteArrayLE(crc_RFC_Location_051_053_RFC_Loc051_053_CRC,data,0,16); //Intel / little-endian;
    }
}


on sysvar CAN_PrivMain::RFC_Location_054_056::RFC_Location_054_056_ON_OFF
{
  if (@this == 1)
  {
     ILSetMsgEvent(RFC_Location_054_056);
     @CAN_PrivMain::RFC_Location_054_056::RFC_Location_054_056_ON_OFF = 0;
  }
}

void cfg_Msg_RFC_Location_054_056(dword aDlc, byte data[])
{
   int64 i,k;//For looping
   byte xor,data_byte;
   dword crcTemp;
   byte DataLength;
   dword Msg_id;
   
   DataLength = Msg_RFC_Location_054_056.DataLength;//Message Data Length
   Msg_id  = Msg_RFC_Location_054_056.id;//Message ID
   
    if (@CAN_PrivMain::RFC_Location_054_056::RFC_Loc054_056_AliveCtr_FaultInject != 3)//AC: user defined value
    {

    clearBitsInByteArrayLE(data,16,8); //Intel / little-endian

    }
    if (@CAN_PrivMain::RFC_Location_054_056::RFC_Loc054_056_AliveCtr_FaultInject == 0)//AC: No Error, calculate AC
    {
      ++counter_RFC_Location_054_056_RFC_Loc054_056_AliveCtr;
      counter_RFC_Location_054_056_RFC_Loc054_056_AliveCtr %=256;

      copyBitsToByteArrayLE(counter_RFC_Location_054_056_RFC_Loc054_056_AliveCtr,data,16,8); //Intel / little-endian;
    }
    else if (@CAN_PrivMain::RFC_Location_054_056::RFC_Loc054_056_AliveCtr_FaultInject == 1)//AC: Error sequence: set AC = 0
    {

      copyBitsToByteArrayLE(0,data,16,8); //Intel / little-endian;
    }
    else if (@CAN_PrivMain::RFC_Location_054_056::RFC_Loc054_056_AliveCtr_FaultInject == 2)//AC: Error sequence: Freeze last valid value
    {

      copyBitsToByteArrayLE(counter_RFC_Location_054_056_RFC_Loc054_056_AliveCtr,data,16,8); //Intel / little-endian;
    }
    if (@CAN_PrivMain::RFC_Location_054_056::RFC_Loc054_056_ProtBlockCtr_FaultInject != 3)//BC: user defined value
    {

    clearBitsInByteArrayLE(data,24,4); //Intel / little-endian

    }
    if (@CAN_PrivMain::RFC_Location_054_056::RFC_Loc054_056_ProtBlockCtr_FaultInject == 0)//BC: No Error, calculate BC
    {
      bc_RFC_Location_054_056_RFC_Loc054_056_ProtBlockCtr = bc_RFC_Location_ProtBlockCtr ;

      copyBitsToByteArrayLE(bc_RFC_Location_054_056_RFC_Loc054_056_ProtBlockCtr,data,24,4); //Intel / little-endian;
    }
    else if (@CAN_PrivMain::RFC_Location_054_056::RFC_Loc054_056_ProtBlockCtr_FaultInject == 1)//BC: Error sequence: set BC = 0
    {

      copyBitsToByteArrayLE(0,data,24,4); //Intel / little-endian;
    }
    else if (@CAN_PrivMain::RFC_Location_054_056::RFC_Loc054_056_ProtBlockCtr_FaultInject == 2)//BC: Error sequence: Freeze last valid value
    {

      copyBitsToByteArrayLE(bc_RFC_Location_054_056_RFC_Loc054_056_ProtBlockCtr,data,24,4); //Intel / little-endian;
    }
    if (@CAN_PrivMain::RFC_Location_054_056::RFC_Loc054_056_CRC_FaultInject != 3)//CRC: user defined value
    {

    clearBitsInByteArrayLE(data,0,16); //Intel / little-endian

    }
    if(@CAN_PrivMain::RFC_Location_054_056::RFC_Loc054_056_CRC_FaultInject == 0)//CRC: No Error, calculate CRC
    {
      crcTemp = CRC16_INIT;
      for(i = 2; i < (DataLength+2); i++)
      {
        if(i < DataLength)
          data_byte = data[i] ;
        else if(i == DataLength)
          data_byte = (0x211a & 0x00FF);
        else if(i == (DataLength+1))
          data_byte = (0x211a & 0xFF00) >> 8;
        else
          write("Error: DLC exceeded in CRC calculation");
        crcTemp ^= data_byte << 8;
        crcTemp = (crcTemp << (8)) ^ CRC16_CCITT_FALSE_POLY_1021H_Lookup[(crcTemp >> (8)) & (0xFF)];
      }
      crcTemp ^= CRC16_XOR;
      crc_RFC_Location_054_056_RFC_Loc054_056_CRC = crcTemp;

      copyBitsToByteArrayLE(crc_RFC_Location_054_056_RFC_Loc054_056_CRC,data,0,16); //Intel / little-endian;
    }
    else if(@CAN_PrivMain::RFC_Location_054_056::RFC_Loc054_056_CRC_FaultInject == 1)//CRC: Error, set to Zero
    {

      copyBitsToByteArrayLE(0,data,0,16); //Intel / little-endian;
    }
    else if(@CAN_PrivMain::RFC_Location_054_056::RFC_Loc054_056_CRC_FaultInject == 2)//CRC: Error, Freeze last valid value
    {

      copyBitsToByteArrayLE(crc_RFC_Location_054_056_RFC_Loc054_056_CRC,data,0,16); //Intel / little-endian;
    }
}


on sysvar CAN_PrivMain::RFC_Location_057_059::RFC_Location_057_059_ON_OFF
{
  if (@this == 1)
  {
     ILSetMsgEvent(RFC_Location_057_059);
     @CAN_PrivMain::RFC_Location_057_059::RFC_Location_057_059_ON_OFF = 0;
  }
}

void cfg_Msg_RFC_Location_057_059(dword aDlc, byte data[])
{
   int64 i,k;//For looping
   byte xor,data_byte;
   dword crcTemp;
   byte DataLength;
   dword Msg_id;
   
   DataLength = Msg_RFC_Location_057_059.DataLength;//Message Data Length
   Msg_id  = Msg_RFC_Location_057_059.id;//Message ID
   
    if (@CAN_PrivMain::RFC_Location_057_059::RFC_Loc057_059_AliveCtr_FaultInject != 3)//AC: user defined value
    {

    clearBitsInByteArrayLE(data,16,8); //Intel / little-endian

    }
    if (@CAN_PrivMain::RFC_Location_057_059::RFC_Loc057_059_AliveCtr_FaultInject == 0)//AC: No Error, calculate AC
    {
      ++counter_RFC_Location_057_059_RFC_Loc057_059_AliveCtr;
      counter_RFC_Location_057_059_RFC_Loc057_059_AliveCtr %=256;

      copyBitsToByteArrayLE(counter_RFC_Location_057_059_RFC_Loc057_059_AliveCtr,data,16,8); //Intel / little-endian;
    }
    else if (@CAN_PrivMain::RFC_Location_057_059::RFC_Loc057_059_AliveCtr_FaultInject == 1)//AC: Error sequence: set AC = 0
    {

      copyBitsToByteArrayLE(0,data,16,8); //Intel / little-endian;
    }
    else if (@CAN_PrivMain::RFC_Location_057_059::RFC_Loc057_059_AliveCtr_FaultInject == 2)//AC: Error sequence: Freeze last valid value
    {

      copyBitsToByteArrayLE(counter_RFC_Location_057_059_RFC_Loc057_059_AliveCtr,data,16,8); //Intel / little-endian;
    }
    if (@CAN_PrivMain::RFC_Location_057_059::RFC_Loc057_059_ProtBlockCtr_FaultInject != 3)//BC: user defined value
    {

    clearBitsInByteArrayLE(data,24,4); //Intel / little-endian

    }
    if (@CAN_PrivMain::RFC_Location_057_059::RFC_Loc057_059_ProtBlockCtr_FaultInject == 0)//BC: No Error, calculate BC
    {
      bc_RFC_Location_057_059_RFC_Loc057_059_ProtBlockCtr = bc_RFC_Location_ProtBlockCtr ;

      copyBitsToByteArrayLE(bc_RFC_Location_057_059_RFC_Loc057_059_ProtBlockCtr,data,24,4); //Intel / little-endian;
    }
    else if (@CAN_PrivMain::RFC_Location_057_059::RFC_Loc057_059_ProtBlockCtr_FaultInject == 1)//BC: Error sequence: set BC = 0
    {

      copyBitsToByteArrayLE(0,data,24,4); //Intel / little-endian;
    }
    else if (@CAN_PrivMain::RFC_Location_057_059::RFC_Loc057_059_ProtBlockCtr_FaultInject == 2)//BC: Error sequence: Freeze last valid value
    {

      copyBitsToByteArrayLE(bc_RFC_Location_057_059_RFC_Loc057_059_ProtBlockCtr,data,24,4); //Intel / little-endian;
    }
    if (@CAN_PrivMain::RFC_Location_057_059::RFC_Loc057_059_CRC_FaultInject != 3)//CRC: user defined value
    {

    clearBitsInByteArrayLE(data,0,16); //Intel / little-endian

    }
    if(@CAN_PrivMain::RFC_Location_057_059::RFC_Loc057_059_CRC_FaultInject == 0)//CRC: No Error, calculate CRC
    {
      crcTemp = CRC16_INIT;
      for(i = 2; i < (DataLength+2); i++)
      {
        if(i < DataLength)
          data_byte = data[i] ;
        else if(i == DataLength)
          data_byte = (0x211b & 0x00FF);
        else if(i == (DataLength+1))
          data_byte = (0x211b & 0xFF00) >> 8;
        else
          write("Error: DLC exceeded in CRC calculation");
        crcTemp ^= data_byte << 8;
        crcTemp = (crcTemp << (8)) ^ CRC16_CCITT_FALSE_POLY_1021H_Lookup[(crcTemp >> (8)) & (0xFF)];
      }
      crcTemp ^= CRC16_XOR;
      crc_RFC_Location_057_059_RFC_Loc057_059_CRC = crcTemp;

      copyBitsToByteArrayLE(crc_RFC_Location_057_059_RFC_Loc057_059_CRC,data,0,16); //Intel / little-endian;
    }
    else if(@CAN_PrivMain::RFC_Location_057_059::RFC_Loc057_059_CRC_FaultInject == 1)//CRC: Error, set to Zero
    {

      copyBitsToByteArrayLE(0,data,0,16); //Intel / little-endian;
    }
    else if(@CAN_PrivMain::RFC_Location_057_059::RFC_Loc057_059_CRC_FaultInject == 2)//CRC: Error, Freeze last valid value
    {

      copyBitsToByteArrayLE(crc_RFC_Location_057_059_RFC_Loc057_059_CRC,data,0,16); //Intel / little-endian;
    }
}


on sysvar CAN_PrivMain::RFC_Location_060_062::RFC_Location_060_062_ON_OFF
{
  if (@this == 1)
  {
     ILSetMsgEvent(RFC_Location_060_062);
     @CAN_PrivMain::RFC_Location_060_062::RFC_Location_060_062_ON_OFF = 0;
  }
}

void cfg_Msg_RFC_Location_060_062(dword aDlc, byte data[])
{
   int64 i,k;//For looping
   byte xor,data_byte;
   dword crcTemp;
   byte DataLength;
   dword Msg_id;
   
   DataLength = Msg_RFC_Location_060_062.DataLength;//Message Data Length
   Msg_id  = Msg_RFC_Location_060_062.id;//Message ID
   
    if (@CAN_PrivMain::RFC_Location_060_062::RFC_Loc060_062_AliveCtr_FaultInject != 3)//AC: user defined value
    {

    clearBitsInByteArrayLE(data,16,8); //Intel / little-endian

    }
    if (@CAN_PrivMain::RFC_Location_060_062::RFC_Loc060_062_AliveCtr_FaultInject == 0)//AC: No Error, calculate AC
    {
      ++counter_RFC_Location_060_062_RFC_Loc060_062_AliveCtr;
      counter_RFC_Location_060_062_RFC_Loc060_062_AliveCtr %=256;

      copyBitsToByteArrayLE(counter_RFC_Location_060_062_RFC_Loc060_062_AliveCtr,data,16,8); //Intel / little-endian;
    }
    else if (@CAN_PrivMain::RFC_Location_060_062::RFC_Loc060_062_AliveCtr_FaultInject == 1)//AC: Error sequence: set AC = 0
    {

      copyBitsToByteArrayLE(0,data,16,8); //Intel / little-endian;
    }
    else if (@CAN_PrivMain::RFC_Location_060_062::RFC_Loc060_062_AliveCtr_FaultInject == 2)//AC: Error sequence: Freeze last valid value
    {

      copyBitsToByteArrayLE(counter_RFC_Location_060_062_RFC_Loc060_062_AliveCtr,data,16,8); //Intel / little-endian;
    }
    if (@CAN_PrivMain::RFC_Location_060_062::RFC_Loc060_062_ProtBlockCtr_FaultInject != 3)//BC: user defined value
    {

    clearBitsInByteArrayLE(data,24,4); //Intel / little-endian

    }
    if (@CAN_PrivMain::RFC_Location_060_062::RFC_Loc060_062_ProtBlockCtr_FaultInject == 0)//BC: No Error, calculate BC
    {
      bc_RFC_Location_060_062_RFC_Loc060_062_ProtBlockCtr = bc_RFC_Location_ProtBlockCtr ;

      copyBitsToByteArrayLE(bc_RFC_Location_060_062_RFC_Loc060_062_ProtBlockCtr,data,24,4); //Intel / little-endian;
    }
    else if (@CAN_PrivMain::RFC_Location_060_062::RFC_Loc060_062_ProtBlockCtr_FaultInject == 1)//BC: Error sequence: set BC = 0
    {

      copyBitsToByteArrayLE(0,data,24,4); //Intel / little-endian;
    }
    else if (@CAN_PrivMain::RFC_Location_060_062::RFC_Loc060_062_ProtBlockCtr_FaultInject == 2)//BC: Error sequence: Freeze last valid value
    {

      copyBitsToByteArrayLE(bc_RFC_Location_060_062_RFC_Loc060_062_ProtBlockCtr,data,24,4); //Intel / little-endian;
    }
    if (@CAN_PrivMain::RFC_Location_060_062::RFC_Loc060_062_CRC_FaultInject != 3)//CRC: user defined value
    {

    clearBitsInByteArrayLE(data,0,16); //Intel / little-endian

    }
    if(@CAN_PrivMain::RFC_Location_060_062::RFC_Loc060_062_CRC_FaultInject == 0)//CRC: No Error, calculate CRC
    {
      crcTemp = CRC16_INIT;
      for(i = 2; i < (DataLength+2); i++)
      {
        if(i < DataLength)
          data_byte = data[i] ;
        else if(i == DataLength)
          data_byte = (0x211c & 0x00FF);
        else if(i == (DataLength+1))
          data_byte = (0x211c & 0xFF00) >> 8;
        else
          write("Error: DLC exceeded in CRC calculation");
        crcTemp ^= data_byte << 8;
        crcTemp = (crcTemp << (8)) ^ CRC16_CCITT_FALSE_POLY_1021H_Lookup[(crcTemp >> (8)) & (0xFF)];
      }
      crcTemp ^= CRC16_XOR;
      crc_RFC_Location_060_062_RFC_Loc060_062_CRC = crcTemp;

      copyBitsToByteArrayLE(crc_RFC_Location_060_062_RFC_Loc060_062_CRC,data,0,16); //Intel / little-endian;
    }
    else if(@CAN_PrivMain::RFC_Location_060_062::RFC_Loc060_062_CRC_FaultInject == 1)//CRC: Error, set to Zero
    {

      copyBitsToByteArrayLE(0,data,0,16); //Intel / little-endian;
    }
    else if(@CAN_PrivMain::RFC_Location_060_062::RFC_Loc060_062_CRC_FaultInject == 2)//CRC: Error, Freeze last valid value
    {

      copyBitsToByteArrayLE(crc_RFC_Location_060_062_RFC_Loc060_062_CRC,data,0,16); //Intel / little-endian;
    }
}


on sysvar CAN_PrivMain::RFC_Location_063_065::RFC_Location_063_065_ON_OFF
{
  if (@this == 1)
  {
     ILSetMsgEvent(RFC_Location_063_065);
     @CAN_PrivMain::RFC_Location_063_065::RFC_Location_063_065_ON_OFF = 0;
  }
}

void cfg_Msg_RFC_Location_063_065(dword aDlc, byte data[])
{
   int64 i,k;//For looping
   byte xor,data_byte;
   dword crcTemp;
   byte DataLength;
   dword Msg_id;
   
   DataLength = Msg_RFC_Location_063_065.DataLength;//Message Data Length
   Msg_id  = Msg_RFC_Location_063_065.id;//Message ID
   
    if (@CAN_PrivMain::RFC_Location_063_065::RFC_Loc063_065_AliveCtr_FaultInject != 3)//AC: user defined value
    {

    clearBitsInByteArrayLE(data,16,8); //Intel / little-endian

    }
    if (@CAN_PrivMain::RFC_Location_063_065::RFC_Loc063_065_AliveCtr_FaultInject == 0)//AC: No Error, calculate AC
    {
      ++counter_RFC_Location_063_065_RFC_Loc063_065_AliveCtr;
      counter_RFC_Location_063_065_RFC_Loc063_065_AliveCtr %=256;

      copyBitsToByteArrayLE(counter_RFC_Location_063_065_RFC_Loc063_065_AliveCtr,data,16,8); //Intel / little-endian;
    }
    else if (@CAN_PrivMain::RFC_Location_063_065::RFC_Loc063_065_AliveCtr_FaultInject == 1)//AC: Error sequence: set AC = 0
    {

      copyBitsToByteArrayLE(0,data,16,8); //Intel / little-endian;
    }
    else if (@CAN_PrivMain::RFC_Location_063_065::RFC_Loc063_065_AliveCtr_FaultInject == 2)//AC: Error sequence: Freeze last valid value
    {

      copyBitsToByteArrayLE(counter_RFC_Location_063_065_RFC_Loc063_065_AliveCtr,data,16,8); //Intel / little-endian;
    }
    if (@CAN_PrivMain::RFC_Location_063_065::RFC_Loc063_065_ProtBlockCtr_FaultInject != 3)//BC: user defined value
    {

    clearBitsInByteArrayLE(data,24,4); //Intel / little-endian

    }
    if (@CAN_PrivMain::RFC_Location_063_065::RFC_Loc063_065_ProtBlockCtr_FaultInject == 0)//BC: No Error, calculate BC
    {
      bc_RFC_Location_063_065_RFC_Loc063_065_ProtBlockCtr = bc_RFC_Location_ProtBlockCtr ;

      copyBitsToByteArrayLE(bc_RFC_Location_063_065_RFC_Loc063_065_ProtBlockCtr,data,24,4); //Intel / little-endian;
    }
    else if (@CAN_PrivMain::RFC_Location_063_065::RFC_Loc063_065_ProtBlockCtr_FaultInject == 1)//BC: Error sequence: set BC = 0
    {

      copyBitsToByteArrayLE(0,data,24,4); //Intel / little-endian;
    }
    else if (@CAN_PrivMain::RFC_Location_063_065::RFC_Loc063_065_ProtBlockCtr_FaultInject == 2)//BC: Error sequence: Freeze last valid value
    {

      copyBitsToByteArrayLE(bc_RFC_Location_063_065_RFC_Loc063_065_ProtBlockCtr,data,24,4); //Intel / little-endian;
    }
    if (@CAN_PrivMain::RFC_Location_063_065::RFC_Loc063_065_CRC_FaultInject != 3)//CRC: user defined value
    {

    clearBitsInByteArrayLE(data,0,16); //Intel / little-endian

    }
    if(@CAN_PrivMain::RFC_Location_063_065::RFC_Loc063_065_CRC_FaultInject == 0)//CRC: No Error, calculate CRC
    {
      crcTemp = CRC16_INIT;
      for(i = 2; i < (DataLength+2); i++)
      {
        if(i < DataLength)
          data_byte = data[i] ;
        else if(i == DataLength)
          data_byte = (0x211d & 0x00FF);
        else if(i == (DataLength+1))
          data_byte = (0x211d & 0xFF00) >> 8;
        else
          write("Error: DLC exceeded in CRC calculation");
        crcTemp ^= data_byte << 8;
        crcTemp = (crcTemp << (8)) ^ CRC16_CCITT_FALSE_POLY_1021H_Lookup[(crcTemp >> (8)) & (0xFF)];
      }
      crcTemp ^= CRC16_XOR;
      crc_RFC_Location_063_065_RFC_Loc063_065_CRC = crcTemp;

      copyBitsToByteArrayLE(crc_RFC_Location_063_065_RFC_Loc063_065_CRC,data,0,16); //Intel / little-endian;
    }
    else if(@CAN_PrivMain::RFC_Location_063_065::RFC_Loc063_065_CRC_FaultInject == 1)//CRC: Error, set to Zero
    {

      copyBitsToByteArrayLE(0,data,0,16); //Intel / little-endian;
    }
    else if(@CAN_PrivMain::RFC_Location_063_065::RFC_Loc063_065_CRC_FaultInject == 2)//CRC: Error, Freeze last valid value
    {

      copyBitsToByteArrayLE(crc_RFC_Location_063_065_RFC_Loc063_065_CRC,data,0,16); //Intel / little-endian;
    }
}


on sysvar CAN_PrivMain::RFC_Location_066_068::RFC_Location_066_068_ON_OFF
{
  if (@this == 1)
  {
     ILSetMsgEvent(RFC_Location_066_068);
     @CAN_PrivMain::RFC_Location_066_068::RFC_Location_066_068_ON_OFF = 0;
  }
}

void cfg_Msg_RFC_Location_066_068(dword aDlc, byte data[])
{
   int64 i,k;//For looping
   byte xor,data_byte;
   dword crcTemp;
   byte DataLength;
   dword Msg_id;
   
   DataLength = Msg_RFC_Location_066_068.DataLength;//Message Data Length
   Msg_id  = Msg_RFC_Location_066_068.id;//Message ID
   
    if (@CAN_PrivMain::RFC_Location_066_068::RFC_Loc066_068_AliveCtr_FaultInject != 3)//AC: user defined value
    {

    clearBitsInByteArrayLE(data,16,8); //Intel / little-endian

    }
    if (@CAN_PrivMain::RFC_Location_066_068::RFC_Loc066_068_AliveCtr_FaultInject == 0)//AC: No Error, calculate AC
    {
      ++counter_RFC_Location_066_068_RFC_Loc066_068_AliveCtr;
      counter_RFC_Location_066_068_RFC_Loc066_068_AliveCtr %=256;

      copyBitsToByteArrayLE(counter_RFC_Location_066_068_RFC_Loc066_068_AliveCtr,data,16,8); //Intel / little-endian;
    }
    else if (@CAN_PrivMain::RFC_Location_066_068::RFC_Loc066_068_AliveCtr_FaultInject == 1)//AC: Error sequence: set AC = 0
    {

      copyBitsToByteArrayLE(0,data,16,8); //Intel / little-endian;
    }
    else if (@CAN_PrivMain::RFC_Location_066_068::RFC_Loc066_068_AliveCtr_FaultInject == 2)//AC: Error sequence: Freeze last valid value
    {

      copyBitsToByteArrayLE(counter_RFC_Location_066_068_RFC_Loc066_068_AliveCtr,data,16,8); //Intel / little-endian;
    }
    if (@CAN_PrivMain::RFC_Location_066_068::RFC_Loc066_068_ProtBlockCtr_FaultInject != 3)//BC: user defined value
    {

    clearBitsInByteArrayLE(data,24,4); //Intel / little-endian

    }
    if (@CAN_PrivMain::RFC_Location_066_068::RFC_Loc066_068_ProtBlockCtr_FaultInject == 0)//BC: No Error, calculate BC
    {
      bc_RFC_Location_066_068_RFC_Loc066_068_ProtBlockCtr = bc_RFC_Location_ProtBlockCtr ;

      copyBitsToByteArrayLE(bc_RFC_Location_066_068_RFC_Loc066_068_ProtBlockCtr,data,24,4); //Intel / little-endian;
    }
    else if (@CAN_PrivMain::RFC_Location_066_068::RFC_Loc066_068_ProtBlockCtr_FaultInject == 1)//BC: Error sequence: set BC = 0
    {

      copyBitsToByteArrayLE(0,data,24,4); //Intel / little-endian;
    }
    else if (@CAN_PrivMain::RFC_Location_066_068::RFC_Loc066_068_ProtBlockCtr_FaultInject == 2)//BC: Error sequence: Freeze last valid value
    {

      copyBitsToByteArrayLE(bc_RFC_Location_066_068_RFC_Loc066_068_ProtBlockCtr,data,24,4); //Intel / little-endian;
    }
    if (@CAN_PrivMain::RFC_Location_066_068::RFC_Loc066_068_CRC_FaultInject != 3)//CRC: user defined value
    {

    clearBitsInByteArrayLE(data,0,16); //Intel / little-endian

    }
    if(@CAN_PrivMain::RFC_Location_066_068::RFC_Loc066_068_CRC_FaultInject == 0)//CRC: No Error, calculate CRC
    {
      crcTemp = CRC16_INIT;
      for(i = 2; i < (DataLength+2); i++)
      {
        if(i < DataLength)
          data_byte = data[i] ;
        else if(i == DataLength)
          data_byte = (0x211e & 0x00FF);
        else if(i == (DataLength+1))
          data_byte = (0x211e & 0xFF00) >> 8;
        else
          write("Error: DLC exceeded in CRC calculation");
        crcTemp ^= data_byte << 8;
        crcTemp = (crcTemp << (8)) ^ CRC16_CCITT_FALSE_POLY_1021H_Lookup[(crcTemp >> (8)) & (0xFF)];
      }
      crcTemp ^= CRC16_XOR;
      crc_RFC_Location_066_068_RFC_Loc066_068_CRC = crcTemp;

      copyBitsToByteArrayLE(crc_RFC_Location_066_068_RFC_Loc066_068_CRC,data,0,16); //Intel / little-endian;
    }
    else if(@CAN_PrivMain::RFC_Location_066_068::RFC_Loc066_068_CRC_FaultInject == 1)//CRC: Error, set to Zero
    {

      copyBitsToByteArrayLE(0,data,0,16); //Intel / little-endian;
    }
    else if(@CAN_PrivMain::RFC_Location_066_068::RFC_Loc066_068_CRC_FaultInject == 2)//CRC: Error, Freeze last valid value
    {

      copyBitsToByteArrayLE(crc_RFC_Location_066_068_RFC_Loc066_068_CRC,data,0,16); //Intel / little-endian;
    }
}


on sysvar CAN_PrivMain::RFC_Location_069_071::RFC_Location_069_071_ON_OFF
{
  if (@this == 1)
  {
     ILSetMsgEvent(RFC_Location_069_071);
     @CAN_PrivMain::RFC_Location_069_071::RFC_Location_069_071_ON_OFF = 0;
  }
}

void cfg_Msg_RFC_Location_069_071(dword aDlc, byte data[])
{
   int64 i,k;//For looping
   byte xor,data_byte;
   dword crcTemp;
   byte DataLength;
   dword Msg_id;
   
   DataLength = Msg_RFC_Location_069_071.DataLength;//Message Data Length
   Msg_id  = Msg_RFC_Location_069_071.id;//Message ID
   
    if (@CAN_PrivMain::RFC_Location_069_071::RFC_Loc069_071_AliveCtr_FaultInject != 3)//AC: user defined value
    {

    clearBitsInByteArrayLE(data,16,8); //Intel / little-endian

    }
    if (@CAN_PrivMain::RFC_Location_069_071::RFC_Loc069_071_AliveCtr_FaultInject == 0)//AC: No Error, calculate AC
    {
      ++counter_RFC_Location_069_071_RFC_Loc069_071_AliveCtr;
      counter_RFC_Location_069_071_RFC_Loc069_071_AliveCtr %=256;

      copyBitsToByteArrayLE(counter_RFC_Location_069_071_RFC_Loc069_071_AliveCtr,data,16,8); //Intel / little-endian;
    }
    else if (@CAN_PrivMain::RFC_Location_069_071::RFC_Loc069_071_AliveCtr_FaultInject == 1)//AC: Error sequence: set AC = 0
    {

      copyBitsToByteArrayLE(0,data,16,8); //Intel / little-endian;
    }
    else if (@CAN_PrivMain::RFC_Location_069_071::RFC_Loc069_071_AliveCtr_FaultInject == 2)//AC: Error sequence: Freeze last valid value
    {

      copyBitsToByteArrayLE(counter_RFC_Location_069_071_RFC_Loc069_071_AliveCtr,data,16,8); //Intel / little-endian;
    }
    if (@CAN_PrivMain::RFC_Location_069_071::RFC_Loc069_071_ProtBlockCtr_FaultInject != 3)//BC: user defined value
    {

    clearBitsInByteArrayLE(data,24,4); //Intel / little-endian

    }
    if (@CAN_PrivMain::RFC_Location_069_071::RFC_Loc069_071_ProtBlockCtr_FaultInject == 0)//BC: No Error, calculate BC
    {
      bc_RFC_Location_069_071_RFC_Loc069_071_ProtBlockCtr = bc_RFC_Location_ProtBlockCtr ;

      copyBitsToByteArrayLE(bc_RFC_Location_069_071_RFC_Loc069_071_ProtBlockCtr,data,24,4); //Intel / little-endian;
    }
    else if (@CAN_PrivMain::RFC_Location_069_071::RFC_Loc069_071_ProtBlockCtr_FaultInject == 1)//BC: Error sequence: set BC = 0
    {

      copyBitsToByteArrayLE(0,data,24,4); //Intel / little-endian;
    }
    else if (@CAN_PrivMain::RFC_Location_069_071::RFC_Loc069_071_ProtBlockCtr_FaultInject == 2)//BC: Error sequence: Freeze last valid value
    {

      copyBitsToByteArrayLE(bc_RFC_Location_069_071_RFC_Loc069_071_ProtBlockCtr,data,24,4); //Intel / little-endian;
    }
    if (@CAN_PrivMain::RFC_Location_069_071::RFC_Loc069_071_CRC_FaultInject != 3)//CRC: user defined value
    {

    clearBitsInByteArrayLE(data,0,16); //Intel / little-endian

    }
    if(@CAN_PrivMain::RFC_Location_069_071::RFC_Loc069_071_CRC_FaultInject == 0)//CRC: No Error, calculate CRC
    {
      crcTemp = CRC16_INIT;
      for(i = 2; i < (DataLength+2); i++)
      {
        if(i < DataLength)
          data_byte = data[i] ;
        else if(i == DataLength)
          data_byte = (0x211f & 0x00FF);
        else if(i == (DataLength+1))
          data_byte = (0x211f & 0xFF00) >> 8;
        else
          write("Error: DLC exceeded in CRC calculation");
        crcTemp ^= data_byte << 8;
        crcTemp = (crcTemp << (8)) ^ CRC16_CCITT_FALSE_POLY_1021H_Lookup[(crcTemp >> (8)) & (0xFF)];
      }
      crcTemp ^= CRC16_XOR;
      crc_RFC_Location_069_071_RFC_Loc069_071_CRC = crcTemp;

      copyBitsToByteArrayLE(crc_RFC_Location_069_071_RFC_Loc069_071_CRC,data,0,16); //Intel / little-endian;
    }
    else if(@CAN_PrivMain::RFC_Location_069_071::RFC_Loc069_071_CRC_FaultInject == 1)//CRC: Error, set to Zero
    {

      copyBitsToByteArrayLE(0,data,0,16); //Intel / little-endian;
    }
    else if(@CAN_PrivMain::RFC_Location_069_071::RFC_Loc069_071_CRC_FaultInject == 2)//CRC: Error, Freeze last valid value
    {

      copyBitsToByteArrayLE(crc_RFC_Location_069_071_RFC_Loc069_071_CRC,data,0,16); //Intel / little-endian;
    }
}


on sysvar CAN_PrivMain::RFC_Location_072_074::RFC_Location_072_074_ON_OFF
{
  if (@this == 1)
  {
     ILSetMsgEvent(RFC_Location_072_074);
     @CAN_PrivMain::RFC_Location_072_074::RFC_Location_072_074_ON_OFF = 0;
  }
}

void cfg_Msg_RFC_Location_072_074(dword aDlc, byte data[])
{
   int64 i,k;//For looping
   byte xor,data_byte;
   dword crcTemp;
   byte DataLength;
   dword Msg_id;
   
   DataLength = Msg_RFC_Location_072_074.DataLength;//Message Data Length
   Msg_id  = Msg_RFC_Location_072_074.id;//Message ID
   
    if (@CAN_PrivMain::RFC_Location_072_074::RFC_Loc072_074_AliveCtr_FaultInject != 3)//AC: user defined value
    {

    clearBitsInByteArrayLE(data,16,8); //Intel / little-endian

    }
    if (@CAN_PrivMain::RFC_Location_072_074::RFC_Loc072_074_AliveCtr_FaultInject == 0)//AC: No Error, calculate AC
    {
      ++counter_RFC_Location_072_074_RFC_Loc072_074_AliveCtr;
      counter_RFC_Location_072_074_RFC_Loc072_074_AliveCtr %=256;

      copyBitsToByteArrayLE(counter_RFC_Location_072_074_RFC_Loc072_074_AliveCtr,data,16,8); //Intel / little-endian;
    }
    else if (@CAN_PrivMain::RFC_Location_072_074::RFC_Loc072_074_AliveCtr_FaultInject == 1)//AC: Error sequence: set AC = 0
    {

      copyBitsToByteArrayLE(0,data,16,8); //Intel / little-endian;
    }
    else if (@CAN_PrivMain::RFC_Location_072_074::RFC_Loc072_074_AliveCtr_FaultInject == 2)//AC: Error sequence: Freeze last valid value
    {

      copyBitsToByteArrayLE(counter_RFC_Location_072_074_RFC_Loc072_074_AliveCtr,data,16,8); //Intel / little-endian;
    }
    if (@CAN_PrivMain::RFC_Location_072_074::RFC_Loc072_074_ProtBlockCtr_FaultInject != 3)//BC: user defined value
    {

    clearBitsInByteArrayLE(data,24,4); //Intel / little-endian

    }
    if (@CAN_PrivMain::RFC_Location_072_074::RFC_Loc072_074_ProtBlockCtr_FaultInject == 0)//BC: No Error, calculate BC
    {
      bc_RFC_Location_072_074_RFC_Loc072_074_ProtBlockCtr = bc_RFC_Location_ProtBlockCtr ;

      copyBitsToByteArrayLE(bc_RFC_Location_072_074_RFC_Loc072_074_ProtBlockCtr,data,24,4); //Intel / little-endian;
    }
    else if (@CAN_PrivMain::RFC_Location_072_074::RFC_Loc072_074_ProtBlockCtr_FaultInject == 1)//BC: Error sequence: set BC = 0
    {

      copyBitsToByteArrayLE(0,data,24,4); //Intel / little-endian;
    }
    else if (@CAN_PrivMain::RFC_Location_072_074::RFC_Loc072_074_ProtBlockCtr_FaultInject == 2)//BC: Error sequence: Freeze last valid value
    {

      copyBitsToByteArrayLE(bc_RFC_Location_072_074_RFC_Loc072_074_ProtBlockCtr,data,24,4); //Intel / little-endian;
    }
    if (@CAN_PrivMain::RFC_Location_072_074::RFC_Loc072_074_CRC_FaultInject != 3)//CRC: user defined value
    {

    clearBitsInByteArrayLE(data,0,16); //Intel / little-endian

    }
    if(@CAN_PrivMain::RFC_Location_072_074::RFC_Loc072_074_CRC_FaultInject == 0)//CRC: No Error, calculate CRC
    {
      crcTemp = CRC16_INIT;
      for(i = 2; i < (DataLength+2); i++)
      {
        if(i < DataLength)
          data_byte = data[i] ;
        else if(i == DataLength)
          data_byte = (0x2120 & 0x00FF);
        else if(i == (DataLength+1))
          data_byte = (0x2120 & 0xFF00) >> 8;
        else
          write("Error: DLC exceeded in CRC calculation");
        crcTemp ^= data_byte << 8;
        crcTemp = (crcTemp << (8)) ^ CRC16_CCITT_FALSE_POLY_1021H_Lookup[(crcTemp >> (8)) & (0xFF)];
      }
      crcTemp ^= CRC16_XOR;
      crc_RFC_Location_072_074_RFC_Loc072_074_CRC = crcTemp;

      copyBitsToByteArrayLE(crc_RFC_Location_072_074_RFC_Loc072_074_CRC,data,0,16); //Intel / little-endian;
    }
    else if(@CAN_PrivMain::RFC_Location_072_074::RFC_Loc072_074_CRC_FaultInject == 1)//CRC: Error, set to Zero
    {

      copyBitsToByteArrayLE(0,data,0,16); //Intel / little-endian;
    }
    else if(@CAN_PrivMain::RFC_Location_072_074::RFC_Loc072_074_CRC_FaultInject == 2)//CRC: Error, Freeze last valid value
    {

      copyBitsToByteArrayLE(crc_RFC_Location_072_074_RFC_Loc072_074_CRC,data,0,16); //Intel / little-endian;
    }
}


on sysvar CAN_PrivMain::RFC_Location_075_077::RFC_Location_075_077_ON_OFF
{
  if (@this == 1)
  {
     ILSetMsgEvent(RFC_Location_075_077);
     @CAN_PrivMain::RFC_Location_075_077::RFC_Location_075_077_ON_OFF = 0;
  }
}

void cfg_Msg_RFC_Location_075_077(dword aDlc, byte data[])
{
   int64 i,k;//For looping
   byte xor,data_byte;
   dword crcTemp;
   byte DataLength;
   dword Msg_id;
   
   DataLength = Msg_RFC_Location_075_077.DataLength;//Message Data Length
   Msg_id  = Msg_RFC_Location_075_077.id;//Message ID
   
    if (@CAN_PrivMain::RFC_Location_075_077::RFC_Loc075_077_AliveCtr_FaultInject != 3)//AC: user defined value
    {

    clearBitsInByteArrayLE(data,16,8); //Intel / little-endian

    }
    if (@CAN_PrivMain::RFC_Location_075_077::RFC_Loc075_077_AliveCtr_FaultInject == 0)//AC: No Error, calculate AC
    {
      ++counter_RFC_Location_075_077_RFC_Loc075_077_AliveCtr;
      counter_RFC_Location_075_077_RFC_Loc075_077_AliveCtr %=256;

      copyBitsToByteArrayLE(counter_RFC_Location_075_077_RFC_Loc075_077_AliveCtr,data,16,8); //Intel / little-endian;
    }
    else if (@CAN_PrivMain::RFC_Location_075_077::RFC_Loc075_077_AliveCtr_FaultInject == 1)//AC: Error sequence: set AC = 0
    {

      copyBitsToByteArrayLE(0,data,16,8); //Intel / little-endian;
    }
    else if (@CAN_PrivMain::RFC_Location_075_077::RFC_Loc075_077_AliveCtr_FaultInject == 2)//AC: Error sequence: Freeze last valid value
    {

      copyBitsToByteArrayLE(counter_RFC_Location_075_077_RFC_Loc075_077_AliveCtr,data,16,8); //Intel / little-endian;
    }
    if (@CAN_PrivMain::RFC_Location_075_077::RFC_Loc075_077_ProtBlockCtr_FaultInject != 3)//BC: user defined value
    {

    clearBitsInByteArrayLE(data,24,4); //Intel / little-endian

    }
    if (@CAN_PrivMain::RFC_Location_075_077::RFC_Loc075_077_ProtBlockCtr_FaultInject == 0)//BC: No Error, calculate BC
    {
      bc_RFC_Location_075_077_RFC_Loc075_077_ProtBlockCtr = bc_RFC_Location_ProtBlockCtr ;

      copyBitsToByteArrayLE(bc_RFC_Location_075_077_RFC_Loc075_077_ProtBlockCtr,data,24,4); //Intel / little-endian;
    }
    else if (@CAN_PrivMain::RFC_Location_075_077::RFC_Loc075_077_ProtBlockCtr_FaultInject == 1)//BC: Error sequence: set BC = 0
    {

      copyBitsToByteArrayLE(0,data,24,4); //Intel / little-endian;
    }
    else if (@CAN_PrivMain::RFC_Location_075_077::RFC_Loc075_077_ProtBlockCtr_FaultInject == 2)//BC: Error sequence: Freeze last valid value
    {

      copyBitsToByteArrayLE(bc_RFC_Location_075_077_RFC_Loc075_077_ProtBlockCtr,data,24,4); //Intel / little-endian;
    }
    if (@CAN_PrivMain::RFC_Location_075_077::RFC_Loc075_077_CRC_FaultInject != 3)//CRC: user defined value
    {

    clearBitsInByteArrayLE(data,0,16); //Intel / little-endian

    }
    if(@CAN_PrivMain::RFC_Location_075_077::RFC_Loc075_077_CRC_FaultInject == 0)//CRC: No Error, calculate CRC
    {
      crcTemp = CRC16_INIT;
      for(i = 2; i < (DataLength+2); i++)
      {
        if(i < DataLength)
          data_byte = data[i] ;
        else if(i == DataLength)
          data_byte = (0x2121 & 0x00FF);
        else if(i == (DataLength+1))
          data_byte = (0x2121 & 0xFF00) >> 8;
        else
          write("Error: DLC exceeded in CRC calculation");
        crcTemp ^= data_byte << 8;
        crcTemp = (crcTemp << (8)) ^ CRC16_CCITT_FALSE_POLY_1021H_Lookup[(crcTemp >> (8)) & (0xFF)];
      }
      crcTemp ^= CRC16_XOR;
      crc_RFC_Location_075_077_RFC_Loc075_077_CRC = crcTemp;

      copyBitsToByteArrayLE(crc_RFC_Location_075_077_RFC_Loc075_077_CRC,data,0,16); //Intel / little-endian;
    }
    else if(@CAN_PrivMain::RFC_Location_075_077::RFC_Loc075_077_CRC_FaultInject == 1)//CRC: Error, set to Zero
    {

      copyBitsToByteArrayLE(0,data,0,16); //Intel / little-endian;
    }
    else if(@CAN_PrivMain::RFC_Location_075_077::RFC_Loc075_077_CRC_FaultInject == 2)//CRC: Error, Freeze last valid value
    {

      copyBitsToByteArrayLE(crc_RFC_Location_075_077_RFC_Loc075_077_CRC,data,0,16); //Intel / little-endian;
    }
}


on sysvar CAN_PrivMain::RFC_Location_078_080::RFC_Location_078_080_ON_OFF
{
  if (@this == 1)
  {
     ILSetMsgEvent(RFC_Location_078_080);
     @CAN_PrivMain::RFC_Location_078_080::RFC_Location_078_080_ON_OFF = 0;
  }
}

void cfg_Msg_RFC_Location_078_080(dword aDlc, byte data[])
{
   int64 i,k;//For looping
   byte xor,data_byte;
   dword crcTemp;
   byte DataLength;
   dword Msg_id;
   
   DataLength = Msg_RFC_Location_078_080.DataLength;//Message Data Length
   Msg_id  = Msg_RFC_Location_078_080.id;//Message ID
   
    if (@CAN_PrivMain::RFC_Location_078_080::RFC_Loc078_080_AliveCtr_FaultInject != 3)//AC: user defined value
    {

    clearBitsInByteArrayLE(data,16,8); //Intel / little-endian

    }
    if (@CAN_PrivMain::RFC_Location_078_080::RFC_Loc078_080_AliveCtr_FaultInject == 0)//AC: No Error, calculate AC
    {
      ++counter_RFC_Location_078_080_RFC_Loc078_080_AliveCtr;
      counter_RFC_Location_078_080_RFC_Loc078_080_AliveCtr %=256;

      copyBitsToByteArrayLE(counter_RFC_Location_078_080_RFC_Loc078_080_AliveCtr,data,16,8); //Intel / little-endian;
    }
    else if (@CAN_PrivMain::RFC_Location_078_080::RFC_Loc078_080_AliveCtr_FaultInject == 1)//AC: Error sequence: set AC = 0
    {

      copyBitsToByteArrayLE(0,data,16,8); //Intel / little-endian;
    }
    else if (@CAN_PrivMain::RFC_Location_078_080::RFC_Loc078_080_AliveCtr_FaultInject == 2)//AC: Error sequence: Freeze last valid value
    {

      copyBitsToByteArrayLE(counter_RFC_Location_078_080_RFC_Loc078_080_AliveCtr,data,16,8); //Intel / little-endian;
    }
    if (@CAN_PrivMain::RFC_Location_078_080::RFC_Loc078_080_ProtBlockCtr_FaultInject != 3)//BC: user defined value
    {

    clearBitsInByteArrayLE(data,24,4); //Intel / little-endian

    }
    if (@CAN_PrivMain::RFC_Location_078_080::RFC_Loc078_080_ProtBlockCtr_FaultInject == 0)//BC: No Error, calculate BC
    {
      bc_RFC_Location_078_080_RFC_Loc078_080_ProtBlockCtr = bc_RFC_Location_ProtBlockCtr ;

      copyBitsToByteArrayLE(bc_RFC_Location_078_080_RFC_Loc078_080_ProtBlockCtr,data,24,4); //Intel / little-endian;
    }
    else if (@CAN_PrivMain::RFC_Location_078_080::RFC_Loc078_080_ProtBlockCtr_FaultInject == 1)//BC: Error sequence: set BC = 0
    {

      copyBitsToByteArrayLE(0,data,24,4); //Intel / little-endian;
    }
    else if (@CAN_PrivMain::RFC_Location_078_080::RFC_Loc078_080_ProtBlockCtr_FaultInject == 2)//BC: Error sequence: Freeze last valid value
    {

      copyBitsToByteArrayLE(bc_RFC_Location_078_080_RFC_Loc078_080_ProtBlockCtr,data,24,4); //Intel / little-endian;
    }
    if (@CAN_PrivMain::RFC_Location_078_080::RFC_Loc078_080_CRC_FaultInject != 3)//CRC: user defined value
    {

    clearBitsInByteArrayLE(data,0,16); //Intel / little-endian

    }
    if(@CAN_PrivMain::RFC_Location_078_080::RFC_Loc078_080_CRC_FaultInject == 0)//CRC: No Error, calculate CRC
    {
      crcTemp = CRC16_INIT;
      for(i = 2; i < (DataLength+2); i++)
      {
        if(i < DataLength)
          data_byte = data[i] ;
        else if(i == DataLength)
          data_byte = (0x2122 & 0x00FF);
        else if(i == (DataLength+1))
          data_byte = (0x2122 & 0xFF00) >> 8;
        else
          write("Error: DLC exceeded in CRC calculation");
        crcTemp ^= data_byte << 8;
        crcTemp = (crcTemp << (8)) ^ CRC16_CCITT_FALSE_POLY_1021H_Lookup[(crcTemp >> (8)) & (0xFF)];
      }
      crcTemp ^= CRC16_XOR;
      crc_RFC_Location_078_080_RFC_Loc078_080_CRC = crcTemp;

      copyBitsToByteArrayLE(crc_RFC_Location_078_080_RFC_Loc078_080_CRC,data,0,16); //Intel / little-endian;
    }
    else if(@CAN_PrivMain::RFC_Location_078_080::RFC_Loc078_080_CRC_FaultInject == 1)//CRC: Error, set to Zero
    {

      copyBitsToByteArrayLE(0,data,0,16); //Intel / little-endian;
    }
    else if(@CAN_PrivMain::RFC_Location_078_080::RFC_Loc078_080_CRC_FaultInject == 2)//CRC: Error, Freeze last valid value
    {

      copyBitsToByteArrayLE(crc_RFC_Location_078_080_RFC_Loc078_080_CRC,data,0,16); //Intel / little-endian;
    }
}


on sysvar CAN_PrivMain::RFC_Location_081_083::RFC_Location_081_083_ON_OFF
{
  if (@this == 1)
  {
     ILSetMsgEvent(RFC_Location_081_083);
     @CAN_PrivMain::RFC_Location_081_083::RFC_Location_081_083_ON_OFF = 0;
  }
}

void cfg_Msg_RFC_Location_081_083(dword aDlc, byte data[])
{
   int64 i,k;//For looping
   byte xor,data_byte;
   dword crcTemp;
   byte DataLength;
   dword Msg_id;
   
   DataLength = Msg_RFC_Location_081_083.DataLength;//Message Data Length
   Msg_id  = Msg_RFC_Location_081_083.id;//Message ID
   
    if (@CAN_PrivMain::RFC_Location_081_083::RFC_Loc081_083_AliveCtr_FaultInject != 3)//AC: user defined value
    {

    clearBitsInByteArrayLE(data,16,8); //Intel / little-endian

    }
    if (@CAN_PrivMain::RFC_Location_081_083::RFC_Loc081_083_AliveCtr_FaultInject == 0)//AC: No Error, calculate AC
    {
      ++counter_RFC_Location_081_083_RFC_Loc081_083_AliveCtr;
      counter_RFC_Location_081_083_RFC_Loc081_083_AliveCtr %=256;

      copyBitsToByteArrayLE(counter_RFC_Location_081_083_RFC_Loc081_083_AliveCtr,data,16,8); //Intel / little-endian;
    }
    else if (@CAN_PrivMain::RFC_Location_081_083::RFC_Loc081_083_AliveCtr_FaultInject == 1)//AC: Error sequence: set AC = 0
    {

      copyBitsToByteArrayLE(0,data,16,8); //Intel / little-endian;
    }
    else if (@CAN_PrivMain::RFC_Location_081_083::RFC_Loc081_083_AliveCtr_FaultInject == 2)//AC: Error sequence: Freeze last valid value
    {

      copyBitsToByteArrayLE(counter_RFC_Location_081_083_RFC_Loc081_083_AliveCtr,data,16,8); //Intel / little-endian;
    }
    if (@CAN_PrivMain::RFC_Location_081_083::RFC_Loc081_083_ProtBlockCtr_FaultInject != 3)//BC: user defined value
    {

    clearBitsInByteArrayLE(data,24,4); //Intel / little-endian

    }
    if (@CAN_PrivMain::RFC_Location_081_083::RFC_Loc081_083_ProtBlockCtr_FaultInject == 0)//BC: No Error, calculate BC
    {
      bc_RFC_Location_081_083_RFC_Loc081_083_ProtBlockCtr = bc_RFC_Location_ProtBlockCtr ;

      copyBitsToByteArrayLE(bc_RFC_Location_081_083_RFC_Loc081_083_ProtBlockCtr,data,24,4); //Intel / little-endian;
    }
    else if (@CAN_PrivMain::RFC_Location_081_083::RFC_Loc081_083_ProtBlockCtr_FaultInject == 1)//BC: Error sequence: set BC = 0
    {

      copyBitsToByteArrayLE(0,data,24,4); //Intel / little-endian;
    }
    else if (@CAN_PrivMain::RFC_Location_081_083::RFC_Loc081_083_ProtBlockCtr_FaultInject == 2)//BC: Error sequence: Freeze last valid value
    {

      copyBitsToByteArrayLE(bc_RFC_Location_081_083_RFC_Loc081_083_ProtBlockCtr,data,24,4); //Intel / little-endian;
    }
    if (@CAN_PrivMain::RFC_Location_081_083::RFC_Loc081_083_CRC_FaultInject != 3)//CRC: user defined value
    {

    clearBitsInByteArrayLE(data,0,16); //Intel / little-endian

    }
    if(@CAN_PrivMain::RFC_Location_081_083::RFC_Loc081_083_CRC_FaultInject == 0)//CRC: No Error, calculate CRC
    {
      crcTemp = CRC16_INIT;
      for(i = 2; i < (DataLength+2); i++)
      {
        if(i < DataLength)
          data_byte = data[i] ;
        else if(i == DataLength)
          data_byte = (0x2123 & 0x00FF);
        else if(i == (DataLength+1))
          data_byte = (0x2123 & 0xFF00) >> 8;
        else
          write("Error: DLC exceeded in CRC calculation");
        crcTemp ^= data_byte << 8;
        crcTemp = (crcTemp << (8)) ^ CRC16_CCITT_FALSE_POLY_1021H_Lookup[(crcTemp >> (8)) & (0xFF)];
      }
      crcTemp ^= CRC16_XOR;
      crc_RFC_Location_081_083_RFC_Loc081_083_CRC = crcTemp;

      copyBitsToByteArrayLE(crc_RFC_Location_081_083_RFC_Loc081_083_CRC,data,0,16); //Intel / little-endian;
    }
    else if(@CAN_PrivMain::RFC_Location_081_083::RFC_Loc081_083_CRC_FaultInject == 1)//CRC: Error, set to Zero
    {

      copyBitsToByteArrayLE(0,data,0,16); //Intel / little-endian;
    }
    else if(@CAN_PrivMain::RFC_Location_081_083::RFC_Loc081_083_CRC_FaultInject == 2)//CRC: Error, Freeze last valid value
    {

      copyBitsToByteArrayLE(crc_RFC_Location_081_083_RFC_Loc081_083_CRC,data,0,16); //Intel / little-endian;
    }
}


on sysvar CAN_PrivMain::RFC_Location_084_086::RFC_Location_084_086_ON_OFF
{
  if (@this == 1)
  {
     ILSetMsgEvent(RFC_Location_084_086);
     @CAN_PrivMain::RFC_Location_084_086::RFC_Location_084_086_ON_OFF = 0;
  }
}

void cfg_Msg_RFC_Location_084_086(dword aDlc, byte data[])
{
   int64 i,k;//For looping
   byte xor,data_byte;
   dword crcTemp;
   byte DataLength;
   dword Msg_id;
   
   DataLength = Msg_RFC_Location_084_086.DataLength;//Message Data Length
   Msg_id  = Msg_RFC_Location_084_086.id;//Message ID
   
    if (@CAN_PrivMain::RFC_Location_084_086::RFC_Loc084_086_AliveCtr_FaultInject != 3)//AC: user defined value
    {

    clearBitsInByteArrayLE(data,16,8); //Intel / little-endian

    }
    if (@CAN_PrivMain::RFC_Location_084_086::RFC_Loc084_086_AliveCtr_FaultInject == 0)//AC: No Error, calculate AC
    {
      ++counter_RFC_Location_084_086_RFC_Loc084_086_AliveCtr;
      counter_RFC_Location_084_086_RFC_Loc084_086_AliveCtr %=256;

      copyBitsToByteArrayLE(counter_RFC_Location_084_086_RFC_Loc084_086_AliveCtr,data,16,8); //Intel / little-endian;
    }
    else if (@CAN_PrivMain::RFC_Location_084_086::RFC_Loc084_086_AliveCtr_FaultInject == 1)//AC: Error sequence: set AC = 0
    {

      copyBitsToByteArrayLE(0,data,16,8); //Intel / little-endian;
    }
    else if (@CAN_PrivMain::RFC_Location_084_086::RFC_Loc084_086_AliveCtr_FaultInject == 2)//AC: Error sequence: Freeze last valid value
    {

      copyBitsToByteArrayLE(counter_RFC_Location_084_086_RFC_Loc084_086_AliveCtr,data,16,8); //Intel / little-endian;
    }
    if (@CAN_PrivMain::RFC_Location_084_086::RFC_Loc084_086_ProtBlockCtr_FaultInject != 3)//BC: user defined value
    {

    clearBitsInByteArrayLE(data,24,4); //Intel / little-endian

    }
    if (@CAN_PrivMain::RFC_Location_084_086::RFC_Loc084_086_ProtBlockCtr_FaultInject == 0)//BC: No Error, calculate BC
    {
      bc_RFC_Location_084_086_RFC_Loc084_086_ProtBlockCtr = bc_RFC_Location_ProtBlockCtr ;

      copyBitsToByteArrayLE(bc_RFC_Location_084_086_RFC_Loc084_086_ProtBlockCtr,data,24,4); //Intel / little-endian;
    }
    else if (@CAN_PrivMain::RFC_Location_084_086::RFC_Loc084_086_ProtBlockCtr_FaultInject == 1)//BC: Error sequence: set BC = 0
    {

      copyBitsToByteArrayLE(0,data,24,4); //Intel / little-endian;
    }
    else if (@CAN_PrivMain::RFC_Location_084_086::RFC_Loc084_086_ProtBlockCtr_FaultInject == 2)//BC: Error sequence: Freeze last valid value
    {

      copyBitsToByteArrayLE(bc_RFC_Location_084_086_RFC_Loc084_086_ProtBlockCtr,data,24,4); //Intel / little-endian;
    }
    if (@CAN_PrivMain::RFC_Location_084_086::RFC_Loc084_086_CRC_FaultInject != 3)//CRC: user defined value
    {

    clearBitsInByteArrayLE(data,0,16); //Intel / little-endian

    }
    if(@CAN_PrivMain::RFC_Location_084_086::RFC_Loc084_086_CRC_FaultInject == 0)//CRC: No Error, calculate CRC
    {
      crcTemp = CRC16_INIT;
      for(i = 2; i < (DataLength+2); i++)
      {
        if(i < DataLength)
          data_byte = data[i] ;
        else if(i == DataLength)
          data_byte = (0x2124 & 0x00FF);
        else if(i == (DataLength+1))
          data_byte = (0x2124 & 0xFF00) >> 8;
        else
          write("Error: DLC exceeded in CRC calculation");
        crcTemp ^= data_byte << 8;
        crcTemp = (crcTemp << (8)) ^ CRC16_CCITT_FALSE_POLY_1021H_Lookup[(crcTemp >> (8)) & (0xFF)];
      }
      crcTemp ^= CRC16_XOR;
      crc_RFC_Location_084_086_RFC_Loc084_086_CRC = crcTemp;

      copyBitsToByteArrayLE(crc_RFC_Location_084_086_RFC_Loc084_086_CRC,data,0,16); //Intel / little-endian;
    }
    else if(@CAN_PrivMain::RFC_Location_084_086::RFC_Loc084_086_CRC_FaultInject == 1)//CRC: Error, set to Zero
    {

      copyBitsToByteArrayLE(0,data,0,16); //Intel / little-endian;
    }
    else if(@CAN_PrivMain::RFC_Location_084_086::RFC_Loc084_086_CRC_FaultInject == 2)//CRC: Error, Freeze last valid value
    {

      copyBitsToByteArrayLE(crc_RFC_Location_084_086_RFC_Loc084_086_CRC,data,0,16); //Intel / little-endian;
    }
}


on sysvar CAN_PrivMain::RFC_Location_087_089::RFC_Location_087_089_ON_OFF
{
  if (@this == 1)
  {
     ILSetMsgEvent(RFC_Location_087_089);
     @CAN_PrivMain::RFC_Location_087_089::RFC_Location_087_089_ON_OFF = 0;
  }
}

void cfg_Msg_RFC_Location_087_089(dword aDlc, byte data[])
{
   int64 i,k;//For looping
   byte xor,data_byte;
   dword crcTemp;
   byte DataLength;
   dword Msg_id;
   
   DataLength = Msg_RFC_Location_087_089.DataLength;//Message Data Length
   Msg_id  = Msg_RFC_Location_087_089.id;//Message ID
   
    if (@CAN_PrivMain::RFC_Location_087_089::RFC_Loc087_089_AliveCtr_FaultInject != 3)//AC: user defined value
    {

    clearBitsInByteArrayLE(data,16,8); //Intel / little-endian

    }
    if (@CAN_PrivMain::RFC_Location_087_089::RFC_Loc087_089_AliveCtr_FaultInject == 0)//AC: No Error, calculate AC
    {
      ++counter_RFC_Location_087_089_RFC_Loc087_089_AliveCtr;
      counter_RFC_Location_087_089_RFC_Loc087_089_AliveCtr %=256;

      copyBitsToByteArrayLE(counter_RFC_Location_087_089_RFC_Loc087_089_AliveCtr,data,16,8); //Intel / little-endian;
    }
    else if (@CAN_PrivMain::RFC_Location_087_089::RFC_Loc087_089_AliveCtr_FaultInject == 1)//AC: Error sequence: set AC = 0
    {

      copyBitsToByteArrayLE(0,data,16,8); //Intel / little-endian;
    }
    else if (@CAN_PrivMain::RFC_Location_087_089::RFC_Loc087_089_AliveCtr_FaultInject == 2)//AC: Error sequence: Freeze last valid value
    {

      copyBitsToByteArrayLE(counter_RFC_Location_087_089_RFC_Loc087_089_AliveCtr,data,16,8); //Intel / little-endian;
    }
    if (@CAN_PrivMain::RFC_Location_087_089::RFC_Loc087_089_ProtBlockCtr_FaultInject != 3)//BC: user defined value
    {

    clearBitsInByteArrayLE(data,24,4); //Intel / little-endian

    }
    if (@CAN_PrivMain::RFC_Location_087_089::RFC_Loc087_089_ProtBlockCtr_FaultInject == 0)//BC: No Error, calculate BC
    {
      bc_RFC_Location_087_089_RFC_Loc087_089_ProtBlockCtr = bc_RFC_Location_ProtBlockCtr ;

      copyBitsToByteArrayLE(bc_RFC_Location_087_089_RFC_Loc087_089_ProtBlockCtr,data,24,4); //Intel / little-endian;
    }
    else if (@CAN_PrivMain::RFC_Location_087_089::RFC_Loc087_089_ProtBlockCtr_FaultInject == 1)//BC: Error sequence: set BC = 0
    {

      copyBitsToByteArrayLE(0,data,24,4); //Intel / little-endian;
    }
    else if (@CAN_PrivMain::RFC_Location_087_089::RFC_Loc087_089_ProtBlockCtr_FaultInject == 2)//BC: Error sequence: Freeze last valid value
    {

      copyBitsToByteArrayLE(bc_RFC_Location_087_089_RFC_Loc087_089_ProtBlockCtr,data,24,4); //Intel / little-endian;
    }
    if (@CAN_PrivMain::RFC_Location_087_089::RFC_Loc087_089_CRC_FaultInject != 3)//CRC: user defined value
    {

    clearBitsInByteArrayLE(data,0,16); //Intel / little-endian

    }
    if(@CAN_PrivMain::RFC_Location_087_089::RFC_Loc087_089_CRC_FaultInject == 0)//CRC: No Error, calculate CRC
    {
      crcTemp = CRC16_INIT;
      for(i = 2; i < (DataLength+2); i++)
      {
        if(i < DataLength)
          data_byte = data[i] ;
        else if(i == DataLength)
          data_byte = (0x2125 & 0x00FF);
        else if(i == (DataLength+1))
          data_byte = (0x2125 & 0xFF00) >> 8;
        else
          write("Error: DLC exceeded in CRC calculation");
        crcTemp ^= data_byte << 8;
        crcTemp = (crcTemp << (8)) ^ CRC16_CCITT_FALSE_POLY_1021H_Lookup[(crcTemp >> (8)) & (0xFF)];
      }
      crcTemp ^= CRC16_XOR;
      crc_RFC_Location_087_089_RFC_Loc087_089_CRC = crcTemp;

      copyBitsToByteArrayLE(crc_RFC_Location_087_089_RFC_Loc087_089_CRC,data,0,16); //Intel / little-endian;
    }
    else if(@CAN_PrivMain::RFC_Location_087_089::RFC_Loc087_089_CRC_FaultInject == 1)//CRC: Error, set to Zero
    {

      copyBitsToByteArrayLE(0,data,0,16); //Intel / little-endian;
    }
    else if(@CAN_PrivMain::RFC_Location_087_089::RFC_Loc087_089_CRC_FaultInject == 2)//CRC: Error, Freeze last valid value
    {

      copyBitsToByteArrayLE(crc_RFC_Location_087_089_RFC_Loc087_089_CRC,data,0,16); //Intel / little-endian;
    }
}


on sysvar CAN_PrivMain::RFC_Location_090_092::RFC_Location_090_092_ON_OFF
{
  if (@this == 1)
  {
     ILSetMsgEvent(RFC_Location_090_092);
     @CAN_PrivMain::RFC_Location_090_092::RFC_Location_090_092_ON_OFF = 0;
  }
}

void cfg_Msg_RFC_Location_090_092(dword aDlc, byte data[])
{
   int64 i,k;//For looping
   byte xor,data_byte;
   dword crcTemp;
   byte DataLength;
   dword Msg_id;
   
   DataLength = Msg_RFC_Location_090_092.DataLength;//Message Data Length
   Msg_id  = Msg_RFC_Location_090_092.id;//Message ID
   
    if (@CAN_PrivMain::RFC_Location_090_092::RFC_Loc090_092_AliveCtr_FaultInject != 3)//AC: user defined value
    {

    clearBitsInByteArrayLE(data,16,8); //Intel / little-endian

    }
    if (@CAN_PrivMain::RFC_Location_090_092::RFC_Loc090_092_AliveCtr_FaultInject == 0)//AC: No Error, calculate AC
    {
      ++counter_RFC_Location_090_092_RFC_Loc090_092_AliveCtr;
      counter_RFC_Location_090_092_RFC_Loc090_092_AliveCtr %=256;

      copyBitsToByteArrayLE(counter_RFC_Location_090_092_RFC_Loc090_092_AliveCtr,data,16,8); //Intel / little-endian;
    }
    else if (@CAN_PrivMain::RFC_Location_090_092::RFC_Loc090_092_AliveCtr_FaultInject == 1)//AC: Error sequence: set AC = 0
    {

      copyBitsToByteArrayLE(0,data,16,8); //Intel / little-endian;
    }
    else if (@CAN_PrivMain::RFC_Location_090_092::RFC_Loc090_092_AliveCtr_FaultInject == 2)//AC: Error sequence: Freeze last valid value
    {

      copyBitsToByteArrayLE(counter_RFC_Location_090_092_RFC_Loc090_092_AliveCtr,data,16,8); //Intel / little-endian;
    }
    if (@CAN_PrivMain::RFC_Location_090_092::RFC_Loc090_092_ProtBlockCtr_FaultInject != 3)//BC: user defined value
    {

    clearBitsInByteArrayLE(data,24,4); //Intel / little-endian

    }
    if (@CAN_PrivMain::RFC_Location_090_092::RFC_Loc090_092_ProtBlockCtr_FaultInject == 0)//BC: No Error, calculate BC
    {
      bc_RFC_Location_090_092_RFC_Loc090_092_ProtBlockCtr = bc_RFC_Location_ProtBlockCtr ;

      copyBitsToByteArrayLE(bc_RFC_Location_090_092_RFC_Loc090_092_ProtBlockCtr,data,24,4); //Intel / little-endian;
    }
    else if (@CAN_PrivMain::RFC_Location_090_092::RFC_Loc090_092_ProtBlockCtr_FaultInject == 1)//BC: Error sequence: set BC = 0
    {

      copyBitsToByteArrayLE(0,data,24,4); //Intel / little-endian;
    }
    else if (@CAN_PrivMain::RFC_Location_090_092::RFC_Loc090_092_ProtBlockCtr_FaultInject == 2)//BC: Error sequence: Freeze last valid value
    {

      copyBitsToByteArrayLE(bc_RFC_Location_090_092_RFC_Loc090_092_ProtBlockCtr,data,24,4); //Intel / little-endian;
    }
    if (@CAN_PrivMain::RFC_Location_090_092::RFC_Loc090_092_CRC_FaultInject != 3)//CRC: user defined value
    {

    clearBitsInByteArrayLE(data,0,16); //Intel / little-endian

    }
    if(@CAN_PrivMain::RFC_Location_090_092::RFC_Loc090_092_CRC_FaultInject == 0)//CRC: No Error, calculate CRC
    {
      crcTemp = CRC16_INIT;
      for(i = 2; i < (DataLength+2); i++)
      {
        if(i < DataLength)
          data_byte = data[i] ;
        else if(i == DataLength)
          data_byte = (0x2126 & 0x00FF);
        else if(i == (DataLength+1))
          data_byte = (0x2126 & 0xFF00) >> 8;
        else
          write("Error: DLC exceeded in CRC calculation");
        crcTemp ^= data_byte << 8;
        crcTemp = (crcTemp << (8)) ^ CRC16_CCITT_FALSE_POLY_1021H_Lookup[(crcTemp >> (8)) & (0xFF)];
      }
      crcTemp ^= CRC16_XOR;
      crc_RFC_Location_090_092_RFC_Loc090_092_CRC = crcTemp;

      copyBitsToByteArrayLE(crc_RFC_Location_090_092_RFC_Loc090_092_CRC,data,0,16); //Intel / little-endian;
    }
    else if(@CAN_PrivMain::RFC_Location_090_092::RFC_Loc090_092_CRC_FaultInject == 1)//CRC: Error, set to Zero
    {

      copyBitsToByteArrayLE(0,data,0,16); //Intel / little-endian;
    }
    else if(@CAN_PrivMain::RFC_Location_090_092::RFC_Loc090_092_CRC_FaultInject == 2)//CRC: Error, Freeze last valid value
    {

      copyBitsToByteArrayLE(crc_RFC_Location_090_092_RFC_Loc090_092_CRC,data,0,16); //Intel / little-endian;
    }
}


on sysvar CAN_PrivMain::RFC_Location_093_095::RFC_Location_093_095_ON_OFF
{
  if (@this == 1)
  {
     ILSetMsgEvent(RFC_Location_093_095);
     @CAN_PrivMain::RFC_Location_093_095::RFC_Location_093_095_ON_OFF = 0;
  }
}

void cfg_Msg_RFC_Location_093_095(dword aDlc, byte data[])
{
   int64 i,k;//For looping
   byte xor,data_byte;
   dword crcTemp;
   byte DataLength;
   dword Msg_id;
   
   DataLength = Msg_RFC_Location_093_095.DataLength;//Message Data Length
   Msg_id  = Msg_RFC_Location_093_095.id;//Message ID
   
    if (@CAN_PrivMain::RFC_Location_093_095::RFC_Loc093_095_AliveCtr_FaultInject != 3)//AC: user defined value
    {

    clearBitsInByteArrayLE(data,16,8); //Intel / little-endian

    }
    if (@CAN_PrivMain::RFC_Location_093_095::RFC_Loc093_095_AliveCtr_FaultInject == 0)//AC: No Error, calculate AC
    {
      ++counter_RFC_Location_093_095_RFC_Loc093_095_AliveCtr;
      counter_RFC_Location_093_095_RFC_Loc093_095_AliveCtr %=256;

      copyBitsToByteArrayLE(counter_RFC_Location_093_095_RFC_Loc093_095_AliveCtr,data,16,8); //Intel / little-endian;
    }
    else if (@CAN_PrivMain::RFC_Location_093_095::RFC_Loc093_095_AliveCtr_FaultInject == 1)//AC: Error sequence: set AC = 0
    {

      copyBitsToByteArrayLE(0,data,16,8); //Intel / little-endian;
    }
    else if (@CAN_PrivMain::RFC_Location_093_095::RFC_Loc093_095_AliveCtr_FaultInject == 2)//AC: Error sequence: Freeze last valid value
    {

      copyBitsToByteArrayLE(counter_RFC_Location_093_095_RFC_Loc093_095_AliveCtr,data,16,8); //Intel / little-endian;
    }
    if (@CAN_PrivMain::RFC_Location_093_095::RFC_Loc093_095_ProtBlockCtr_FaultInject != 3)//BC: user defined value
    {

    clearBitsInByteArrayLE(data,24,4); //Intel / little-endian

    }
    if (@CAN_PrivMain::RFC_Location_093_095::RFC_Loc093_095_ProtBlockCtr_FaultInject == 0)//BC: No Error, calculate BC
    {
      bc_RFC_Location_093_095_RFC_Loc093_095_ProtBlockCtr = bc_RFC_Location_ProtBlockCtr ;

      copyBitsToByteArrayLE(bc_RFC_Location_093_095_RFC_Loc093_095_ProtBlockCtr,data,24,4); //Intel / little-endian;
    }
    else if (@CAN_PrivMain::RFC_Location_093_095::RFC_Loc093_095_ProtBlockCtr_FaultInject == 1)//BC: Error sequence: set BC = 0
    {

      copyBitsToByteArrayLE(0,data,24,4); //Intel / little-endian;
    }
    else if (@CAN_PrivMain::RFC_Location_093_095::RFC_Loc093_095_ProtBlockCtr_FaultInject == 2)//BC: Error sequence: Freeze last valid value
    {

      copyBitsToByteArrayLE(bc_RFC_Location_093_095_RFC_Loc093_095_ProtBlockCtr,data,24,4); //Intel / little-endian;
    }
    if (@CAN_PrivMain::RFC_Location_093_095::RFC_Loc093_095_CRC_FaultInject != 3)//CRC: user defined value
    {

    clearBitsInByteArrayLE(data,0,16); //Intel / little-endian

    }
    if(@CAN_PrivMain::RFC_Location_093_095::RFC_Loc093_095_CRC_FaultInject == 0)//CRC: No Error, calculate CRC
    {
      crcTemp = CRC16_INIT;
      for(i = 2; i < (DataLength+2); i++)
      {
        if(i < DataLength)
          data_byte = data[i] ;
        else if(i == DataLength)
          data_byte = (0x2127 & 0x00FF);
        else if(i == (DataLength+1))
          data_byte = (0x2127 & 0xFF00) >> 8;
        else
          write("Error: DLC exceeded in CRC calculation");
        crcTemp ^= data_byte << 8;
        crcTemp = (crcTemp << (8)) ^ CRC16_CCITT_FALSE_POLY_1021H_Lookup[(crcTemp >> (8)) & (0xFF)];
      }
      crcTemp ^= CRC16_XOR;
      crc_RFC_Location_093_095_RFC_Loc093_095_CRC = crcTemp;

      copyBitsToByteArrayLE(crc_RFC_Location_093_095_RFC_Loc093_095_CRC,data,0,16); //Intel / little-endian;
    }
    else if(@CAN_PrivMain::RFC_Location_093_095::RFC_Loc093_095_CRC_FaultInject == 1)//CRC: Error, set to Zero
    {

      copyBitsToByteArrayLE(0,data,0,16); //Intel / little-endian;
    }
    else if(@CAN_PrivMain::RFC_Location_093_095::RFC_Loc093_095_CRC_FaultInject == 2)//CRC: Error, Freeze last valid value
    {

      copyBitsToByteArrayLE(crc_RFC_Location_093_095_RFC_Loc093_095_CRC,data,0,16); //Intel / little-endian;
    }
}


on sysvar CAN_PrivMain::RFC_Location_096_098::RFC_Location_096_098_ON_OFF
{
  if (@this == 1)
  {
     ILSetMsgEvent(RFC_Location_096_098);
     @CAN_PrivMain::RFC_Location_096_098::RFC_Location_096_098_ON_OFF = 0;
  }
}

void cfg_Msg_RFC_Location_096_098(dword aDlc, byte data[])
{
   int64 i,k;//For looping
   byte xor,data_byte;
   dword crcTemp;
   byte DataLength;
   dword Msg_id;
   
   DataLength = Msg_RFC_Location_096_098.DataLength;//Message Data Length
   Msg_id  = Msg_RFC_Location_096_098.id;//Message ID
   
    if (@CAN_PrivMain::RFC_Location_096_098::RFC_Loc096_098_AliveCtr_FaultInject != 3)//AC: user defined value
    {

    clearBitsInByteArrayLE(data,16,8); //Intel / little-endian

    }
    if (@CAN_PrivMain::RFC_Location_096_098::RFC_Loc096_098_AliveCtr_FaultInject == 0)//AC: No Error, calculate AC
    {
      ++counter_RFC_Location_096_098_RFC_Loc096_098_AliveCtr;
      counter_RFC_Location_096_098_RFC_Loc096_098_AliveCtr %=256;

      copyBitsToByteArrayLE(counter_RFC_Location_096_098_RFC_Loc096_098_AliveCtr,data,16,8); //Intel / little-endian;
    }
    else if (@CAN_PrivMain::RFC_Location_096_098::RFC_Loc096_098_AliveCtr_FaultInject == 1)//AC: Error sequence: set AC = 0
    {

      copyBitsToByteArrayLE(0,data,16,8); //Intel / little-endian;
    }
    else if (@CAN_PrivMain::RFC_Location_096_098::RFC_Loc096_098_AliveCtr_FaultInject == 2)//AC: Error sequence: Freeze last valid value
    {

      copyBitsToByteArrayLE(counter_RFC_Location_096_098_RFC_Loc096_098_AliveCtr,data,16,8); //Intel / little-endian;
    }
    if (@CAN_PrivMain::RFC_Location_096_098::RFC_Loc096_098_ProtBlockCtr_FaultInject != 3)//BC: user defined value
    {

    clearBitsInByteArrayLE(data,24,4); //Intel / little-endian

    }
    if (@CAN_PrivMain::RFC_Location_096_098::RFC_Loc096_098_ProtBlockCtr_FaultInject == 0)//BC: No Error, calculate BC
    {
      bc_RFC_Location_096_098_RFC_Loc096_098_ProtBlockCtr = bc_RFC_Location_ProtBlockCtr ;

      copyBitsToByteArrayLE(bc_RFC_Location_096_098_RFC_Loc096_098_ProtBlockCtr,data,24,4); //Intel / little-endian;
    }
    else if (@CAN_PrivMain::RFC_Location_096_098::RFC_Loc096_098_ProtBlockCtr_FaultInject == 1)//BC: Error sequence: set BC = 0
    {

      copyBitsToByteArrayLE(0,data,24,4); //Intel / little-endian;
    }
    else if (@CAN_PrivMain::RFC_Location_096_098::RFC_Loc096_098_ProtBlockCtr_FaultInject == 2)//BC: Error sequence: Freeze last valid value
    {

      copyBitsToByteArrayLE(bc_RFC_Location_096_098_RFC_Loc096_098_ProtBlockCtr,data,24,4); //Intel / little-endian;
    }
    if (@CAN_PrivMain::RFC_Location_096_098::RFC_Loc096_098_CRC_FaultInject != 3)//CRC: user defined value
    {

    clearBitsInByteArrayLE(data,0,16); //Intel / little-endian

    }
    if(@CAN_PrivMain::RFC_Location_096_098::RFC_Loc096_098_CRC_FaultInject == 0)//CRC: No Error, calculate CRC
    {
      crcTemp = CRC16_INIT;
      for(i = 2; i < (DataLength+2); i++)
      {
        if(i < DataLength)
          data_byte = data[i] ;
        else if(i == DataLength)
          data_byte = (0x2128 & 0x00FF);
        else if(i == (DataLength+1))
          data_byte = (0x2128 & 0xFF00) >> 8;
        else
          write("Error: DLC exceeded in CRC calculation");
        crcTemp ^= data_byte << 8;
        crcTemp = (crcTemp << (8)) ^ CRC16_CCITT_FALSE_POLY_1021H_Lookup[(crcTemp >> (8)) & (0xFF)];
      }
      crcTemp ^= CRC16_XOR;
      crc_RFC_Location_096_098_RFC_Loc096_098_CRC = crcTemp;

      copyBitsToByteArrayLE(crc_RFC_Location_096_098_RFC_Loc096_098_CRC,data,0,16); //Intel / little-endian;
    }
    else if(@CAN_PrivMain::RFC_Location_096_098::RFC_Loc096_098_CRC_FaultInject == 1)//CRC: Error, set to Zero
    {

      copyBitsToByteArrayLE(0,data,0,16); //Intel / little-endian;
    }
    else if(@CAN_PrivMain::RFC_Location_096_098::RFC_Loc096_098_CRC_FaultInject == 2)//CRC: Error, Freeze last valid value
    {

      copyBitsToByteArrayLE(crc_RFC_Location_096_098_RFC_Loc096_098_CRC,data,0,16); //Intel / little-endian;
    }
}


on sysvar CAN_PrivMain::RFC_Location_099_101::RFC_Location_099_101_ON_OFF
{
  if (@this == 1)
  {
     ILSetMsgEvent(RFC_Location_099_101);
     @CAN_PrivMain::RFC_Location_099_101::RFC_Location_099_101_ON_OFF = 0;
  }
}

void cfg_Msg_RFC_Location_099_101(dword aDlc, byte data[])
{
   int64 i,k;//For looping
   byte xor,data_byte;
   dword crcTemp;
   byte DataLength;
   dword Msg_id;
   
   DataLength = Msg_RFC_Location_099_101.DataLength;//Message Data Length
   Msg_id  = Msg_RFC_Location_099_101.id;//Message ID
   
    if (@CAN_PrivMain::RFC_Location_099_101::RFC_Loc099_101_AliveCtr_FaultInject != 3)//AC: user defined value
    {

    clearBitsInByteArrayLE(data,16,8); //Intel / little-endian

    }
    if (@CAN_PrivMain::RFC_Location_099_101::RFC_Loc099_101_AliveCtr_FaultInject == 0)//AC: No Error, calculate AC
    {
      ++counter_RFC_Location_099_101_RFC_Loc099_101_AliveCtr;
      counter_RFC_Location_099_101_RFC_Loc099_101_AliveCtr %=256;

      copyBitsToByteArrayLE(counter_RFC_Location_099_101_RFC_Loc099_101_AliveCtr,data,16,8); //Intel / little-endian;
    }
    else if (@CAN_PrivMain::RFC_Location_099_101::RFC_Loc099_101_AliveCtr_FaultInject == 1)//AC: Error sequence: set AC = 0
    {

      copyBitsToByteArrayLE(0,data,16,8); //Intel / little-endian;
    }
    else if (@CAN_PrivMain::RFC_Location_099_101::RFC_Loc099_101_AliveCtr_FaultInject == 2)//AC: Error sequence: Freeze last valid value
    {

      copyBitsToByteArrayLE(counter_RFC_Location_099_101_RFC_Loc099_101_AliveCtr,data,16,8); //Intel / little-endian;
    }
    if (@CAN_PrivMain::RFC_Location_099_101::RFC_Loc099_101_ProtBlockCtr_FaultInject != 3)//BC: user defined value
    {

    clearBitsInByteArrayLE(data,24,4); //Intel / little-endian

    }
    if (@CAN_PrivMain::RFC_Location_099_101::RFC_Loc099_101_ProtBlockCtr_FaultInject == 0)//BC: No Error, calculate BC
    {
      bc_RFC_Location_099_101_RFC_Loc099_101_ProtBlockCtr = bc_RFC_Location_ProtBlockCtr ;

      copyBitsToByteArrayLE(bc_RFC_Location_099_101_RFC_Loc099_101_ProtBlockCtr,data,24,4); //Intel / little-endian;
    }
    else if (@CAN_PrivMain::RFC_Location_099_101::RFC_Loc099_101_ProtBlockCtr_FaultInject == 1)//BC: Error sequence: set BC = 0
    {

      copyBitsToByteArrayLE(0,data,24,4); //Intel / little-endian;
    }
    else if (@CAN_PrivMain::RFC_Location_099_101::RFC_Loc099_101_ProtBlockCtr_FaultInject == 2)//BC: Error sequence: Freeze last valid value
    {

      copyBitsToByteArrayLE(bc_RFC_Location_099_101_RFC_Loc099_101_ProtBlockCtr,data,24,4); //Intel / little-endian;
    }
    if (@CAN_PrivMain::RFC_Location_099_101::RFC_Loc099_101_CRC_FaultInject != 3)//CRC: user defined value
    {

    clearBitsInByteArrayLE(data,0,16); //Intel / little-endian

    }
    if(@CAN_PrivMain::RFC_Location_099_101::RFC_Loc099_101_CRC_FaultInject == 0)//CRC: No Error, calculate CRC
    {
      crcTemp = CRC16_INIT;
      for(i = 2; i < (DataLength+2); i++)
      {
        if(i < DataLength)
          data_byte = data[i] ;
        else if(i == DataLength)
          data_byte = (0x2129 & 0x00FF);
        else if(i == (DataLength+1))
          data_byte = (0x2129 & 0xFF00) >> 8;
        else
          write("Error: DLC exceeded in CRC calculation");
        crcTemp ^= data_byte << 8;
        crcTemp = (crcTemp << (8)) ^ CRC16_CCITT_FALSE_POLY_1021H_Lookup[(crcTemp >> (8)) & (0xFF)];
      }
      crcTemp ^= CRC16_XOR;
      crc_RFC_Location_099_101_RFC_Loc099_101_CRC = crcTemp;

      copyBitsToByteArrayLE(crc_RFC_Location_099_101_RFC_Loc099_101_CRC,data,0,16); //Intel / little-endian;
    }
    else if(@CAN_PrivMain::RFC_Location_099_101::RFC_Loc099_101_CRC_FaultInject == 1)//CRC: Error, set to Zero
    {

      copyBitsToByteArrayLE(0,data,0,16); //Intel / little-endian;
    }
    else if(@CAN_PrivMain::RFC_Location_099_101::RFC_Loc099_101_CRC_FaultInject == 2)//CRC: Error, Freeze last valid value
    {

      copyBitsToByteArrayLE(crc_RFC_Location_099_101_RFC_Loc099_101_CRC,data,0,16); //Intel / little-endian;
    }
}


on sysvar CAN_PrivMain::RFC_Location_102_104::RFC_Location_102_104_ON_OFF
{
  if (@this == 1)
  {
     ILSetMsgEvent(RFC_Location_102_104);
     @CAN_PrivMain::RFC_Location_102_104::RFC_Location_102_104_ON_OFF = 0;
  }
}

void cfg_Msg_RFC_Location_102_104(dword aDlc, byte data[])
{
   int64 i,k;//For looping
   byte xor,data_byte;
   dword crcTemp;
   byte DataLength;
   dword Msg_id;
   
   DataLength = Msg_RFC_Location_102_104.DataLength;//Message Data Length
   Msg_id  = Msg_RFC_Location_102_104.id;//Message ID
   
    if (@CAN_PrivMain::RFC_Location_102_104::RFC_Loc102_104_AliveCtr_FaultInject != 3)//AC: user defined value
    {

    clearBitsInByteArrayLE(data,16,8); //Intel / little-endian

    }
    if (@CAN_PrivMain::RFC_Location_102_104::RFC_Loc102_104_AliveCtr_FaultInject == 0)//AC: No Error, calculate AC
    {
      ++counter_RFC_Location_102_104_RFC_Loc102_104_AliveCtr;
      counter_RFC_Location_102_104_RFC_Loc102_104_AliveCtr %=256;

      copyBitsToByteArrayLE(counter_RFC_Location_102_104_RFC_Loc102_104_AliveCtr,data,16,8); //Intel / little-endian;
    }
    else if (@CAN_PrivMain::RFC_Location_102_104::RFC_Loc102_104_AliveCtr_FaultInject == 1)//AC: Error sequence: set AC = 0
    {

      copyBitsToByteArrayLE(0,data,16,8); //Intel / little-endian;
    }
    else if (@CAN_PrivMain::RFC_Location_102_104::RFC_Loc102_104_AliveCtr_FaultInject == 2)//AC: Error sequence: Freeze last valid value
    {

      copyBitsToByteArrayLE(counter_RFC_Location_102_104_RFC_Loc102_104_AliveCtr,data,16,8); //Intel / little-endian;
    }
    if (@CAN_PrivMain::RFC_Location_102_104::RFC_Loc102_104_ProtBlockCtr_FaultInject != 3)//BC: user defined value
    {

    clearBitsInByteArrayLE(data,24,4); //Intel / little-endian

    }
    if (@CAN_PrivMain::RFC_Location_102_104::RFC_Loc102_104_ProtBlockCtr_FaultInject == 0)//BC: No Error, calculate BC
    {
      bc_RFC_Location_102_104_RFC_Loc102_104_ProtBlockCtr = bc_RFC_Location_ProtBlockCtr ;

      copyBitsToByteArrayLE(bc_RFC_Location_102_104_RFC_Loc102_104_ProtBlockCtr,data,24,4); //Intel / little-endian;
    }
    else if (@CAN_PrivMain::RFC_Location_102_104::RFC_Loc102_104_ProtBlockCtr_FaultInject == 1)//BC: Error sequence: set BC = 0
    {

      copyBitsToByteArrayLE(0,data,24,4); //Intel / little-endian;
    }
    else if (@CAN_PrivMain::RFC_Location_102_104::RFC_Loc102_104_ProtBlockCtr_FaultInject == 2)//BC: Error sequence: Freeze last valid value
    {

      copyBitsToByteArrayLE(bc_RFC_Location_102_104_RFC_Loc102_104_ProtBlockCtr,data,24,4); //Intel / little-endian;
    }
    if (@CAN_PrivMain::RFC_Location_102_104::RFC_Loc102_104_CRC_FaultInject != 3)//CRC: user defined value
    {

    clearBitsInByteArrayLE(data,0,16); //Intel / little-endian

    }
    if(@CAN_PrivMain::RFC_Location_102_104::RFC_Loc102_104_CRC_FaultInject == 0)//CRC: No Error, calculate CRC
    {
      crcTemp = CRC16_INIT;
      for(i = 2; i < (DataLength+2); i++)
      {
        if(i < DataLength)
          data_byte = data[i] ;
        else if(i == DataLength)
          data_byte = (0x212a & 0x00FF);
        else if(i == (DataLength+1))
          data_byte = (0x212a & 0xFF00) >> 8;
        else
          write("Error: DLC exceeded in CRC calculation");
        crcTemp ^= data_byte << 8;
        crcTemp = (crcTemp << (8)) ^ CRC16_CCITT_FALSE_POLY_1021H_Lookup[(crcTemp >> (8)) & (0xFF)];
      }
      crcTemp ^= CRC16_XOR;
      crc_RFC_Location_102_104_RFC_Loc102_104_CRC = crcTemp;

      copyBitsToByteArrayLE(crc_RFC_Location_102_104_RFC_Loc102_104_CRC,data,0,16); //Intel / little-endian;
    }
    else if(@CAN_PrivMain::RFC_Location_102_104::RFC_Loc102_104_CRC_FaultInject == 1)//CRC: Error, set to Zero
    {

      copyBitsToByteArrayLE(0,data,0,16); //Intel / little-endian;
    }
    else if(@CAN_PrivMain::RFC_Location_102_104::RFC_Loc102_104_CRC_FaultInject == 2)//CRC: Error, Freeze last valid value
    {

      copyBitsToByteArrayLE(crc_RFC_Location_102_104_RFC_Loc102_104_CRC,data,0,16); //Intel / little-endian;
    }
}


on sysvar CAN_PrivMain::RFC_Location_105_107::RFC_Location_105_107_ON_OFF
{
  if (@this == 1)
  {
     ILSetMsgEvent(RFC_Location_105_107);
     @CAN_PrivMain::RFC_Location_105_107::RFC_Location_105_107_ON_OFF = 0;
  }
}

void cfg_Msg_RFC_Location_105_107(dword aDlc, byte data[])
{
   int64 i,k;//For looping
   byte xor,data_byte;
   dword crcTemp;
   byte DataLength;
   dword Msg_id;
   
   DataLength = Msg_RFC_Location_105_107.DataLength;//Message Data Length
   Msg_id  = Msg_RFC_Location_105_107.id;//Message ID
   
    if (@CAN_PrivMain::RFC_Location_105_107::RFC_Loc105_107_AliveCtr_FaultInject != 3)//AC: user defined value
    {

    clearBitsInByteArrayLE(data,16,8); //Intel / little-endian

    }
    if (@CAN_PrivMain::RFC_Location_105_107::RFC_Loc105_107_AliveCtr_FaultInject == 0)//AC: No Error, calculate AC
    {
      ++counter_RFC_Location_105_107_RFC_Loc105_107_AliveCtr;
      counter_RFC_Location_105_107_RFC_Loc105_107_AliveCtr %=256;

      copyBitsToByteArrayLE(counter_RFC_Location_105_107_RFC_Loc105_107_AliveCtr,data,16,8); //Intel / little-endian;
    }
    else if (@CAN_PrivMain::RFC_Location_105_107::RFC_Loc105_107_AliveCtr_FaultInject == 1)//AC: Error sequence: set AC = 0
    {

      copyBitsToByteArrayLE(0,data,16,8); //Intel / little-endian;
    }
    else if (@CAN_PrivMain::RFC_Location_105_107::RFC_Loc105_107_AliveCtr_FaultInject == 2)//AC: Error sequence: Freeze last valid value
    {

      copyBitsToByteArrayLE(counter_RFC_Location_105_107_RFC_Loc105_107_AliveCtr,data,16,8); //Intel / little-endian;
    }
    if (@CAN_PrivMain::RFC_Location_105_107::RFC_Loc105_107_ProtBlockCtr_FaultInject != 3)//BC: user defined value
    {

    clearBitsInByteArrayLE(data,24,4); //Intel / little-endian

    }
    if (@CAN_PrivMain::RFC_Location_105_107::RFC_Loc105_107_ProtBlockCtr_FaultInject == 0)//BC: No Error, calculate BC
    {
      bc_RFC_Location_105_107_RFC_Loc105_107_ProtBlockCtr = bc_RFC_Location_ProtBlockCtr ;

      copyBitsToByteArrayLE(bc_RFC_Location_105_107_RFC_Loc105_107_ProtBlockCtr,data,24,4); //Intel / little-endian;
    }
    else if (@CAN_PrivMain::RFC_Location_105_107::RFC_Loc105_107_ProtBlockCtr_FaultInject == 1)//BC: Error sequence: set BC = 0
    {

      copyBitsToByteArrayLE(0,data,24,4); //Intel / little-endian;
    }
    else if (@CAN_PrivMain::RFC_Location_105_107::RFC_Loc105_107_ProtBlockCtr_FaultInject == 2)//BC: Error sequence: Freeze last valid value
    {

      copyBitsToByteArrayLE(bc_RFC_Location_105_107_RFC_Loc105_107_ProtBlockCtr,data,24,4); //Intel / little-endian;
    }
    if (@CAN_PrivMain::RFC_Location_105_107::RFC_Loc105_107_CRC_FaultInject != 3)//CRC: user defined value
    {

    clearBitsInByteArrayLE(data,0,16); //Intel / little-endian

    }
    if(@CAN_PrivMain::RFC_Location_105_107::RFC_Loc105_107_CRC_FaultInject == 0)//CRC: No Error, calculate CRC
    {
      crcTemp = CRC16_INIT;
      for(i = 2; i < (DataLength+2); i++)
      {
        if(i < DataLength)
          data_byte = data[i] ;
        else if(i == DataLength)
          data_byte = (0x212b & 0x00FF);
        else if(i == (DataLength+1))
          data_byte = (0x212b & 0xFF00) >> 8;
        else
          write("Error: DLC exceeded in CRC calculation");
        crcTemp ^= data_byte << 8;
        crcTemp = (crcTemp << (8)) ^ CRC16_CCITT_FALSE_POLY_1021H_Lookup[(crcTemp >> (8)) & (0xFF)];
      }
      crcTemp ^= CRC16_XOR;
      crc_RFC_Location_105_107_RFC_Loc105_107_CRC = crcTemp;

      copyBitsToByteArrayLE(crc_RFC_Location_105_107_RFC_Loc105_107_CRC,data,0,16); //Intel / little-endian;
    }
    else if(@CAN_PrivMain::RFC_Location_105_107::RFC_Loc105_107_CRC_FaultInject == 1)//CRC: Error, set to Zero
    {

      copyBitsToByteArrayLE(0,data,0,16); //Intel / little-endian;
    }
    else if(@CAN_PrivMain::RFC_Location_105_107::RFC_Loc105_107_CRC_FaultInject == 2)//CRC: Error, Freeze last valid value
    {

      copyBitsToByteArrayLE(crc_RFC_Location_105_107_RFC_Loc105_107_CRC,data,0,16); //Intel / little-endian;
    }
}


on sysvar CAN_PrivMain::RFC_Location_108_110::RFC_Location_108_110_ON_OFF
{
  if (@this == 1)
  {
     ILSetMsgEvent(RFC_Location_108_110);
     @CAN_PrivMain::RFC_Location_108_110::RFC_Location_108_110_ON_OFF = 0;
  }
}

void cfg_Msg_RFC_Location_108_110(dword aDlc, byte data[])
{
   int64 i,k;//For looping
   byte xor,data_byte;
   dword crcTemp;
   byte DataLength;
   dword Msg_id;
   
   DataLength = Msg_RFC_Location_108_110.DataLength;//Message Data Length
   Msg_id  = Msg_RFC_Location_108_110.id;//Message ID
   
    if (@CAN_PrivMain::RFC_Location_108_110::RFC_Loc108_110_AliveCtr_FaultInject != 3)//AC: user defined value
    {

    clearBitsInByteArrayLE(data,16,8); //Intel / little-endian

    }
    if (@CAN_PrivMain::RFC_Location_108_110::RFC_Loc108_110_AliveCtr_FaultInject == 0)//AC: No Error, calculate AC
    {
      ++counter_RFC_Location_108_110_RFC_Loc108_110_AliveCtr;
      counter_RFC_Location_108_110_RFC_Loc108_110_AliveCtr %=256;

      copyBitsToByteArrayLE(counter_RFC_Location_108_110_RFC_Loc108_110_AliveCtr,data,16,8); //Intel / little-endian;
    }
    else if (@CAN_PrivMain::RFC_Location_108_110::RFC_Loc108_110_AliveCtr_FaultInject == 1)//AC: Error sequence: set AC = 0
    {

      copyBitsToByteArrayLE(0,data,16,8); //Intel / little-endian;
    }
    else if (@CAN_PrivMain::RFC_Location_108_110::RFC_Loc108_110_AliveCtr_FaultInject == 2)//AC: Error sequence: Freeze last valid value
    {

      copyBitsToByteArrayLE(counter_RFC_Location_108_110_RFC_Loc108_110_AliveCtr,data,16,8); //Intel / little-endian;
    }
    if (@CAN_PrivMain::RFC_Location_108_110::RFC_Loc108_110_ProtBlockCtr_FaultInject != 3)//BC: user defined value
    {

    clearBitsInByteArrayLE(data,24,4); //Intel / little-endian

    }
    if (@CAN_PrivMain::RFC_Location_108_110::RFC_Loc108_110_ProtBlockCtr_FaultInject == 0)//BC: No Error, calculate BC
    {
      bc_RFC_Location_108_110_RFC_Loc108_110_ProtBlockCtr = bc_RFC_Location_ProtBlockCtr ;

      copyBitsToByteArrayLE(bc_RFC_Location_108_110_RFC_Loc108_110_ProtBlockCtr,data,24,4); //Intel / little-endian;
    }
    else if (@CAN_PrivMain::RFC_Location_108_110::RFC_Loc108_110_ProtBlockCtr_FaultInject == 1)//BC: Error sequence: set BC = 0
    {

      copyBitsToByteArrayLE(0,data,24,4); //Intel / little-endian;
    }
    else if (@CAN_PrivMain::RFC_Location_108_110::RFC_Loc108_110_ProtBlockCtr_FaultInject == 2)//BC: Error sequence: Freeze last valid value
    {

      copyBitsToByteArrayLE(bc_RFC_Location_108_110_RFC_Loc108_110_ProtBlockCtr,data,24,4); //Intel / little-endian;
    }
    if (@CAN_PrivMain::RFC_Location_108_110::RFC_Loc108_110_CRC_FaultInject != 3)//CRC: user defined value
    {

    clearBitsInByteArrayLE(data,0,16); //Intel / little-endian

    }
    if(@CAN_PrivMain::RFC_Location_108_110::RFC_Loc108_110_CRC_FaultInject == 0)//CRC: No Error, calculate CRC
    {
      crcTemp = CRC16_INIT;
      for(i = 2; i < (DataLength+2); i++)
      {
        if(i < DataLength)
          data_byte = data[i] ;
        else if(i == DataLength)
          data_byte = (0x212c & 0x00FF);
        else if(i == (DataLength+1))
          data_byte = (0x212c & 0xFF00) >> 8;
        else
          write("Error: DLC exceeded in CRC calculation");
        crcTemp ^= data_byte << 8;
        crcTemp = (crcTemp << (8)) ^ CRC16_CCITT_FALSE_POLY_1021H_Lookup[(crcTemp >> (8)) & (0xFF)];
      }
      crcTemp ^= CRC16_XOR;
      crc_RFC_Location_108_110_RFC_Loc108_110_CRC = crcTemp;

      copyBitsToByteArrayLE(crc_RFC_Location_108_110_RFC_Loc108_110_CRC,data,0,16); //Intel / little-endian;
    }
    else if(@CAN_PrivMain::RFC_Location_108_110::RFC_Loc108_110_CRC_FaultInject == 1)//CRC: Error, set to Zero
    {

      copyBitsToByteArrayLE(0,data,0,16); //Intel / little-endian;
    }
    else if(@CAN_PrivMain::RFC_Location_108_110::RFC_Loc108_110_CRC_FaultInject == 2)//CRC: Error, Freeze last valid value
    {

      copyBitsToByteArrayLE(crc_RFC_Location_108_110_RFC_Loc108_110_CRC,data,0,16); //Intel / little-endian;
    }
}


on sysvar CAN_PrivMain::RFC_Location_111_113::RFC_Location_111_113_ON_OFF
{
  if (@this == 1)
  {
     ILSetMsgEvent(RFC_Location_111_113);
     @CAN_PrivMain::RFC_Location_111_113::RFC_Location_111_113_ON_OFF = 0;
  }
}

void cfg_Msg_RFC_Location_111_113(dword aDlc, byte data[])
{
   int64 i,k;//For looping
   byte xor,data_byte;
   dword crcTemp;
   byte DataLength;
   dword Msg_id;
   
   DataLength = Msg_RFC_Location_111_113.DataLength;//Message Data Length
   Msg_id  = Msg_RFC_Location_111_113.id;//Message ID
   
    if (@CAN_PrivMain::RFC_Location_111_113::RFC_Loc111_113_AliveCtr_FaultInject != 3)//AC: user defined value
    {

    clearBitsInByteArrayLE(data,16,8); //Intel / little-endian

    }
    if (@CAN_PrivMain::RFC_Location_111_113::RFC_Loc111_113_AliveCtr_FaultInject == 0)//AC: No Error, calculate AC
    {
      ++counter_RFC_Location_111_113_RFC_Loc111_113_AliveCtr;
      counter_RFC_Location_111_113_RFC_Loc111_113_AliveCtr %=256;

      copyBitsToByteArrayLE(counter_RFC_Location_111_113_RFC_Loc111_113_AliveCtr,data,16,8); //Intel / little-endian;
    }
    else if (@CAN_PrivMain::RFC_Location_111_113::RFC_Loc111_113_AliveCtr_FaultInject == 1)//AC: Error sequence: set AC = 0
    {

      copyBitsToByteArrayLE(0,data,16,8); //Intel / little-endian;
    }
    else if (@CAN_PrivMain::RFC_Location_111_113::RFC_Loc111_113_AliveCtr_FaultInject == 2)//AC: Error sequence: Freeze last valid value
    {

      copyBitsToByteArrayLE(counter_RFC_Location_111_113_RFC_Loc111_113_AliveCtr,data,16,8); //Intel / little-endian;
    }
    if (@CAN_PrivMain::RFC_Location_111_113::RFC_Loc111_113_ProtBlockCtr_FaultInject != 3)//BC: user defined value
    {

    clearBitsInByteArrayLE(data,24,4); //Intel / little-endian

    }
    if (@CAN_PrivMain::RFC_Location_111_113::RFC_Loc111_113_ProtBlockCtr_FaultInject == 0)//BC: No Error, calculate BC
    {
      bc_RFC_Location_111_113_RFC_Loc111_113_ProtBlockCtr = bc_RFC_Location_ProtBlockCtr ;

      copyBitsToByteArrayLE(bc_RFC_Location_111_113_RFC_Loc111_113_ProtBlockCtr,data,24,4); //Intel / little-endian;
    }
    else if (@CAN_PrivMain::RFC_Location_111_113::RFC_Loc111_113_ProtBlockCtr_FaultInject == 1)//BC: Error sequence: set BC = 0
    {

      copyBitsToByteArrayLE(0,data,24,4); //Intel / little-endian;
    }
    else if (@CAN_PrivMain::RFC_Location_111_113::RFC_Loc111_113_ProtBlockCtr_FaultInject == 2)//BC: Error sequence: Freeze last valid value
    {

      copyBitsToByteArrayLE(bc_RFC_Location_111_113_RFC_Loc111_113_ProtBlockCtr,data,24,4); //Intel / little-endian;
    }
    if (@CAN_PrivMain::RFC_Location_111_113::RFC_Loc111_113_CRC_FaultInject != 3)//CRC: user defined value
    {

    clearBitsInByteArrayLE(data,0,16); //Intel / little-endian

    }
    if(@CAN_PrivMain::RFC_Location_111_113::RFC_Loc111_113_CRC_FaultInject == 0)//CRC: No Error, calculate CRC
    {
      crcTemp = CRC16_INIT;
      for(i = 2; i < (DataLength+2); i++)
      {
        if(i < DataLength)
          data_byte = data[i] ;
        else if(i == DataLength)
          data_byte = (0x212d & 0x00FF);
        else if(i == (DataLength+1))
          data_byte = (0x212d & 0xFF00) >> 8;
        else
          write("Error: DLC exceeded in CRC calculation");
        crcTemp ^= data_byte << 8;
        crcTemp = (crcTemp << (8)) ^ CRC16_CCITT_FALSE_POLY_1021H_Lookup[(crcTemp >> (8)) & (0xFF)];
      }
      crcTemp ^= CRC16_XOR;
      crc_RFC_Location_111_113_RFC_Loc111_113_CRC = crcTemp;

      copyBitsToByteArrayLE(crc_RFC_Location_111_113_RFC_Loc111_113_CRC,data,0,16); //Intel / little-endian;
    }
    else if(@CAN_PrivMain::RFC_Location_111_113::RFC_Loc111_113_CRC_FaultInject == 1)//CRC: Error, set to Zero
    {

      copyBitsToByteArrayLE(0,data,0,16); //Intel / little-endian;
    }
    else if(@CAN_PrivMain::RFC_Location_111_113::RFC_Loc111_113_CRC_FaultInject == 2)//CRC: Error, Freeze last valid value
    {

      copyBitsToByteArrayLE(crc_RFC_Location_111_113_RFC_Loc111_113_CRC,data,0,16); //Intel / little-endian;
    }
}


on sysvar CAN_PrivMain::RFC_Location_114_116::RFC_Location_114_116_ON_OFF
{
  if (@this == 1)
  {
     ILSetMsgEvent(RFC_Location_114_116);
     @CAN_PrivMain::RFC_Location_114_116::RFC_Location_114_116_ON_OFF = 0;
  }
}

void cfg_Msg_RFC_Location_114_116(dword aDlc, byte data[])
{
   int64 i,k;//For looping
   byte xor,data_byte;
   dword crcTemp;
   byte DataLength;
   dword Msg_id;
   
   DataLength = Msg_RFC_Location_114_116.DataLength;//Message Data Length
   Msg_id  = Msg_RFC_Location_114_116.id;//Message ID
   
    if (@CAN_PrivMain::RFC_Location_114_116::RFC_Loc114_116_AliveCtr_FaultInject != 3)//AC: user defined value
    {

    clearBitsInByteArrayLE(data,16,8); //Intel / little-endian

    }
    if (@CAN_PrivMain::RFC_Location_114_116::RFC_Loc114_116_AliveCtr_FaultInject == 0)//AC: No Error, calculate AC
    {
      ++counter_RFC_Location_114_116_RFC_Loc114_116_AliveCtr;
      counter_RFC_Location_114_116_RFC_Loc114_116_AliveCtr %=256;

      copyBitsToByteArrayLE(counter_RFC_Location_114_116_RFC_Loc114_116_AliveCtr,data,16,8); //Intel / little-endian;
    }
    else if (@CAN_PrivMain::RFC_Location_114_116::RFC_Loc114_116_AliveCtr_FaultInject == 1)//AC: Error sequence: set AC = 0
    {

      copyBitsToByteArrayLE(0,data,16,8); //Intel / little-endian;
    }
    else if (@CAN_PrivMain::RFC_Location_114_116::RFC_Loc114_116_AliveCtr_FaultInject == 2)//AC: Error sequence: Freeze last valid value
    {

      copyBitsToByteArrayLE(counter_RFC_Location_114_116_RFC_Loc114_116_AliveCtr,data,16,8); //Intel / little-endian;
    }
    if (@CAN_PrivMain::RFC_Location_114_116::RFC_Loc114_116_ProtBlockCtr_FaultInject != 3)//BC: user defined value
    {

    clearBitsInByteArrayLE(data,24,4); //Intel / little-endian

    }
    if (@CAN_PrivMain::RFC_Location_114_116::RFC_Loc114_116_ProtBlockCtr_FaultInject == 0)//BC: No Error, calculate BC
    {
      bc_RFC_Location_114_116_RFC_Loc114_116_ProtBlockCtr = bc_RFC_Location_ProtBlockCtr ;

      copyBitsToByteArrayLE(bc_RFC_Location_114_116_RFC_Loc114_116_ProtBlockCtr,data,24,4); //Intel / little-endian;
    }
    else if (@CAN_PrivMain::RFC_Location_114_116::RFC_Loc114_116_ProtBlockCtr_FaultInject == 1)//BC: Error sequence: set BC = 0
    {

      copyBitsToByteArrayLE(0,data,24,4); //Intel / little-endian;
    }
    else if (@CAN_PrivMain::RFC_Location_114_116::RFC_Loc114_116_ProtBlockCtr_FaultInject == 2)//BC: Error sequence: Freeze last valid value
    {

      copyBitsToByteArrayLE(bc_RFC_Location_114_116_RFC_Loc114_116_ProtBlockCtr,data,24,4); //Intel / little-endian;
    }
    if (@CAN_PrivMain::RFC_Location_114_116::RFC_Loc114_116_CRC_FaultInject != 3)//CRC: user defined value
    {

    clearBitsInByteArrayLE(data,0,16); //Intel / little-endian

    }
    if(@CAN_PrivMain::RFC_Location_114_116::RFC_Loc114_116_CRC_FaultInject == 0)//CRC: No Error, calculate CRC
    {
      crcTemp = CRC16_INIT;
      for(i = 2; i < (DataLength+2); i++)
      {
        if(i < DataLength)
          data_byte = data[i] ;
        else if(i == DataLength)
          data_byte = (0x212e & 0x00FF);
        else if(i == (DataLength+1))
          data_byte = (0x212e & 0xFF00) >> 8;
        else
          write("Error: DLC exceeded in CRC calculation");
        crcTemp ^= data_byte << 8;
        crcTemp = (crcTemp << (8)) ^ CRC16_CCITT_FALSE_POLY_1021H_Lookup[(crcTemp >> (8)) & (0xFF)];
      }
      crcTemp ^= CRC16_XOR;
      crc_RFC_Location_114_116_RFC_Loc114_116_CRC = crcTemp;

      copyBitsToByteArrayLE(crc_RFC_Location_114_116_RFC_Loc114_116_CRC,data,0,16); //Intel / little-endian;
    }
    else if(@CAN_PrivMain::RFC_Location_114_116::RFC_Loc114_116_CRC_FaultInject == 1)//CRC: Error, set to Zero
    {

      copyBitsToByteArrayLE(0,data,0,16); //Intel / little-endian;
    }
    else if(@CAN_PrivMain::RFC_Location_114_116::RFC_Loc114_116_CRC_FaultInject == 2)//CRC: Error, Freeze last valid value
    {

      copyBitsToByteArrayLE(crc_RFC_Location_114_116_RFC_Loc114_116_CRC,data,0,16); //Intel / little-endian;
    }
}


on sysvar CAN_PrivMain::RFC_Location_117_119::RFC_Location_117_119_ON_OFF
{
  if (@this == 1)
  {
     ILSetMsgEvent(RFC_Location_117_119);
     @CAN_PrivMain::RFC_Location_117_119::RFC_Location_117_119_ON_OFF = 0;
  }
}

void cfg_Msg_RFC_Location_117_119(dword aDlc, byte data[])
{
   int64 i,k;//For looping
   byte xor,data_byte;
   dword crcTemp;
   byte DataLength;
   dword Msg_id;
   
   DataLength = Msg_RFC_Location_117_119.DataLength;//Message Data Length
   Msg_id  = Msg_RFC_Location_117_119.id;//Message ID
   
    if (@CAN_PrivMain::RFC_Location_117_119::RFC_Loc117_119_AliveCtr_FaultInject != 3)//AC: user defined value
    {

    clearBitsInByteArrayLE(data,16,8); //Intel / little-endian

    }
    if (@CAN_PrivMain::RFC_Location_117_119::RFC_Loc117_119_AliveCtr_FaultInject == 0)//AC: No Error, calculate AC
    {
      ++counter_RFC_Location_117_119_RFC_Loc117_119_AliveCtr;
      counter_RFC_Location_117_119_RFC_Loc117_119_AliveCtr %=256;

      copyBitsToByteArrayLE(counter_RFC_Location_117_119_RFC_Loc117_119_AliveCtr,data,16,8); //Intel / little-endian;
    }
    else if (@CAN_PrivMain::RFC_Location_117_119::RFC_Loc117_119_AliveCtr_FaultInject == 1)//AC: Error sequence: set AC = 0
    {

      copyBitsToByteArrayLE(0,data,16,8); //Intel / little-endian;
    }
    else if (@CAN_PrivMain::RFC_Location_117_119::RFC_Loc117_119_AliveCtr_FaultInject == 2)//AC: Error sequence: Freeze last valid value
    {

      copyBitsToByteArrayLE(counter_RFC_Location_117_119_RFC_Loc117_119_AliveCtr,data,16,8); //Intel / little-endian;
    }
    if (@CAN_PrivMain::RFC_Location_117_119::RFC_Loc117_119_ProtBlockCtr_FaultInject != 3)//BC: user defined value
    {

    clearBitsInByteArrayLE(data,24,4); //Intel / little-endian

    }
    if (@CAN_PrivMain::RFC_Location_117_119::RFC_Loc117_119_ProtBlockCtr_FaultInject == 0)//BC: No Error, calculate BC
    {
      bc_RFC_Location_117_119_RFC_Loc117_119_ProtBlockCtr = bc_RFC_Location_ProtBlockCtr ;

      copyBitsToByteArrayLE(bc_RFC_Location_117_119_RFC_Loc117_119_ProtBlockCtr,data,24,4); //Intel / little-endian;
    }
    else if (@CAN_PrivMain::RFC_Location_117_119::RFC_Loc117_119_ProtBlockCtr_FaultInject == 1)//BC: Error sequence: set BC = 0
    {

      copyBitsToByteArrayLE(0,data,24,4); //Intel / little-endian;
    }
    else if (@CAN_PrivMain::RFC_Location_117_119::RFC_Loc117_119_ProtBlockCtr_FaultInject == 2)//BC: Error sequence: Freeze last valid value
    {

      copyBitsToByteArrayLE(bc_RFC_Location_117_119_RFC_Loc117_119_ProtBlockCtr,data,24,4); //Intel / little-endian;
    }
    if (@CAN_PrivMain::RFC_Location_117_119::RFC_Loc117_119_CRC_FaultInject != 3)//CRC: user defined value
    {

    clearBitsInByteArrayLE(data,0,16); //Intel / little-endian

    }
    if(@CAN_PrivMain::RFC_Location_117_119::RFC_Loc117_119_CRC_FaultInject == 0)//CRC: No Error, calculate CRC
    {
      crcTemp = CRC16_INIT;
      for(i = 2; i < (DataLength+2); i++)
      {
        if(i < DataLength)
          data_byte = data[i] ;
        else if(i == DataLength)
          data_byte = (0x212f & 0x00FF);
        else if(i == (DataLength+1))
          data_byte = (0x212f & 0xFF00) >> 8;
        else
          write("Error: DLC exceeded in CRC calculation");
        crcTemp ^= data_byte << 8;
        crcTemp = (crcTemp << (8)) ^ CRC16_CCITT_FALSE_POLY_1021H_Lookup[(crcTemp >> (8)) & (0xFF)];
      }
      crcTemp ^= CRC16_XOR;
      crc_RFC_Location_117_119_RFC_Loc117_119_CRC = crcTemp;

      copyBitsToByteArrayLE(crc_RFC_Location_117_119_RFC_Loc117_119_CRC,data,0,16); //Intel / little-endian;
    }
    else if(@CAN_PrivMain::RFC_Location_117_119::RFC_Loc117_119_CRC_FaultInject == 1)//CRC: Error, set to Zero
    {

      copyBitsToByteArrayLE(0,data,0,16); //Intel / little-endian;
    }
    else if(@CAN_PrivMain::RFC_Location_117_119::RFC_Loc117_119_CRC_FaultInject == 2)//CRC: Error, Freeze last valid value
    {

      copyBitsToByteArrayLE(crc_RFC_Location_117_119_RFC_Loc117_119_CRC,data,0,16); //Intel / little-endian;
    }
}


on sysvar CAN_PrivMain::RFC_Location_120_122::RFC_Location_120_122_ON_OFF
{
  if (@this == 1)
  {
     ILSetMsgEvent(RFC_Location_120_122);
     @CAN_PrivMain::RFC_Location_120_122::RFC_Location_120_122_ON_OFF = 0;
  }
}

void cfg_Msg_RFC_Location_120_122(dword aDlc, byte data[])
{
   int64 i,k;//For looping
   byte xor,data_byte;
   dword crcTemp;
   byte DataLength;
   dword Msg_id;
   
   DataLength = Msg_RFC_Location_120_122.DataLength;//Message Data Length
   Msg_id  = Msg_RFC_Location_120_122.id;//Message ID
   
    if (@CAN_PrivMain::RFC_Location_120_122::RFC_Loc120_122_AliveCtr_FaultInject != 3)//AC: user defined value
    {

    clearBitsInByteArrayLE(data,16,8); //Intel / little-endian

    }
    if (@CAN_PrivMain::RFC_Location_120_122::RFC_Loc120_122_AliveCtr_FaultInject == 0)//AC: No Error, calculate AC
    {
      ++counter_RFC_Location_120_122_RFC_Loc120_122_AliveCtr;
      counter_RFC_Location_120_122_RFC_Loc120_122_AliveCtr %=256;

      copyBitsToByteArrayLE(counter_RFC_Location_120_122_RFC_Loc120_122_AliveCtr,data,16,8); //Intel / little-endian;
    }
    else if (@CAN_PrivMain::RFC_Location_120_122::RFC_Loc120_122_AliveCtr_FaultInject == 1)//AC: Error sequence: set AC = 0
    {

      copyBitsToByteArrayLE(0,data,16,8); //Intel / little-endian;
    }
    else if (@CAN_PrivMain::RFC_Location_120_122::RFC_Loc120_122_AliveCtr_FaultInject == 2)//AC: Error sequence: Freeze last valid value
    {

      copyBitsToByteArrayLE(counter_RFC_Location_120_122_RFC_Loc120_122_AliveCtr,data,16,8); //Intel / little-endian;
    }
    if (@CAN_PrivMain::RFC_Location_120_122::RFC_Loc120_122_ProtBlockCtr_FaultInject != 3)//BC: user defined value
    {

    clearBitsInByteArrayLE(data,24,4); //Intel / little-endian

    }
    if (@CAN_PrivMain::RFC_Location_120_122::RFC_Loc120_122_ProtBlockCtr_FaultInject == 0)//BC: No Error, calculate BC
    {
      bc_RFC_Location_120_122_RFC_Loc120_122_ProtBlockCtr = bc_RFC_Location_ProtBlockCtr ;

      copyBitsToByteArrayLE(bc_RFC_Location_120_122_RFC_Loc120_122_ProtBlockCtr,data,24,4); //Intel / little-endian;
    }
    else if (@CAN_PrivMain::RFC_Location_120_122::RFC_Loc120_122_ProtBlockCtr_FaultInject == 1)//BC: Error sequence: set BC = 0
    {

      copyBitsToByteArrayLE(0,data,24,4); //Intel / little-endian;
    }
    else if (@CAN_PrivMain::RFC_Location_120_122::RFC_Loc120_122_ProtBlockCtr_FaultInject == 2)//BC: Error sequence: Freeze last valid value
    {

      copyBitsToByteArrayLE(bc_RFC_Location_120_122_RFC_Loc120_122_ProtBlockCtr,data,24,4); //Intel / little-endian;
    }
    if (@CAN_PrivMain::RFC_Location_120_122::RFC_Loc120_122_CRC_FaultInject != 3)//CRC: user defined value
    {

    clearBitsInByteArrayLE(data,0,16); //Intel / little-endian

    }
    if(@CAN_PrivMain::RFC_Location_120_122::RFC_Loc120_122_CRC_FaultInject == 0)//CRC: No Error, calculate CRC
    {
      crcTemp = CRC16_INIT;
      for(i = 2; i < (DataLength+2); i++)
      {
        if(i < DataLength)
          data_byte = data[i] ;
        else if(i == DataLength)
          data_byte = (0x2130 & 0x00FF);
        else if(i == (DataLength+1))
          data_byte = (0x2130 & 0xFF00) >> 8;
        else
          write("Error: DLC exceeded in CRC calculation");
        crcTemp ^= data_byte << 8;
        crcTemp = (crcTemp << (8)) ^ CRC16_CCITT_FALSE_POLY_1021H_Lookup[(crcTemp >> (8)) & (0xFF)];
      }
      crcTemp ^= CRC16_XOR;
      crc_RFC_Location_120_122_RFC_Loc120_122_CRC = crcTemp;

      copyBitsToByteArrayLE(crc_RFC_Location_120_122_RFC_Loc120_122_CRC,data,0,16); //Intel / little-endian;
    }
    else if(@CAN_PrivMain::RFC_Location_120_122::RFC_Loc120_122_CRC_FaultInject == 1)//CRC: Error, set to Zero
    {

      copyBitsToByteArrayLE(0,data,0,16); //Intel / little-endian;
    }
    else if(@CAN_PrivMain::RFC_Location_120_122::RFC_Loc120_122_CRC_FaultInject == 2)//CRC: Error, Freeze last valid value
    {

      copyBitsToByteArrayLE(crc_RFC_Location_120_122_RFC_Loc120_122_CRC,data,0,16); //Intel / little-endian;
    }
}


on sysvar CAN_PrivMain::RFC_Location_123_125::RFC_Location_123_125_ON_OFF
{
  if (@this == 1)
  {
     ILSetMsgEvent(RFC_Location_123_125);
     @CAN_PrivMain::RFC_Location_123_125::RFC_Location_123_125_ON_OFF = 0;
  }
}

void cfg_Msg_RFC_Location_123_125(dword aDlc, byte data[])
{
   int64 i,k;//For looping
   byte xor,data_byte;
   dword crcTemp;
   byte DataLength;
   dword Msg_id;
   
   DataLength = Msg_RFC_Location_123_125.DataLength;//Message Data Length
   Msg_id  = Msg_RFC_Location_123_125.id;//Message ID
   
    if (@CAN_PrivMain::RFC_Location_123_125::RFC_Loc123_125_AliveCtr_FaultInject != 3)//AC: user defined value
    {

    clearBitsInByteArrayLE(data,16,8); //Intel / little-endian

    }
    if (@CAN_PrivMain::RFC_Location_123_125::RFC_Loc123_125_AliveCtr_FaultInject == 0)//AC: No Error, calculate AC
    {
      ++counter_RFC_Location_123_125_RFC_Loc123_125_AliveCtr;
      counter_RFC_Location_123_125_RFC_Loc123_125_AliveCtr %=256;

      copyBitsToByteArrayLE(counter_RFC_Location_123_125_RFC_Loc123_125_AliveCtr,data,16,8); //Intel / little-endian;
    }
    else if (@CAN_PrivMain::RFC_Location_123_125::RFC_Loc123_125_AliveCtr_FaultInject == 1)//AC: Error sequence: set AC = 0
    {

      copyBitsToByteArrayLE(0,data,16,8); //Intel / little-endian;
    }
    else if (@CAN_PrivMain::RFC_Location_123_125::RFC_Loc123_125_AliveCtr_FaultInject == 2)//AC: Error sequence: Freeze last valid value
    {

      copyBitsToByteArrayLE(counter_RFC_Location_123_125_RFC_Loc123_125_AliveCtr,data,16,8); //Intel / little-endian;
    }
    if (@CAN_PrivMain::RFC_Location_123_125::RFC_Loc123_125_ProtBlockCtr_FaultInject != 3)//BC: user defined value
    {

    clearBitsInByteArrayLE(data,24,4); //Intel / little-endian

    }
    if (@CAN_PrivMain::RFC_Location_123_125::RFC_Loc123_125_ProtBlockCtr_FaultInject == 0)//BC: No Error, calculate BC
    {
      bc_RFC_Location_123_125_RFC_Loc123_125_ProtBlockCtr = bc_RFC_Location_ProtBlockCtr ;

      copyBitsToByteArrayLE(bc_RFC_Location_123_125_RFC_Loc123_125_ProtBlockCtr,data,24,4); //Intel / little-endian;
    }
    else if (@CAN_PrivMain::RFC_Location_123_125::RFC_Loc123_125_ProtBlockCtr_FaultInject == 1)//BC: Error sequence: set BC = 0
    {

      copyBitsToByteArrayLE(0,data,24,4); //Intel / little-endian;
    }
    else if (@CAN_PrivMain::RFC_Location_123_125::RFC_Loc123_125_ProtBlockCtr_FaultInject == 2)//BC: Error sequence: Freeze last valid value
    {

      copyBitsToByteArrayLE(bc_RFC_Location_123_125_RFC_Loc123_125_ProtBlockCtr,data,24,4); //Intel / little-endian;
    }
    if (@CAN_PrivMain::RFC_Location_123_125::RFC_Loc123_125_CRC_FaultInject != 3)//CRC: user defined value
    {

    clearBitsInByteArrayLE(data,0,16); //Intel / little-endian

    }
    if(@CAN_PrivMain::RFC_Location_123_125::RFC_Loc123_125_CRC_FaultInject == 0)//CRC: No Error, calculate CRC
    {
      crcTemp = CRC16_INIT;
      for(i = 2; i < (DataLength+2); i++)
      {
        if(i < DataLength)
          data_byte = data[i] ;
        else if(i == DataLength)
          data_byte = (0x2131 & 0x00FF);
        else if(i == (DataLength+1))
          data_byte = (0x2131 & 0xFF00) >> 8;
        else
          write("Error: DLC exceeded in CRC calculation");
        crcTemp ^= data_byte << 8;
        crcTemp = (crcTemp << (8)) ^ CRC16_CCITT_FALSE_POLY_1021H_Lookup[(crcTemp >> (8)) & (0xFF)];
      }
      crcTemp ^= CRC16_XOR;
      crc_RFC_Location_123_125_RFC_Loc123_125_CRC = crcTemp;

      copyBitsToByteArrayLE(crc_RFC_Location_123_125_RFC_Loc123_125_CRC,data,0,16); //Intel / little-endian;
    }
    else if(@CAN_PrivMain::RFC_Location_123_125::RFC_Loc123_125_CRC_FaultInject == 1)//CRC: Error, set to Zero
    {

      copyBitsToByteArrayLE(0,data,0,16); //Intel / little-endian;
    }
    else if(@CAN_PrivMain::RFC_Location_123_125::RFC_Loc123_125_CRC_FaultInject == 2)//CRC: Error, Freeze last valid value
    {

      copyBitsToByteArrayLE(crc_RFC_Location_123_125_RFC_Loc123_125_CRC,data,0,16); //Intel / little-endian;
    }
}


on sysvar CAN_PrivMain::RFC_Location_126_128::RFC_Location_126_128_ON_OFF
{
  if (@this == 1)
  {
     ILSetMsgEvent(RFC_Location_126_128);
     @CAN_PrivMain::RFC_Location_126_128::RFC_Location_126_128_ON_OFF = 0;
  }
}

void cfg_Msg_RFC_Location_126_128(dword aDlc, byte data[])
{
   int64 i,k;//For looping
   byte xor,data_byte;
   dword crcTemp;
   byte DataLength;
   dword Msg_id;
   
   DataLength = Msg_RFC_Location_126_128.DataLength;//Message Data Length
   Msg_id  = Msg_RFC_Location_126_128.id;//Message ID
   
    if (@CAN_PrivMain::RFC_Location_126_128::RFC_Loc126_128_AliveCtr_FaultInject != 3)//AC: user defined value
    {

    clearBitsInByteArrayLE(data,16,8); //Intel / little-endian

    }
    if (@CAN_PrivMain::RFC_Location_126_128::RFC_Loc126_128_AliveCtr_FaultInject == 0)//AC: No Error, calculate AC
    {
      ++counter_RFC_Location_126_128_RFC_Loc126_128_AliveCtr;
      counter_RFC_Location_126_128_RFC_Loc126_128_AliveCtr %=256;

      copyBitsToByteArrayLE(counter_RFC_Location_126_128_RFC_Loc126_128_AliveCtr,data,16,8); //Intel / little-endian;
    }
    else if (@CAN_PrivMain::RFC_Location_126_128::RFC_Loc126_128_AliveCtr_FaultInject == 1)//AC: Error sequence: set AC = 0
    {

      copyBitsToByteArrayLE(0,data,16,8); //Intel / little-endian;
    }
    else if (@CAN_PrivMain::RFC_Location_126_128::RFC_Loc126_128_AliveCtr_FaultInject == 2)//AC: Error sequence: Freeze last valid value
    {

      copyBitsToByteArrayLE(counter_RFC_Location_126_128_RFC_Loc126_128_AliveCtr,data,16,8); //Intel / little-endian;
    }
    if (@CAN_PrivMain::RFC_Location_126_128::RFC_Loc126_128_ProtBlockCtr_FaultInject != 3)//BC: user defined value
    {

    clearBitsInByteArrayLE(data,24,4); //Intel / little-endian

    }
    if (@CAN_PrivMain::RFC_Location_126_128::RFC_Loc126_128_ProtBlockCtr_FaultInject == 0)//BC: No Error, calculate BC
    {
      bc_RFC_Location_126_128_RFC_Loc126_128_ProtBlockCtr = bc_RFC_Location_ProtBlockCtr ;

      copyBitsToByteArrayLE(bc_RFC_Location_126_128_RFC_Loc126_128_ProtBlockCtr,data,24,4); //Intel / little-endian;
    }
    else if (@CAN_PrivMain::RFC_Location_126_128::RFC_Loc126_128_ProtBlockCtr_FaultInject == 1)//BC: Error sequence: set BC = 0
    {

      copyBitsToByteArrayLE(0,data,24,4); //Intel / little-endian;
    }
    else if (@CAN_PrivMain::RFC_Location_126_128::RFC_Loc126_128_ProtBlockCtr_FaultInject == 2)//BC: Error sequence: Freeze last valid value
    {

      copyBitsToByteArrayLE(bc_RFC_Location_126_128_RFC_Loc126_128_ProtBlockCtr,data,24,4); //Intel / little-endian;
    }
    if (@CAN_PrivMain::RFC_Location_126_128::RFC_Loc126_128_CRC_FaultInject != 3)//CRC: user defined value
    {

    clearBitsInByteArrayLE(data,0,16); //Intel / little-endian

    }
    if(@CAN_PrivMain::RFC_Location_126_128::RFC_Loc126_128_CRC_FaultInject == 0)//CRC: No Error, calculate CRC
    {
      crcTemp = CRC16_INIT;
      for(i = 2; i < (DataLength+2); i++)
      {
        if(i < DataLength)
          data_byte = data[i] ;
        else if(i == DataLength)
          data_byte = (0x2132 & 0x00FF);
        else if(i == (DataLength+1))
          data_byte = (0x2132 & 0xFF00) >> 8;
        else
          write("Error: DLC exceeded in CRC calculation");
        crcTemp ^= data_byte << 8;
        crcTemp = (crcTemp << (8)) ^ CRC16_CCITT_FALSE_POLY_1021H_Lookup[(crcTemp >> (8)) & (0xFF)];
      }
      crcTemp ^= CRC16_XOR;
      crc_RFC_Location_126_128_RFC_Loc126_128_CRC = crcTemp;

      copyBitsToByteArrayLE(crc_RFC_Location_126_128_RFC_Loc126_128_CRC,data,0,16); //Intel / little-endian;
    }
    else if(@CAN_PrivMain::RFC_Location_126_128::RFC_Loc126_128_CRC_FaultInject == 1)//CRC: Error, set to Zero
    {

      copyBitsToByteArrayLE(0,data,0,16); //Intel / little-endian;
    }
    else if(@CAN_PrivMain::RFC_Location_126_128::RFC_Loc126_128_CRC_FaultInject == 2)//CRC: Error, Freeze last valid value
    {

      copyBitsToByteArrayLE(crc_RFC_Location_126_128_RFC_Loc126_128_CRC,data,0,16); //Intel / little-endian;
    }
}


on sysvar CAN_PrivMain::RFC_Location_129_131::RFC_Location_129_131_ON_OFF
{
  if (@this == 1)
  {
     ILSetMsgEvent(RFC_Location_129_131);
     @CAN_PrivMain::RFC_Location_129_131::RFC_Location_129_131_ON_OFF = 0;
  }
}

void cfg_Msg_RFC_Location_129_131(dword aDlc, byte data[])
{
   int64 i,k;//For looping
   byte xor,data_byte;
   dword crcTemp;
   byte DataLength;
   dword Msg_id;
   
   DataLength = Msg_RFC_Location_129_131.DataLength;//Message Data Length
   Msg_id  = Msg_RFC_Location_129_131.id;//Message ID
   
    if (@CAN_PrivMain::RFC_Location_129_131::RFC_Loc129_131_AliveCtr_FaultInject != 3)//AC: user defined value
    {

    clearBitsInByteArrayLE(data,16,8); //Intel / little-endian

    }
    if (@CAN_PrivMain::RFC_Location_129_131::RFC_Loc129_131_AliveCtr_FaultInject == 0)//AC: No Error, calculate AC
    {
      ++counter_RFC_Location_129_131_RFC_Loc129_131_AliveCtr;
      counter_RFC_Location_129_131_RFC_Loc129_131_AliveCtr %=256;

      copyBitsToByteArrayLE(counter_RFC_Location_129_131_RFC_Loc129_131_AliveCtr,data,16,8); //Intel / little-endian;
    }
    else if (@CAN_PrivMain::RFC_Location_129_131::RFC_Loc129_131_AliveCtr_FaultInject == 1)//AC: Error sequence: set AC = 0
    {

      copyBitsToByteArrayLE(0,data,16,8); //Intel / little-endian;
    }
    else if (@CAN_PrivMain::RFC_Location_129_131::RFC_Loc129_131_AliveCtr_FaultInject == 2)//AC: Error sequence: Freeze last valid value
    {

      copyBitsToByteArrayLE(counter_RFC_Location_129_131_RFC_Loc129_131_AliveCtr,data,16,8); //Intel / little-endian;
    }
    if (@CAN_PrivMain::RFC_Location_129_131::RFC_Loc129_131_ProtBlockCtr_FaultInject != 3)//BC: user defined value
    {

    clearBitsInByteArrayLE(data,24,4); //Intel / little-endian

    }
    if (@CAN_PrivMain::RFC_Location_129_131::RFC_Loc129_131_ProtBlockCtr_FaultInject == 0)//BC: No Error, calculate BC
    {
      bc_RFC_Location_129_131_RFC_Loc129_131_ProtBlockCtr = bc_RFC_Location_ProtBlockCtr ;

      copyBitsToByteArrayLE(bc_RFC_Location_129_131_RFC_Loc129_131_ProtBlockCtr,data,24,4); //Intel / little-endian;
    }
    else if (@CAN_PrivMain::RFC_Location_129_131::RFC_Loc129_131_ProtBlockCtr_FaultInject == 1)//BC: Error sequence: set BC = 0
    {

      copyBitsToByteArrayLE(0,data,24,4); //Intel / little-endian;
    }
    else if (@CAN_PrivMain::RFC_Location_129_131::RFC_Loc129_131_ProtBlockCtr_FaultInject == 2)//BC: Error sequence: Freeze last valid value
    {

      copyBitsToByteArrayLE(bc_RFC_Location_129_131_RFC_Loc129_131_ProtBlockCtr,data,24,4); //Intel / little-endian;
    }
    if (@CAN_PrivMain::RFC_Location_129_131::RFC_Loc129_131_CRC_FaultInject != 3)//CRC: user defined value
    {

    clearBitsInByteArrayLE(data,0,16); //Intel / little-endian

    }
    if(@CAN_PrivMain::RFC_Location_129_131::RFC_Loc129_131_CRC_FaultInject == 0)//CRC: No Error, calculate CRC
    {
      crcTemp = CRC16_INIT;
      for(i = 2; i < (DataLength+2); i++)
      {
        if(i < DataLength)
          data_byte = data[i] ;
        else if(i == DataLength)
          data_byte = (0x2133 & 0x00FF);
        else if(i == (DataLength+1))
          data_byte = (0x2133 & 0xFF00) >> 8;
        else
          write("Error: DLC exceeded in CRC calculation");
        crcTemp ^= data_byte << 8;
        crcTemp = (crcTemp << (8)) ^ CRC16_CCITT_FALSE_POLY_1021H_Lookup[(crcTemp >> (8)) & (0xFF)];
      }
      crcTemp ^= CRC16_XOR;
      crc_RFC_Location_129_131_RFC_Loc129_131_CRC = crcTemp;

      copyBitsToByteArrayLE(crc_RFC_Location_129_131_RFC_Loc129_131_CRC,data,0,16); //Intel / little-endian;
    }
    else if(@CAN_PrivMain::RFC_Location_129_131::RFC_Loc129_131_CRC_FaultInject == 1)//CRC: Error, set to Zero
    {

      copyBitsToByteArrayLE(0,data,0,16); //Intel / little-endian;
    }
    else if(@CAN_PrivMain::RFC_Location_129_131::RFC_Loc129_131_CRC_FaultInject == 2)//CRC: Error, Freeze last valid value
    {

      copyBitsToByteArrayLE(crc_RFC_Location_129_131_RFC_Loc129_131_CRC,data,0,16); //Intel / little-endian;
    }
}


on sysvar CAN_PrivMain::RFC_Location_132_134::RFC_Location_132_134_ON_OFF
{
  if (@this == 1)
  {
     ILSetMsgEvent(RFC_Location_132_134);
     @CAN_PrivMain::RFC_Location_132_134::RFC_Location_132_134_ON_OFF = 0;
  }
}

void cfg_Msg_RFC_Location_132_134(dword aDlc, byte data[])
{
   int64 i,k;//For looping
   byte xor,data_byte;
   dword crcTemp;
   byte DataLength;
   dword Msg_id;
   
   DataLength = Msg_RFC_Location_132_134.DataLength;//Message Data Length
   Msg_id  = Msg_RFC_Location_132_134.id;//Message ID
   
    if (@CAN_PrivMain::RFC_Location_132_134::RFC_Loc132_134_AliveCtr_FaultInject != 3)//AC: user defined value
    {

    clearBitsInByteArrayLE(data,16,8); //Intel / little-endian

    }
    if (@CAN_PrivMain::RFC_Location_132_134::RFC_Loc132_134_AliveCtr_FaultInject == 0)//AC: No Error, calculate AC
    {
      ++counter_RFC_Location_132_134_RFC_Loc132_134_AliveCtr;
      counter_RFC_Location_132_134_RFC_Loc132_134_AliveCtr %=256;

      copyBitsToByteArrayLE(counter_RFC_Location_132_134_RFC_Loc132_134_AliveCtr,data,16,8); //Intel / little-endian;
    }
    else if (@CAN_PrivMain::RFC_Location_132_134::RFC_Loc132_134_AliveCtr_FaultInject == 1)//AC: Error sequence: set AC = 0
    {

      copyBitsToByteArrayLE(0,data,16,8); //Intel / little-endian;
    }
    else if (@CAN_PrivMain::RFC_Location_132_134::RFC_Loc132_134_AliveCtr_FaultInject == 2)//AC: Error sequence: Freeze last valid value
    {

      copyBitsToByteArrayLE(counter_RFC_Location_132_134_RFC_Loc132_134_AliveCtr,data,16,8); //Intel / little-endian;
    }
    if (@CAN_PrivMain::RFC_Location_132_134::RFC_Loc132_134_ProtBlockCtr_FaultInject != 3)//BC: user defined value
    {

    clearBitsInByteArrayLE(data,24,4); //Intel / little-endian

    }
    if (@CAN_PrivMain::RFC_Location_132_134::RFC_Loc132_134_ProtBlockCtr_FaultInject == 0)//BC: No Error, calculate BC
    {
      bc_RFC_Location_132_134_RFC_Loc132_134_ProtBlockCtr = bc_RFC_Location_ProtBlockCtr ;

      copyBitsToByteArrayLE(bc_RFC_Location_132_134_RFC_Loc132_134_ProtBlockCtr,data,24,4); //Intel / little-endian;
    }
    else if (@CAN_PrivMain::RFC_Location_132_134::RFC_Loc132_134_ProtBlockCtr_FaultInject == 1)//BC: Error sequence: set BC = 0
    {

      copyBitsToByteArrayLE(0,data,24,4); //Intel / little-endian;
    }
    else if (@CAN_PrivMain::RFC_Location_132_134::RFC_Loc132_134_ProtBlockCtr_FaultInject == 2)//BC: Error sequence: Freeze last valid value
    {

      copyBitsToByteArrayLE(bc_RFC_Location_132_134_RFC_Loc132_134_ProtBlockCtr,data,24,4); //Intel / little-endian;
    }
    if (@CAN_PrivMain::RFC_Location_132_134::RFC_Loc132_134_CRC_FaultInject != 3)//CRC: user defined value
    {

    clearBitsInByteArrayLE(data,0,16); //Intel / little-endian

    }
    if(@CAN_PrivMain::RFC_Location_132_134::RFC_Loc132_134_CRC_FaultInject == 0)//CRC: No Error, calculate CRC
    {
      crcTemp = CRC16_INIT;
      for(i = 2; i < (DataLength+2); i++)
      {
        if(i < DataLength)
          data_byte = data[i] ;
        else if(i == DataLength)
          data_byte = (0x2134 & 0x00FF);
        else if(i == (DataLength+1))
          data_byte = (0x2134 & 0xFF00) >> 8;
        else
          write("Error: DLC exceeded in CRC calculation");
        crcTemp ^= data_byte << 8;
        crcTemp = (crcTemp << (8)) ^ CRC16_CCITT_FALSE_POLY_1021H_Lookup[(crcTemp >> (8)) & (0xFF)];
      }
      crcTemp ^= CRC16_XOR;
      crc_RFC_Location_132_134_RFC_Loc132_134_CRC = crcTemp;

      copyBitsToByteArrayLE(crc_RFC_Location_132_134_RFC_Loc132_134_CRC,data,0,16); //Intel / little-endian;
    }
    else if(@CAN_PrivMain::RFC_Location_132_134::RFC_Loc132_134_CRC_FaultInject == 1)//CRC: Error, set to Zero
    {

      copyBitsToByteArrayLE(0,data,0,16); //Intel / little-endian;
    }
    else if(@CAN_PrivMain::RFC_Location_132_134::RFC_Loc132_134_CRC_FaultInject == 2)//CRC: Error, Freeze last valid value
    {

      copyBitsToByteArrayLE(crc_RFC_Location_132_134_RFC_Loc132_134_CRC,data,0,16); //Intel / little-endian;
    }
}


on sysvar CAN_PrivMain::RFC_Location_135_137::RFC_Location_135_137_ON_OFF
{
  if (@this == 1)
  {
     ILSetMsgEvent(RFC_Location_135_137);
     @CAN_PrivMain::RFC_Location_135_137::RFC_Location_135_137_ON_OFF = 0;
  }
}

void cfg_Msg_RFC_Location_135_137(dword aDlc, byte data[])
{
   int64 i,k;//For looping
   byte xor,data_byte;
   dword crcTemp;
   byte DataLength;
   dword Msg_id;
   
   DataLength = Msg_RFC_Location_135_137.DataLength;//Message Data Length
   Msg_id  = Msg_RFC_Location_135_137.id;//Message ID
   
    if (@CAN_PrivMain::RFC_Location_135_137::RFC_Loc135_137_AliveCtr_FaultInject != 3)//AC: user defined value
    {

    clearBitsInByteArrayLE(data,16,8); //Intel / little-endian

    }
    if (@CAN_PrivMain::RFC_Location_135_137::RFC_Loc135_137_AliveCtr_FaultInject == 0)//AC: No Error, calculate AC
    {
      ++counter_RFC_Location_135_137_RFC_Loc135_137_AliveCtr;
      counter_RFC_Location_135_137_RFC_Loc135_137_AliveCtr %=256;

      copyBitsToByteArrayLE(counter_RFC_Location_135_137_RFC_Loc135_137_AliveCtr,data,16,8); //Intel / little-endian;
    }
    else if (@CAN_PrivMain::RFC_Location_135_137::RFC_Loc135_137_AliveCtr_FaultInject == 1)//AC: Error sequence: set AC = 0
    {

      copyBitsToByteArrayLE(0,data,16,8); //Intel / little-endian;
    }
    else if (@CAN_PrivMain::RFC_Location_135_137::RFC_Loc135_137_AliveCtr_FaultInject == 2)//AC: Error sequence: Freeze last valid value
    {

      copyBitsToByteArrayLE(counter_RFC_Location_135_137_RFC_Loc135_137_AliveCtr,data,16,8); //Intel / little-endian;
    }
    if (@CAN_PrivMain::RFC_Location_135_137::RFC_Loc135_137_ProtBlockCtr_FaultInject != 3)//BC: user defined value
    {

    clearBitsInByteArrayLE(data,24,4); //Intel / little-endian

    }
    if (@CAN_PrivMain::RFC_Location_135_137::RFC_Loc135_137_ProtBlockCtr_FaultInject == 0)//BC: No Error, calculate BC
    {
      bc_RFC_Location_135_137_RFC_Loc135_137_ProtBlockCtr = bc_RFC_Location_ProtBlockCtr ;

      copyBitsToByteArrayLE(bc_RFC_Location_135_137_RFC_Loc135_137_ProtBlockCtr,data,24,4); //Intel / little-endian;
    }
    else if (@CAN_PrivMain::RFC_Location_135_137::RFC_Loc135_137_ProtBlockCtr_FaultInject == 1)//BC: Error sequence: set BC = 0
    {

      copyBitsToByteArrayLE(0,data,24,4); //Intel / little-endian;
    }
    else if (@CAN_PrivMain::RFC_Location_135_137::RFC_Loc135_137_ProtBlockCtr_FaultInject == 2)//BC: Error sequence: Freeze last valid value
    {

      copyBitsToByteArrayLE(bc_RFC_Location_135_137_RFC_Loc135_137_ProtBlockCtr,data,24,4); //Intel / little-endian;
    }
    if (@CAN_PrivMain::RFC_Location_135_137::RFC_Loc135_137_CRC_FaultInject != 3)//CRC: user defined value
    {

    clearBitsInByteArrayLE(data,0,16); //Intel / little-endian

    }
    if(@CAN_PrivMain::RFC_Location_135_137::RFC_Loc135_137_CRC_FaultInject == 0)//CRC: No Error, calculate CRC
    {
      crcTemp = CRC16_INIT;
      for(i = 2; i < (DataLength+2); i++)
      {
        if(i < DataLength)
          data_byte = data[i] ;
        else if(i == DataLength)
          data_byte = (0x2135 & 0x00FF);
        else if(i == (DataLength+1))
          data_byte = (0x2135 & 0xFF00) >> 8;
        else
          write("Error: DLC exceeded in CRC calculation");
        crcTemp ^= data_byte << 8;
        crcTemp = (crcTemp << (8)) ^ CRC16_CCITT_FALSE_POLY_1021H_Lookup[(crcTemp >> (8)) & (0xFF)];
      }
      crcTemp ^= CRC16_XOR;
      crc_RFC_Location_135_137_RFC_Loc135_137_CRC = crcTemp;

      copyBitsToByteArrayLE(crc_RFC_Location_135_137_RFC_Loc135_137_CRC,data,0,16); //Intel / little-endian;
    }
    else if(@CAN_PrivMain::RFC_Location_135_137::RFC_Loc135_137_CRC_FaultInject == 1)//CRC: Error, set to Zero
    {

      copyBitsToByteArrayLE(0,data,0,16); //Intel / little-endian;
    }
    else if(@CAN_PrivMain::RFC_Location_135_137::RFC_Loc135_137_CRC_FaultInject == 2)//CRC: Error, Freeze last valid value
    {

      copyBitsToByteArrayLE(crc_RFC_Location_135_137_RFC_Loc135_137_CRC,data,0,16); //Intel / little-endian;
    }
}


on sysvar CAN_PrivMain::RFC_Location_138_140::RFC_Location_138_140_ON_OFF
{
  if (@this == 1)
  {
     ILSetMsgEvent(RFC_Location_138_140);
     @CAN_PrivMain::RFC_Location_138_140::RFC_Location_138_140_ON_OFF = 0;
  }
}

void cfg_Msg_RFC_Location_138_140(dword aDlc, byte data[])
{
   int64 i,k;//For looping
   byte xor,data_byte;
   dword crcTemp;
   byte DataLength;
   dword Msg_id;
   
   DataLength = Msg_RFC_Location_138_140.DataLength;//Message Data Length
   Msg_id  = Msg_RFC_Location_138_140.id;//Message ID
   
    if (@CAN_PrivMain::RFC_Location_138_140::RFC_Loc138_140_AliveCtr_FaultInject != 3)//AC: user defined value
    {

    clearBitsInByteArrayLE(data,16,8); //Intel / little-endian

    }
    if (@CAN_PrivMain::RFC_Location_138_140::RFC_Loc138_140_AliveCtr_FaultInject == 0)//AC: No Error, calculate AC
    {
      ++counter_RFC_Location_138_140_RFC_Loc138_140_AliveCtr;
      counter_RFC_Location_138_140_RFC_Loc138_140_AliveCtr %=256;

      copyBitsToByteArrayLE(counter_RFC_Location_138_140_RFC_Loc138_140_AliveCtr,data,16,8); //Intel / little-endian;
    }
    else if (@CAN_PrivMain::RFC_Location_138_140::RFC_Loc138_140_AliveCtr_FaultInject == 1)//AC: Error sequence: set AC = 0
    {

      copyBitsToByteArrayLE(0,data,16,8); //Intel / little-endian;
    }
    else if (@CAN_PrivMain::RFC_Location_138_140::RFC_Loc138_140_AliveCtr_FaultInject == 2)//AC: Error sequence: Freeze last valid value
    {

      copyBitsToByteArrayLE(counter_RFC_Location_138_140_RFC_Loc138_140_AliveCtr,data,16,8); //Intel / little-endian;
    }
    if (@CAN_PrivMain::RFC_Location_138_140::RFC_Loc138_140_ProtBlockCtr_FaultInject != 3)//BC: user defined value
    {

    clearBitsInByteArrayLE(data,24,4); //Intel / little-endian

    }
    if (@CAN_PrivMain::RFC_Location_138_140::RFC_Loc138_140_ProtBlockCtr_FaultInject == 0)//BC: No Error, calculate BC
    {
      bc_RFC_Location_138_140_RFC_Loc138_140_ProtBlockCtr = bc_RFC_Location_ProtBlockCtr ;

      copyBitsToByteArrayLE(bc_RFC_Location_138_140_RFC_Loc138_140_ProtBlockCtr,data,24,4); //Intel / little-endian;
    }
    else if (@CAN_PrivMain::RFC_Location_138_140::RFC_Loc138_140_ProtBlockCtr_FaultInject == 1)//BC: Error sequence: set BC = 0
    {

      copyBitsToByteArrayLE(0,data,24,4); //Intel / little-endian;
    }
    else if (@CAN_PrivMain::RFC_Location_138_140::RFC_Loc138_140_ProtBlockCtr_FaultInject == 2)//BC: Error sequence: Freeze last valid value
    {

      copyBitsToByteArrayLE(bc_RFC_Location_138_140_RFC_Loc138_140_ProtBlockCtr,data,24,4); //Intel / little-endian;
    }
    if (@CAN_PrivMain::RFC_Location_138_140::RFC_Loc138_140_CRC_FaultInject != 3)//CRC: user defined value
    {

    clearBitsInByteArrayLE(data,0,16); //Intel / little-endian

    }
    if(@CAN_PrivMain::RFC_Location_138_140::RFC_Loc138_140_CRC_FaultInject == 0)//CRC: No Error, calculate CRC
    {
      crcTemp = CRC16_INIT;
      for(i = 2; i < (DataLength+2); i++)
      {
        if(i < DataLength)
          data_byte = data[i] ;
        else if(i == DataLength)
          data_byte = (0x2136 & 0x00FF);
        else if(i == (DataLength+1))
          data_byte = (0x2136 & 0xFF00) >> 8;
        else
          write("Error: DLC exceeded in CRC calculation");
        crcTemp ^= data_byte << 8;
        crcTemp = (crcTemp << (8)) ^ CRC16_CCITT_FALSE_POLY_1021H_Lookup[(crcTemp >> (8)) & (0xFF)];
      }
      crcTemp ^= CRC16_XOR;
      crc_RFC_Location_138_140_RFC_Loc138_140_CRC = crcTemp;

      copyBitsToByteArrayLE(crc_RFC_Location_138_140_RFC_Loc138_140_CRC,data,0,16); //Intel / little-endian;
    }
    else if(@CAN_PrivMain::RFC_Location_138_140::RFC_Loc138_140_CRC_FaultInject == 1)//CRC: Error, set to Zero
    {

      copyBitsToByteArrayLE(0,data,0,16); //Intel / little-endian;
    }
    else if(@CAN_PrivMain::RFC_Location_138_140::RFC_Loc138_140_CRC_FaultInject == 2)//CRC: Error, Freeze last valid value
    {

      copyBitsToByteArrayLE(crc_RFC_Location_138_140_RFC_Loc138_140_CRC,data,0,16); //Intel / little-endian;
    }
}


on sysvar CAN_PrivMain::RFC_Location_141_143::RFC_Location_141_143_ON_OFF
{
  if (@this == 1)
  {
     ILSetMsgEvent(RFC_Location_141_143);
     @CAN_PrivMain::RFC_Location_141_143::RFC_Location_141_143_ON_OFF = 0;
  }
}

void cfg_Msg_RFC_Location_141_143(dword aDlc, byte data[])
{
   int64 i,k;//For looping
   byte xor,data_byte;
   dword crcTemp;
   byte DataLength;
   dword Msg_id;
   
   DataLength = Msg_RFC_Location_141_143.DataLength;//Message Data Length
   Msg_id  = Msg_RFC_Location_141_143.id;//Message ID
   
    if (@CAN_PrivMain::RFC_Location_141_143::RFC_Loc141_143_AliveCtr_FaultInject != 3)//AC: user defined value
    {

    clearBitsInByteArrayLE(data,16,8); //Intel / little-endian

    }
    if (@CAN_PrivMain::RFC_Location_141_143::RFC_Loc141_143_AliveCtr_FaultInject == 0)//AC: No Error, calculate AC
    {
      ++counter_RFC_Location_141_143_RFC_Loc141_143_AliveCtr;
      counter_RFC_Location_141_143_RFC_Loc141_143_AliveCtr %=256;

      copyBitsToByteArrayLE(counter_RFC_Location_141_143_RFC_Loc141_143_AliveCtr,data,16,8); //Intel / little-endian;
    }
    else if (@CAN_PrivMain::RFC_Location_141_143::RFC_Loc141_143_AliveCtr_FaultInject == 1)//AC: Error sequence: set AC = 0
    {

      copyBitsToByteArrayLE(0,data,16,8); //Intel / little-endian;
    }
    else if (@CAN_PrivMain::RFC_Location_141_143::RFC_Loc141_143_AliveCtr_FaultInject == 2)//AC: Error sequence: Freeze last valid value
    {

      copyBitsToByteArrayLE(counter_RFC_Location_141_143_RFC_Loc141_143_AliveCtr,data,16,8); //Intel / little-endian;
    }
    if (@CAN_PrivMain::RFC_Location_141_143::RFC_Loc141_143_ProtBlockCtr_FaultInject != 3)//BC: user defined value
    {

    clearBitsInByteArrayLE(data,24,4); //Intel / little-endian

    }
    if (@CAN_PrivMain::RFC_Location_141_143::RFC_Loc141_143_ProtBlockCtr_FaultInject == 0)//BC: No Error, calculate BC
    {
      bc_RFC_Location_141_143_RFC_Loc141_143_ProtBlockCtr = bc_RFC_Location_ProtBlockCtr ;

      copyBitsToByteArrayLE(bc_RFC_Location_141_143_RFC_Loc141_143_ProtBlockCtr,data,24,4); //Intel / little-endian;
    }
    else if (@CAN_PrivMain::RFC_Location_141_143::RFC_Loc141_143_ProtBlockCtr_FaultInject == 1)//BC: Error sequence: set BC = 0
    {

      copyBitsToByteArrayLE(0,data,24,4); //Intel / little-endian;
    }
    else if (@CAN_PrivMain::RFC_Location_141_143::RFC_Loc141_143_ProtBlockCtr_FaultInject == 2)//BC: Error sequence: Freeze last valid value
    {

      copyBitsToByteArrayLE(bc_RFC_Location_141_143_RFC_Loc141_143_ProtBlockCtr,data,24,4); //Intel / little-endian;
    }
    if (@CAN_PrivMain::RFC_Location_141_143::RFC_Loc141_143_CRC_FaultInject != 3)//CRC: user defined value
    {

    clearBitsInByteArrayLE(data,0,16); //Intel / little-endian

    }
    if(@CAN_PrivMain::RFC_Location_141_143::RFC_Loc141_143_CRC_FaultInject == 0)//CRC: No Error, calculate CRC
    {
      crcTemp = CRC16_INIT;
      for(i = 2; i < (DataLength+2); i++)
      {
        if(i < DataLength)
          data_byte = data[i] ;
        else if(i == DataLength)
          data_byte = (0x2137 & 0x00FF);
        else if(i == (DataLength+1))
          data_byte = (0x2137 & 0xFF00) >> 8;
        else
          write("Error: DLC exceeded in CRC calculation");
        crcTemp ^= data_byte << 8;
        crcTemp = (crcTemp << (8)) ^ CRC16_CCITT_FALSE_POLY_1021H_Lookup[(crcTemp >> (8)) & (0xFF)];
      }
      crcTemp ^= CRC16_XOR;
      crc_RFC_Location_141_143_RFC_Loc141_143_CRC = crcTemp;

      copyBitsToByteArrayLE(crc_RFC_Location_141_143_RFC_Loc141_143_CRC,data,0,16); //Intel / little-endian;
    }
    else if(@CAN_PrivMain::RFC_Location_141_143::RFC_Loc141_143_CRC_FaultInject == 1)//CRC: Error, set to Zero
    {

      copyBitsToByteArrayLE(0,data,0,16); //Intel / little-endian;
    }
    else if(@CAN_PrivMain::RFC_Location_141_143::RFC_Loc141_143_CRC_FaultInject == 2)//CRC: Error, Freeze last valid value
    {

      copyBitsToByteArrayLE(crc_RFC_Location_141_143_RFC_Loc141_143_CRC,data,0,16); //Intel / little-endian;
    }
}


on sysvar CAN_PrivMain::RFC_Location_144_146::RFC_Location_144_146_ON_OFF
{
  if (@this == 1)
  {
     ILSetMsgEvent(RFC_Location_144_146);
     @CAN_PrivMain::RFC_Location_144_146::RFC_Location_144_146_ON_OFF = 0;
  }
}

void cfg_Msg_RFC_Location_144_146(dword aDlc, byte data[])
{
   int64 i,k;//For looping
   byte xor,data_byte;
   dword crcTemp;
   byte DataLength;
   dword Msg_id;
   
   DataLength = Msg_RFC_Location_144_146.DataLength;//Message Data Length
   Msg_id  = Msg_RFC_Location_144_146.id;//Message ID
   
    if (@CAN_PrivMain::RFC_Location_144_146::RFC_Loc144_146_AliveCtr_FaultInject != 3)//AC: user defined value
    {

    clearBitsInByteArrayLE(data,16,8); //Intel / little-endian

    }
    if (@CAN_PrivMain::RFC_Location_144_146::RFC_Loc144_146_AliveCtr_FaultInject == 0)//AC: No Error, calculate AC
    {
      ++counter_RFC_Location_144_146_RFC_Loc144_146_AliveCtr;
      counter_RFC_Location_144_146_RFC_Loc144_146_AliveCtr %=256;

      copyBitsToByteArrayLE(counter_RFC_Location_144_146_RFC_Loc144_146_AliveCtr,data,16,8); //Intel / little-endian;
    }
    else if (@CAN_PrivMain::RFC_Location_144_146::RFC_Loc144_146_AliveCtr_FaultInject == 1)//AC: Error sequence: set AC = 0
    {

      copyBitsToByteArrayLE(0,data,16,8); //Intel / little-endian;
    }
    else if (@CAN_PrivMain::RFC_Location_144_146::RFC_Loc144_146_AliveCtr_FaultInject == 2)//AC: Error sequence: Freeze last valid value
    {

      copyBitsToByteArrayLE(counter_RFC_Location_144_146_RFC_Loc144_146_AliveCtr,data,16,8); //Intel / little-endian;
    }
    if (@CAN_PrivMain::RFC_Location_144_146::RFC_Loc144_146_ProtBlockCtr_FaultInject != 3)//BC: user defined value
    {

    clearBitsInByteArrayLE(data,24,4); //Intel / little-endian

    }
    if (@CAN_PrivMain::RFC_Location_144_146::RFC_Loc144_146_ProtBlockCtr_FaultInject == 0)//BC: No Error, calculate BC
    {
      bc_RFC_Location_144_146_RFC_Loc144_146_ProtBlockCtr = bc_RFC_Location_ProtBlockCtr ;

      copyBitsToByteArrayLE(bc_RFC_Location_144_146_RFC_Loc144_146_ProtBlockCtr,data,24,4); //Intel / little-endian;
    }
    else if (@CAN_PrivMain::RFC_Location_144_146::RFC_Loc144_146_ProtBlockCtr_FaultInject == 1)//BC: Error sequence: set BC = 0
    {

      copyBitsToByteArrayLE(0,data,24,4); //Intel / little-endian;
    }
    else if (@CAN_PrivMain::RFC_Location_144_146::RFC_Loc144_146_ProtBlockCtr_FaultInject == 2)//BC: Error sequence: Freeze last valid value
    {

      copyBitsToByteArrayLE(bc_RFC_Location_144_146_RFC_Loc144_146_ProtBlockCtr,data,24,4); //Intel / little-endian;
    }
    if (@CAN_PrivMain::RFC_Location_144_146::RFC_Loc144_146_CRC_FaultInject != 3)//CRC: user defined value
    {

    clearBitsInByteArrayLE(data,0,16); //Intel / little-endian

    }
    if(@CAN_PrivMain::RFC_Location_144_146::RFC_Loc144_146_CRC_FaultInject == 0)//CRC: No Error, calculate CRC
    {
      crcTemp = CRC16_INIT;
      for(i = 2; i < (DataLength+2); i++)
      {
        if(i < DataLength)
          data_byte = data[i] ;
        else if(i == DataLength)
          data_byte = (0x2138 & 0x00FF);
        else if(i == (DataLength+1))
          data_byte = (0x2138 & 0xFF00) >> 8;
        else
          write("Error: DLC exceeded in CRC calculation");
        crcTemp ^= data_byte << 8;
        crcTemp = (crcTemp << (8)) ^ CRC16_CCITT_FALSE_POLY_1021H_Lookup[(crcTemp >> (8)) & (0xFF)];
      }
      crcTemp ^= CRC16_XOR;
      crc_RFC_Location_144_146_RFC_Loc144_146_CRC = crcTemp;

      copyBitsToByteArrayLE(crc_RFC_Location_144_146_RFC_Loc144_146_CRC,data,0,16); //Intel / little-endian;
    }
    else if(@CAN_PrivMain::RFC_Location_144_146::RFC_Loc144_146_CRC_FaultInject == 1)//CRC: Error, set to Zero
    {

      copyBitsToByteArrayLE(0,data,0,16); //Intel / little-endian;
    }
    else if(@CAN_PrivMain::RFC_Location_144_146::RFC_Loc144_146_CRC_FaultInject == 2)//CRC: Error, Freeze last valid value
    {

      copyBitsToByteArrayLE(crc_RFC_Location_144_146_RFC_Loc144_146_CRC,data,0,16); //Intel / little-endian;
    }
}


on sysvar CAN_PrivMain::RFC_Location_147_149::RFC_Location_147_149_ON_OFF
{
  if (@this == 1)
  {
     ILSetMsgEvent(RFC_Location_147_149);
     @CAN_PrivMain::RFC_Location_147_149::RFC_Location_147_149_ON_OFF = 0;
  }
}

void cfg_Msg_RFC_Location_147_149(dword aDlc, byte data[])
{
   int64 i,k;//For looping
   byte xor,data_byte;
   dword crcTemp;
   byte DataLength;
   dword Msg_id;
   
   DataLength = Msg_RFC_Location_147_149.DataLength;//Message Data Length
   Msg_id  = Msg_RFC_Location_147_149.id;//Message ID
   
    if (@CAN_PrivMain::RFC_Location_147_149::RFC_Loc147_149_AliveCtr_FaultInject != 3)//AC: user defined value
    {

    clearBitsInByteArrayLE(data,16,8); //Intel / little-endian

    }
    if (@CAN_PrivMain::RFC_Location_147_149::RFC_Loc147_149_AliveCtr_FaultInject == 0)//AC: No Error, calculate AC
    {
      ++counter_RFC_Location_147_149_RFC_Loc147_149_AliveCtr;
      counter_RFC_Location_147_149_RFC_Loc147_149_AliveCtr %=256;

      copyBitsToByteArrayLE(counter_RFC_Location_147_149_RFC_Loc147_149_AliveCtr,data,16,8); //Intel / little-endian;
    }
    else if (@CAN_PrivMain::RFC_Location_147_149::RFC_Loc147_149_AliveCtr_FaultInject == 1)//AC: Error sequence: set AC = 0
    {

      copyBitsToByteArrayLE(0,data,16,8); //Intel / little-endian;
    }
    else if (@CAN_PrivMain::RFC_Location_147_149::RFC_Loc147_149_AliveCtr_FaultInject == 2)//AC: Error sequence: Freeze last valid value
    {

      copyBitsToByteArrayLE(counter_RFC_Location_147_149_RFC_Loc147_149_AliveCtr,data,16,8); //Intel / little-endian;
    }
    if (@CAN_PrivMain::RFC_Location_147_149::RFC_Loc147_149_ProtBlockCtr_FaultInject != 3)//BC: user defined value
    {

    clearBitsInByteArrayLE(data,24,4); //Intel / little-endian

    }
    if (@CAN_PrivMain::RFC_Location_147_149::RFC_Loc147_149_ProtBlockCtr_FaultInject == 0)//BC: No Error, calculate BC
    {
      bc_RFC_Location_147_149_RFC_Loc147_149_ProtBlockCtr = bc_RFC_Location_ProtBlockCtr ;

      copyBitsToByteArrayLE(bc_RFC_Location_147_149_RFC_Loc147_149_ProtBlockCtr,data,24,4); //Intel / little-endian;
    }
    else if (@CAN_PrivMain::RFC_Location_147_149::RFC_Loc147_149_ProtBlockCtr_FaultInject == 1)//BC: Error sequence: set BC = 0
    {

      copyBitsToByteArrayLE(0,data,24,4); //Intel / little-endian;
    }
    else if (@CAN_PrivMain::RFC_Location_147_149::RFC_Loc147_149_ProtBlockCtr_FaultInject == 2)//BC: Error sequence: Freeze last valid value
    {

      copyBitsToByteArrayLE(bc_RFC_Location_147_149_RFC_Loc147_149_ProtBlockCtr,data,24,4); //Intel / little-endian;
    }
    if (@CAN_PrivMain::RFC_Location_147_149::RFC_Loc147_149_CRC_FaultInject != 3)//CRC: user defined value
    {

    clearBitsInByteArrayLE(data,0,16); //Intel / little-endian

    }
    if(@CAN_PrivMain::RFC_Location_147_149::RFC_Loc147_149_CRC_FaultInject == 0)//CRC: No Error, calculate CRC
    {
      crcTemp = CRC16_INIT;
      for(i = 2; i < (DataLength+2); i++)
      {
        if(i < DataLength)
          data_byte = data[i] ;
        else if(i == DataLength)
          data_byte = (0x2139 & 0x00FF);
        else if(i == (DataLength+1))
          data_byte = (0x2139 & 0xFF00) >> 8;
        else
          write("Error: DLC exceeded in CRC calculation");
        crcTemp ^= data_byte << 8;
        crcTemp = (crcTemp << (8)) ^ CRC16_CCITT_FALSE_POLY_1021H_Lookup[(crcTemp >> (8)) & (0xFF)];
      }
      crcTemp ^= CRC16_XOR;
      crc_RFC_Location_147_149_RFC_Loc147_149_CRC = crcTemp;

      copyBitsToByteArrayLE(crc_RFC_Location_147_149_RFC_Loc147_149_CRC,data,0,16); //Intel / little-endian;
    }
    else if(@CAN_PrivMain::RFC_Location_147_149::RFC_Loc147_149_CRC_FaultInject == 1)//CRC: Error, set to Zero
    {

      copyBitsToByteArrayLE(0,data,0,16); //Intel / little-endian;
    }
    else if(@CAN_PrivMain::RFC_Location_147_149::RFC_Loc147_149_CRC_FaultInject == 2)//CRC: Error, Freeze last valid value
    {

      copyBitsToByteArrayLE(crc_RFC_Location_147_149_RFC_Loc147_149_CRC,data,0,16); //Intel / little-endian;
    }
}


on sysvar CAN_PrivMain::RFC_Location_150_152::RFC_Location_150_152_ON_OFF
{
  if (@this == 1)
  {
     ILSetMsgEvent(RFC_Location_150_152);
     @CAN_PrivMain::RFC_Location_150_152::RFC_Location_150_152_ON_OFF = 0;
  }
}

void cfg_Msg_RFC_Location_150_152(dword aDlc, byte data[])
{
   int64 i,k;//For looping
   byte xor,data_byte;
   dword crcTemp;
   byte DataLength;
   dword Msg_id;
   
   DataLength = Msg_RFC_Location_150_152.DataLength;//Message Data Length
   Msg_id  = Msg_RFC_Location_150_152.id;//Message ID
   
    if (@CAN_PrivMain::RFC_Location_150_152::RFC_Loc150_152_AliveCtr_FaultInject != 3)//AC: user defined value
    {

    clearBitsInByteArrayLE(data,16,8); //Intel / little-endian

    }
    if (@CAN_PrivMain::RFC_Location_150_152::RFC_Loc150_152_AliveCtr_FaultInject == 0)//AC: No Error, calculate AC
    {
      ++counter_RFC_Location_150_152_RFC_Loc150_152_AliveCtr;
      counter_RFC_Location_150_152_RFC_Loc150_152_AliveCtr %=256;

      copyBitsToByteArrayLE(counter_RFC_Location_150_152_RFC_Loc150_152_AliveCtr,data,16,8); //Intel / little-endian;
    }
    else if (@CAN_PrivMain::RFC_Location_150_152::RFC_Loc150_152_AliveCtr_FaultInject == 1)//AC: Error sequence: set AC = 0
    {

      copyBitsToByteArrayLE(0,data,16,8); //Intel / little-endian;
    }
    else if (@CAN_PrivMain::RFC_Location_150_152::RFC_Loc150_152_AliveCtr_FaultInject == 2)//AC: Error sequence: Freeze last valid value
    {

      copyBitsToByteArrayLE(counter_RFC_Location_150_152_RFC_Loc150_152_AliveCtr,data,16,8); //Intel / little-endian;
    }
    if (@CAN_PrivMain::RFC_Location_150_152::RFC_Loc150_152_ProtBlockCtr_FaultInject != 3)//BC: user defined value
    {

    clearBitsInByteArrayLE(data,24,4); //Intel / little-endian

    }
    if (@CAN_PrivMain::RFC_Location_150_152::RFC_Loc150_152_ProtBlockCtr_FaultInject == 0)//BC: No Error, calculate BC
    {
      bc_RFC_Location_150_152_RFC_Loc150_152_ProtBlockCtr = bc_RFC_Location_ProtBlockCtr ;

      copyBitsToByteArrayLE(bc_RFC_Location_150_152_RFC_Loc150_152_ProtBlockCtr,data,24,4); //Intel / little-endian;
    }
    else if (@CAN_PrivMain::RFC_Location_150_152::RFC_Loc150_152_ProtBlockCtr_FaultInject == 1)//BC: Error sequence: set BC = 0
    {

      copyBitsToByteArrayLE(0,data,24,4); //Intel / little-endian;
    }
    else if (@CAN_PrivMain::RFC_Location_150_152::RFC_Loc150_152_ProtBlockCtr_FaultInject == 2)//BC: Error sequence: Freeze last valid value
    {

      copyBitsToByteArrayLE(bc_RFC_Location_150_152_RFC_Loc150_152_ProtBlockCtr,data,24,4); //Intel / little-endian;
    }
    if (@CAN_PrivMain::RFC_Location_150_152::RFC_Loc150_152_CRC_FaultInject != 3)//CRC: user defined value
    {

    clearBitsInByteArrayLE(data,0,16); //Intel / little-endian

    }
    if(@CAN_PrivMain::RFC_Location_150_152::RFC_Loc150_152_CRC_FaultInject == 0)//CRC: No Error, calculate CRC
    {
      crcTemp = CRC16_INIT;
      for(i = 2; i < (DataLength+2); i++)
      {
        if(i < DataLength)
          data_byte = data[i] ;
        else if(i == DataLength)
          data_byte = (0x213a & 0x00FF);
        else if(i == (DataLength+1))
          data_byte = (0x213a & 0xFF00) >> 8;
        else
          write("Error: DLC exceeded in CRC calculation");
        crcTemp ^= data_byte << 8;
        crcTemp = (crcTemp << (8)) ^ CRC16_CCITT_FALSE_POLY_1021H_Lookup[(crcTemp >> (8)) & (0xFF)];
      }
      crcTemp ^= CRC16_XOR;
      crc_RFC_Location_150_152_RFC_Loc150_152_CRC = crcTemp;

      copyBitsToByteArrayLE(crc_RFC_Location_150_152_RFC_Loc150_152_CRC,data,0,16); //Intel / little-endian;
    }
    else if(@CAN_PrivMain::RFC_Location_150_152::RFC_Loc150_152_CRC_FaultInject == 1)//CRC: Error, set to Zero
    {

      copyBitsToByteArrayLE(0,data,0,16); //Intel / little-endian;
    }
    else if(@CAN_PrivMain::RFC_Location_150_152::RFC_Loc150_152_CRC_FaultInject == 2)//CRC: Error, Freeze last valid value
    {

      copyBitsToByteArrayLE(crc_RFC_Location_150_152_RFC_Loc150_152_CRC,data,0,16); //Intel / little-endian;
    }
}


on sysvar CAN_PrivMain::RFC_Location_153_155::RFC_Location_153_155_ON_OFF
{
  if (@this == 1)
  {
     ILSetMsgEvent(RFC_Location_153_155);
     @CAN_PrivMain::RFC_Location_153_155::RFC_Location_153_155_ON_OFF = 0;
  }
}

void cfg_Msg_RFC_Location_153_155(dword aDlc, byte data[])
{
   int64 i,k;//For looping
   byte xor,data_byte;
   dword crcTemp;
   byte DataLength;
   dword Msg_id;
   
   DataLength = Msg_RFC_Location_153_155.DataLength;//Message Data Length
   Msg_id  = Msg_RFC_Location_153_155.id;//Message ID
   
    if (@CAN_PrivMain::RFC_Location_153_155::RFC_Loc153_155_AliveCtr_FaultInject != 3)//AC: user defined value
    {

    clearBitsInByteArrayLE(data,16,8); //Intel / little-endian

    }
    if (@CAN_PrivMain::RFC_Location_153_155::RFC_Loc153_155_AliveCtr_FaultInject == 0)//AC: No Error, calculate AC
    {
      ++counter_RFC_Location_153_155_RFC_Loc153_155_AliveCtr;
      counter_RFC_Location_153_155_RFC_Loc153_155_AliveCtr %=256;

      copyBitsToByteArrayLE(counter_RFC_Location_153_155_RFC_Loc153_155_AliveCtr,data,16,8); //Intel / little-endian;
    }
    else if (@CAN_PrivMain::RFC_Location_153_155::RFC_Loc153_155_AliveCtr_FaultInject == 1)//AC: Error sequence: set AC = 0
    {

      copyBitsToByteArrayLE(0,data,16,8); //Intel / little-endian;
    }
    else if (@CAN_PrivMain::RFC_Location_153_155::RFC_Loc153_155_AliveCtr_FaultInject == 2)//AC: Error sequence: Freeze last valid value
    {

      copyBitsToByteArrayLE(counter_RFC_Location_153_155_RFC_Loc153_155_AliveCtr,data,16,8); //Intel / little-endian;
    }
    if (@CAN_PrivMain::RFC_Location_153_155::RFC_Loc153_155_ProtBlockCtr_FaultInject != 3)//BC: user defined value
    {

    clearBitsInByteArrayLE(data,24,4); //Intel / little-endian

    }
    if (@CAN_PrivMain::RFC_Location_153_155::RFC_Loc153_155_ProtBlockCtr_FaultInject == 0)//BC: No Error, calculate BC
    {
      bc_RFC_Location_153_155_RFC_Loc153_155_ProtBlockCtr = bc_RFC_Location_ProtBlockCtr ;

      copyBitsToByteArrayLE(bc_RFC_Location_153_155_RFC_Loc153_155_ProtBlockCtr,data,24,4); //Intel / little-endian;
    }
    else if (@CAN_PrivMain::RFC_Location_153_155::RFC_Loc153_155_ProtBlockCtr_FaultInject == 1)//BC: Error sequence: set BC = 0
    {

      copyBitsToByteArrayLE(0,data,24,4); //Intel / little-endian;
    }
    else if (@CAN_PrivMain::RFC_Location_153_155::RFC_Loc153_155_ProtBlockCtr_FaultInject == 2)//BC: Error sequence: Freeze last valid value
    {

      copyBitsToByteArrayLE(bc_RFC_Location_153_155_RFC_Loc153_155_ProtBlockCtr,data,24,4); //Intel / little-endian;
    }
    if (@CAN_PrivMain::RFC_Location_153_155::RFC_Loc153_155_CRC_FaultInject != 3)//CRC: user defined value
    {

    clearBitsInByteArrayLE(data,0,16); //Intel / little-endian

    }
    if(@CAN_PrivMain::RFC_Location_153_155::RFC_Loc153_155_CRC_FaultInject == 0)//CRC: No Error, calculate CRC
    {
      crcTemp = CRC16_INIT;
      for(i = 2; i < (DataLength+2); i++)
      {
        if(i < DataLength)
          data_byte = data[i] ;
        else if(i == DataLength)
          data_byte = (0x213b & 0x00FF);
        else if(i == (DataLength+1))
          data_byte = (0x213b & 0xFF00) >> 8;
        else
          write("Error: DLC exceeded in CRC calculation");
        crcTemp ^= data_byte << 8;
        crcTemp = (crcTemp << (8)) ^ CRC16_CCITT_FALSE_POLY_1021H_Lookup[(crcTemp >> (8)) & (0xFF)];
      }
      crcTemp ^= CRC16_XOR;
      crc_RFC_Location_153_155_RFC_Loc153_155_CRC = crcTemp;

      copyBitsToByteArrayLE(crc_RFC_Location_153_155_RFC_Loc153_155_CRC,data,0,16); //Intel / little-endian;
    }
    else if(@CAN_PrivMain::RFC_Location_153_155::RFC_Loc153_155_CRC_FaultInject == 1)//CRC: Error, set to Zero
    {

      copyBitsToByteArrayLE(0,data,0,16); //Intel / little-endian;
    }
    else if(@CAN_PrivMain::RFC_Location_153_155::RFC_Loc153_155_CRC_FaultInject == 2)//CRC: Error, Freeze last valid value
    {

      copyBitsToByteArrayLE(crc_RFC_Location_153_155_RFC_Loc153_155_CRC,data,0,16); //Intel / little-endian;
    }
}


on sysvar CAN_PrivMain::RFC_Location_156_158::RFC_Location_156_158_ON_OFF
{
  if (@this == 1)
  {
     ILSetMsgEvent(RFC_Location_156_158);
     @CAN_PrivMain::RFC_Location_156_158::RFC_Location_156_158_ON_OFF = 0;
  }
}

void cfg_Msg_RFC_Location_156_158(dword aDlc, byte data[])
{
   int64 i,k;//For looping
   byte xor,data_byte;
   dword crcTemp;
   byte DataLength;
   dword Msg_id;
   
   DataLength = Msg_RFC_Location_156_158.DataLength;//Message Data Length
   Msg_id  = Msg_RFC_Location_156_158.id;//Message ID
   
    if (@CAN_PrivMain::RFC_Location_156_158::RFC_Loc156_158_AliveCtr_FaultInject != 3)//AC: user defined value
    {

    clearBitsInByteArrayLE(data,16,8); //Intel / little-endian

    }
    if (@CAN_PrivMain::RFC_Location_156_158::RFC_Loc156_158_AliveCtr_FaultInject == 0)//AC: No Error, calculate AC
    {
      ++counter_RFC_Location_156_158_RFC_Loc156_158_AliveCtr;
      counter_RFC_Location_156_158_RFC_Loc156_158_AliveCtr %=256;

      copyBitsToByteArrayLE(counter_RFC_Location_156_158_RFC_Loc156_158_AliveCtr,data,16,8); //Intel / little-endian;
    }
    else if (@CAN_PrivMain::RFC_Location_156_158::RFC_Loc156_158_AliveCtr_FaultInject == 1)//AC: Error sequence: set AC = 0
    {

      copyBitsToByteArrayLE(0,data,16,8); //Intel / little-endian;
    }
    else if (@CAN_PrivMain::RFC_Location_156_158::RFC_Loc156_158_AliveCtr_FaultInject == 2)//AC: Error sequence: Freeze last valid value
    {

      copyBitsToByteArrayLE(counter_RFC_Location_156_158_RFC_Loc156_158_AliveCtr,data,16,8); //Intel / little-endian;
    }
    if (@CAN_PrivMain::RFC_Location_156_158::RFC_Loc156_158_ProtBlockCtr_FaultInject != 3)//BC: user defined value
    {

    clearBitsInByteArrayLE(data,24,4); //Intel / little-endian

    }
    if (@CAN_PrivMain::RFC_Location_156_158::RFC_Loc156_158_ProtBlockCtr_FaultInject == 0)//BC: No Error, calculate BC
    {
      bc_RFC_Location_156_158_RFC_Loc156_158_ProtBlockCtr = bc_RFC_Location_ProtBlockCtr ;

      copyBitsToByteArrayLE(bc_RFC_Location_156_158_RFC_Loc156_158_ProtBlockCtr,data,24,4); //Intel / little-endian;
    }
    else if (@CAN_PrivMain::RFC_Location_156_158::RFC_Loc156_158_ProtBlockCtr_FaultInject == 1)//BC: Error sequence: set BC = 0
    {

      copyBitsToByteArrayLE(0,data,24,4); //Intel / little-endian;
    }
    else if (@CAN_PrivMain::RFC_Location_156_158::RFC_Loc156_158_ProtBlockCtr_FaultInject == 2)//BC: Error sequence: Freeze last valid value
    {

      copyBitsToByteArrayLE(bc_RFC_Location_156_158_RFC_Loc156_158_ProtBlockCtr,data,24,4); //Intel / little-endian;
    }
    if (@CAN_PrivMain::RFC_Location_156_158::RFC_Loc156_158_CRC_FaultInject != 3)//CRC: user defined value
    {

    clearBitsInByteArrayLE(data,0,16); //Intel / little-endian

    }
    if(@CAN_PrivMain::RFC_Location_156_158::RFC_Loc156_158_CRC_FaultInject == 0)//CRC: No Error, calculate CRC
    {
      crcTemp = CRC16_INIT;
      for(i = 2; i < (DataLength+2); i++)
      {
        if(i < DataLength)
          data_byte = data[i] ;
        else if(i == DataLength)
          data_byte = (0x213c & 0x00FF);
        else if(i == (DataLength+1))
          data_byte = (0x213c & 0xFF00) >> 8;
        else
          write("Error: DLC exceeded in CRC calculation");
        crcTemp ^= data_byte << 8;
        crcTemp = (crcTemp << (8)) ^ CRC16_CCITT_FALSE_POLY_1021H_Lookup[(crcTemp >> (8)) & (0xFF)];
      }
      crcTemp ^= CRC16_XOR;
      crc_RFC_Location_156_158_RFC_Loc156_158_CRC = crcTemp;

      copyBitsToByteArrayLE(crc_RFC_Location_156_158_RFC_Loc156_158_CRC,data,0,16); //Intel / little-endian;
    }
    else if(@CAN_PrivMain::RFC_Location_156_158::RFC_Loc156_158_CRC_FaultInject == 1)//CRC: Error, set to Zero
    {

      copyBitsToByteArrayLE(0,data,0,16); //Intel / little-endian;
    }
    else if(@CAN_PrivMain::RFC_Location_156_158::RFC_Loc156_158_CRC_FaultInject == 2)//CRC: Error, Freeze last valid value
    {

      copyBitsToByteArrayLE(crc_RFC_Location_156_158_RFC_Loc156_158_CRC,data,0,16); //Intel / little-endian;
    }
}


on sysvar CAN_PrivMain::RFC_Location_159_161::RFC_Location_159_161_ON_OFF
{
  if (@this == 1)
  {
     ILSetMsgEvent(RFC_Location_159_161);
     @CAN_PrivMain::RFC_Location_159_161::RFC_Location_159_161_ON_OFF = 0;
  }
}

void cfg_Msg_RFC_Location_159_161(dword aDlc, byte data[])
{
   int64 i,k;//For looping
   byte xor,data_byte;
   dword crcTemp;
   byte DataLength;
   dword Msg_id;
   
   DataLength = Msg_RFC_Location_159_161.DataLength;//Message Data Length
   Msg_id  = Msg_RFC_Location_159_161.id;//Message ID
   
    if (@CAN_PrivMain::RFC_Location_159_161::RFC_Loc159_161_AliveCtr_FaultInject != 3)//AC: user defined value
    {

    clearBitsInByteArrayLE(data,16,8); //Intel / little-endian

    }
    if (@CAN_PrivMain::RFC_Location_159_161::RFC_Loc159_161_AliveCtr_FaultInject == 0)//AC: No Error, calculate AC
    {
      ++counter_RFC_Location_159_161_RFC_Loc159_161_AliveCtr;
      counter_RFC_Location_159_161_RFC_Loc159_161_AliveCtr %=256;

      copyBitsToByteArrayLE(counter_RFC_Location_159_161_RFC_Loc159_161_AliveCtr,data,16,8); //Intel / little-endian;
    }
    else if (@CAN_PrivMain::RFC_Location_159_161::RFC_Loc159_161_AliveCtr_FaultInject == 1)//AC: Error sequence: set AC = 0
    {

      copyBitsToByteArrayLE(0,data,16,8); //Intel / little-endian;
    }
    else if (@CAN_PrivMain::RFC_Location_159_161::RFC_Loc159_161_AliveCtr_FaultInject == 2)//AC: Error sequence: Freeze last valid value
    {

      copyBitsToByteArrayLE(counter_RFC_Location_159_161_RFC_Loc159_161_AliveCtr,data,16,8); //Intel / little-endian;
    }
    if (@CAN_PrivMain::RFC_Location_159_161::RFC_Loc159_161_ProtBlockCtr_FaultInject != 3)//BC: user defined value
    {

    clearBitsInByteArrayLE(data,24,4); //Intel / little-endian

    }
    if (@CAN_PrivMain::RFC_Location_159_161::RFC_Loc159_161_ProtBlockCtr_FaultInject == 0)//BC: No Error, calculate BC
    {
      bc_RFC_Location_159_161_RFC_Loc159_161_ProtBlockCtr = bc_RFC_Location_ProtBlockCtr ;

      copyBitsToByteArrayLE(bc_RFC_Location_159_161_RFC_Loc159_161_ProtBlockCtr,data,24,4); //Intel / little-endian;
    }
    else if (@CAN_PrivMain::RFC_Location_159_161::RFC_Loc159_161_ProtBlockCtr_FaultInject == 1)//BC: Error sequence: set BC = 0
    {

      copyBitsToByteArrayLE(0,data,24,4); //Intel / little-endian;
    }
    else if (@CAN_PrivMain::RFC_Location_159_161::RFC_Loc159_161_ProtBlockCtr_FaultInject == 2)//BC: Error sequence: Freeze last valid value
    {

      copyBitsToByteArrayLE(bc_RFC_Location_159_161_RFC_Loc159_161_ProtBlockCtr,data,24,4); //Intel / little-endian;
    }
    if (@CAN_PrivMain::RFC_Location_159_161::RFC_Loc159_161_CRC_FaultInject != 3)//CRC: user defined value
    {

    clearBitsInByteArrayLE(data,0,16); //Intel / little-endian

    }
    if(@CAN_PrivMain::RFC_Location_159_161::RFC_Loc159_161_CRC_FaultInject == 0)//CRC: No Error, calculate CRC
    {
      crcTemp = CRC16_INIT;
      for(i = 2; i < (DataLength+2); i++)
      {
        if(i < DataLength)
          data_byte = data[i] ;
        else if(i == DataLength)
          data_byte = (0x213d & 0x00FF);
        else if(i == (DataLength+1))
          data_byte = (0x213d & 0xFF00) >> 8;
        else
          write("Error: DLC exceeded in CRC calculation");
        crcTemp ^= data_byte << 8;
        crcTemp = (crcTemp << (8)) ^ CRC16_CCITT_FALSE_POLY_1021H_Lookup[(crcTemp >> (8)) & (0xFF)];
      }
      crcTemp ^= CRC16_XOR;
      crc_RFC_Location_159_161_RFC_Loc159_161_CRC = crcTemp;

      copyBitsToByteArrayLE(crc_RFC_Location_159_161_RFC_Loc159_161_CRC,data,0,16); //Intel / little-endian;
    }
    else if(@CAN_PrivMain::RFC_Location_159_161::RFC_Loc159_161_CRC_FaultInject == 1)//CRC: Error, set to Zero
    {

      copyBitsToByteArrayLE(0,data,0,16); //Intel / little-endian;
    }
    else if(@CAN_PrivMain::RFC_Location_159_161::RFC_Loc159_161_CRC_FaultInject == 2)//CRC: Error, Freeze last valid value
    {

      copyBitsToByteArrayLE(crc_RFC_Location_159_161_RFC_Loc159_161_CRC,data,0,16); //Intel / little-endian;
    }
}


on sysvar CAN_PrivMain::RFC_Location_162_164::RFC_Location_162_164_ON_OFF
{
  if (@this == 1)
  {
     ILSetMsgEvent(RFC_Location_162_164);
     @CAN_PrivMain::RFC_Location_162_164::RFC_Location_162_164_ON_OFF = 0;
  }
}

void cfg_Msg_RFC_Location_162_164(dword aDlc, byte data[])
{
   int64 i,k;//For looping
   byte xor,data_byte;
   dword crcTemp;
   byte DataLength;
   dword Msg_id;
   
   DataLength = Msg_RFC_Location_162_164.DataLength;//Message Data Length
   Msg_id  = Msg_RFC_Location_162_164.id;//Message ID
   
    if (@CAN_PrivMain::RFC_Location_162_164::RFC_Loc162_164_AliveCtr_FaultInject != 3)//AC: user defined value
    {

    clearBitsInByteArrayLE(data,16,8); //Intel / little-endian

    }
    if (@CAN_PrivMain::RFC_Location_162_164::RFC_Loc162_164_AliveCtr_FaultInject == 0)//AC: No Error, calculate AC
    {
      ++counter_RFC_Location_162_164_RFC_Loc162_164_AliveCtr;
      counter_RFC_Location_162_164_RFC_Loc162_164_AliveCtr %=256;

      copyBitsToByteArrayLE(counter_RFC_Location_162_164_RFC_Loc162_164_AliveCtr,data,16,8); //Intel / little-endian;
    }
    else if (@CAN_PrivMain::RFC_Location_162_164::RFC_Loc162_164_AliveCtr_FaultInject == 1)//AC: Error sequence: set AC = 0
    {

      copyBitsToByteArrayLE(0,data,16,8); //Intel / little-endian;
    }
    else if (@CAN_PrivMain::RFC_Location_162_164::RFC_Loc162_164_AliveCtr_FaultInject == 2)//AC: Error sequence: Freeze last valid value
    {

      copyBitsToByteArrayLE(counter_RFC_Location_162_164_RFC_Loc162_164_AliveCtr,data,16,8); //Intel / little-endian;
    }
    if (@CAN_PrivMain::RFC_Location_162_164::RFC_Loc162_164_ProtBlockCtr_FaultInject != 3)//BC: user defined value
    {

    clearBitsInByteArrayLE(data,24,4); //Intel / little-endian

    }
    if (@CAN_PrivMain::RFC_Location_162_164::RFC_Loc162_164_ProtBlockCtr_FaultInject == 0)//BC: No Error, calculate BC
    {
      bc_RFC_Location_162_164_RFC_Loc162_164_ProtBlockCtr = bc_RFC_Location_ProtBlockCtr ;

      copyBitsToByteArrayLE(bc_RFC_Location_162_164_RFC_Loc162_164_ProtBlockCtr,data,24,4); //Intel / little-endian;
    }
    else if (@CAN_PrivMain::RFC_Location_162_164::RFC_Loc162_164_ProtBlockCtr_FaultInject == 1)//BC: Error sequence: set BC = 0
    {

      copyBitsToByteArrayLE(0,data,24,4); //Intel / little-endian;
    }
    else if (@CAN_PrivMain::RFC_Location_162_164::RFC_Loc162_164_ProtBlockCtr_FaultInject == 2)//BC: Error sequence: Freeze last valid value
    {

      copyBitsToByteArrayLE(bc_RFC_Location_162_164_RFC_Loc162_164_ProtBlockCtr,data,24,4); //Intel / little-endian;
    }
    if (@CAN_PrivMain::RFC_Location_162_164::RFC_Loc162_164_CRC_FaultInject != 3)//CRC: user defined value
    {

    clearBitsInByteArrayLE(data,0,16); //Intel / little-endian

    }
    if(@CAN_PrivMain::RFC_Location_162_164::RFC_Loc162_164_CRC_FaultInject == 0)//CRC: No Error, calculate CRC
    {
      crcTemp = CRC16_INIT;
      for(i = 2; i < (DataLength+2); i++)
      {
        if(i < DataLength)
          data_byte = data[i] ;
        else if(i == DataLength)
          data_byte = (0x213e & 0x00FF);
        else if(i == (DataLength+1))
          data_byte = (0x213e & 0xFF00) >> 8;
        else
          write("Error: DLC exceeded in CRC calculation");
        crcTemp ^= data_byte << 8;
        crcTemp = (crcTemp << (8)) ^ CRC16_CCITT_FALSE_POLY_1021H_Lookup[(crcTemp >> (8)) & (0xFF)];
      }
      crcTemp ^= CRC16_XOR;
      crc_RFC_Location_162_164_RFC_Loc162_164_CRC = crcTemp;

      copyBitsToByteArrayLE(crc_RFC_Location_162_164_RFC_Loc162_164_CRC,data,0,16); //Intel / little-endian;
    }
    else if(@CAN_PrivMain::RFC_Location_162_164::RFC_Loc162_164_CRC_FaultInject == 1)//CRC: Error, set to Zero
    {

      copyBitsToByteArrayLE(0,data,0,16); //Intel / little-endian;
    }
    else if(@CAN_PrivMain::RFC_Location_162_164::RFC_Loc162_164_CRC_FaultInject == 2)//CRC: Error, Freeze last valid value
    {

      copyBitsToByteArrayLE(crc_RFC_Location_162_164_RFC_Loc162_164_CRC,data,0,16); //Intel / little-endian;
    }
}


on sysvar CAN_PrivMain::RFC_Location_165_167::RFC_Location_165_167_ON_OFF
{
  if (@this == 1)
  {
     ILSetMsgEvent(RFC_Location_165_167);
     @CAN_PrivMain::RFC_Location_165_167::RFC_Location_165_167_ON_OFF = 0;
  }
}

void cfg_Msg_RFC_Location_165_167(dword aDlc, byte data[])
{
   int64 i,k;//For looping
   byte xor,data_byte;
   dword crcTemp;
   byte DataLength;
   dword Msg_id;
   
   DataLength = Msg_RFC_Location_165_167.DataLength;//Message Data Length
   Msg_id  = Msg_RFC_Location_165_167.id;//Message ID
   
    if (@CAN_PrivMain::RFC_Location_165_167::RFC_Loc165_167_AliveCtr_FaultInject != 3)//AC: user defined value
    {

    clearBitsInByteArrayLE(data,16,8); //Intel / little-endian

    }
    if (@CAN_PrivMain::RFC_Location_165_167::RFC_Loc165_167_AliveCtr_FaultInject == 0)//AC: No Error, calculate AC
    {
      ++counter_RFC_Location_165_167_RFC_Loc165_167_AliveCtr;
      counter_RFC_Location_165_167_RFC_Loc165_167_AliveCtr %=256;

      copyBitsToByteArrayLE(counter_RFC_Location_165_167_RFC_Loc165_167_AliveCtr,data,16,8); //Intel / little-endian;
    }
    else if (@CAN_PrivMain::RFC_Location_165_167::RFC_Loc165_167_AliveCtr_FaultInject == 1)//AC: Error sequence: set AC = 0
    {

      copyBitsToByteArrayLE(0,data,16,8); //Intel / little-endian;
    }
    else if (@CAN_PrivMain::RFC_Location_165_167::RFC_Loc165_167_AliveCtr_FaultInject == 2)//AC: Error sequence: Freeze last valid value
    {

      copyBitsToByteArrayLE(counter_RFC_Location_165_167_RFC_Loc165_167_AliveCtr,data,16,8); //Intel / little-endian;
    }
    if (@CAN_PrivMain::RFC_Location_165_167::RFC_Loc165_167_ProtBlockCtr_FaultInject != 3)//BC: user defined value
    {

    clearBitsInByteArrayLE(data,24,4); //Intel / little-endian

    }
    if (@CAN_PrivMain::RFC_Location_165_167::RFC_Loc165_167_ProtBlockCtr_FaultInject == 0)//BC: No Error, calculate BC
    {
      bc_RFC_Location_165_167_RFC_Loc165_167_ProtBlockCtr = bc_RFC_Location_ProtBlockCtr ;

      copyBitsToByteArrayLE(bc_RFC_Location_165_167_RFC_Loc165_167_ProtBlockCtr,data,24,4); //Intel / little-endian;
    }
    else if (@CAN_PrivMain::RFC_Location_165_167::RFC_Loc165_167_ProtBlockCtr_FaultInject == 1)//BC: Error sequence: set BC = 0
    {

      copyBitsToByteArrayLE(0,data,24,4); //Intel / little-endian;
    }
    else if (@CAN_PrivMain::RFC_Location_165_167::RFC_Loc165_167_ProtBlockCtr_FaultInject == 2)//BC: Error sequence: Freeze last valid value
    {

      copyBitsToByteArrayLE(bc_RFC_Location_165_167_RFC_Loc165_167_ProtBlockCtr,data,24,4); //Intel / little-endian;
    }
    if (@CAN_PrivMain::RFC_Location_165_167::RFC_Loc165_167_CRC_FaultInject != 3)//CRC: user defined value
    {

    clearBitsInByteArrayLE(data,0,16); //Intel / little-endian

    }
    if(@CAN_PrivMain::RFC_Location_165_167::RFC_Loc165_167_CRC_FaultInject == 0)//CRC: No Error, calculate CRC
    {
      crcTemp = CRC16_INIT;
      for(i = 2; i < (DataLength+2); i++)
      {
        if(i < DataLength)
          data_byte = data[i] ;
        else if(i == DataLength)
          data_byte = (0x213f & 0x00FF);
        else if(i == (DataLength+1))
          data_byte = (0x213f & 0xFF00) >> 8;
        else
          write("Error: DLC exceeded in CRC calculation");
        crcTemp ^= data_byte << 8;
        crcTemp = (crcTemp << (8)) ^ CRC16_CCITT_FALSE_POLY_1021H_Lookup[(crcTemp >> (8)) & (0xFF)];
      }
      crcTemp ^= CRC16_XOR;
      crc_RFC_Location_165_167_RFC_Loc165_167_CRC = crcTemp;

      copyBitsToByteArrayLE(crc_RFC_Location_165_167_RFC_Loc165_167_CRC,data,0,16); //Intel / little-endian;
    }
    else if(@CAN_PrivMain::RFC_Location_165_167::RFC_Loc165_167_CRC_FaultInject == 1)//CRC: Error, set to Zero
    {

      copyBitsToByteArrayLE(0,data,0,16); //Intel / little-endian;
    }
    else if(@CAN_PrivMain::RFC_Location_165_167::RFC_Loc165_167_CRC_FaultInject == 2)//CRC: Error, Freeze last valid value
    {

      copyBitsToByteArrayLE(crc_RFC_Location_165_167_RFC_Loc165_167_CRC,data,0,16); //Intel / little-endian;
    }
}


on sysvar CAN_PrivMain::RFC_Location_168_170::RFC_Location_168_170_ON_OFF
{
  if (@this == 1)
  {
     ILSetMsgEvent(RFC_Location_168_170);
     @CAN_PrivMain::RFC_Location_168_170::RFC_Location_168_170_ON_OFF = 0;
  }
}

void cfg_Msg_RFC_Location_168_170(dword aDlc, byte data[])
{
   int64 i,k;//For looping
   byte xor,data_byte;
   dword crcTemp;
   byte DataLength;
   dword Msg_id;
   
   DataLength = Msg_RFC_Location_168_170.DataLength;//Message Data Length
   Msg_id  = Msg_RFC_Location_168_170.id;//Message ID
   
    if (@CAN_PrivMain::RFC_Location_168_170::RFC_Loc168_170_AliveCtr_FaultInject != 3)//AC: user defined value
    {

    clearBitsInByteArrayLE(data,16,8); //Intel / little-endian

    }
    if (@CAN_PrivMain::RFC_Location_168_170::RFC_Loc168_170_AliveCtr_FaultInject == 0)//AC: No Error, calculate AC
    {
      ++counter_RFC_Location_168_170_RFC_Loc168_170_AliveCtr;
      counter_RFC_Location_168_170_RFC_Loc168_170_AliveCtr %=256;

      copyBitsToByteArrayLE(counter_RFC_Location_168_170_RFC_Loc168_170_AliveCtr,data,16,8); //Intel / little-endian;
    }
    else if (@CAN_PrivMain::RFC_Location_168_170::RFC_Loc168_170_AliveCtr_FaultInject == 1)//AC: Error sequence: set AC = 0
    {

      copyBitsToByteArrayLE(0,data,16,8); //Intel / little-endian;
    }
    else if (@CAN_PrivMain::RFC_Location_168_170::RFC_Loc168_170_AliveCtr_FaultInject == 2)//AC: Error sequence: Freeze last valid value
    {

      copyBitsToByteArrayLE(counter_RFC_Location_168_170_RFC_Loc168_170_AliveCtr,data,16,8); //Intel / little-endian;
    }
    if (@CAN_PrivMain::RFC_Location_168_170::RFC_Loc168_170_ProtBlockCtr_FaultInject != 3)//BC: user defined value
    {

    clearBitsInByteArrayLE(data,24,4); //Intel / little-endian

    }
    if (@CAN_PrivMain::RFC_Location_168_170::RFC_Loc168_170_ProtBlockCtr_FaultInject == 0)//BC: No Error, calculate BC
    {
      bc_RFC_Location_168_170_RFC_Loc168_170_ProtBlockCtr = bc_RFC_Location_ProtBlockCtr ;

      copyBitsToByteArrayLE(bc_RFC_Location_168_170_RFC_Loc168_170_ProtBlockCtr,data,24,4); //Intel / little-endian;
    }
    else if (@CAN_PrivMain::RFC_Location_168_170::RFC_Loc168_170_ProtBlockCtr_FaultInject == 1)//BC: Error sequence: set BC = 0
    {

      copyBitsToByteArrayLE(0,data,24,4); //Intel / little-endian;
    }
    else if (@CAN_PrivMain::RFC_Location_168_170::RFC_Loc168_170_ProtBlockCtr_FaultInject == 2)//BC: Error sequence: Freeze last valid value
    {

      copyBitsToByteArrayLE(bc_RFC_Location_168_170_RFC_Loc168_170_ProtBlockCtr,data,24,4); //Intel / little-endian;
    }
    if (@CAN_PrivMain::RFC_Location_168_170::RFC_Loc168_170_CRC_FaultInject != 3)//CRC: user defined value
    {

    clearBitsInByteArrayLE(data,0,16); //Intel / little-endian

    }
    if(@CAN_PrivMain::RFC_Location_168_170::RFC_Loc168_170_CRC_FaultInject == 0)//CRC: No Error, calculate CRC
    {
      crcTemp = CRC16_INIT;
      for(i = 2; i < (DataLength+2); i++)
      {
        if(i < DataLength)
          data_byte = data[i] ;
        else if(i == DataLength)
          data_byte = (0x2140 & 0x00FF);
        else if(i == (DataLength+1))
          data_byte = (0x2140 & 0xFF00) >> 8;
        else
          write("Error: DLC exceeded in CRC calculation");
        crcTemp ^= data_byte << 8;
        crcTemp = (crcTemp << (8)) ^ CRC16_CCITT_FALSE_POLY_1021H_Lookup[(crcTemp >> (8)) & (0xFF)];
      }
      crcTemp ^= CRC16_XOR;
      crc_RFC_Location_168_170_RFC_Loc168_170_CRC = crcTemp;

      copyBitsToByteArrayLE(crc_RFC_Location_168_170_RFC_Loc168_170_CRC,data,0,16); //Intel / little-endian;
    }
    else if(@CAN_PrivMain::RFC_Location_168_170::RFC_Loc168_170_CRC_FaultInject == 1)//CRC: Error, set to Zero
    {

      copyBitsToByteArrayLE(0,data,0,16); //Intel / little-endian;
    }
    else if(@CAN_PrivMain::RFC_Location_168_170::RFC_Loc168_170_CRC_FaultInject == 2)//CRC: Error, Freeze last valid value
    {

      copyBitsToByteArrayLE(crc_RFC_Location_168_170_RFC_Loc168_170_CRC,data,0,16); //Intel / little-endian;
    }
}


on sysvar CAN_PrivMain::RFC_Location_171_173::RFC_Location_171_173_ON_OFF
{
  if (@this == 1)
  {
     ILSetMsgEvent(RFC_Location_171_173);
     @CAN_PrivMain::RFC_Location_171_173::RFC_Location_171_173_ON_OFF = 0;
  }
}

void cfg_Msg_RFC_Location_171_173(dword aDlc, byte data[])
{
   int64 i,k;//For looping
   byte xor,data_byte;
   dword crcTemp;
   byte DataLength;
   dword Msg_id;
   
   DataLength = Msg_RFC_Location_171_173.DataLength;//Message Data Length
   Msg_id  = Msg_RFC_Location_171_173.id;//Message ID
   
    if (@CAN_PrivMain::RFC_Location_171_173::RFC_Loc171_173_AliveCtr_FaultInject != 3)//AC: user defined value
    {

    clearBitsInByteArrayLE(data,16,8); //Intel / little-endian

    }
    if (@CAN_PrivMain::RFC_Location_171_173::RFC_Loc171_173_AliveCtr_FaultInject == 0)//AC: No Error, calculate AC
    {
      ++counter_RFC_Location_171_173_RFC_Loc171_173_AliveCtr;
      counter_RFC_Location_171_173_RFC_Loc171_173_AliveCtr %=256;

      copyBitsToByteArrayLE(counter_RFC_Location_171_173_RFC_Loc171_173_AliveCtr,data,16,8); //Intel / little-endian;
    }
    else if (@CAN_PrivMain::RFC_Location_171_173::RFC_Loc171_173_AliveCtr_FaultInject == 1)//AC: Error sequence: set AC = 0
    {

      copyBitsToByteArrayLE(0,data,16,8); //Intel / little-endian;
    }
    else if (@CAN_PrivMain::RFC_Location_171_173::RFC_Loc171_173_AliveCtr_FaultInject == 2)//AC: Error sequence: Freeze last valid value
    {

      copyBitsToByteArrayLE(counter_RFC_Location_171_173_RFC_Loc171_173_AliveCtr,data,16,8); //Intel / little-endian;
    }
    if (@CAN_PrivMain::RFC_Location_171_173::RFC_Loc171_173_ProtBlockCtr_FaultInject != 3)//BC: user defined value
    {

    clearBitsInByteArrayLE(data,24,4); //Intel / little-endian

    }
    if (@CAN_PrivMain::RFC_Location_171_173::RFC_Loc171_173_ProtBlockCtr_FaultInject == 0)//BC: No Error, calculate BC
    {
      bc_RFC_Location_171_173_RFC_Loc171_173_ProtBlockCtr = bc_RFC_Location_ProtBlockCtr ;

      copyBitsToByteArrayLE(bc_RFC_Location_171_173_RFC_Loc171_173_ProtBlockCtr,data,24,4); //Intel / little-endian;
    }
    else if (@CAN_PrivMain::RFC_Location_171_173::RFC_Loc171_173_ProtBlockCtr_FaultInject == 1)//BC: Error sequence: set BC = 0
    {

      copyBitsToByteArrayLE(0,data,24,4); //Intel / little-endian;
    }
    else if (@CAN_PrivMain::RFC_Location_171_173::RFC_Loc171_173_ProtBlockCtr_FaultInject == 2)//BC: Error sequence: Freeze last valid value
    {

      copyBitsToByteArrayLE(bc_RFC_Location_171_173_RFC_Loc171_173_ProtBlockCtr,data,24,4); //Intel / little-endian;
    }
    if (@CAN_PrivMain::RFC_Location_171_173::RFC_Loc171_173_CRC_FaultInject != 3)//CRC: user defined value
    {

    clearBitsInByteArrayLE(data,0,16); //Intel / little-endian

    }
    if(@CAN_PrivMain::RFC_Location_171_173::RFC_Loc171_173_CRC_FaultInject == 0)//CRC: No Error, calculate CRC
    {
      crcTemp = CRC16_INIT;
      for(i = 2; i < (DataLength+2); i++)
      {
        if(i < DataLength)
          data_byte = data[i] ;
        else if(i == DataLength)
          data_byte = (0x2141 & 0x00FF);
        else if(i == (DataLength+1))
          data_byte = (0x2141 & 0xFF00) >> 8;
        else
          write("Error: DLC exceeded in CRC calculation");
        crcTemp ^= data_byte << 8;
        crcTemp = (crcTemp << (8)) ^ CRC16_CCITT_FALSE_POLY_1021H_Lookup[(crcTemp >> (8)) & (0xFF)];
      }
      crcTemp ^= CRC16_XOR;
      crc_RFC_Location_171_173_RFC_Loc171_173_CRC = crcTemp;

      copyBitsToByteArrayLE(crc_RFC_Location_171_173_RFC_Loc171_173_CRC,data,0,16); //Intel / little-endian;
    }
    else if(@CAN_PrivMain::RFC_Location_171_173::RFC_Loc171_173_CRC_FaultInject == 1)//CRC: Error, set to Zero
    {

      copyBitsToByteArrayLE(0,data,0,16); //Intel / little-endian;
    }
    else if(@CAN_PrivMain::RFC_Location_171_173::RFC_Loc171_173_CRC_FaultInject == 2)//CRC: Error, Freeze last valid value
    {

      copyBitsToByteArrayLE(crc_RFC_Location_171_173_RFC_Loc171_173_CRC,data,0,16); //Intel / little-endian;
    }
}


on sysvar CAN_PrivMain::RFC_Location_174_176::RFC_Location_174_176_ON_OFF
{
  if (@this == 1)
  {
     ILSetMsgEvent(RFC_Location_174_176);
     @CAN_PrivMain::RFC_Location_174_176::RFC_Location_174_176_ON_OFF = 0;
  }
}

void cfg_Msg_RFC_Location_174_176(dword aDlc, byte data[])
{
   int64 i,k;//For looping
   byte xor,data_byte;
   dword crcTemp;
   byte DataLength;
   dword Msg_id;
   
   DataLength = Msg_RFC_Location_174_176.DataLength;//Message Data Length
   Msg_id  = Msg_RFC_Location_174_176.id;//Message ID
   
    if (@CAN_PrivMain::RFC_Location_174_176::RFC_Loc174_176_AliveCtr_FaultInject != 3)//AC: user defined value
    {

    clearBitsInByteArrayLE(data,16,8); //Intel / little-endian

    }
    if (@CAN_PrivMain::RFC_Location_174_176::RFC_Loc174_176_AliveCtr_FaultInject == 0)//AC: No Error, calculate AC
    {
      ++counter_RFC_Location_174_176_RFC_Loc174_176_AliveCtr;
      counter_RFC_Location_174_176_RFC_Loc174_176_AliveCtr %=256;

      copyBitsToByteArrayLE(counter_RFC_Location_174_176_RFC_Loc174_176_AliveCtr,data,16,8); //Intel / little-endian;
    }
    else if (@CAN_PrivMain::RFC_Location_174_176::RFC_Loc174_176_AliveCtr_FaultInject == 1)//AC: Error sequence: set AC = 0
    {

      copyBitsToByteArrayLE(0,data,16,8); //Intel / little-endian;
    }
    else if (@CAN_PrivMain::RFC_Location_174_176::RFC_Loc174_176_AliveCtr_FaultInject == 2)//AC: Error sequence: Freeze last valid value
    {

      copyBitsToByteArrayLE(counter_RFC_Location_174_176_RFC_Loc174_176_AliveCtr,data,16,8); //Intel / little-endian;
    }
    if (@CAN_PrivMain::RFC_Location_174_176::RFC_Loc174_176_ProtBlockCtr_FaultInject != 3)//BC: user defined value
    {

    clearBitsInByteArrayLE(data,24,4); //Intel / little-endian

    }
    if (@CAN_PrivMain::RFC_Location_174_176::RFC_Loc174_176_ProtBlockCtr_FaultInject == 0)//BC: No Error, calculate BC
    {
      bc_RFC_Location_174_176_RFC_Loc174_176_ProtBlockCtr = bc_RFC_Location_ProtBlockCtr ;

      copyBitsToByteArrayLE(bc_RFC_Location_174_176_RFC_Loc174_176_ProtBlockCtr,data,24,4); //Intel / little-endian;
    }
    else if (@CAN_PrivMain::RFC_Location_174_176::RFC_Loc174_176_ProtBlockCtr_FaultInject == 1)//BC: Error sequence: set BC = 0
    {

      copyBitsToByteArrayLE(0,data,24,4); //Intel / little-endian;
    }
    else if (@CAN_PrivMain::RFC_Location_174_176::RFC_Loc174_176_ProtBlockCtr_FaultInject == 2)//BC: Error sequence: Freeze last valid value
    {

      copyBitsToByteArrayLE(bc_RFC_Location_174_176_RFC_Loc174_176_ProtBlockCtr,data,24,4); //Intel / little-endian;
    }
    if (@CAN_PrivMain::RFC_Location_174_176::RFC_Loc174_176_CRC_FaultInject != 3)//CRC: user defined value
    {

    clearBitsInByteArrayLE(data,0,16); //Intel / little-endian

    }
    if(@CAN_PrivMain::RFC_Location_174_176::RFC_Loc174_176_CRC_FaultInject == 0)//CRC: No Error, calculate CRC
    {
      crcTemp = CRC16_INIT;
      for(i = 2; i < (DataLength+2); i++)
      {
        if(i < DataLength)
          data_byte = data[i] ;
        else if(i == DataLength)
          data_byte = (0x2142 & 0x00FF);
        else if(i == (DataLength+1))
          data_byte = (0x2142 & 0xFF00) >> 8;
        else
          write("Error: DLC exceeded in CRC calculation");
        crcTemp ^= data_byte << 8;
        crcTemp = (crcTemp << (8)) ^ CRC16_CCITT_FALSE_POLY_1021H_Lookup[(crcTemp >> (8)) & (0xFF)];
      }
      crcTemp ^= CRC16_XOR;
      crc_RFC_Location_174_176_RFC_Loc174_176_CRC = crcTemp;

      copyBitsToByteArrayLE(crc_RFC_Location_174_176_RFC_Loc174_176_CRC,data,0,16); //Intel / little-endian;
    }
    else if(@CAN_PrivMain::RFC_Location_174_176::RFC_Loc174_176_CRC_FaultInject == 1)//CRC: Error, set to Zero
    {

      copyBitsToByteArrayLE(0,data,0,16); //Intel / little-endian;
    }
    else if(@CAN_PrivMain::RFC_Location_174_176::RFC_Loc174_176_CRC_FaultInject == 2)//CRC: Error, Freeze last valid value
    {

      copyBitsToByteArrayLE(crc_RFC_Location_174_176_RFC_Loc174_176_CRC,data,0,16); //Intel / little-endian;
    }
}


on sysvar CAN_PrivMain::RFC_Location_177_179::RFC_Location_177_179_ON_OFF
{
  if (@this == 1)
  {
     ILSetMsgEvent(RFC_Location_177_179);
     @CAN_PrivMain::RFC_Location_177_179::RFC_Location_177_179_ON_OFF = 0;
  }
}

void cfg_Msg_RFC_Location_177_179(dword aDlc, byte data[])
{
   int64 i,k;//For looping
   byte xor,data_byte;
   dword crcTemp;
   byte DataLength;
   dword Msg_id;
   
   DataLength = Msg_RFC_Location_177_179.DataLength;//Message Data Length
   Msg_id  = Msg_RFC_Location_177_179.id;//Message ID
   
    if (@CAN_PrivMain::RFC_Location_177_179::RFC_Loc177_179_AliveCtr_FaultInject != 3)//AC: user defined value
    {

    clearBitsInByteArrayLE(data,16,8); //Intel / little-endian

    }
    if (@CAN_PrivMain::RFC_Location_177_179::RFC_Loc177_179_AliveCtr_FaultInject == 0)//AC: No Error, calculate AC
    {
      ++counter_RFC_Location_177_179_RFC_Loc177_179_AliveCtr;
      counter_RFC_Location_177_179_RFC_Loc177_179_AliveCtr %=256;

      copyBitsToByteArrayLE(counter_RFC_Location_177_179_RFC_Loc177_179_AliveCtr,data,16,8); //Intel / little-endian;
    }
    else if (@CAN_PrivMain::RFC_Location_177_179::RFC_Loc177_179_AliveCtr_FaultInject == 1)//AC: Error sequence: set AC = 0
    {

      copyBitsToByteArrayLE(0,data,16,8); //Intel / little-endian;
    }
    else if (@CAN_PrivMain::RFC_Location_177_179::RFC_Loc177_179_AliveCtr_FaultInject == 2)//AC: Error sequence: Freeze last valid value
    {

      copyBitsToByteArrayLE(counter_RFC_Location_177_179_RFC_Loc177_179_AliveCtr,data,16,8); //Intel / little-endian;
    }
    if (@CAN_PrivMain::RFC_Location_177_179::RFC_Loc177_179_ProtBlockCtr_FaultInject != 3)//BC: user defined value
    {

    clearBitsInByteArrayLE(data,24,4); //Intel / little-endian

    }
    if (@CAN_PrivMain::RFC_Location_177_179::RFC_Loc177_179_ProtBlockCtr_FaultInject == 0)//BC: No Error, calculate BC
    {
      bc_RFC_Location_177_179_RFC_Loc177_179_ProtBlockCtr = bc_RFC_Location_ProtBlockCtr ;

      copyBitsToByteArrayLE(bc_RFC_Location_177_179_RFC_Loc177_179_ProtBlockCtr,data,24,4); //Intel / little-endian;
    }
    else if (@CAN_PrivMain::RFC_Location_177_179::RFC_Loc177_179_ProtBlockCtr_FaultInject == 1)//BC: Error sequence: set BC = 0
    {

      copyBitsToByteArrayLE(0,data,24,4); //Intel / little-endian;
    }
    else if (@CAN_PrivMain::RFC_Location_177_179::RFC_Loc177_179_ProtBlockCtr_FaultInject == 2)//BC: Error sequence: Freeze last valid value
    {

      copyBitsToByteArrayLE(bc_RFC_Location_177_179_RFC_Loc177_179_ProtBlockCtr,data,24,4); //Intel / little-endian;
    }
    if (@CAN_PrivMain::RFC_Location_177_179::RFC_Loc177_179_CRC_FaultInject != 3)//CRC: user defined value
    {

    clearBitsInByteArrayLE(data,0,16); //Intel / little-endian

    }
    if(@CAN_PrivMain::RFC_Location_177_179::RFC_Loc177_179_CRC_FaultInject == 0)//CRC: No Error, calculate CRC
    {
      crcTemp = CRC16_INIT;
      for(i = 2; i < (DataLength+2); i++)
      {
        if(i < DataLength)
          data_byte = data[i] ;
        else if(i == DataLength)
          data_byte = (0x2143 & 0x00FF);
        else if(i == (DataLength+1))
          data_byte = (0x2143 & 0xFF00) >> 8;
        else
          write("Error: DLC exceeded in CRC calculation");
        crcTemp ^= data_byte << 8;
        crcTemp = (crcTemp << (8)) ^ CRC16_CCITT_FALSE_POLY_1021H_Lookup[(crcTemp >> (8)) & (0xFF)];
      }
      crcTemp ^= CRC16_XOR;
      crc_RFC_Location_177_179_RFC_Loc177_179_CRC = crcTemp;

      copyBitsToByteArrayLE(crc_RFC_Location_177_179_RFC_Loc177_179_CRC,data,0,16); //Intel / little-endian;
    }
    else if(@CAN_PrivMain::RFC_Location_177_179::RFC_Loc177_179_CRC_FaultInject == 1)//CRC: Error, set to Zero
    {

      copyBitsToByteArrayLE(0,data,0,16); //Intel / little-endian;
    }
    else if(@CAN_PrivMain::RFC_Location_177_179::RFC_Loc177_179_CRC_FaultInject == 2)//CRC: Error, Freeze last valid value
    {

      copyBitsToByteArrayLE(crc_RFC_Location_177_179_RFC_Loc177_179_CRC,data,0,16); //Intel / little-endian;
    }
}


on sysvar CAN_PrivMain::RFC_Location_180_182::RFC_Location_180_182_ON_OFF
{
  if (@this == 1)
  {
     ILSetMsgEvent(RFC_Location_180_182);
     @CAN_PrivMain::RFC_Location_180_182::RFC_Location_180_182_ON_OFF = 0;
  }
}

void cfg_Msg_RFC_Location_180_182(dword aDlc, byte data[])
{
   int64 i,k;//For looping
   byte xor,data_byte;
   dword crcTemp;
   byte DataLength;
   dword Msg_id;
   
   DataLength = Msg_RFC_Location_180_182.DataLength;//Message Data Length
   Msg_id  = Msg_RFC_Location_180_182.id;//Message ID
   
    if (@CAN_PrivMain::RFC_Location_180_182::RFC_Loc180_182_AliveCtr_FaultInject != 3)//AC: user defined value
    {

    clearBitsInByteArrayLE(data,16,8); //Intel / little-endian

    }
    if (@CAN_PrivMain::RFC_Location_180_182::RFC_Loc180_182_AliveCtr_FaultInject == 0)//AC: No Error, calculate AC
    {
      ++counter_RFC_Location_180_182_RFC_Loc180_182_AliveCtr;
      counter_RFC_Location_180_182_RFC_Loc180_182_AliveCtr %=256;

      copyBitsToByteArrayLE(counter_RFC_Location_180_182_RFC_Loc180_182_AliveCtr,data,16,8); //Intel / little-endian;
    }
    else if (@CAN_PrivMain::RFC_Location_180_182::RFC_Loc180_182_AliveCtr_FaultInject == 1)//AC: Error sequence: set AC = 0
    {

      copyBitsToByteArrayLE(0,data,16,8); //Intel / little-endian;
    }
    else if (@CAN_PrivMain::RFC_Location_180_182::RFC_Loc180_182_AliveCtr_FaultInject == 2)//AC: Error sequence: Freeze last valid value
    {

      copyBitsToByteArrayLE(counter_RFC_Location_180_182_RFC_Loc180_182_AliveCtr,data,16,8); //Intel / little-endian;
    }
    if (@CAN_PrivMain::RFC_Location_180_182::RFC_Loc180_182_ProtBlockCtr_FaultInject != 3)//BC: user defined value
    {

    clearBitsInByteArrayLE(data,24,4); //Intel / little-endian

    }
    if (@CAN_PrivMain::RFC_Location_180_182::RFC_Loc180_182_ProtBlockCtr_FaultInject == 0)//BC: No Error, calculate BC
    {
      bc_RFC_Location_180_182_RFC_Loc180_182_ProtBlockCtr = bc_RFC_Location_ProtBlockCtr ;

      copyBitsToByteArrayLE(bc_RFC_Location_180_182_RFC_Loc180_182_ProtBlockCtr,data,24,4); //Intel / little-endian;
    }
    else if (@CAN_PrivMain::RFC_Location_180_182::RFC_Loc180_182_ProtBlockCtr_FaultInject == 1)//BC: Error sequence: set BC = 0
    {

      copyBitsToByteArrayLE(0,data,24,4); //Intel / little-endian;
    }
    else if (@CAN_PrivMain::RFC_Location_180_182::RFC_Loc180_182_ProtBlockCtr_FaultInject == 2)//BC: Error sequence: Freeze last valid value
    {

      copyBitsToByteArrayLE(bc_RFC_Location_180_182_RFC_Loc180_182_ProtBlockCtr,data,24,4); //Intel / little-endian;
    }
    if (@CAN_PrivMain::RFC_Location_180_182::RFC_Loc180_182_CRC_FaultInject != 3)//CRC: user defined value
    {

    clearBitsInByteArrayLE(data,0,16); //Intel / little-endian

    }
    if(@CAN_PrivMain::RFC_Location_180_182::RFC_Loc180_182_CRC_FaultInject == 0)//CRC: No Error, calculate CRC
    {
      crcTemp = CRC16_INIT;
      for(i = 2; i < (DataLength+2); i++)
      {
        if(i < DataLength)
          data_byte = data[i] ;
        else if(i == DataLength)
          data_byte = (0x2144 & 0x00FF);
        else if(i == (DataLength+1))
          data_byte = (0x2144 & 0xFF00) >> 8;
        else
          write("Error: DLC exceeded in CRC calculation");
        crcTemp ^= data_byte << 8;
        crcTemp = (crcTemp << (8)) ^ CRC16_CCITT_FALSE_POLY_1021H_Lookup[(crcTemp >> (8)) & (0xFF)];
      }
      crcTemp ^= CRC16_XOR;
      crc_RFC_Location_180_182_RFC_Loc180_182_CRC = crcTemp;

      copyBitsToByteArrayLE(crc_RFC_Location_180_182_RFC_Loc180_182_CRC,data,0,16); //Intel / little-endian;
    }
    else if(@CAN_PrivMain::RFC_Location_180_182::RFC_Loc180_182_CRC_FaultInject == 1)//CRC: Error, set to Zero
    {

      copyBitsToByteArrayLE(0,data,0,16); //Intel / little-endian;
    }
    else if(@CAN_PrivMain::RFC_Location_180_182::RFC_Loc180_182_CRC_FaultInject == 2)//CRC: Error, Freeze last valid value
    {

      copyBitsToByteArrayLE(crc_RFC_Location_180_182_RFC_Loc180_182_CRC,data,0,16); //Intel / little-endian;
    }
}


on sysvar CAN_PrivMain::RFC_Location_183_185::RFC_Location_183_185_ON_OFF
{
  if (@this == 1)
  {
     ILSetMsgEvent(RFC_Location_183_185);
     @CAN_PrivMain::RFC_Location_183_185::RFC_Location_183_185_ON_OFF = 0;
  }
}

void cfg_Msg_RFC_Location_183_185(dword aDlc, byte data[])
{
   int64 i,k;//For looping
   byte xor,data_byte;
   dword crcTemp;
   byte DataLength;
   dword Msg_id;
   
   DataLength = Msg_RFC_Location_183_185.DataLength;//Message Data Length
   Msg_id  = Msg_RFC_Location_183_185.id;//Message ID
   
    if (@CAN_PrivMain::RFC_Location_183_185::RFC_Loc183_185_AliveCtr_FaultInject != 3)//AC: user defined value
    {

    clearBitsInByteArrayLE(data,16,8); //Intel / little-endian

    }
    if (@CAN_PrivMain::RFC_Location_183_185::RFC_Loc183_185_AliveCtr_FaultInject == 0)//AC: No Error, calculate AC
    {
      ++counter_RFC_Location_183_185_RFC_Loc183_185_AliveCtr;
      counter_RFC_Location_183_185_RFC_Loc183_185_AliveCtr %=256;

      copyBitsToByteArrayLE(counter_RFC_Location_183_185_RFC_Loc183_185_AliveCtr,data,16,8); //Intel / little-endian;
    }
    else if (@CAN_PrivMain::RFC_Location_183_185::RFC_Loc183_185_AliveCtr_FaultInject == 1)//AC: Error sequence: set AC = 0
    {

      copyBitsToByteArrayLE(0,data,16,8); //Intel / little-endian;
    }
    else if (@CAN_PrivMain::RFC_Location_183_185::RFC_Loc183_185_AliveCtr_FaultInject == 2)//AC: Error sequence: Freeze last valid value
    {

      copyBitsToByteArrayLE(counter_RFC_Location_183_185_RFC_Loc183_185_AliveCtr,data,16,8); //Intel / little-endian;
    }
    if (@CAN_PrivMain::RFC_Location_183_185::RFC_Loc183_185_ProtBlockCtr_FaultInject != 3)//BC: user defined value
    {

    clearBitsInByteArrayLE(data,24,4); //Intel / little-endian

    }
    if (@CAN_PrivMain::RFC_Location_183_185::RFC_Loc183_185_ProtBlockCtr_FaultInject == 0)//BC: No Error, calculate BC
    {
      bc_RFC_Location_183_185_RFC_Loc183_185_ProtBlockCtr = bc_RFC_Location_ProtBlockCtr ;

      copyBitsToByteArrayLE(bc_RFC_Location_183_185_RFC_Loc183_185_ProtBlockCtr,data,24,4); //Intel / little-endian;
    }
    else if (@CAN_PrivMain::RFC_Location_183_185::RFC_Loc183_185_ProtBlockCtr_FaultInject == 1)//BC: Error sequence: set BC = 0
    {

      copyBitsToByteArrayLE(0,data,24,4); //Intel / little-endian;
    }
    else if (@CAN_PrivMain::RFC_Location_183_185::RFC_Loc183_185_ProtBlockCtr_FaultInject == 2)//BC: Error sequence: Freeze last valid value
    {

      copyBitsToByteArrayLE(bc_RFC_Location_183_185_RFC_Loc183_185_ProtBlockCtr,data,24,4); //Intel / little-endian;
    }
    if (@CAN_PrivMain::RFC_Location_183_185::RFC_Loc183_185_CRC_FaultInject != 3)//CRC: user defined value
    {

    clearBitsInByteArrayLE(data,0,16); //Intel / little-endian

    }
    if(@CAN_PrivMain::RFC_Location_183_185::RFC_Loc183_185_CRC_FaultInject == 0)//CRC: No Error, calculate CRC
    {
      crcTemp = CRC16_INIT;
      for(i = 2; i < (DataLength+2); i++)
      {
        if(i < DataLength)
          data_byte = data[i] ;
        else if(i == DataLength)
          data_byte = (0x2145 & 0x00FF);
        else if(i == (DataLength+1))
          data_byte = (0x2145 & 0xFF00) >> 8;
        else
          write("Error: DLC exceeded in CRC calculation");
        crcTemp ^= data_byte << 8;
        crcTemp = (crcTemp << (8)) ^ CRC16_CCITT_FALSE_POLY_1021H_Lookup[(crcTemp >> (8)) & (0xFF)];
      }
      crcTemp ^= CRC16_XOR;
      crc_RFC_Location_183_185_RFC_Loc183_185_CRC = crcTemp;

      copyBitsToByteArrayLE(crc_RFC_Location_183_185_RFC_Loc183_185_CRC,data,0,16); //Intel / little-endian;
    }
    else if(@CAN_PrivMain::RFC_Location_183_185::RFC_Loc183_185_CRC_FaultInject == 1)//CRC: Error, set to Zero
    {

      copyBitsToByteArrayLE(0,data,0,16); //Intel / little-endian;
    }
    else if(@CAN_PrivMain::RFC_Location_183_185::RFC_Loc183_185_CRC_FaultInject == 2)//CRC: Error, Freeze last valid value
    {

      copyBitsToByteArrayLE(crc_RFC_Location_183_185_RFC_Loc183_185_CRC,data,0,16); //Intel / little-endian;
    }
}


on sysvar CAN_PrivMain::RFC_Location_186_188::RFC_Location_186_188_ON_OFF
{
  if (@this == 1)
  {
     ILSetMsgEvent(RFC_Location_186_188);
     @CAN_PrivMain::RFC_Location_186_188::RFC_Location_186_188_ON_OFF = 0;
  }
}

void cfg_Msg_RFC_Location_186_188(dword aDlc, byte data[])
{
   int64 i,k;//For looping
   byte xor,data_byte;
   dword crcTemp;
   byte DataLength;
   dword Msg_id;
   
   DataLength = Msg_RFC_Location_186_188.DataLength;//Message Data Length
   Msg_id  = Msg_RFC_Location_186_188.id;//Message ID
   
    if (@CAN_PrivMain::RFC_Location_186_188::RFC_Loc186_188_AliveCtr_FaultInject != 3)//AC: user defined value
    {

    clearBitsInByteArrayLE(data,16,8); //Intel / little-endian

    }
    if (@CAN_PrivMain::RFC_Location_186_188::RFC_Loc186_188_AliveCtr_FaultInject == 0)//AC: No Error, calculate AC
    {
      ++counter_RFC_Location_186_188_RFC_Loc186_188_AliveCtr;
      counter_RFC_Location_186_188_RFC_Loc186_188_AliveCtr %=256;

      copyBitsToByteArrayLE(counter_RFC_Location_186_188_RFC_Loc186_188_AliveCtr,data,16,8); //Intel / little-endian;
    }
    else if (@CAN_PrivMain::RFC_Location_186_188::RFC_Loc186_188_AliveCtr_FaultInject == 1)//AC: Error sequence: set AC = 0
    {

      copyBitsToByteArrayLE(0,data,16,8); //Intel / little-endian;
    }
    else if (@CAN_PrivMain::RFC_Location_186_188::RFC_Loc186_188_AliveCtr_FaultInject == 2)//AC: Error sequence: Freeze last valid value
    {

      copyBitsToByteArrayLE(counter_RFC_Location_186_188_RFC_Loc186_188_AliveCtr,data,16,8); //Intel / little-endian;
    }
    if (@CAN_PrivMain::RFC_Location_186_188::RFC_Loc186_188_ProtBlockCtr_FaultInject != 3)//BC: user defined value
    {

    clearBitsInByteArrayLE(data,24,4); //Intel / little-endian

    }
    if (@CAN_PrivMain::RFC_Location_186_188::RFC_Loc186_188_ProtBlockCtr_FaultInject == 0)//BC: No Error, calculate BC
    {
      bc_RFC_Location_186_188_RFC_Loc186_188_ProtBlockCtr = bc_RFC_Location_ProtBlockCtr ;

      copyBitsToByteArrayLE(bc_RFC_Location_186_188_RFC_Loc186_188_ProtBlockCtr,data,24,4); //Intel / little-endian;
    }
    else if (@CAN_PrivMain::RFC_Location_186_188::RFC_Loc186_188_ProtBlockCtr_FaultInject == 1)//BC: Error sequence: set BC = 0
    {

      copyBitsToByteArrayLE(0,data,24,4); //Intel / little-endian;
    }
    else if (@CAN_PrivMain::RFC_Location_186_188::RFC_Loc186_188_ProtBlockCtr_FaultInject == 2)//BC: Error sequence: Freeze last valid value
    {

      copyBitsToByteArrayLE(bc_RFC_Location_186_188_RFC_Loc186_188_ProtBlockCtr,data,24,4); //Intel / little-endian;
    }
    if (@CAN_PrivMain::RFC_Location_186_188::RFC_Loc186_188_CRC_FaultInject != 3)//CRC: user defined value
    {

    clearBitsInByteArrayLE(data,0,16); //Intel / little-endian

    }
    if(@CAN_PrivMain::RFC_Location_186_188::RFC_Loc186_188_CRC_FaultInject == 0)//CRC: No Error, calculate CRC
    {
      crcTemp = CRC16_INIT;
      for(i = 2; i < (DataLength+2); i++)
      {
        if(i < DataLength)
          data_byte = data[i] ;
        else if(i == DataLength)
          data_byte = (0x2146 & 0x00FF);
        else if(i == (DataLength+1))
          data_byte = (0x2146 & 0xFF00) >> 8;
        else
          write("Error: DLC exceeded in CRC calculation");
        crcTemp ^= data_byte << 8;
        crcTemp = (crcTemp << (8)) ^ CRC16_CCITT_FALSE_POLY_1021H_Lookup[(crcTemp >> (8)) & (0xFF)];
      }
      crcTemp ^= CRC16_XOR;
      crc_RFC_Location_186_188_RFC_Loc186_188_CRC = crcTemp;

      copyBitsToByteArrayLE(crc_RFC_Location_186_188_RFC_Loc186_188_CRC,data,0,16); //Intel / little-endian;
    }
    else if(@CAN_PrivMain::RFC_Location_186_188::RFC_Loc186_188_CRC_FaultInject == 1)//CRC: Error, set to Zero
    {

      copyBitsToByteArrayLE(0,data,0,16); //Intel / little-endian;
    }
    else if(@CAN_PrivMain::RFC_Location_186_188::RFC_Loc186_188_CRC_FaultInject == 2)//CRC: Error, Freeze last valid value
    {

      copyBitsToByteArrayLE(crc_RFC_Location_186_188_RFC_Loc186_188_CRC,data,0,16); //Intel / little-endian;
    }
}


on sysvar CAN_PrivMain::RFC_Location_189_191::RFC_Location_189_191_ON_OFF
{
  if (@this == 1)
  {
     ILSetMsgEvent(RFC_Location_189_191);
     @CAN_PrivMain::RFC_Location_189_191::RFC_Location_189_191_ON_OFF = 0;
  }
}

void cfg_Msg_RFC_Location_189_191(dword aDlc, byte data[])
{
   int64 i,k;//For looping
   byte xor,data_byte;
   dword crcTemp;
   byte DataLength;
   dword Msg_id;
   
   DataLength = Msg_RFC_Location_189_191.DataLength;//Message Data Length
   Msg_id  = Msg_RFC_Location_189_191.id;//Message ID
   
    if (@CAN_PrivMain::RFC_Location_189_191::RFC_Loc189_191_AliveCtr_FaultInject != 3)//AC: user defined value
    {

    clearBitsInByteArrayLE(data,16,8); //Intel / little-endian

    }
    if (@CAN_PrivMain::RFC_Location_189_191::RFC_Loc189_191_AliveCtr_FaultInject == 0)//AC: No Error, calculate AC
    {
      ++counter_RFC_Location_189_191_RFC_Loc189_191_AliveCtr;
      counter_RFC_Location_189_191_RFC_Loc189_191_AliveCtr %=256;

      copyBitsToByteArrayLE(counter_RFC_Location_189_191_RFC_Loc189_191_AliveCtr,data,16,8); //Intel / little-endian;
    }
    else if (@CAN_PrivMain::RFC_Location_189_191::RFC_Loc189_191_AliveCtr_FaultInject == 1)//AC: Error sequence: set AC = 0
    {

      copyBitsToByteArrayLE(0,data,16,8); //Intel / little-endian;
    }
    else if (@CAN_PrivMain::RFC_Location_189_191::RFC_Loc189_191_AliveCtr_FaultInject == 2)//AC: Error sequence: Freeze last valid value
    {

      copyBitsToByteArrayLE(counter_RFC_Location_189_191_RFC_Loc189_191_AliveCtr,data,16,8); //Intel / little-endian;
    }
    if (@CAN_PrivMain::RFC_Location_189_191::RFC_Loc189_191_ProtBlockCtr_FaultInject != 3)//BC: user defined value
    {

    clearBitsInByteArrayLE(data,24,4); //Intel / little-endian

    }
    if (@CAN_PrivMain::RFC_Location_189_191::RFC_Loc189_191_ProtBlockCtr_FaultInject == 0)//BC: No Error, calculate BC
    {
      bc_RFC_Location_189_191_RFC_Loc189_191_ProtBlockCtr = bc_RFC_Location_ProtBlockCtr ;

      copyBitsToByteArrayLE(bc_RFC_Location_189_191_RFC_Loc189_191_ProtBlockCtr,data,24,4); //Intel / little-endian;
    }
    else if (@CAN_PrivMain::RFC_Location_189_191::RFC_Loc189_191_ProtBlockCtr_FaultInject == 1)//BC: Error sequence: set BC = 0
    {

      copyBitsToByteArrayLE(0,data,24,4); //Intel / little-endian;
    }
    else if (@CAN_PrivMain::RFC_Location_189_191::RFC_Loc189_191_ProtBlockCtr_FaultInject == 2)//BC: Error sequence: Freeze last valid value
    {

      copyBitsToByteArrayLE(bc_RFC_Location_189_191_RFC_Loc189_191_ProtBlockCtr,data,24,4); //Intel / little-endian;
    }
    if (@CAN_PrivMain::RFC_Location_189_191::RFC_Loc189_191_CRC_FaultInject != 3)//CRC: user defined value
    {

    clearBitsInByteArrayLE(data,0,16); //Intel / little-endian

    }
    if(@CAN_PrivMain::RFC_Location_189_191::RFC_Loc189_191_CRC_FaultInject == 0)//CRC: No Error, calculate CRC
    {
      crcTemp = CRC16_INIT;
      for(i = 2; i < (DataLength+2); i++)
      {
        if(i < DataLength)
          data_byte = data[i] ;
        else if(i == DataLength)
          data_byte = (0x2147 & 0x00FF);
        else if(i == (DataLength+1))
          data_byte = (0x2147 & 0xFF00) >> 8;
        else
          write("Error: DLC exceeded in CRC calculation");
        crcTemp ^= data_byte << 8;
        crcTemp = (crcTemp << (8)) ^ CRC16_CCITT_FALSE_POLY_1021H_Lookup[(crcTemp >> (8)) & (0xFF)];
      }
      crcTemp ^= CRC16_XOR;
      crc_RFC_Location_189_191_RFC_Loc189_191_CRC = crcTemp;

      copyBitsToByteArrayLE(crc_RFC_Location_189_191_RFC_Loc189_191_CRC,data,0,16); //Intel / little-endian;
    }
    else if(@CAN_PrivMain::RFC_Location_189_191::RFC_Loc189_191_CRC_FaultInject == 1)//CRC: Error, set to Zero
    {

      copyBitsToByteArrayLE(0,data,0,16); //Intel / little-endian;
    }
    else if(@CAN_PrivMain::RFC_Location_189_191::RFC_Loc189_191_CRC_FaultInject == 2)//CRC: Error, Freeze last valid value
    {

      copyBitsToByteArrayLE(crc_RFC_Location_189_191_RFC_Loc189_191_CRC,data,0,16); //Intel / little-endian;
    }
}


on sysvar CAN_PrivMain::RFC_Location_192_194::RFC_Location_192_194_ON_OFF
{
  if (@this == 1)
  {
     ILSetMsgEvent(RFC_Location_192_194);
     @CAN_PrivMain::RFC_Location_192_194::RFC_Location_192_194_ON_OFF = 0;
  }
}

void cfg_Msg_RFC_Location_192_194(dword aDlc, byte data[])
{
   int64 i,k;//For looping
   byte xor,data_byte;
   dword crcTemp;
   byte DataLength;
   dword Msg_id;
   
   DataLength = Msg_RFC_Location_192_194.DataLength;//Message Data Length
   Msg_id  = Msg_RFC_Location_192_194.id;//Message ID
   
    if (@CAN_PrivMain::RFC_Location_192_194::RFC_Loc192_194_AliveCtr_FaultInject != 3)//AC: user defined value
    {

    clearBitsInByteArrayLE(data,16,8); //Intel / little-endian

    }
    if (@CAN_PrivMain::RFC_Location_192_194::RFC_Loc192_194_AliveCtr_FaultInject == 0)//AC: No Error, calculate AC
    {
      ++counter_RFC_Location_192_194_RFC_Loc192_194_AliveCtr;
      counter_RFC_Location_192_194_RFC_Loc192_194_AliveCtr %=256;

      copyBitsToByteArrayLE(counter_RFC_Location_192_194_RFC_Loc192_194_AliveCtr,data,16,8); //Intel / little-endian;
    }
    else if (@CAN_PrivMain::RFC_Location_192_194::RFC_Loc192_194_AliveCtr_FaultInject == 1)//AC: Error sequence: set AC = 0
    {

      copyBitsToByteArrayLE(0,data,16,8); //Intel / little-endian;
    }
    else if (@CAN_PrivMain::RFC_Location_192_194::RFC_Loc192_194_AliveCtr_FaultInject == 2)//AC: Error sequence: Freeze last valid value
    {

      copyBitsToByteArrayLE(counter_RFC_Location_192_194_RFC_Loc192_194_AliveCtr,data,16,8); //Intel / little-endian;
    }
    if (@CAN_PrivMain::RFC_Location_192_194::RFC_Loc192_194_ProtBlockCtr_FaultInject != 3)//BC: user defined value
    {

    clearBitsInByteArrayLE(data,24,4); //Intel / little-endian

    }
    if (@CAN_PrivMain::RFC_Location_192_194::RFC_Loc192_194_ProtBlockCtr_FaultInject == 0)//BC: No Error, calculate BC
    {
      bc_RFC_Location_192_194_RFC_Loc192_194_ProtBlockCtr = bc_RFC_Location_ProtBlockCtr ;

      copyBitsToByteArrayLE(bc_RFC_Location_192_194_RFC_Loc192_194_ProtBlockCtr,data,24,4); //Intel / little-endian;
    }
    else if (@CAN_PrivMain::RFC_Location_192_194::RFC_Loc192_194_ProtBlockCtr_FaultInject == 1)//BC: Error sequence: set BC = 0
    {

      copyBitsToByteArrayLE(0,data,24,4); //Intel / little-endian;
    }
    else if (@CAN_PrivMain::RFC_Location_192_194::RFC_Loc192_194_ProtBlockCtr_FaultInject == 2)//BC: Error sequence: Freeze last valid value
    {

      copyBitsToByteArrayLE(bc_RFC_Location_192_194_RFC_Loc192_194_ProtBlockCtr,data,24,4); //Intel / little-endian;
    }
    if (@CAN_PrivMain::RFC_Location_192_194::RFC_Loc192_194_CRC_FaultInject != 3)//CRC: user defined value
    {

    clearBitsInByteArrayLE(data,0,16); //Intel / little-endian

    }
    if(@CAN_PrivMain::RFC_Location_192_194::RFC_Loc192_194_CRC_FaultInject == 0)//CRC: No Error, calculate CRC
    {
      crcTemp = CRC16_INIT;
      for(i = 2; i < (DataLength+2); i++)
      {
        if(i < DataLength)
          data_byte = data[i] ;
        else if(i == DataLength)
          data_byte = (0x2148 & 0x00FF);
        else if(i == (DataLength+1))
          data_byte = (0x2148 & 0xFF00) >> 8;
        else
          write("Error: DLC exceeded in CRC calculation");
        crcTemp ^= data_byte << 8;
        crcTemp = (crcTemp << (8)) ^ CRC16_CCITT_FALSE_POLY_1021H_Lookup[(crcTemp >> (8)) & (0xFF)];
      }
      crcTemp ^= CRC16_XOR;
      crc_RFC_Location_192_194_RFC_Loc192_194_CRC = crcTemp;

      copyBitsToByteArrayLE(crc_RFC_Location_192_194_RFC_Loc192_194_CRC,data,0,16); //Intel / little-endian;
    }
    else if(@CAN_PrivMain::RFC_Location_192_194::RFC_Loc192_194_CRC_FaultInject == 1)//CRC: Error, set to Zero
    {

      copyBitsToByteArrayLE(0,data,0,16); //Intel / little-endian;
    }
    else if(@CAN_PrivMain::RFC_Location_192_194::RFC_Loc192_194_CRC_FaultInject == 2)//CRC: Error, Freeze last valid value
    {

      copyBitsToByteArrayLE(crc_RFC_Location_192_194_RFC_Loc192_194_CRC,data,0,16); //Intel / little-endian;
    }
}


on sysvar CAN_PrivMain::RFC_Location_195_197::RFC_Location_195_197_ON_OFF
{
  if (@this == 1)
  {
     ILSetMsgEvent(RFC_Location_195_197);
     @CAN_PrivMain::RFC_Location_195_197::RFC_Location_195_197_ON_OFF = 0;
  }
}

void cfg_Msg_RFC_Location_195_197(dword aDlc, byte data[])
{
   int64 i,k;//For looping
   byte xor,data_byte;
   dword crcTemp;
   byte DataLength;
   dword Msg_id;
   
   DataLength = Msg_RFC_Location_195_197.DataLength;//Message Data Length
   Msg_id  = Msg_RFC_Location_195_197.id;//Message ID
   
    if (@CAN_PrivMain::RFC_Location_195_197::RFC_Loc195_197_AliveCtr_FaultInject != 3)//AC: user defined value
    {

    clearBitsInByteArrayLE(data,16,8); //Intel / little-endian

    }
    if (@CAN_PrivMain::RFC_Location_195_197::RFC_Loc195_197_AliveCtr_FaultInject == 0)//AC: No Error, calculate AC
    {
      ++counter_RFC_Location_195_197_RFC_Loc195_197_AliveCtr;
      counter_RFC_Location_195_197_RFC_Loc195_197_AliveCtr %=256;

      copyBitsToByteArrayLE(counter_RFC_Location_195_197_RFC_Loc195_197_AliveCtr,data,16,8); //Intel / little-endian;
    }
    else if (@CAN_PrivMain::RFC_Location_195_197::RFC_Loc195_197_AliveCtr_FaultInject == 1)//AC: Error sequence: set AC = 0
    {

      copyBitsToByteArrayLE(0,data,16,8); //Intel / little-endian;
    }
    else if (@CAN_PrivMain::RFC_Location_195_197::RFC_Loc195_197_AliveCtr_FaultInject == 2)//AC: Error sequence: Freeze last valid value
    {

      copyBitsToByteArrayLE(counter_RFC_Location_195_197_RFC_Loc195_197_AliveCtr,data,16,8); //Intel / little-endian;
    }
    if (@CAN_PrivMain::RFC_Location_195_197::RFC_Loc195_197_ProtBlockCtr_FaultInject != 3)//BC: user defined value
    {

    clearBitsInByteArrayLE(data,24,4); //Intel / little-endian

    }
    if (@CAN_PrivMain::RFC_Location_195_197::RFC_Loc195_197_ProtBlockCtr_FaultInject == 0)//BC: No Error, calculate BC
    {
      bc_RFC_Location_195_197_RFC_Loc195_197_ProtBlockCtr = bc_RFC_Location_ProtBlockCtr ;

      copyBitsToByteArrayLE(bc_RFC_Location_195_197_RFC_Loc195_197_ProtBlockCtr,data,24,4); //Intel / little-endian;
    }
    else if (@CAN_PrivMain::RFC_Location_195_197::RFC_Loc195_197_ProtBlockCtr_FaultInject == 1)//BC: Error sequence: set BC = 0
    {

      copyBitsToByteArrayLE(0,data,24,4); //Intel / little-endian;
    }
    else if (@CAN_PrivMain::RFC_Location_195_197::RFC_Loc195_197_ProtBlockCtr_FaultInject == 2)//BC: Error sequence: Freeze last valid value
    {

      copyBitsToByteArrayLE(bc_RFC_Location_195_197_RFC_Loc195_197_ProtBlockCtr,data,24,4); //Intel / little-endian;
    }
    if (@CAN_PrivMain::RFC_Location_195_197::RFC_Loc195_197_CRC_FaultInject != 3)//CRC: user defined value
    {

    clearBitsInByteArrayLE(data,0,16); //Intel / little-endian

    }
    if(@CAN_PrivMain::RFC_Location_195_197::RFC_Loc195_197_CRC_FaultInject == 0)//CRC: No Error, calculate CRC
    {
      crcTemp = CRC16_INIT;
      for(i = 2; i < (DataLength+2); i++)
      {
        if(i < DataLength)
          data_byte = data[i] ;
        else if(i == DataLength)
          data_byte = (0x2149 & 0x00FF);
        else if(i == (DataLength+1))
          data_byte = (0x2149 & 0xFF00) >> 8;
        else
          write("Error: DLC exceeded in CRC calculation");
        crcTemp ^= data_byte << 8;
        crcTemp = (crcTemp << (8)) ^ CRC16_CCITT_FALSE_POLY_1021H_Lookup[(crcTemp >> (8)) & (0xFF)];
      }
      crcTemp ^= CRC16_XOR;
      crc_RFC_Location_195_197_RFC_Loc195_197_CRC = crcTemp;

      copyBitsToByteArrayLE(crc_RFC_Location_195_197_RFC_Loc195_197_CRC,data,0,16); //Intel / little-endian;
    }
    else if(@CAN_PrivMain::RFC_Location_195_197::RFC_Loc195_197_CRC_FaultInject == 1)//CRC: Error, set to Zero
    {

      copyBitsToByteArrayLE(0,data,0,16); //Intel / little-endian;
    }
    else if(@CAN_PrivMain::RFC_Location_195_197::RFC_Loc195_197_CRC_FaultInject == 2)//CRC: Error, Freeze last valid value
    {

      copyBitsToByteArrayLE(crc_RFC_Location_195_197_RFC_Loc195_197_CRC,data,0,16); //Intel / little-endian;
    }
}


on sysvar CAN_PrivMain::RFC_Location_198_200::RFC_Location_198_200_ON_OFF
{
  if (@this == 1)
  {
     ILSetMsgEvent(RFC_Location_198_200);
     @CAN_PrivMain::RFC_Location_198_200::RFC_Location_198_200_ON_OFF = 0;
  }
}

void cfg_Msg_RFC_Location_198_200(dword aDlc, byte data[])
{
   int64 i,k;//For looping
   byte xor,data_byte;
   dword crcTemp;
   byte DataLength;
   dword Msg_id;
   
   DataLength = Msg_RFC_Location_198_200.DataLength;//Message Data Length
   Msg_id  = Msg_RFC_Location_198_200.id;//Message ID
   
    if (@CAN_PrivMain::RFC_Location_198_200::RFC_Loc198_200_AliveCtr_FaultInject != 3)//AC: user defined value
    {

    clearBitsInByteArrayLE(data,16,8); //Intel / little-endian

    }
    if (@CAN_PrivMain::RFC_Location_198_200::RFC_Loc198_200_AliveCtr_FaultInject == 0)//AC: No Error, calculate AC
    {
      ++counter_RFC_Location_198_200_RFC_Loc198_200_AliveCtr;
      counter_RFC_Location_198_200_RFC_Loc198_200_AliveCtr %=256;

      copyBitsToByteArrayLE(counter_RFC_Location_198_200_RFC_Loc198_200_AliveCtr,data,16,8); //Intel / little-endian;
    }
    else if (@CAN_PrivMain::RFC_Location_198_200::RFC_Loc198_200_AliveCtr_FaultInject == 1)//AC: Error sequence: set AC = 0
    {

      copyBitsToByteArrayLE(0,data,16,8); //Intel / little-endian;
    }
    else if (@CAN_PrivMain::RFC_Location_198_200::RFC_Loc198_200_AliveCtr_FaultInject == 2)//AC: Error sequence: Freeze last valid value
    {

      copyBitsToByteArrayLE(counter_RFC_Location_198_200_RFC_Loc198_200_AliveCtr,data,16,8); //Intel / little-endian;
    }
    if (@CAN_PrivMain::RFC_Location_198_200::RFC_Loc198_200_ProtBlockCtr_FaultInject != 3)//BC: user defined value
    {

    clearBitsInByteArrayLE(data,24,4); //Intel / little-endian

    }
    if (@CAN_PrivMain::RFC_Location_198_200::RFC_Loc198_200_ProtBlockCtr_FaultInject == 0)//BC: No Error, calculate BC
    {
      bc_RFC_Location_198_200_RFC_Loc198_200_ProtBlockCtr = bc_RFC_Location_ProtBlockCtr ;

      copyBitsToByteArrayLE(bc_RFC_Location_198_200_RFC_Loc198_200_ProtBlockCtr,data,24,4); //Intel / little-endian;
    }
    else if (@CAN_PrivMain::RFC_Location_198_200::RFC_Loc198_200_ProtBlockCtr_FaultInject == 1)//BC: Error sequence: set BC = 0
    {

      copyBitsToByteArrayLE(0,data,24,4); //Intel / little-endian;
    }
    else if (@CAN_PrivMain::RFC_Location_198_200::RFC_Loc198_200_ProtBlockCtr_FaultInject == 2)//BC: Error sequence: Freeze last valid value
    {

      copyBitsToByteArrayLE(bc_RFC_Location_198_200_RFC_Loc198_200_ProtBlockCtr,data,24,4); //Intel / little-endian;
    }
    if (@CAN_PrivMain::RFC_Location_198_200::RFC_Loc198_200_CRC_FaultInject != 3)//CRC: user defined value
    {

    clearBitsInByteArrayLE(data,0,16); //Intel / little-endian

    }
    if(@CAN_PrivMain::RFC_Location_198_200::RFC_Loc198_200_CRC_FaultInject == 0)//CRC: No Error, calculate CRC
    {
      crcTemp = CRC16_INIT;
      for(i = 2; i < (DataLength+2); i++)
      {
        if(i < DataLength)
          data_byte = data[i] ;
        else if(i == DataLength)
          data_byte = (0x214a & 0x00FF);
        else if(i == (DataLength+1))
          data_byte = (0x214a & 0xFF00) >> 8;
        else
          write("Error: DLC exceeded in CRC calculation");
        crcTemp ^= data_byte << 8;
        crcTemp = (crcTemp << (8)) ^ CRC16_CCITT_FALSE_POLY_1021H_Lookup[(crcTemp >> (8)) & (0xFF)];
      }
      crcTemp ^= CRC16_XOR;
      crc_RFC_Location_198_200_RFC_Loc198_200_CRC = crcTemp;

      copyBitsToByteArrayLE(crc_RFC_Location_198_200_RFC_Loc198_200_CRC,data,0,16); //Intel / little-endian;
    }
    else if(@CAN_PrivMain::RFC_Location_198_200::RFC_Loc198_200_CRC_FaultInject == 1)//CRC: Error, set to Zero
    {

      copyBitsToByteArrayLE(0,data,0,16); //Intel / little-endian;
    }
    else if(@CAN_PrivMain::RFC_Location_198_200::RFC_Loc198_200_CRC_FaultInject == 2)//CRC: Error, Freeze last valid value
    {

      copyBitsToByteArrayLE(crc_RFC_Location_198_200_RFC_Loc198_200_CRC,data,0,16); //Intel / little-endian;
    }
}


on sysvar CAN_PrivMain::RFC_Location_201_203::RFC_Location_201_203_ON_OFF
{
  if (@this == 1)
  {
     ILSetMsgEvent(RFC_Location_201_203);
     @CAN_PrivMain::RFC_Location_201_203::RFC_Location_201_203_ON_OFF = 0;
  }
}

void cfg_Msg_RFC_Location_201_203(dword aDlc, byte data[])
{
   int64 i,k;//For looping
   byte xor,data_byte;
   dword crcTemp;
   byte DataLength;
   dword Msg_id;
   
   DataLength = Msg_RFC_Location_201_203.DataLength;//Message Data Length
   Msg_id  = Msg_RFC_Location_201_203.id;//Message ID
   
    if (@CAN_PrivMain::RFC_Location_201_203::RFC_Loc201_203_AliveCtr_FaultInject != 3)//AC: user defined value
    {

    clearBitsInByteArrayLE(data,16,8); //Intel / little-endian

    }
    if (@CAN_PrivMain::RFC_Location_201_203::RFC_Loc201_203_AliveCtr_FaultInject == 0)//AC: No Error, calculate AC
    {
      ++counter_RFC_Location_201_203_RFC_Loc201_203_AliveCtr;
      counter_RFC_Location_201_203_RFC_Loc201_203_AliveCtr %=256;

      copyBitsToByteArrayLE(counter_RFC_Location_201_203_RFC_Loc201_203_AliveCtr,data,16,8); //Intel / little-endian;
    }
    else if (@CAN_PrivMain::RFC_Location_201_203::RFC_Loc201_203_AliveCtr_FaultInject == 1)//AC: Error sequence: set AC = 0
    {

      copyBitsToByteArrayLE(0,data,16,8); //Intel / little-endian;
    }
    else if (@CAN_PrivMain::RFC_Location_201_203::RFC_Loc201_203_AliveCtr_FaultInject == 2)//AC: Error sequence: Freeze last valid value
    {

      copyBitsToByteArrayLE(counter_RFC_Location_201_203_RFC_Loc201_203_AliveCtr,data,16,8); //Intel / little-endian;
    }
    if (@CAN_PrivMain::RFC_Location_201_203::RFC_Loc201_203_ProtBlockCtr_FaultInject != 3)//BC: user defined value
    {

    clearBitsInByteArrayLE(data,24,4); //Intel / little-endian

    }
    if (@CAN_PrivMain::RFC_Location_201_203::RFC_Loc201_203_ProtBlockCtr_FaultInject == 0)//BC: No Error, calculate BC
    {
      bc_RFC_Location_201_203_RFC_Loc201_203_ProtBlockCtr = bc_RFC_Location_ProtBlockCtr ;

      copyBitsToByteArrayLE(bc_RFC_Location_201_203_RFC_Loc201_203_ProtBlockCtr,data,24,4); //Intel / little-endian;
    }
    else if (@CAN_PrivMain::RFC_Location_201_203::RFC_Loc201_203_ProtBlockCtr_FaultInject == 1)//BC: Error sequence: set BC = 0
    {

      copyBitsToByteArrayLE(0,data,24,4); //Intel / little-endian;
    }
    else if (@CAN_PrivMain::RFC_Location_201_203::RFC_Loc201_203_ProtBlockCtr_FaultInject == 2)//BC: Error sequence: Freeze last valid value
    {

      copyBitsToByteArrayLE(bc_RFC_Location_201_203_RFC_Loc201_203_ProtBlockCtr,data,24,4); //Intel / little-endian;
    }
    if (@CAN_PrivMain::RFC_Location_201_203::RFC_Loc201_203_CRC_FaultInject != 3)//CRC: user defined value
    {

    clearBitsInByteArrayLE(data,0,16); //Intel / little-endian

    }
    if(@CAN_PrivMain::RFC_Location_201_203::RFC_Loc201_203_CRC_FaultInject == 0)//CRC: No Error, calculate CRC
    {
      crcTemp = CRC16_INIT;
      for(i = 2; i < (DataLength+2); i++)
      {
        if(i < DataLength)
          data_byte = data[i] ;
        else if(i == DataLength)
          data_byte = (0x214b & 0x00FF);
        else if(i == (DataLength+1))
          data_byte = (0x214b & 0xFF00) >> 8;
        else
          write("Error: DLC exceeded in CRC calculation");
        crcTemp ^= data_byte << 8;
        crcTemp = (crcTemp << (8)) ^ CRC16_CCITT_FALSE_POLY_1021H_Lookup[(crcTemp >> (8)) & (0xFF)];
      }
      crcTemp ^= CRC16_XOR;
      crc_RFC_Location_201_203_RFC_Loc201_203_CRC = crcTemp;

      copyBitsToByteArrayLE(crc_RFC_Location_201_203_RFC_Loc201_203_CRC,data,0,16); //Intel / little-endian;
    }
    else if(@CAN_PrivMain::RFC_Location_201_203::RFC_Loc201_203_CRC_FaultInject == 1)//CRC: Error, set to Zero
    {

      copyBitsToByteArrayLE(0,data,0,16); //Intel / little-endian;
    }
    else if(@CAN_PrivMain::RFC_Location_201_203::RFC_Loc201_203_CRC_FaultInject == 2)//CRC: Error, Freeze last valid value
    {

      copyBitsToByteArrayLE(crc_RFC_Location_201_203_RFC_Loc201_203_CRC,data,0,16); //Intel / little-endian;
    }
}


on sysvar CAN_PrivMain::RFC_Location_204_206::RFC_Location_204_206_ON_OFF
{
  if (@this == 1)
  {
     ILSetMsgEvent(RFC_Location_204_206);
     @CAN_PrivMain::RFC_Location_204_206::RFC_Location_204_206_ON_OFF = 0;
  }
}

void cfg_Msg_RFC_Location_204_206(dword aDlc, byte data[])
{
   int64 i,k;//For looping
   byte xor,data_byte;
   dword crcTemp;
   byte DataLength;
   dword Msg_id;
   
   DataLength = Msg_RFC_Location_204_206.DataLength;//Message Data Length
   Msg_id  = Msg_RFC_Location_204_206.id;//Message ID
   
    if (@CAN_PrivMain::RFC_Location_204_206::RFC_Loc204_206_AliveCtr_FaultInject != 3)//AC: user defined value
    {

    clearBitsInByteArrayLE(data,16,8); //Intel / little-endian

    }
    if (@CAN_PrivMain::RFC_Location_204_206::RFC_Loc204_206_AliveCtr_FaultInject == 0)//AC: No Error, calculate AC
    {
      ++counter_RFC_Location_204_206_RFC_Loc204_206_AliveCtr;
      counter_RFC_Location_204_206_RFC_Loc204_206_AliveCtr %=256;

      copyBitsToByteArrayLE(counter_RFC_Location_204_206_RFC_Loc204_206_AliveCtr,data,16,8); //Intel / little-endian;
    }
    else if (@CAN_PrivMain::RFC_Location_204_206::RFC_Loc204_206_AliveCtr_FaultInject == 1)//AC: Error sequence: set AC = 0
    {

      copyBitsToByteArrayLE(0,data,16,8); //Intel / little-endian;
    }
    else if (@CAN_PrivMain::RFC_Location_204_206::RFC_Loc204_206_AliveCtr_FaultInject == 2)//AC: Error sequence: Freeze last valid value
    {

      copyBitsToByteArrayLE(counter_RFC_Location_204_206_RFC_Loc204_206_AliveCtr,data,16,8); //Intel / little-endian;
    }
    if (@CAN_PrivMain::RFC_Location_204_206::RFC_Loc204_206_ProtBlockCtr_FaultInject != 3)//BC: user defined value
    {

    clearBitsInByteArrayLE(data,24,4); //Intel / little-endian

    }
    if (@CAN_PrivMain::RFC_Location_204_206::RFC_Loc204_206_ProtBlockCtr_FaultInject == 0)//BC: No Error, calculate BC
    {
      bc_RFC_Location_204_206_RFC_Loc204_206_ProtBlockCtr = bc_RFC_Location_ProtBlockCtr ;

      copyBitsToByteArrayLE(bc_RFC_Location_204_206_RFC_Loc204_206_ProtBlockCtr,data,24,4); //Intel / little-endian;
    }
    else if (@CAN_PrivMain::RFC_Location_204_206::RFC_Loc204_206_ProtBlockCtr_FaultInject == 1)//BC: Error sequence: set BC = 0
    {

      copyBitsToByteArrayLE(0,data,24,4); //Intel / little-endian;
    }
    else if (@CAN_PrivMain::RFC_Location_204_206::RFC_Loc204_206_ProtBlockCtr_FaultInject == 2)//BC: Error sequence: Freeze last valid value
    {

      copyBitsToByteArrayLE(bc_RFC_Location_204_206_RFC_Loc204_206_ProtBlockCtr,data,24,4); //Intel / little-endian;
    }
    if (@CAN_PrivMain::RFC_Location_204_206::RFC_Loc204_206_CRC_FaultInject != 3)//CRC: user defined value
    {

    clearBitsInByteArrayLE(data,0,16); //Intel / little-endian

    }
    if(@CAN_PrivMain::RFC_Location_204_206::RFC_Loc204_206_CRC_FaultInject == 0)//CRC: No Error, calculate CRC
    {
      crcTemp = CRC16_INIT;
      for(i = 2; i < (DataLength+2); i++)
      {
        if(i < DataLength)
          data_byte = data[i] ;
        else if(i == DataLength)
          data_byte = (0x214c & 0x00FF);
        else if(i == (DataLength+1))
          data_byte = (0x214c & 0xFF00) >> 8;
        else
          write("Error: DLC exceeded in CRC calculation");
        crcTemp ^= data_byte << 8;
        crcTemp = (crcTemp << (8)) ^ CRC16_CCITT_FALSE_POLY_1021H_Lookup[(crcTemp >> (8)) & (0xFF)];
      }
      crcTemp ^= CRC16_XOR;
      crc_RFC_Location_204_206_RFC_Loc204_206_CRC = crcTemp;

      copyBitsToByteArrayLE(crc_RFC_Location_204_206_RFC_Loc204_206_CRC,data,0,16); //Intel / little-endian;
    }
    else if(@CAN_PrivMain::RFC_Location_204_206::RFC_Loc204_206_CRC_FaultInject == 1)//CRC: Error, set to Zero
    {

      copyBitsToByteArrayLE(0,data,0,16); //Intel / little-endian;
    }
    else if(@CAN_PrivMain::RFC_Location_204_206::RFC_Loc204_206_CRC_FaultInject == 2)//CRC: Error, Freeze last valid value
    {

      copyBitsToByteArrayLE(crc_RFC_Location_204_206_RFC_Loc204_206_CRC,data,0,16); //Intel / little-endian;
    }
}


on sysvar CAN_PrivMain::RFC_Location_207_209::RFC_Location_207_209_ON_OFF
{
  if (@this == 1)
  {
     ILSetMsgEvent(RFC_Location_207_209);
     @CAN_PrivMain::RFC_Location_207_209::RFC_Location_207_209_ON_OFF = 0;
  }
}

void cfg_Msg_RFC_Location_207_209(dword aDlc, byte data[])
{
   int64 i,k;//For looping
   byte xor,data_byte;
   dword crcTemp;
   byte DataLength;
   dword Msg_id;
   
   DataLength = Msg_RFC_Location_207_209.DataLength;//Message Data Length
   Msg_id  = Msg_RFC_Location_207_209.id;//Message ID
   
    if (@CAN_PrivMain::RFC_Location_207_209::RFC_Loc207_209_AliveCtr_FaultInject != 3)//AC: user defined value
    {

    clearBitsInByteArrayLE(data,16,8); //Intel / little-endian

    }
    if (@CAN_PrivMain::RFC_Location_207_209::RFC_Loc207_209_AliveCtr_FaultInject == 0)//AC: No Error, calculate AC
    {
      ++counter_RFC_Location_207_209_RFC_Loc207_209_AliveCtr;
      counter_RFC_Location_207_209_RFC_Loc207_209_AliveCtr %=256;

      copyBitsToByteArrayLE(counter_RFC_Location_207_209_RFC_Loc207_209_AliveCtr,data,16,8); //Intel / little-endian;
    }
    else if (@CAN_PrivMain::RFC_Location_207_209::RFC_Loc207_209_AliveCtr_FaultInject == 1)//AC: Error sequence: set AC = 0
    {

      copyBitsToByteArrayLE(0,data,16,8); //Intel / little-endian;
    }
    else if (@CAN_PrivMain::RFC_Location_207_209::RFC_Loc207_209_AliveCtr_FaultInject == 2)//AC: Error sequence: Freeze last valid value
    {

      copyBitsToByteArrayLE(counter_RFC_Location_207_209_RFC_Loc207_209_AliveCtr,data,16,8); //Intel / little-endian;
    }
    if (@CAN_PrivMain::RFC_Location_207_209::RFC_Loc207_209_ProtBlockCtr_FaultInject != 3)//BC: user defined value
    {

    clearBitsInByteArrayLE(data,24,4); //Intel / little-endian

    }
    if (@CAN_PrivMain::RFC_Location_207_209::RFC_Loc207_209_ProtBlockCtr_FaultInject == 0)//BC: No Error, calculate BC
    {
      bc_RFC_Location_207_209_RFC_Loc207_209_ProtBlockCtr = bc_RFC_Location_ProtBlockCtr ;

      copyBitsToByteArrayLE(bc_RFC_Location_207_209_RFC_Loc207_209_ProtBlockCtr,data,24,4); //Intel / little-endian;
    }
    else if (@CAN_PrivMain::RFC_Location_207_209::RFC_Loc207_209_ProtBlockCtr_FaultInject == 1)//BC: Error sequence: set BC = 0
    {

      copyBitsToByteArrayLE(0,data,24,4); //Intel / little-endian;
    }
    else if (@CAN_PrivMain::RFC_Location_207_209::RFC_Loc207_209_ProtBlockCtr_FaultInject == 2)//BC: Error sequence: Freeze last valid value
    {

      copyBitsToByteArrayLE(bc_RFC_Location_207_209_RFC_Loc207_209_ProtBlockCtr,data,24,4); //Intel / little-endian;
    }
    if (@CAN_PrivMain::RFC_Location_207_209::RFC_Loc207_209_CRC_FaultInject != 3)//CRC: user defined value
    {

    clearBitsInByteArrayLE(data,0,16); //Intel / little-endian

    }
    if(@CAN_PrivMain::RFC_Location_207_209::RFC_Loc207_209_CRC_FaultInject == 0)//CRC: No Error, calculate CRC
    {
      crcTemp = CRC16_INIT;
      for(i = 2; i < (DataLength+2); i++)
      {
        if(i < DataLength)
          data_byte = data[i] ;
        else if(i == DataLength)
          data_byte = (0x214d & 0x00FF);
        else if(i == (DataLength+1))
          data_byte = (0x214d & 0xFF00) >> 8;
        else
          write("Error: DLC exceeded in CRC calculation");
        crcTemp ^= data_byte << 8;
        crcTemp = (crcTemp << (8)) ^ CRC16_CCITT_FALSE_POLY_1021H_Lookup[(crcTemp >> (8)) & (0xFF)];
      }
      crcTemp ^= CRC16_XOR;
      crc_RFC_Location_207_209_RFC_Loc207_209_CRC = crcTemp;

      copyBitsToByteArrayLE(crc_RFC_Location_207_209_RFC_Loc207_209_CRC,data,0,16); //Intel / little-endian;
    }
    else if(@CAN_PrivMain::RFC_Location_207_209::RFC_Loc207_209_CRC_FaultInject == 1)//CRC: Error, set to Zero
    {

      copyBitsToByteArrayLE(0,data,0,16); //Intel / little-endian;
    }
    else if(@CAN_PrivMain::RFC_Location_207_209::RFC_Loc207_209_CRC_FaultInject == 2)//CRC: Error, Freeze last valid value
    {

      copyBitsToByteArrayLE(crc_RFC_Location_207_209_RFC_Loc207_209_CRC,data,0,16); //Intel / little-endian;
    }
}


on sysvar CAN_PrivMain::RFC_Location_210_212::RFC_Location_210_212_ON_OFF
{
  if (@this == 1)
  {
     ILSetMsgEvent(RFC_Location_210_212);
     @CAN_PrivMain::RFC_Location_210_212::RFC_Location_210_212_ON_OFF = 0;
  }
}

void cfg_Msg_RFC_Location_210_212(dword aDlc, byte data[])
{
   int64 i,k;//For looping
   byte xor,data_byte;
   dword crcTemp;
   byte DataLength;
   dword Msg_id;
   
   DataLength = Msg_RFC_Location_210_212.DataLength;//Message Data Length
   Msg_id  = Msg_RFC_Location_210_212.id;//Message ID
   
    if (@CAN_PrivMain::RFC_Location_210_212::RFC_Loc210_212_AliveCtr_FaultInject != 3)//AC: user defined value
    {

    clearBitsInByteArrayLE(data,16,8); //Intel / little-endian

    }
    if (@CAN_PrivMain::RFC_Location_210_212::RFC_Loc210_212_AliveCtr_FaultInject == 0)//AC: No Error, calculate AC
    {
      ++counter_RFC_Location_210_212_RFC_Loc210_212_AliveCtr;
      counter_RFC_Location_210_212_RFC_Loc210_212_AliveCtr %=256;

      copyBitsToByteArrayLE(counter_RFC_Location_210_212_RFC_Loc210_212_AliveCtr,data,16,8); //Intel / little-endian;
    }
    else if (@CAN_PrivMain::RFC_Location_210_212::RFC_Loc210_212_AliveCtr_FaultInject == 1)//AC: Error sequence: set AC = 0
    {

      copyBitsToByteArrayLE(0,data,16,8); //Intel / little-endian;
    }
    else if (@CAN_PrivMain::RFC_Location_210_212::RFC_Loc210_212_AliveCtr_FaultInject == 2)//AC: Error sequence: Freeze last valid value
    {

      copyBitsToByteArrayLE(counter_RFC_Location_210_212_RFC_Loc210_212_AliveCtr,data,16,8); //Intel / little-endian;
    }
    if (@CAN_PrivMain::RFC_Location_210_212::RFC_Loc210_212_ProtBlockCtr_FaultInject != 3)//BC: user defined value
    {

    clearBitsInByteArrayLE(data,24,4); //Intel / little-endian

    }
    if (@CAN_PrivMain::RFC_Location_210_212::RFC_Loc210_212_ProtBlockCtr_FaultInject == 0)//BC: No Error, calculate BC
    {
      bc_RFC_Location_210_212_RFC_Loc210_212_ProtBlockCtr = bc_RFC_Location_ProtBlockCtr ;

      copyBitsToByteArrayLE(bc_RFC_Location_210_212_RFC_Loc210_212_ProtBlockCtr,data,24,4); //Intel / little-endian;
    }
    else if (@CAN_PrivMain::RFC_Location_210_212::RFC_Loc210_212_ProtBlockCtr_FaultInject == 1)//BC: Error sequence: set BC = 0
    {

      copyBitsToByteArrayLE(0,data,24,4); //Intel / little-endian;
    }
    else if (@CAN_PrivMain::RFC_Location_210_212::RFC_Loc210_212_ProtBlockCtr_FaultInject == 2)//BC: Error sequence: Freeze last valid value
    {

      copyBitsToByteArrayLE(bc_RFC_Location_210_212_RFC_Loc210_212_ProtBlockCtr,data,24,4); //Intel / little-endian;
    }
    if (@CAN_PrivMain::RFC_Location_210_212::RFC_Loc210_212_CRC_FaultInject != 3)//CRC: user defined value
    {

    clearBitsInByteArrayLE(data,0,16); //Intel / little-endian

    }
    if(@CAN_PrivMain::RFC_Location_210_212::RFC_Loc210_212_CRC_FaultInject == 0)//CRC: No Error, calculate CRC
    {
      crcTemp = CRC16_INIT;
      for(i = 2; i < (DataLength+2); i++)
      {
        if(i < DataLength)
          data_byte = data[i] ;
        else if(i == DataLength)
          data_byte = (0x214e & 0x00FF);
        else if(i == (DataLength+1))
          data_byte = (0x214e & 0xFF00) >> 8;
        else
          write("Error: DLC exceeded in CRC calculation");
        crcTemp ^= data_byte << 8;
        crcTemp = (crcTemp << (8)) ^ CRC16_CCITT_FALSE_POLY_1021H_Lookup[(crcTemp >> (8)) & (0xFF)];
      }
      crcTemp ^= CRC16_XOR;
      crc_RFC_Location_210_212_RFC_Loc210_212_CRC = crcTemp;

      copyBitsToByteArrayLE(crc_RFC_Location_210_212_RFC_Loc210_212_CRC,data,0,16); //Intel / little-endian;
    }
    else if(@CAN_PrivMain::RFC_Location_210_212::RFC_Loc210_212_CRC_FaultInject == 1)//CRC: Error, set to Zero
    {

      copyBitsToByteArrayLE(0,data,0,16); //Intel / little-endian;
    }
    else if(@CAN_PrivMain::RFC_Location_210_212::RFC_Loc210_212_CRC_FaultInject == 2)//CRC: Error, Freeze last valid value
    {

      copyBitsToByteArrayLE(crc_RFC_Location_210_212_RFC_Loc210_212_CRC,data,0,16); //Intel / little-endian;
    }
}


on sysvar CAN_PrivMain::RFC_Location_213_215::RFC_Location_213_215_ON_OFF
{
  if (@this == 1)
  {
     ILSetMsgEvent(RFC_Location_213_215);
     @CAN_PrivMain::RFC_Location_213_215::RFC_Location_213_215_ON_OFF = 0;
  }
}

void cfg_Msg_RFC_Location_213_215(dword aDlc, byte data[])
{
   int64 i,k;//For looping
   byte xor,data_byte;
   dword crcTemp;
   byte DataLength;
   dword Msg_id;
   
   DataLength = Msg_RFC_Location_213_215.DataLength;//Message Data Length
   Msg_id  = Msg_RFC_Location_213_215.id;//Message ID
   
    if (@CAN_PrivMain::RFC_Location_213_215::RFC_Loc213_215_AliveCtr_FaultInject != 3)//AC: user defined value
    {

    clearBitsInByteArrayLE(data,16,8); //Intel / little-endian

    }
    if (@CAN_PrivMain::RFC_Location_213_215::RFC_Loc213_215_AliveCtr_FaultInject == 0)//AC: No Error, calculate AC
    {
      ++counter_RFC_Location_213_215_RFC_Loc213_215_AliveCtr;
      counter_RFC_Location_213_215_RFC_Loc213_215_AliveCtr %=256;

      copyBitsToByteArrayLE(counter_RFC_Location_213_215_RFC_Loc213_215_AliveCtr,data,16,8); //Intel / little-endian;
    }
    else if (@CAN_PrivMain::RFC_Location_213_215::RFC_Loc213_215_AliveCtr_FaultInject == 1)//AC: Error sequence: set AC = 0
    {

      copyBitsToByteArrayLE(0,data,16,8); //Intel / little-endian;
    }
    else if (@CAN_PrivMain::RFC_Location_213_215::RFC_Loc213_215_AliveCtr_FaultInject == 2)//AC: Error sequence: Freeze last valid value
    {

      copyBitsToByteArrayLE(counter_RFC_Location_213_215_RFC_Loc213_215_AliveCtr,data,16,8); //Intel / little-endian;
    }
    if (@CAN_PrivMain::RFC_Location_213_215::RFC_Loc213_215_ProtBlockCtr_FaultInject != 3)//BC: user defined value
    {

    clearBitsInByteArrayLE(data,24,4); //Intel / little-endian

    }
    if (@CAN_PrivMain::RFC_Location_213_215::RFC_Loc213_215_ProtBlockCtr_FaultInject == 0)//BC: No Error, calculate BC
    {
      bc_RFC_Location_213_215_RFC_Loc213_215_ProtBlockCtr = bc_RFC_Location_ProtBlockCtr ;

      copyBitsToByteArrayLE(bc_RFC_Location_213_215_RFC_Loc213_215_ProtBlockCtr,data,24,4); //Intel / little-endian;
    }
    else if (@CAN_PrivMain::RFC_Location_213_215::RFC_Loc213_215_ProtBlockCtr_FaultInject == 1)//BC: Error sequence: set BC = 0
    {

      copyBitsToByteArrayLE(0,data,24,4); //Intel / little-endian;
    }
    else if (@CAN_PrivMain::RFC_Location_213_215::RFC_Loc213_215_ProtBlockCtr_FaultInject == 2)//BC: Error sequence: Freeze last valid value
    {

      copyBitsToByteArrayLE(bc_RFC_Location_213_215_RFC_Loc213_215_ProtBlockCtr,data,24,4); //Intel / little-endian;
    }
    if (@CAN_PrivMain::RFC_Location_213_215::RFC_Loc213_215_CRC_FaultInject != 3)//CRC: user defined value
    {

    clearBitsInByteArrayLE(data,0,16); //Intel / little-endian

    }
    if(@CAN_PrivMain::RFC_Location_213_215::RFC_Loc213_215_CRC_FaultInject == 0)//CRC: No Error, calculate CRC
    {
      crcTemp = CRC16_INIT;
      for(i = 2; i < (DataLength+2); i++)
      {
        if(i < DataLength)
          data_byte = data[i] ;
        else if(i == DataLength)
          data_byte = (0x214f & 0x00FF);
        else if(i == (DataLength+1))
          data_byte = (0x214f & 0xFF00) >> 8;
        else
          write("Error: DLC exceeded in CRC calculation");
        crcTemp ^= data_byte << 8;
        crcTemp = (crcTemp << (8)) ^ CRC16_CCITT_FALSE_POLY_1021H_Lookup[(crcTemp >> (8)) & (0xFF)];
      }
      crcTemp ^= CRC16_XOR;
      crc_RFC_Location_213_215_RFC_Loc213_215_CRC = crcTemp;

      copyBitsToByteArrayLE(crc_RFC_Location_213_215_RFC_Loc213_215_CRC,data,0,16); //Intel / little-endian;
    }
    else if(@CAN_PrivMain::RFC_Location_213_215::RFC_Loc213_215_CRC_FaultInject == 1)//CRC: Error, set to Zero
    {

      copyBitsToByteArrayLE(0,data,0,16); //Intel / little-endian;
    }
    else if(@CAN_PrivMain::RFC_Location_213_215::RFC_Loc213_215_CRC_FaultInject == 2)//CRC: Error, Freeze last valid value
    {

      copyBitsToByteArrayLE(crc_RFC_Location_213_215_RFC_Loc213_215_CRC,data,0,16); //Intel / little-endian;
    }
}


on sysvar CAN_PrivMain::RFC_Location_216_218::RFC_Location_216_218_ON_OFF
{
  if (@this == 1)
  {
     ILSetMsgEvent(RFC_Location_216_218);
     @CAN_PrivMain::RFC_Location_216_218::RFC_Location_216_218_ON_OFF = 0;
  }
}

void cfg_Msg_RFC_Location_216_218(dword aDlc, byte data[])
{
   int64 i,k;//For looping
   byte xor,data_byte;
   dword crcTemp;
   byte DataLength;
   dword Msg_id;
   
   DataLength = Msg_RFC_Location_216_218.DataLength;//Message Data Length
   Msg_id  = Msg_RFC_Location_216_218.id;//Message ID
   
    if (@CAN_PrivMain::RFC_Location_216_218::RFC_Loc216_218_AliveCtr_FaultInject != 3)//AC: user defined value
    {

    clearBitsInByteArrayLE(data,16,8); //Intel / little-endian

    }
    if (@CAN_PrivMain::RFC_Location_216_218::RFC_Loc216_218_AliveCtr_FaultInject == 0)//AC: No Error, calculate AC
    {
      ++counter_RFC_Location_216_218_RFC_Loc216_218_AliveCtr;
      counter_RFC_Location_216_218_RFC_Loc216_218_AliveCtr %=256;

      copyBitsToByteArrayLE(counter_RFC_Location_216_218_RFC_Loc216_218_AliveCtr,data,16,8); //Intel / little-endian;
    }
    else if (@CAN_PrivMain::RFC_Location_216_218::RFC_Loc216_218_AliveCtr_FaultInject == 1)//AC: Error sequence: set AC = 0
    {

      copyBitsToByteArrayLE(0,data,16,8); //Intel / little-endian;
    }
    else if (@CAN_PrivMain::RFC_Location_216_218::RFC_Loc216_218_AliveCtr_FaultInject == 2)//AC: Error sequence: Freeze last valid value
    {

      copyBitsToByteArrayLE(counter_RFC_Location_216_218_RFC_Loc216_218_AliveCtr,data,16,8); //Intel / little-endian;
    }
    if (@CAN_PrivMain::RFC_Location_216_218::RFC_Loc216_218_ProtBlockCtr_FaultInject != 3)//BC: user defined value
    {

    clearBitsInByteArrayLE(data,24,4); //Intel / little-endian

    }
    if (@CAN_PrivMain::RFC_Location_216_218::RFC_Loc216_218_ProtBlockCtr_FaultInject == 0)//BC: No Error, calculate BC
    {
      bc_RFC_Location_216_218_RFC_Loc216_218_ProtBlockCtr = bc_RFC_Location_ProtBlockCtr ;

      copyBitsToByteArrayLE(bc_RFC_Location_216_218_RFC_Loc216_218_ProtBlockCtr,data,24,4); //Intel / little-endian;
    }
    else if (@CAN_PrivMain::RFC_Location_216_218::RFC_Loc216_218_ProtBlockCtr_FaultInject == 1)//BC: Error sequence: set BC = 0
    {

      copyBitsToByteArrayLE(0,data,24,4); //Intel / little-endian;
    }
    else if (@CAN_PrivMain::RFC_Location_216_218::RFC_Loc216_218_ProtBlockCtr_FaultInject == 2)//BC: Error sequence: Freeze last valid value
    {

      copyBitsToByteArrayLE(bc_RFC_Location_216_218_RFC_Loc216_218_ProtBlockCtr,data,24,4); //Intel / little-endian;
    }
    if (@CAN_PrivMain::RFC_Location_216_218::RFC_Loc216_218_CRC_FaultInject != 3)//CRC: user defined value
    {

    clearBitsInByteArrayLE(data,0,16); //Intel / little-endian

    }
    if(@CAN_PrivMain::RFC_Location_216_218::RFC_Loc216_218_CRC_FaultInject == 0)//CRC: No Error, calculate CRC
    {
      crcTemp = CRC16_INIT;
      for(i = 2; i < (DataLength+2); i++)
      {
        if(i < DataLength)
          data_byte = data[i] ;
        else if(i == DataLength)
          data_byte = (0x2150 & 0x00FF);
        else if(i == (DataLength+1))
          data_byte = (0x2150 & 0xFF00) >> 8;
        else
          write("Error: DLC exceeded in CRC calculation");
        crcTemp ^= data_byte << 8;
        crcTemp = (crcTemp << (8)) ^ CRC16_CCITT_FALSE_POLY_1021H_Lookup[(crcTemp >> (8)) & (0xFF)];
      }
      crcTemp ^= CRC16_XOR;
      crc_RFC_Location_216_218_RFC_Loc216_218_CRC = crcTemp;

      copyBitsToByteArrayLE(crc_RFC_Location_216_218_RFC_Loc216_218_CRC,data,0,16); //Intel / little-endian;
    }
    else if(@CAN_PrivMain::RFC_Location_216_218::RFC_Loc216_218_CRC_FaultInject == 1)//CRC: Error, set to Zero
    {

      copyBitsToByteArrayLE(0,data,0,16); //Intel / little-endian;
    }
    else if(@CAN_PrivMain::RFC_Location_216_218::RFC_Loc216_218_CRC_FaultInject == 2)//CRC: Error, Freeze last valid value
    {

      copyBitsToByteArrayLE(crc_RFC_Location_216_218_RFC_Loc216_218_CRC,data,0,16); //Intel / little-endian;
    }
}


on sysvar CAN_PrivMain::RFC_Location_219_221::RFC_Location_219_221_ON_OFF
{
  if (@this == 1)
  {
     ILSetMsgEvent(RFC_Location_219_221);
     @CAN_PrivMain::RFC_Location_219_221::RFC_Location_219_221_ON_OFF = 0;
  }
}

void cfg_Msg_RFC_Location_219_221(dword aDlc, byte data[])
{
   int64 i,k;//For looping
   byte xor,data_byte;
   dword crcTemp;
   byte DataLength;
   dword Msg_id;
   
   DataLength = Msg_RFC_Location_219_221.DataLength;//Message Data Length
   Msg_id  = Msg_RFC_Location_219_221.id;//Message ID
   
    if (@CAN_PrivMain::RFC_Location_219_221::RFC_Loc219_221_AliveCtr_FaultInject != 3)//AC: user defined value
    {

    clearBitsInByteArrayLE(data,16,8); //Intel / little-endian

    }
    if (@CAN_PrivMain::RFC_Location_219_221::RFC_Loc219_221_AliveCtr_FaultInject == 0)//AC: No Error, calculate AC
    {
      ++counter_RFC_Location_219_221_RFC_Loc219_221_AliveCtr;
      counter_RFC_Location_219_221_RFC_Loc219_221_AliveCtr %=256;

      copyBitsToByteArrayLE(counter_RFC_Location_219_221_RFC_Loc219_221_AliveCtr,data,16,8); //Intel / little-endian;
    }
    else if (@CAN_PrivMain::RFC_Location_219_221::RFC_Loc219_221_AliveCtr_FaultInject == 1)//AC: Error sequence: set AC = 0
    {

      copyBitsToByteArrayLE(0,data,16,8); //Intel / little-endian;
    }
    else if (@CAN_PrivMain::RFC_Location_219_221::RFC_Loc219_221_AliveCtr_FaultInject == 2)//AC: Error sequence: Freeze last valid value
    {

      copyBitsToByteArrayLE(counter_RFC_Location_219_221_RFC_Loc219_221_AliveCtr,data,16,8); //Intel / little-endian;
    }
    if (@CAN_PrivMain::RFC_Location_219_221::RFC_Loc219_221_ProtBlockCtr_FaultInject != 3)//BC: user defined value
    {

    clearBitsInByteArrayLE(data,24,4); //Intel / little-endian

    }
    if (@CAN_PrivMain::RFC_Location_219_221::RFC_Loc219_221_ProtBlockCtr_FaultInject == 0)//BC: No Error, calculate BC
    {
      bc_RFC_Location_219_221_RFC_Loc219_221_ProtBlockCtr = bc_RFC_Location_ProtBlockCtr ;

      copyBitsToByteArrayLE(bc_RFC_Location_219_221_RFC_Loc219_221_ProtBlockCtr,data,24,4); //Intel / little-endian;
    }
    else if (@CAN_PrivMain::RFC_Location_219_221::RFC_Loc219_221_ProtBlockCtr_FaultInject == 1)//BC: Error sequence: set BC = 0
    {

      copyBitsToByteArrayLE(0,data,24,4); //Intel / little-endian;
    }
    else if (@CAN_PrivMain::RFC_Location_219_221::RFC_Loc219_221_ProtBlockCtr_FaultInject == 2)//BC: Error sequence: Freeze last valid value
    {

      copyBitsToByteArrayLE(bc_RFC_Location_219_221_RFC_Loc219_221_ProtBlockCtr,data,24,4); //Intel / little-endian;
    }
    if (@CAN_PrivMain::RFC_Location_219_221::RFC_Loc219_221_CRC_FaultInject != 3)//CRC: user defined value
    {

    clearBitsInByteArrayLE(data,0,16); //Intel / little-endian

    }
    if(@CAN_PrivMain::RFC_Location_219_221::RFC_Loc219_221_CRC_FaultInject == 0)//CRC: No Error, calculate CRC
    {
      crcTemp = CRC16_INIT;
      for(i = 2; i < (DataLength+2); i++)
      {
        if(i < DataLength)
          data_byte = data[i] ;
        else if(i == DataLength)
          data_byte = (0x2151 & 0x00FF);
        else if(i == (DataLength+1))
          data_byte = (0x2151 & 0xFF00) >> 8;
        else
          write("Error: DLC exceeded in CRC calculation");
        crcTemp ^= data_byte << 8;
        crcTemp = (crcTemp << (8)) ^ CRC16_CCITT_FALSE_POLY_1021H_Lookup[(crcTemp >> (8)) & (0xFF)];
      }
      crcTemp ^= CRC16_XOR;
      crc_RFC_Location_219_221_RFC_Loc219_221_CRC = crcTemp;

      copyBitsToByteArrayLE(crc_RFC_Location_219_221_RFC_Loc219_221_CRC,data,0,16); //Intel / little-endian;
    }
    else if(@CAN_PrivMain::RFC_Location_219_221::RFC_Loc219_221_CRC_FaultInject == 1)//CRC: Error, set to Zero
    {

      copyBitsToByteArrayLE(0,data,0,16); //Intel / little-endian;
    }
    else if(@CAN_PrivMain::RFC_Location_219_221::RFC_Loc219_221_CRC_FaultInject == 2)//CRC: Error, Freeze last valid value
    {

      copyBitsToByteArrayLE(crc_RFC_Location_219_221_RFC_Loc219_221_CRC,data,0,16); //Intel / little-endian;
    }
}


on sysvar CAN_PrivMain::RFC_Location_222_224::RFC_Location_222_224_ON_OFF
{
  if (@this == 1)
  {
     ILSetMsgEvent(RFC_Location_222_224);
     @CAN_PrivMain::RFC_Location_222_224::RFC_Location_222_224_ON_OFF = 0;
  }
}

void cfg_Msg_RFC_Location_222_224(dword aDlc, byte data[])
{
   int64 i,k;//For looping
   byte xor,data_byte;
   dword crcTemp;
   byte DataLength;
   dword Msg_id;
   
   DataLength = Msg_RFC_Location_222_224.DataLength;//Message Data Length
   Msg_id  = Msg_RFC_Location_222_224.id;//Message ID
   
    if (@CAN_PrivMain::RFC_Location_222_224::RFC_Loc222_224_AliveCtr_FaultInject != 3)//AC: user defined value
    {

    clearBitsInByteArrayLE(data,16,8); //Intel / little-endian

    }
    if (@CAN_PrivMain::RFC_Location_222_224::RFC_Loc222_224_AliveCtr_FaultInject == 0)//AC: No Error, calculate AC
    {
      ++counter_RFC_Location_222_224_RFC_Loc222_224_AliveCtr;
      counter_RFC_Location_222_224_RFC_Loc222_224_AliveCtr %=256;

      copyBitsToByteArrayLE(counter_RFC_Location_222_224_RFC_Loc222_224_AliveCtr,data,16,8); //Intel / little-endian;
    }
    else if (@CAN_PrivMain::RFC_Location_222_224::RFC_Loc222_224_AliveCtr_FaultInject == 1)//AC: Error sequence: set AC = 0
    {

      copyBitsToByteArrayLE(0,data,16,8); //Intel / little-endian;
    }
    else if (@CAN_PrivMain::RFC_Location_222_224::RFC_Loc222_224_AliveCtr_FaultInject == 2)//AC: Error sequence: Freeze last valid value
    {

      copyBitsToByteArrayLE(counter_RFC_Location_222_224_RFC_Loc222_224_AliveCtr,data,16,8); //Intel / little-endian;
    }
    if (@CAN_PrivMain::RFC_Location_222_224::RFC_Loc222_224_ProtBlockCtr_FaultInject != 3)//BC: user defined value
    {

    clearBitsInByteArrayLE(data,24,4); //Intel / little-endian

    }
    if (@CAN_PrivMain::RFC_Location_222_224::RFC_Loc222_224_ProtBlockCtr_FaultInject == 0)//BC: No Error, calculate BC
    {
      bc_RFC_Location_222_224_RFC_Loc222_224_ProtBlockCtr = bc_RFC_Location_ProtBlockCtr ;

      copyBitsToByteArrayLE(bc_RFC_Location_222_224_RFC_Loc222_224_ProtBlockCtr,data,24,4); //Intel / little-endian;
    }
    else if (@CAN_PrivMain::RFC_Location_222_224::RFC_Loc222_224_ProtBlockCtr_FaultInject == 1)//BC: Error sequence: set BC = 0
    {

      copyBitsToByteArrayLE(0,data,24,4); //Intel / little-endian;
    }
    else if (@CAN_PrivMain::RFC_Location_222_224::RFC_Loc222_224_ProtBlockCtr_FaultInject == 2)//BC: Error sequence: Freeze last valid value
    {

      copyBitsToByteArrayLE(bc_RFC_Location_222_224_RFC_Loc222_224_ProtBlockCtr,data,24,4); //Intel / little-endian;
    }
    if (@CAN_PrivMain::RFC_Location_222_224::RFC_Loc222_224_CRC_FaultInject != 3)//CRC: user defined value
    {

    clearBitsInByteArrayLE(data,0,16); //Intel / little-endian

    }
    if(@CAN_PrivMain::RFC_Location_222_224::RFC_Loc222_224_CRC_FaultInject == 0)//CRC: No Error, calculate CRC
    {
      crcTemp = CRC16_INIT;
      for(i = 2; i < (DataLength+2); i++)
      {
        if(i < DataLength)
          data_byte = data[i] ;
        else if(i == DataLength)
          data_byte = (0x2152 & 0x00FF);
        else if(i == (DataLength+1))
          data_byte = (0x2152 & 0xFF00) >> 8;
        else
          write("Error: DLC exceeded in CRC calculation");
        crcTemp ^= data_byte << 8;
        crcTemp = (crcTemp << (8)) ^ CRC16_CCITT_FALSE_POLY_1021H_Lookup[(crcTemp >> (8)) & (0xFF)];
      }
      crcTemp ^= CRC16_XOR;
      crc_RFC_Location_222_224_RFC_Loc222_224_CRC = crcTemp;

      copyBitsToByteArrayLE(crc_RFC_Location_222_224_RFC_Loc222_224_CRC,data,0,16); //Intel / little-endian;
    }
    else if(@CAN_PrivMain::RFC_Location_222_224::RFC_Loc222_224_CRC_FaultInject == 1)//CRC: Error, set to Zero
    {

      copyBitsToByteArrayLE(0,data,0,16); //Intel / little-endian;
    }
    else if(@CAN_PrivMain::RFC_Location_222_224::RFC_Loc222_224_CRC_FaultInject == 2)//CRC: Error, Freeze last valid value
    {

      copyBitsToByteArrayLE(crc_RFC_Location_222_224_RFC_Loc222_224_CRC,data,0,16); //Intel / little-endian;
    }
}


on sysvar CAN_PrivMain::RFC_Location_225_227::RFC_Location_225_227_ON_OFF
{
  if (@this == 1)
  {
     ILSetMsgEvent(RFC_Location_225_227);
     @CAN_PrivMain::RFC_Location_225_227::RFC_Location_225_227_ON_OFF = 0;
  }
}

void cfg_Msg_RFC_Location_225_227(dword aDlc, byte data[])
{
   int64 i,k;//For looping
   byte xor,data_byte;
   dword crcTemp;
   byte DataLength;
   dword Msg_id;
   
   DataLength = Msg_RFC_Location_225_227.DataLength;//Message Data Length
   Msg_id  = Msg_RFC_Location_225_227.id;//Message ID
   
    if (@CAN_PrivMain::RFC_Location_225_227::RFC_Loc225_227_AliveCtr_FaultInject != 3)//AC: user defined value
    {

    clearBitsInByteArrayLE(data,16,8); //Intel / little-endian

    }
    if (@CAN_PrivMain::RFC_Location_225_227::RFC_Loc225_227_AliveCtr_FaultInject == 0)//AC: No Error, calculate AC
    {
      ++counter_RFC_Location_225_227_RFC_Loc225_227_AliveCtr;
      counter_RFC_Location_225_227_RFC_Loc225_227_AliveCtr %=256;

      copyBitsToByteArrayLE(counter_RFC_Location_225_227_RFC_Loc225_227_AliveCtr,data,16,8); //Intel / little-endian;
    }
    else if (@CAN_PrivMain::RFC_Location_225_227::RFC_Loc225_227_AliveCtr_FaultInject == 1)//AC: Error sequence: set AC = 0
    {

      copyBitsToByteArrayLE(0,data,16,8); //Intel / little-endian;
    }
    else if (@CAN_PrivMain::RFC_Location_225_227::RFC_Loc225_227_AliveCtr_FaultInject == 2)//AC: Error sequence: Freeze last valid value
    {

      copyBitsToByteArrayLE(counter_RFC_Location_225_227_RFC_Loc225_227_AliveCtr,data,16,8); //Intel / little-endian;
    }
    if (@CAN_PrivMain::RFC_Location_225_227::RFC_Loc225_227_ProtBlockCtr_FaultInject != 3)//BC: user defined value
    {

    clearBitsInByteArrayLE(data,24,4); //Intel / little-endian

    }
    if (@CAN_PrivMain::RFC_Location_225_227::RFC_Loc225_227_ProtBlockCtr_FaultInject == 0)//BC: No Error, calculate BC
    {
      bc_RFC_Location_225_227_RFC_Loc225_227_ProtBlockCtr = bc_RFC_Location_ProtBlockCtr ;

      copyBitsToByteArrayLE(bc_RFC_Location_225_227_RFC_Loc225_227_ProtBlockCtr,data,24,4); //Intel / little-endian;
    }
    else if (@CAN_PrivMain::RFC_Location_225_227::RFC_Loc225_227_ProtBlockCtr_FaultInject == 1)//BC: Error sequence: set BC = 0
    {

      copyBitsToByteArrayLE(0,data,24,4); //Intel / little-endian;
    }
    else if (@CAN_PrivMain::RFC_Location_225_227::RFC_Loc225_227_ProtBlockCtr_FaultInject == 2)//BC: Error sequence: Freeze last valid value
    {

      copyBitsToByteArrayLE(bc_RFC_Location_225_227_RFC_Loc225_227_ProtBlockCtr,data,24,4); //Intel / little-endian;
    }
    if (@CAN_PrivMain::RFC_Location_225_227::RFC_Loc225_227_CRC_FaultInject != 3)//CRC: user defined value
    {

    clearBitsInByteArrayLE(data,0,16); //Intel / little-endian

    }
    if(@CAN_PrivMain::RFC_Location_225_227::RFC_Loc225_227_CRC_FaultInject == 0)//CRC: No Error, calculate CRC
    {
      crcTemp = CRC16_INIT;
      for(i = 2; i < (DataLength+2); i++)
      {
        if(i < DataLength)
          data_byte = data[i] ;
        else if(i == DataLength)
          data_byte = (0x2153 & 0x00FF);
        else if(i == (DataLength+1))
          data_byte = (0x2153 & 0xFF00) >> 8;
        else
          write("Error: DLC exceeded in CRC calculation");
        crcTemp ^= data_byte << 8;
        crcTemp = (crcTemp << (8)) ^ CRC16_CCITT_FALSE_POLY_1021H_Lookup[(crcTemp >> (8)) & (0xFF)];
      }
      crcTemp ^= CRC16_XOR;
      crc_RFC_Location_225_227_RFC_Loc225_227_CRC = crcTemp;

      copyBitsToByteArrayLE(crc_RFC_Location_225_227_RFC_Loc225_227_CRC,data,0,16); //Intel / little-endian;
    }
    else if(@CAN_PrivMain::RFC_Location_225_227::RFC_Loc225_227_CRC_FaultInject == 1)//CRC: Error, set to Zero
    {

      copyBitsToByteArrayLE(0,data,0,16); //Intel / little-endian;
    }
    else if(@CAN_PrivMain::RFC_Location_225_227::RFC_Loc225_227_CRC_FaultInject == 2)//CRC: Error, Freeze last valid value
    {

      copyBitsToByteArrayLE(crc_RFC_Location_225_227_RFC_Loc225_227_CRC,data,0,16); //Intel / little-endian;
    }
}


on sysvar CAN_PrivMain::RFC_Location_228_230::RFC_Location_228_230_ON_OFF
{
  if (@this == 1)
  {
     ILSetMsgEvent(RFC_Location_228_230);
     @CAN_PrivMain::RFC_Location_228_230::RFC_Location_228_230_ON_OFF = 0;
  }
}

void cfg_Msg_RFC_Location_228_230(dword aDlc, byte data[])
{
   int64 i,k;//For looping
   byte xor,data_byte;
   dword crcTemp;
   byte DataLength;
   dword Msg_id;
   
   DataLength = Msg_RFC_Location_228_230.DataLength;//Message Data Length
   Msg_id  = Msg_RFC_Location_228_230.id;//Message ID
   
    if (@CAN_PrivMain::RFC_Location_228_230::RFC_Loc228_230_AliveCtr_FaultInject != 3)//AC: user defined value
    {

    clearBitsInByteArrayLE(data,16,8); //Intel / little-endian

    }
    if (@CAN_PrivMain::RFC_Location_228_230::RFC_Loc228_230_AliveCtr_FaultInject == 0)//AC: No Error, calculate AC
    {
      ++counter_RFC_Location_228_230_RFC_Loc228_230_AliveCtr;
      counter_RFC_Location_228_230_RFC_Loc228_230_AliveCtr %=256;

      copyBitsToByteArrayLE(counter_RFC_Location_228_230_RFC_Loc228_230_AliveCtr,data,16,8); //Intel / little-endian;
    }
    else if (@CAN_PrivMain::RFC_Location_228_230::RFC_Loc228_230_AliveCtr_FaultInject == 1)//AC: Error sequence: set AC = 0
    {

      copyBitsToByteArrayLE(0,data,16,8); //Intel / little-endian;
    }
    else if (@CAN_PrivMain::RFC_Location_228_230::RFC_Loc228_230_AliveCtr_FaultInject == 2)//AC: Error sequence: Freeze last valid value
    {

      copyBitsToByteArrayLE(counter_RFC_Location_228_230_RFC_Loc228_230_AliveCtr,data,16,8); //Intel / little-endian;
    }
    if (@CAN_PrivMain::RFC_Location_228_230::RFC_Loc228_230_ProtBlockCtr_FaultInject != 3)//BC: user defined value
    {

    clearBitsInByteArrayLE(data,24,4); //Intel / little-endian

    }
    if (@CAN_PrivMain::RFC_Location_228_230::RFC_Loc228_230_ProtBlockCtr_FaultInject == 0)//BC: No Error, calculate BC
    {
      bc_RFC_Location_228_230_RFC_Loc228_230_ProtBlockCtr = bc_RFC_Location_ProtBlockCtr ;

      copyBitsToByteArrayLE(bc_RFC_Location_228_230_RFC_Loc228_230_ProtBlockCtr,data,24,4); //Intel / little-endian;
    }
    else if (@CAN_PrivMain::RFC_Location_228_230::RFC_Loc228_230_ProtBlockCtr_FaultInject == 1)//BC: Error sequence: set BC = 0
    {

      copyBitsToByteArrayLE(0,data,24,4); //Intel / little-endian;
    }
    else if (@CAN_PrivMain::RFC_Location_228_230::RFC_Loc228_230_ProtBlockCtr_FaultInject == 2)//BC: Error sequence: Freeze last valid value
    {

      copyBitsToByteArrayLE(bc_RFC_Location_228_230_RFC_Loc228_230_ProtBlockCtr,data,24,4); //Intel / little-endian;
    }
    if (@CAN_PrivMain::RFC_Location_228_230::RFC_Loc228_230_CRC_FaultInject != 3)//CRC: user defined value
    {

    clearBitsInByteArrayLE(data,0,16); //Intel / little-endian

    }
    if(@CAN_PrivMain::RFC_Location_228_230::RFC_Loc228_230_CRC_FaultInject == 0)//CRC: No Error, calculate CRC
    {
      crcTemp = CRC16_INIT;
      for(i = 2; i < (DataLength+2); i++)
      {
        if(i < DataLength)
          data_byte = data[i] ;
        else if(i == DataLength)
          data_byte = (0x2154 & 0x00FF);
        else if(i == (DataLength+1))
          data_byte = (0x2154 & 0xFF00) >> 8;
        else
          write("Error: DLC exceeded in CRC calculation");
        crcTemp ^= data_byte << 8;
        crcTemp = (crcTemp << (8)) ^ CRC16_CCITT_FALSE_POLY_1021H_Lookup[(crcTemp >> (8)) & (0xFF)];
      }
      crcTemp ^= CRC16_XOR;
      crc_RFC_Location_228_230_RFC_Loc228_230_CRC = crcTemp;

      copyBitsToByteArrayLE(crc_RFC_Location_228_230_RFC_Loc228_230_CRC,data,0,16); //Intel / little-endian;
    }
    else if(@CAN_PrivMain::RFC_Location_228_230::RFC_Loc228_230_CRC_FaultInject == 1)//CRC: Error, set to Zero
    {

      copyBitsToByteArrayLE(0,data,0,16); //Intel / little-endian;
    }
    else if(@CAN_PrivMain::RFC_Location_228_230::RFC_Loc228_230_CRC_FaultInject == 2)//CRC: Error, Freeze last valid value
    {

      copyBitsToByteArrayLE(crc_RFC_Location_228_230_RFC_Loc228_230_CRC,data,0,16); //Intel / little-endian;
    }
}


on sysvar CAN_PrivMain::RFC_Location_231_233::RFC_Location_231_233_ON_OFF
{
  if (@this == 1)
  {
     ILSetMsgEvent(RFC_Location_231_233);
     @CAN_PrivMain::RFC_Location_231_233::RFC_Location_231_233_ON_OFF = 0;
  }
}

void cfg_Msg_RFC_Location_231_233(dword aDlc, byte data[])
{
   int64 i,k;//For looping
   byte xor,data_byte;
   dword crcTemp;
   byte DataLength;
   dword Msg_id;
   
   DataLength = Msg_RFC_Location_231_233.DataLength;//Message Data Length
   Msg_id  = Msg_RFC_Location_231_233.id;//Message ID
   
    if (@CAN_PrivMain::RFC_Location_231_233::RFC_Loc231_233_AliveCtr_FaultInject != 3)//AC: user defined value
    {

    clearBitsInByteArrayLE(data,16,8); //Intel / little-endian

    }
    if (@CAN_PrivMain::RFC_Location_231_233::RFC_Loc231_233_AliveCtr_FaultInject == 0)//AC: No Error, calculate AC
    {
      ++counter_RFC_Location_231_233_RFC_Loc231_233_AliveCtr;
      counter_RFC_Location_231_233_RFC_Loc231_233_AliveCtr %=256;

      copyBitsToByteArrayLE(counter_RFC_Location_231_233_RFC_Loc231_233_AliveCtr,data,16,8); //Intel / little-endian;
    }
    else if (@CAN_PrivMain::RFC_Location_231_233::RFC_Loc231_233_AliveCtr_FaultInject == 1)//AC: Error sequence: set AC = 0
    {

      copyBitsToByteArrayLE(0,data,16,8); //Intel / little-endian;
    }
    else if (@CAN_PrivMain::RFC_Location_231_233::RFC_Loc231_233_AliveCtr_FaultInject == 2)//AC: Error sequence: Freeze last valid value
    {

      copyBitsToByteArrayLE(counter_RFC_Location_231_233_RFC_Loc231_233_AliveCtr,data,16,8); //Intel / little-endian;
    }
    if (@CAN_PrivMain::RFC_Location_231_233::RFC_Loc231_233_ProtBlockCtr_FaultInject != 3)//BC: user defined value
    {

    clearBitsInByteArrayLE(data,24,4); //Intel / little-endian

    }
    if (@CAN_PrivMain::RFC_Location_231_233::RFC_Loc231_233_ProtBlockCtr_FaultInject == 0)//BC: No Error, calculate BC
    {
      bc_RFC_Location_231_233_RFC_Loc231_233_ProtBlockCtr = bc_RFC_Location_ProtBlockCtr ;

      copyBitsToByteArrayLE(bc_RFC_Location_231_233_RFC_Loc231_233_ProtBlockCtr,data,24,4); //Intel / little-endian;
    }
    else if (@CAN_PrivMain::RFC_Location_231_233::RFC_Loc231_233_ProtBlockCtr_FaultInject == 1)//BC: Error sequence: set BC = 0
    {

      copyBitsToByteArrayLE(0,data,24,4); //Intel / little-endian;
    }
    else if (@CAN_PrivMain::RFC_Location_231_233::RFC_Loc231_233_ProtBlockCtr_FaultInject == 2)//BC: Error sequence: Freeze last valid value
    {

      copyBitsToByteArrayLE(bc_RFC_Location_231_233_RFC_Loc231_233_ProtBlockCtr,data,24,4); //Intel / little-endian;
    }
    if (@CAN_PrivMain::RFC_Location_231_233::RFC_Loc231_233_CRC_FaultInject != 3)//CRC: user defined value
    {

    clearBitsInByteArrayLE(data,0,16); //Intel / little-endian

    }
    if(@CAN_PrivMain::RFC_Location_231_233::RFC_Loc231_233_CRC_FaultInject == 0)//CRC: No Error, calculate CRC
    {
      crcTemp = CRC16_INIT;
      for(i = 2; i < (DataLength+2); i++)
      {
        if(i < DataLength)
          data_byte = data[i] ;
        else if(i == DataLength)
          data_byte = (0x2155 & 0x00FF);
        else if(i == (DataLength+1))
          data_byte = (0x2155 & 0xFF00) >> 8;
        else
          write("Error: DLC exceeded in CRC calculation");
        crcTemp ^= data_byte << 8;
        crcTemp = (crcTemp << (8)) ^ CRC16_CCITT_FALSE_POLY_1021H_Lookup[(crcTemp >> (8)) & (0xFF)];
      }
      crcTemp ^= CRC16_XOR;
      crc_RFC_Location_231_233_RFC_Loc231_233_CRC = crcTemp;

      copyBitsToByteArrayLE(crc_RFC_Location_231_233_RFC_Loc231_233_CRC,data,0,16); //Intel / little-endian;
    }
    else if(@CAN_PrivMain::RFC_Location_231_233::RFC_Loc231_233_CRC_FaultInject == 1)//CRC: Error, set to Zero
    {

      copyBitsToByteArrayLE(0,data,0,16); //Intel / little-endian;
    }
    else if(@CAN_PrivMain::RFC_Location_231_233::RFC_Loc231_233_CRC_FaultInject == 2)//CRC: Error, Freeze last valid value
    {

      copyBitsToByteArrayLE(crc_RFC_Location_231_233_RFC_Loc231_233_CRC,data,0,16); //Intel / little-endian;
    }
}


on sysvar CAN_PrivMain::RFC_Location_234_236::RFC_Location_234_236_ON_OFF
{
  if (@this == 1)
  {
     ILSetMsgEvent(RFC_Location_234_236);
     @CAN_PrivMain::RFC_Location_234_236::RFC_Location_234_236_ON_OFF = 0;
  }
}

void cfg_Msg_RFC_Location_234_236(dword aDlc, byte data[])
{
   int64 i,k;//For looping
   byte xor,data_byte;
   dword crcTemp;
   byte DataLength;
   dword Msg_id;
   
   DataLength = Msg_RFC_Location_234_236.DataLength;//Message Data Length
   Msg_id  = Msg_RFC_Location_234_236.id;//Message ID
   
    if (@CAN_PrivMain::RFC_Location_234_236::RFC_Loc234_236_AliveCtr_FaultInject != 3)//AC: user defined value
    {

    clearBitsInByteArrayLE(data,16,8); //Intel / little-endian

    }
    if (@CAN_PrivMain::RFC_Location_234_236::RFC_Loc234_236_AliveCtr_FaultInject == 0)//AC: No Error, calculate AC
    {
      ++counter_RFC_Location_234_236_RFC_Loc234_236_AliveCtr;
      counter_RFC_Location_234_236_RFC_Loc234_236_AliveCtr %=256;

      copyBitsToByteArrayLE(counter_RFC_Location_234_236_RFC_Loc234_236_AliveCtr,data,16,8); //Intel / little-endian;
    }
    else if (@CAN_PrivMain::RFC_Location_234_236::RFC_Loc234_236_AliveCtr_FaultInject == 1)//AC: Error sequence: set AC = 0
    {

      copyBitsToByteArrayLE(0,data,16,8); //Intel / little-endian;
    }
    else if (@CAN_PrivMain::RFC_Location_234_236::RFC_Loc234_236_AliveCtr_FaultInject == 2)//AC: Error sequence: Freeze last valid value
    {

      copyBitsToByteArrayLE(counter_RFC_Location_234_236_RFC_Loc234_236_AliveCtr,data,16,8); //Intel / little-endian;
    }
    if (@CAN_PrivMain::RFC_Location_234_236::RFC_Loc234_236_ProtBlockCtr_FaultInject != 3)//BC: user defined value
    {

    clearBitsInByteArrayLE(data,24,4); //Intel / little-endian

    }
    if (@CAN_PrivMain::RFC_Location_234_236::RFC_Loc234_236_ProtBlockCtr_FaultInject == 0)//BC: No Error, calculate BC
    {
      bc_RFC_Location_234_236_RFC_Loc234_236_ProtBlockCtr = bc_RFC_Location_ProtBlockCtr ;

      copyBitsToByteArrayLE(bc_RFC_Location_234_236_RFC_Loc234_236_ProtBlockCtr,data,24,4); //Intel / little-endian;
    }
    else if (@CAN_PrivMain::RFC_Location_234_236::RFC_Loc234_236_ProtBlockCtr_FaultInject == 1)//BC: Error sequence: set BC = 0
    {

      copyBitsToByteArrayLE(0,data,24,4); //Intel / little-endian;
    }
    else if (@CAN_PrivMain::RFC_Location_234_236::RFC_Loc234_236_ProtBlockCtr_FaultInject == 2)//BC: Error sequence: Freeze last valid value
    {

      copyBitsToByteArrayLE(bc_RFC_Location_234_236_RFC_Loc234_236_ProtBlockCtr,data,24,4); //Intel / little-endian;
    }
    if (@CAN_PrivMain::RFC_Location_234_236::RFC_Loc234_236_CRC_FaultInject != 3)//CRC: user defined value
    {

    clearBitsInByteArrayLE(data,0,16); //Intel / little-endian

    }
    if(@CAN_PrivMain::RFC_Location_234_236::RFC_Loc234_236_CRC_FaultInject == 0)//CRC: No Error, calculate CRC
    {
      crcTemp = CRC16_INIT;
      for(i = 2; i < (DataLength+2); i++)
      {
        if(i < DataLength)
          data_byte = data[i] ;
        else if(i == DataLength)
          data_byte = (0x2156 & 0x00FF);
        else if(i == (DataLength+1))
          data_byte = (0x2156 & 0xFF00) >> 8;
        else
          write("Error: DLC exceeded in CRC calculation");
        crcTemp ^= data_byte << 8;
        crcTemp = (crcTemp << (8)) ^ CRC16_CCITT_FALSE_POLY_1021H_Lookup[(crcTemp >> (8)) & (0xFF)];
      }
      crcTemp ^= CRC16_XOR;
      crc_RFC_Location_234_236_RFC_Loc234_236_CRC = crcTemp;

      copyBitsToByteArrayLE(crc_RFC_Location_234_236_RFC_Loc234_236_CRC,data,0,16); //Intel / little-endian;
    }
    else if(@CAN_PrivMain::RFC_Location_234_236::RFC_Loc234_236_CRC_FaultInject == 1)//CRC: Error, set to Zero
    {

      copyBitsToByteArrayLE(0,data,0,16); //Intel / little-endian;
    }
    else if(@CAN_PrivMain::RFC_Location_234_236::RFC_Loc234_236_CRC_FaultInject == 2)//CRC: Error, Freeze last valid value
    {

      copyBitsToByteArrayLE(crc_RFC_Location_234_236_RFC_Loc234_236_CRC,data,0,16); //Intel / little-endian;
    }
}


on sysvar CAN_PrivMain::RFC_Location_237_239::RFC_Location_237_239_ON_OFF
{
  if (@this == 1)
  {
     ILSetMsgEvent(RFC_Location_237_239);
     @CAN_PrivMain::RFC_Location_237_239::RFC_Location_237_239_ON_OFF = 0;
  }
}

void cfg_Msg_RFC_Location_237_239(dword aDlc, byte data[])
{
   int64 i,k;//For looping
   byte xor,data_byte;
   dword crcTemp;
   byte DataLength;
   dword Msg_id;
   
   DataLength = Msg_RFC_Location_237_239.DataLength;//Message Data Length
   Msg_id  = Msg_RFC_Location_237_239.id;//Message ID
   
    if (@CAN_PrivMain::RFC_Location_237_239::RFC_Loc237_239_AliveCtr_FaultInject != 3)//AC: user defined value
    {

    clearBitsInByteArrayLE(data,16,8); //Intel / little-endian

    }
    if (@CAN_PrivMain::RFC_Location_237_239::RFC_Loc237_239_AliveCtr_FaultInject == 0)//AC: No Error, calculate AC
    {
      ++counter_RFC_Location_237_239_RFC_Loc237_239_AliveCtr;
      counter_RFC_Location_237_239_RFC_Loc237_239_AliveCtr %=256;

      copyBitsToByteArrayLE(counter_RFC_Location_237_239_RFC_Loc237_239_AliveCtr,data,16,8); //Intel / little-endian;
    }
    else if (@CAN_PrivMain::RFC_Location_237_239::RFC_Loc237_239_AliveCtr_FaultInject == 1)//AC: Error sequence: set AC = 0
    {

      copyBitsToByteArrayLE(0,data,16,8); //Intel / little-endian;
    }
    else if (@CAN_PrivMain::RFC_Location_237_239::RFC_Loc237_239_AliveCtr_FaultInject == 2)//AC: Error sequence: Freeze last valid value
    {

      copyBitsToByteArrayLE(counter_RFC_Location_237_239_RFC_Loc237_239_AliveCtr,data,16,8); //Intel / little-endian;
    }
    if (@CAN_PrivMain::RFC_Location_237_239::RFC_Loc237_239_ProtBlockCtr_FaultInject != 3)//BC: user defined value
    {

    clearBitsInByteArrayLE(data,24,4); //Intel / little-endian

    }
    if (@CAN_PrivMain::RFC_Location_237_239::RFC_Loc237_239_ProtBlockCtr_FaultInject == 0)//BC: No Error, calculate BC
    {
      bc_RFC_Location_237_239_RFC_Loc237_239_ProtBlockCtr = bc_RFC_Location_ProtBlockCtr ;

      copyBitsToByteArrayLE(bc_RFC_Location_237_239_RFC_Loc237_239_ProtBlockCtr,data,24,4); //Intel / little-endian;
    }
    else if (@CAN_PrivMain::RFC_Location_237_239::RFC_Loc237_239_ProtBlockCtr_FaultInject == 1)//BC: Error sequence: set BC = 0
    {

      copyBitsToByteArrayLE(0,data,24,4); //Intel / little-endian;
    }
    else if (@CAN_PrivMain::RFC_Location_237_239::RFC_Loc237_239_ProtBlockCtr_FaultInject == 2)//BC: Error sequence: Freeze last valid value
    {

      copyBitsToByteArrayLE(bc_RFC_Location_237_239_RFC_Loc237_239_ProtBlockCtr,data,24,4); //Intel / little-endian;
    }
    if (@CAN_PrivMain::RFC_Location_237_239::RFC_Loc237_239_CRC_FaultInject != 3)//CRC: user defined value
    {

    clearBitsInByteArrayLE(data,0,16); //Intel / little-endian

    }
    if(@CAN_PrivMain::RFC_Location_237_239::RFC_Loc237_239_CRC_FaultInject == 0)//CRC: No Error, calculate CRC
    {
      crcTemp = CRC16_INIT;
      for(i = 2; i < (DataLength+2); i++)
      {
        if(i < DataLength)
          data_byte = data[i] ;
        else if(i == DataLength)
          data_byte = (0x2157 & 0x00FF);
        else if(i == (DataLength+1))
          data_byte = (0x2157 & 0xFF00) >> 8;
        else
          write("Error: DLC exceeded in CRC calculation");
        crcTemp ^= data_byte << 8;
        crcTemp = (crcTemp << (8)) ^ CRC16_CCITT_FALSE_POLY_1021H_Lookup[(crcTemp >> (8)) & (0xFF)];
      }
      crcTemp ^= CRC16_XOR;
      crc_RFC_Location_237_239_RFC_Loc237_239_CRC = crcTemp;

      copyBitsToByteArrayLE(crc_RFC_Location_237_239_RFC_Loc237_239_CRC,data,0,16); //Intel / little-endian;
    }
    else if(@CAN_PrivMain::RFC_Location_237_239::RFC_Loc237_239_CRC_FaultInject == 1)//CRC: Error, set to Zero
    {

      copyBitsToByteArrayLE(0,data,0,16); //Intel / little-endian;
    }
    else if(@CAN_PrivMain::RFC_Location_237_239::RFC_Loc237_239_CRC_FaultInject == 2)//CRC: Error, Freeze last valid value
    {

      copyBitsToByteArrayLE(crc_RFC_Location_237_239_RFC_Loc237_239_CRC,data,0,16); //Intel / little-endian;
    }
}


on sysvar CAN_PrivMain::RFC_Location_240_242::RFC_Location_240_242_ON_OFF
{
  if (@this == 1)
  {
     ILSetMsgEvent(RFC_Location_240_242);
     @CAN_PrivMain::RFC_Location_240_242::RFC_Location_240_242_ON_OFF = 0;
  }
}

void cfg_Msg_RFC_Location_240_242(dword aDlc, byte data[])
{
   int64 i,k;//For looping
   byte xor,data_byte;
   dword crcTemp;
   byte DataLength;
   dword Msg_id;
   
   DataLength = Msg_RFC_Location_240_242.DataLength;//Message Data Length
   Msg_id  = Msg_RFC_Location_240_242.id;//Message ID
   
    if (@CAN_PrivMain::RFC_Location_240_242::RFC_Loc240_242_AliveCtr_FaultInject != 3)//AC: user defined value
    {

    clearBitsInByteArrayLE(data,16,8); //Intel / little-endian

    }
    if (@CAN_PrivMain::RFC_Location_240_242::RFC_Loc240_242_AliveCtr_FaultInject == 0)//AC: No Error, calculate AC
    {
      ++counter_RFC_Location_240_242_RFC_Loc240_242_AliveCtr;
      counter_RFC_Location_240_242_RFC_Loc240_242_AliveCtr %=256;

      copyBitsToByteArrayLE(counter_RFC_Location_240_242_RFC_Loc240_242_AliveCtr,data,16,8); //Intel / little-endian;
    }
    else if (@CAN_PrivMain::RFC_Location_240_242::RFC_Loc240_242_AliveCtr_FaultInject == 1)//AC: Error sequence: set AC = 0
    {

      copyBitsToByteArrayLE(0,data,16,8); //Intel / little-endian;
    }
    else if (@CAN_PrivMain::RFC_Location_240_242::RFC_Loc240_242_AliveCtr_FaultInject == 2)//AC: Error sequence: Freeze last valid value
    {

      copyBitsToByteArrayLE(counter_RFC_Location_240_242_RFC_Loc240_242_AliveCtr,data,16,8); //Intel / little-endian;
    }
    if (@CAN_PrivMain::RFC_Location_240_242::RFC_Loc240_242_ProtBlockCtr_FaultInject != 3)//BC: user defined value
    {

    clearBitsInByteArrayLE(data,24,4); //Intel / little-endian

    }
    if (@CAN_PrivMain::RFC_Location_240_242::RFC_Loc240_242_ProtBlockCtr_FaultInject == 0)//BC: No Error, calculate BC
    {
      bc_RFC_Location_240_242_RFC_Loc240_242_ProtBlockCtr = bc_RFC_Location_ProtBlockCtr ;

      copyBitsToByteArrayLE(bc_RFC_Location_240_242_RFC_Loc240_242_ProtBlockCtr,data,24,4); //Intel / little-endian;
    }
    else if (@CAN_PrivMain::RFC_Location_240_242::RFC_Loc240_242_ProtBlockCtr_FaultInject == 1)//BC: Error sequence: set BC = 0
    {

      copyBitsToByteArrayLE(0,data,24,4); //Intel / little-endian;
    }
    else if (@CAN_PrivMain::RFC_Location_240_242::RFC_Loc240_242_ProtBlockCtr_FaultInject == 2)//BC: Error sequence: Freeze last valid value
    {

      copyBitsToByteArrayLE(bc_RFC_Location_240_242_RFC_Loc240_242_ProtBlockCtr,data,24,4); //Intel / little-endian;
    }
    if (@CAN_PrivMain::RFC_Location_240_242::RFC_Loc240_242_CRC_FaultInject != 3)//CRC: user defined value
    {

    clearBitsInByteArrayLE(data,0,16); //Intel / little-endian

    }
    if(@CAN_PrivMain::RFC_Location_240_242::RFC_Loc240_242_CRC_FaultInject == 0)//CRC: No Error, calculate CRC
    {
      crcTemp = CRC16_INIT;
      for(i = 2; i < (DataLength+2); i++)
      {
        if(i < DataLength)
          data_byte = data[i] ;
        else if(i == DataLength)
          data_byte = (0x2158 & 0x00FF);
        else if(i == (DataLength+1))
          data_byte = (0x2158 & 0xFF00) >> 8;
        else
          write("Error: DLC exceeded in CRC calculation");
        crcTemp ^= data_byte << 8;
        crcTemp = (crcTemp << (8)) ^ CRC16_CCITT_FALSE_POLY_1021H_Lookup[(crcTemp >> (8)) & (0xFF)];
      }
      crcTemp ^= CRC16_XOR;
      crc_RFC_Location_240_242_RFC_Loc240_242_CRC = crcTemp;

      copyBitsToByteArrayLE(crc_RFC_Location_240_242_RFC_Loc240_242_CRC,data,0,16); //Intel / little-endian;
    }
    else if(@CAN_PrivMain::RFC_Location_240_242::RFC_Loc240_242_CRC_FaultInject == 1)//CRC: Error, set to Zero
    {

      copyBitsToByteArrayLE(0,data,0,16); //Intel / little-endian;
    }
    else if(@CAN_PrivMain::RFC_Location_240_242::RFC_Loc240_242_CRC_FaultInject == 2)//CRC: Error, Freeze last valid value
    {

      copyBitsToByteArrayLE(crc_RFC_Location_240_242_RFC_Loc240_242_CRC,data,0,16); //Intel / little-endian;
    }
}


on sysvar CAN_PrivMain::RFC_Location_243_245::RFC_Location_243_245_ON_OFF
{
  if (@this == 1)
  {
     ILSetMsgEvent(RFC_Location_243_245);
     @CAN_PrivMain::RFC_Location_243_245::RFC_Location_243_245_ON_OFF = 0;
  }
}

void cfg_Msg_RFC_Location_243_245(dword aDlc, byte data[])
{
   int64 i,k;//For looping
   byte xor,data_byte;
   dword crcTemp;
   byte DataLength;
   dword Msg_id;
   
   DataLength = Msg_RFC_Location_243_245.DataLength;//Message Data Length
   Msg_id  = Msg_RFC_Location_243_245.id;//Message ID
   
    if (@CAN_PrivMain::RFC_Location_243_245::RFC_Loc243_245_AliveCtr_FaultInject != 3)//AC: user defined value
    {

    clearBitsInByteArrayLE(data,16,8); //Intel / little-endian

    }
    if (@CAN_PrivMain::RFC_Location_243_245::RFC_Loc243_245_AliveCtr_FaultInject == 0)//AC: No Error, calculate AC
    {
      ++counter_RFC_Location_243_245_RFC_Loc243_245_AliveCtr;
      counter_RFC_Location_243_245_RFC_Loc243_245_AliveCtr %=256;

      copyBitsToByteArrayLE(counter_RFC_Location_243_245_RFC_Loc243_245_AliveCtr,data,16,8); //Intel / little-endian;
    }
    else if (@CAN_PrivMain::RFC_Location_243_245::RFC_Loc243_245_AliveCtr_FaultInject == 1)//AC: Error sequence: set AC = 0
    {

      copyBitsToByteArrayLE(0,data,16,8); //Intel / little-endian;
    }
    else if (@CAN_PrivMain::RFC_Location_243_245::RFC_Loc243_245_AliveCtr_FaultInject == 2)//AC: Error sequence: Freeze last valid value
    {

      copyBitsToByteArrayLE(counter_RFC_Location_243_245_RFC_Loc243_245_AliveCtr,data,16,8); //Intel / little-endian;
    }
    if (@CAN_PrivMain::RFC_Location_243_245::RFC_Loc243_245_ProtBlockCtr_FaultInject != 3)//BC: user defined value
    {

    clearBitsInByteArrayLE(data,24,4); //Intel / little-endian

    }
    if (@CAN_PrivMain::RFC_Location_243_245::RFC_Loc243_245_ProtBlockCtr_FaultInject == 0)//BC: No Error, calculate BC
    {
      bc_RFC_Location_243_245_RFC_Loc243_245_ProtBlockCtr = bc_RFC_Location_ProtBlockCtr ;

      copyBitsToByteArrayLE(bc_RFC_Location_243_245_RFC_Loc243_245_ProtBlockCtr,data,24,4); //Intel / little-endian;
    }
    else if (@CAN_PrivMain::RFC_Location_243_245::RFC_Loc243_245_ProtBlockCtr_FaultInject == 1)//BC: Error sequence: set BC = 0
    {

      copyBitsToByteArrayLE(0,data,24,4); //Intel / little-endian;
    }
    else if (@CAN_PrivMain::RFC_Location_243_245::RFC_Loc243_245_ProtBlockCtr_FaultInject == 2)//BC: Error sequence: Freeze last valid value
    {

      copyBitsToByteArrayLE(bc_RFC_Location_243_245_RFC_Loc243_245_ProtBlockCtr,data,24,4); //Intel / little-endian;
    }
    if (@CAN_PrivMain::RFC_Location_243_245::RFC_Loc243_245_CRC_FaultInject != 3)//CRC: user defined value
    {

    clearBitsInByteArrayLE(data,0,16); //Intel / little-endian

    }
    if(@CAN_PrivMain::RFC_Location_243_245::RFC_Loc243_245_CRC_FaultInject == 0)//CRC: No Error, calculate CRC
    {
      crcTemp = CRC16_INIT;
      for(i = 2; i < (DataLength+2); i++)
      {
        if(i < DataLength)
          data_byte = data[i] ;
        else if(i == DataLength)
          data_byte = (0x2159 & 0x00FF);
        else if(i == (DataLength+1))
          data_byte = (0x2159 & 0xFF00) >> 8;
        else
          write("Error: DLC exceeded in CRC calculation");
        crcTemp ^= data_byte << 8;
        crcTemp = (crcTemp << (8)) ^ CRC16_CCITT_FALSE_POLY_1021H_Lookup[(crcTemp >> (8)) & (0xFF)];
      }
      crcTemp ^= CRC16_XOR;
      crc_RFC_Location_243_245_RFC_Loc243_245_CRC = crcTemp;

      copyBitsToByteArrayLE(crc_RFC_Location_243_245_RFC_Loc243_245_CRC,data,0,16); //Intel / little-endian;
    }
    else if(@CAN_PrivMain::RFC_Location_243_245::RFC_Loc243_245_CRC_FaultInject == 1)//CRC: Error, set to Zero
    {

      copyBitsToByteArrayLE(0,data,0,16); //Intel / little-endian;
    }
    else if(@CAN_PrivMain::RFC_Location_243_245::RFC_Loc243_245_CRC_FaultInject == 2)//CRC: Error, Freeze last valid value
    {

      copyBitsToByteArrayLE(crc_RFC_Location_243_245_RFC_Loc243_245_CRC,data,0,16); //Intel / little-endian;
    }
}


on sysvar CAN_PrivMain::RFC_Location_246_248::RFC_Location_246_248_ON_OFF
{
  if (@this == 1)
  {
     ILSetMsgEvent(RFC_Location_246_248);
     @CAN_PrivMain::RFC_Location_246_248::RFC_Location_246_248_ON_OFF = 0;
  }
}

void cfg_Msg_RFC_Location_246_248(dword aDlc, byte data[])
{
   int64 i,k;//For looping
   byte xor,data_byte;
   dword crcTemp;
   byte DataLength;
   dword Msg_id;
   
   DataLength = Msg_RFC_Location_246_248.DataLength;//Message Data Length
   Msg_id  = Msg_RFC_Location_246_248.id;//Message ID
   
    if (@CAN_PrivMain::RFC_Location_246_248::RFC_Loc246_248_AliveCtr_FaultInject != 3)//AC: user defined value
    {

    clearBitsInByteArrayLE(data,16,8); //Intel / little-endian

    }
    if (@CAN_PrivMain::RFC_Location_246_248::RFC_Loc246_248_AliveCtr_FaultInject == 0)//AC: No Error, calculate AC
    {
      ++counter_RFC_Location_246_248_RFC_Loc246_248_AliveCtr;
      counter_RFC_Location_246_248_RFC_Loc246_248_AliveCtr %=256;

      copyBitsToByteArrayLE(counter_RFC_Location_246_248_RFC_Loc246_248_AliveCtr,data,16,8); //Intel / little-endian;
    }
    else if (@CAN_PrivMain::RFC_Location_246_248::RFC_Loc246_248_AliveCtr_FaultInject == 1)//AC: Error sequence: set AC = 0
    {

      copyBitsToByteArrayLE(0,data,16,8); //Intel / little-endian;
    }
    else if (@CAN_PrivMain::RFC_Location_246_248::RFC_Loc246_248_AliveCtr_FaultInject == 2)//AC: Error sequence: Freeze last valid value
    {

      copyBitsToByteArrayLE(counter_RFC_Location_246_248_RFC_Loc246_248_AliveCtr,data,16,8); //Intel / little-endian;
    }
    if (@CAN_PrivMain::RFC_Location_246_248::RFC_Loc246_248_ProtBlockCtr_FaultInject != 3)//BC: user defined value
    {

    clearBitsInByteArrayLE(data,24,4); //Intel / little-endian

    }
    if (@CAN_PrivMain::RFC_Location_246_248::RFC_Loc246_248_ProtBlockCtr_FaultInject == 0)//BC: No Error, calculate BC
    {
      bc_RFC_Location_246_248_RFC_Loc246_248_ProtBlockCtr = bc_RFC_Location_ProtBlockCtr ;

      copyBitsToByteArrayLE(bc_RFC_Location_246_248_RFC_Loc246_248_ProtBlockCtr,data,24,4); //Intel / little-endian;
    }
    else if (@CAN_PrivMain::RFC_Location_246_248::RFC_Loc246_248_ProtBlockCtr_FaultInject == 1)//BC: Error sequence: set BC = 0
    {

      copyBitsToByteArrayLE(0,data,24,4); //Intel / little-endian;
    }
    else if (@CAN_PrivMain::RFC_Location_246_248::RFC_Loc246_248_ProtBlockCtr_FaultInject == 2)//BC: Error sequence: Freeze last valid value
    {

      copyBitsToByteArrayLE(bc_RFC_Location_246_248_RFC_Loc246_248_ProtBlockCtr,data,24,4); //Intel / little-endian;
    }
    if (@CAN_PrivMain::RFC_Location_246_248::RFC_Loc246_248_CRC_FaultInject != 3)//CRC: user defined value
    {

    clearBitsInByteArrayLE(data,0,16); //Intel / little-endian

    }
    if(@CAN_PrivMain::RFC_Location_246_248::RFC_Loc246_248_CRC_FaultInject == 0)//CRC: No Error, calculate CRC
    {
      crcTemp = CRC16_INIT;
      for(i = 2; i < (DataLength+2); i++)
      {
        if(i < DataLength)
          data_byte = data[i] ;
        else if(i == DataLength)
          data_byte = (0x215a & 0x00FF);
        else if(i == (DataLength+1))
          data_byte = (0x215a & 0xFF00) >> 8;
        else
          write("Error: DLC exceeded in CRC calculation");
        crcTemp ^= data_byte << 8;
        crcTemp = (crcTemp << (8)) ^ CRC16_CCITT_FALSE_POLY_1021H_Lookup[(crcTemp >> (8)) & (0xFF)];
      }
      crcTemp ^= CRC16_XOR;
      crc_RFC_Location_246_248_RFC_Loc246_248_CRC = crcTemp;

      copyBitsToByteArrayLE(crc_RFC_Location_246_248_RFC_Loc246_248_CRC,data,0,16); //Intel / little-endian;
    }
    else if(@CAN_PrivMain::RFC_Location_246_248::RFC_Loc246_248_CRC_FaultInject == 1)//CRC: Error, set to Zero
    {

      copyBitsToByteArrayLE(0,data,0,16); //Intel / little-endian;
    }
    else if(@CAN_PrivMain::RFC_Location_246_248::RFC_Loc246_248_CRC_FaultInject == 2)//CRC: Error, Freeze last valid value
    {

      copyBitsToByteArrayLE(crc_RFC_Location_246_248_RFC_Loc246_248_CRC,data,0,16); //Intel / little-endian;
    }
}


on sysvar CAN_PrivMain::RFC_Location_249_251::RFC_Location_249_251_ON_OFF
{
  if (@this == 1)
  {
     ILSetMsgEvent(RFC_Location_249_251);
     @CAN_PrivMain::RFC_Location_249_251::RFC_Location_249_251_ON_OFF = 0;
  }
}

void cfg_Msg_RFC_Location_249_251(dword aDlc, byte data[])
{
   int64 i,k;//For looping
   byte xor,data_byte;
   dword crcTemp;
   byte DataLength;
   dword Msg_id;
   
   DataLength = Msg_RFC_Location_249_251.DataLength;//Message Data Length
   Msg_id  = Msg_RFC_Location_249_251.id;//Message ID
   
    if (@CAN_PrivMain::RFC_Location_249_251::RFC_Loc249_251_AliveCtr_FaultInject != 3)//AC: user defined value
    {

    clearBitsInByteArrayLE(data,16,8); //Intel / little-endian

    }
    if (@CAN_PrivMain::RFC_Location_249_251::RFC_Loc249_251_AliveCtr_FaultInject == 0)//AC: No Error, calculate AC
    {
      ++counter_RFC_Location_249_251_RFC_Loc249_251_AliveCtr;
      counter_RFC_Location_249_251_RFC_Loc249_251_AliveCtr %=256;

      copyBitsToByteArrayLE(counter_RFC_Location_249_251_RFC_Loc249_251_AliveCtr,data,16,8); //Intel / little-endian;
    }
    else if (@CAN_PrivMain::RFC_Location_249_251::RFC_Loc249_251_AliveCtr_FaultInject == 1)//AC: Error sequence: set AC = 0
    {

      copyBitsToByteArrayLE(0,data,16,8); //Intel / little-endian;
    }
    else if (@CAN_PrivMain::RFC_Location_249_251::RFC_Loc249_251_AliveCtr_FaultInject == 2)//AC: Error sequence: Freeze last valid value
    {

      copyBitsToByteArrayLE(counter_RFC_Location_249_251_RFC_Loc249_251_AliveCtr,data,16,8); //Intel / little-endian;
    }
    if (@CAN_PrivMain::RFC_Location_249_251::RFC_Loc249_251_ProtBlockCtr_FaultInject != 3)//BC: user defined value
    {

    clearBitsInByteArrayLE(data,24,4); //Intel / little-endian

    }
    if (@CAN_PrivMain::RFC_Location_249_251::RFC_Loc249_251_ProtBlockCtr_FaultInject == 0)//BC: No Error, calculate BC
    {
      bc_RFC_Location_249_251_RFC_Loc249_251_ProtBlockCtr = bc_RFC_Location_ProtBlockCtr ;

      copyBitsToByteArrayLE(bc_RFC_Location_249_251_RFC_Loc249_251_ProtBlockCtr,data,24,4); //Intel / little-endian;
    }
    else if (@CAN_PrivMain::RFC_Location_249_251::RFC_Loc249_251_ProtBlockCtr_FaultInject == 1)//BC: Error sequence: set BC = 0
    {

      copyBitsToByteArrayLE(0,data,24,4); //Intel / little-endian;
    }
    else if (@CAN_PrivMain::RFC_Location_249_251::RFC_Loc249_251_ProtBlockCtr_FaultInject == 2)//BC: Error sequence: Freeze last valid value
    {

      copyBitsToByteArrayLE(bc_RFC_Location_249_251_RFC_Loc249_251_ProtBlockCtr,data,24,4); //Intel / little-endian;
    }
    if (@CAN_PrivMain::RFC_Location_249_251::RFC_Loc249_251_CRC_FaultInject != 3)//CRC: user defined value
    {

    clearBitsInByteArrayLE(data,0,16); //Intel / little-endian

    }
    if(@CAN_PrivMain::RFC_Location_249_251::RFC_Loc249_251_CRC_FaultInject == 0)//CRC: No Error, calculate CRC
    {
      crcTemp = CRC16_INIT;
      for(i = 2; i < (DataLength+2); i++)
      {
        if(i < DataLength)
          data_byte = data[i] ;
        else if(i == DataLength)
          data_byte = (0x215b & 0x00FF);
        else if(i == (DataLength+1))
          data_byte = (0x215b & 0xFF00) >> 8;
        else
          write("Error: DLC exceeded in CRC calculation");
        crcTemp ^= data_byte << 8;
        crcTemp = (crcTemp << (8)) ^ CRC16_CCITT_FALSE_POLY_1021H_Lookup[(crcTemp >> (8)) & (0xFF)];
      }
      crcTemp ^= CRC16_XOR;
      crc_RFC_Location_249_251_RFC_Loc249_251_CRC = crcTemp;

      copyBitsToByteArrayLE(crc_RFC_Location_249_251_RFC_Loc249_251_CRC,data,0,16); //Intel / little-endian;
    }
    else if(@CAN_PrivMain::RFC_Location_249_251::RFC_Loc249_251_CRC_FaultInject == 1)//CRC: Error, set to Zero
    {

      copyBitsToByteArrayLE(0,data,0,16); //Intel / little-endian;
    }
    else if(@CAN_PrivMain::RFC_Location_249_251::RFC_Loc249_251_CRC_FaultInject == 2)//CRC: Error, Freeze last valid value
    {

      copyBitsToByteArrayLE(crc_RFC_Location_249_251_RFC_Loc249_251_CRC,data,0,16); //Intel / little-endian;
    }
}


on sysvar CAN_PrivMain::RFC_Location_252_254::RFC_Location_252_254_ON_OFF
{
  if (@this == 1)
  {
     ILSetMsgEvent(RFC_Location_252_254);
     @CAN_PrivMain::RFC_Location_252_254::RFC_Location_252_254_ON_OFF = 0;
  }
}

void cfg_Msg_RFC_Location_252_254(dword aDlc, byte data[])
{
   int64 i,k;//For looping
   byte xor,data_byte;
   dword crcTemp;
   byte DataLength;
   dword Msg_id;
   
   DataLength = Msg_RFC_Location_252_254.DataLength;//Message Data Length
   Msg_id  = Msg_RFC_Location_252_254.id;//Message ID
   
    if (@CAN_PrivMain::RFC_Location_252_254::RFC_Loc252_254_AliveCtr_FaultInject != 3)//AC: user defined value
    {

    clearBitsInByteArrayLE(data,16,8); //Intel / little-endian

    }
    if (@CAN_PrivMain::RFC_Location_252_254::RFC_Loc252_254_AliveCtr_FaultInject == 0)//AC: No Error, calculate AC
    {
      ++counter_RFC_Location_252_254_RFC_Loc252_254_AliveCtr;
      counter_RFC_Location_252_254_RFC_Loc252_254_AliveCtr %=256;

      copyBitsToByteArrayLE(counter_RFC_Location_252_254_RFC_Loc252_254_AliveCtr,data,16,8); //Intel / little-endian;
    }
    else if (@CAN_PrivMain::RFC_Location_252_254::RFC_Loc252_254_AliveCtr_FaultInject == 1)//AC: Error sequence: set AC = 0
    {

      copyBitsToByteArrayLE(0,data,16,8); //Intel / little-endian;
    }
    else if (@CAN_PrivMain::RFC_Location_252_254::RFC_Loc252_254_AliveCtr_FaultInject == 2)//AC: Error sequence: Freeze last valid value
    {

      copyBitsToByteArrayLE(counter_RFC_Location_252_254_RFC_Loc252_254_AliveCtr,data,16,8); //Intel / little-endian;
    }
    if (@CAN_PrivMain::RFC_Location_252_254::RFC_Loc252_254_ProtBlockCtr_FaultInject != 3)//BC: user defined value
    {

    clearBitsInByteArrayLE(data,24,4); //Intel / little-endian

    }
    if (@CAN_PrivMain::RFC_Location_252_254::RFC_Loc252_254_ProtBlockCtr_FaultInject == 0)//BC: No Error, calculate BC
    {
      bc_RFC_Location_252_254_RFC_Loc252_254_ProtBlockCtr = bc_RFC_Location_ProtBlockCtr ;

      copyBitsToByteArrayLE(bc_RFC_Location_252_254_RFC_Loc252_254_ProtBlockCtr,data,24,4); //Intel / little-endian;
    }
    else if (@CAN_PrivMain::RFC_Location_252_254::RFC_Loc252_254_ProtBlockCtr_FaultInject == 1)//BC: Error sequence: set BC = 0
    {

      copyBitsToByteArrayLE(0,data,24,4); //Intel / little-endian;
    }
    else if (@CAN_PrivMain::RFC_Location_252_254::RFC_Loc252_254_ProtBlockCtr_FaultInject == 2)//BC: Error sequence: Freeze last valid value
    {

      copyBitsToByteArrayLE(bc_RFC_Location_252_254_RFC_Loc252_254_ProtBlockCtr,data,24,4); //Intel / little-endian;
    }
    if (@CAN_PrivMain::RFC_Location_252_254::RFC_Loc252_254_CRC_FaultInject != 3)//CRC: user defined value
    {

    clearBitsInByteArrayLE(data,0,16); //Intel / little-endian

    }
    if(@CAN_PrivMain::RFC_Location_252_254::RFC_Loc252_254_CRC_FaultInject == 0)//CRC: No Error, calculate CRC
    {
      crcTemp = CRC16_INIT;
      for(i = 2; i < (DataLength+2); i++)
      {
        if(i < DataLength)
          data_byte = data[i] ;
        else if(i == DataLength)
          data_byte = (0x215c & 0x00FF);
        else if(i == (DataLength+1))
          data_byte = (0x215c & 0xFF00) >> 8;
        else
          write("Error: DLC exceeded in CRC calculation");
        crcTemp ^= data_byte << 8;
        crcTemp = (crcTemp << (8)) ^ CRC16_CCITT_FALSE_POLY_1021H_Lookup[(crcTemp >> (8)) & (0xFF)];
      }
      crcTemp ^= CRC16_XOR;
      crc_RFC_Location_252_254_RFC_Loc252_254_CRC = crcTemp;

      copyBitsToByteArrayLE(crc_RFC_Location_252_254_RFC_Loc252_254_CRC,data,0,16); //Intel / little-endian;
    }
    else if(@CAN_PrivMain::RFC_Location_252_254::RFC_Loc252_254_CRC_FaultInject == 1)//CRC: Error, set to Zero
    {

      copyBitsToByteArrayLE(0,data,0,16); //Intel / little-endian;
    }
    else if(@CAN_PrivMain::RFC_Location_252_254::RFC_Loc252_254_CRC_FaultInject == 2)//CRC: Error, Freeze last valid value
    {

      copyBitsToByteArrayLE(crc_RFC_Location_252_254_RFC_Loc252_254_CRC,data,0,16); //Intel / little-endian;
    }
}


on sysvar CAN_PrivMain::RFC_Status::RFC_Status_ON_OFF
{
  if (@this == 1)
  {
    ILFaultInjectionEnableMsg(RFC_Status);
  }
  else{
         ILFaultInjectionDisableMsg(RFC_Status);
      }
}

void cfg_Msg_RFC_Status(dword aDlc, byte data[])
{
   int64 i,k;//For looping
   byte xor,data_byte;
   dword crcTemp;
   byte DataLength;
   dword Msg_id;
   
   DataLength = Msg_RFC_Status.DataLength;//Message Data Length
   Msg_id  = Msg_RFC_Status.id;//Message ID
   
    if (@CAN_PrivMain::RFC_Status::RFC_Status_AliveCtr_FaultInject != 3)//AC: user defined value
    {

    clearBitsInByteArrayLE(data,8,4); //Intel / little-endian

    }
    if (@CAN_PrivMain::RFC_Status::RFC_Status_AliveCtr_FaultInject == 0)//AC: No Error, calculate AC
    {
      ++counter_RFC_Status_RFC_Status_AliveCtr;
      counter_RFC_Status_RFC_Status_AliveCtr %=16;

      copyBitsToByteArrayLE(counter_RFC_Status_RFC_Status_AliveCtr,data,8,4); //Intel / little-endian;
    }
    else if (@CAN_PrivMain::RFC_Status::RFC_Status_AliveCtr_FaultInject == 1)//AC: Error sequence: set AC = 0
    {

      copyBitsToByteArrayLE(0,data,8,4); //Intel / little-endian;
    }
    else if (@CAN_PrivMain::RFC_Status::RFC_Status_AliveCtr_FaultInject == 2)//AC: Error sequence: Freeze last valid value
    {

      copyBitsToByteArrayLE(counter_RFC_Status_RFC_Status_AliveCtr,data,8,4); //Intel / little-endian;
    }
    if (@CAN_PrivMain::RFC_Status::RFC_Status_CRC_FaultInject != 3)//CRC: user defined value
    {

    clearBitsInByteArrayLE(data,0,8); //Intel / little-endian

    }
    if(@CAN_PrivMain::RFC_Status::RFC_Status_CRC_FaultInject == 0)//CRC: No Error, calculate CRC
    {
      xor = initialization_value;
      for(i = 0; i < DataLength; i++)
      {
        if(i==0)
          xor = CRC8_SAE_J1850_Poly_1D_Lookup[Data_ID_Lookup_PRIVATE(Msg_id) ^ xor];
        else
          xor = CRC8_SAE_J1850_Poly_1D_Lookup[ data[i] ^ xor ];
      }
      crc_RFC_Status_RFC_Status_CRC = result_XOR_value ^ xor;

      copyBitsToByteArrayLE(crc_RFC_Status_RFC_Status_CRC,data,0,8); //Intel / little-endian;
    }
    else if(@CAN_PrivMain::RFC_Status::RFC_Status_CRC_FaultInject == 1)//CRC: Error, set to Zero
    {

      copyBitsToByteArrayLE(0,data,0,8); //Intel / little-endian;
    }
    else if(@CAN_PrivMain::RFC_Status::RFC_Status_CRC_FaultInject == 2)//CRC: Error, Freeze last valid value
    {

      copyBitsToByteArrayLE(crc_RFC_Status_RFC_Status_CRC,data,0,8); //Intel / little-endian;
    }
}


on sysvar CAN_PrivMain::RFC_Status::RFC_Status_CycleTime
{
  ILFaultInjectionSetMsgCycleTime(RFC_Status,@this);
  //ILFaultInjectionResetMsgCycleTime(RFC_Status);
}

void FRadarLoc_sim_SetCycleTimeOffset()
{

//  ILNodeSetPDUTimingCyclic (dbMsg dbMessage, long TrueOrFalse, long offset, long period, long disturbanceCount, long flags);
//  TrueOrFalse ; 0: denotes the False timing; 1: denotes the True timing; 3: denotes the True and the False timing.
//  offset :Defines the delay in [ms] from now when the first cyclic transmission will start.
//  period :Defines the period in [ms] for the cyclic transmission.
//  disturbanceCount :Reserved/unused; should be set to -1 (infinite).
//  flags :Reserved; should be set to 0.

}