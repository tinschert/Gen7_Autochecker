/*@!Encoding:1252*/
/**
 * @file DMS_CAN_ADAS.can
 * @author ADAS_HIL_TEAM
 * @date 10-04-2022
 * @brief 
 *
 * ################################################################
 * C O P Y R I G H T S
 * ----------------------------------------------------------------
 * Copyright (c) 2022-2023 by Robert Bosch GmbH. All rights reserved.
 
 * The reproduction, distribution and utilization of this file as
 * well as the communication of its contents to others without express
 * authorization is prohibited. Offenders will be held liable for the
 * payment of damages. All rights reserved in the event of the grant
 * of a patent, utility model or design.
 *
 * ################################################################
*/

// Autogenerated by -> Platform\Classe\Scripts\Rbs_Scripts\create_nodes.py
includes
{
  #pragma library ("C:\ProgramData\Vector\AddOn Packages\Vector AddOn\vModules\CANoeILNLVector.vmodule")
  #include "CAPL\DataHandling.cin" /*DataHandling for IL*/
  #include "CAPL\E2E.cin" /*OD Specific for CRC calculation */
}

variables {
  message DMS_HSC4_FrP01 Msg_DMS_HSC4_FrP01;

  word counter_DMS_HSC4_FrP01_DMS_FrP01_RolingCounterHSC4;

  byte chksum_DMS_HSC4_FrP01_DMS_FrP01_ChecksumHSC4;

}

on preStart {
  long result;
  result=ILControlInit ();//Initialization of CANoe IL,to prevent the IL autostart function.
  switch(result)
  {
    case  0   : write("ILControlInit :: DMS :: No error."); break;
    case -1   : write("ILControlInit :: DMS :: Momentary state of the IL does not permit this query."); break;
    case -50  : write("ILControlInit :: DMS :: Nodelayer is inactive - possibly deactivated in the nodes configuration dialog.");  break;
   }

  DMS_sim_Disable();
  DMS_sim_SetCycleTimeOffset();
}

on start {

  ILControlSimulationOn();//Starts the simulation of the IL.
  DMS_sim_SetCANFDParameter();
  ILControlStart ();//Cyclical sending starts; setting signals is now possible.
  DMS_sim_Reset();
}

on stopMeasurement {

  DMS_sim_DisableMsg();
  DMS_sim_Disable();
  ILControlStop();//Cyclical sending is stopped; setting signals is now no longer possible.
  ILControlSimulationOff();//Stops the simulation of the IL. After that no other function to control the IL has an effect to the IL.

}

on sysvar_update hil_ctrl::dms_sim
{
  DMS_sim_Reset();
}

on sysvar_update hil_ctrl::variant
{
  DMS_sim_Reset();
}

on sysvar_update Cus_bus::bus_CAN_ADAS_ON_OFF
{
  DMS_sim_Reset();
}

void DMS_sim_Reset()
{

  DMS_sim_DisableMsg();
  DMS_sim_Disable();

  if ((@Cus_bus::bus_CAN_ADAS_ON_OFF == 1) && (@hil_ctrl::dms_sim == 1))
  {
    switch(@hil_ctrl::variant)
    {
      case a_variant:DMS_sim_start_a_variant();break;
      case b_variant:DMS_sim_start_b_variant();break;
    }
    if (@hil_ctrl::hil_mode == @hil_ctrl::hil_mode::Restbus) 
    {
       DMS_sim_EnableEventMsg();
    }
    else
    {
       DMS_sim_DisableEventMsg();
    }
  }
}

void DMS_sim_start_a_variant()
{
  @CAN_ADAS::DMS_HSC4_FrP01::DMS_HSC4_FrP01_ON_OFF = 1;
}

void DMS_sim_start_b_variant()
{
  @CAN_ADAS::DMS_HSC4_FrP01::DMS_HSC4_FrP01_ON_OFF = 1;
}

void DMS_sim_Disable()
{
  @CAN_ADAS::DMS_HSC4_FrP01::DMS_HSC4_FrP01_ON_OFF = 0;
}

void DMS_sim_DisableMsg()
{
   ILFaultInjectionDisableMsg(CAN_ADAS::DMS_HSC4_FrP01);
}
on sysvar hil_ctrl::hil_mode
{
  DMS_sim_Reset();
}

void DMS_sim_DisableEventMsg()
{

}

void DMS_sim_EnableEventMsg()
{

}
void DMS_sim_SetCANParameter()
{
  //For future purpose
  //ILFaultInjectionSetMsgDlc(dbMsg msg, dword dlc)
  //ILFaultInjectionSetMsgLength(dbMsg msg, dword msgLength)
  //ILFaultInjectionResetMsgDlc(dbMsg msg)
  //ILFaultInjectionResetMsgLength (dbMsg msg)
}

void DMS_sim_SetCANFDParameter()
{
   //CAN FD Parameter Setting
   int FDF =1;
   int BRS =1;
   ILSetCANFDParam(CAN_ADAS::DMS_HSC4_FrP01,FDF,BRS,CAN_ADAS::DMS_HSC4_FrP01.dlc);
}

dword applILTxPending (long aId, dword aDlc, byte data[])//This callback is being called before the IL sends a message to the bus
{
  switch(aId)
  {
    case CAN_ADAS::DMS_HSC4_FrP01.id:cfg_Msg_DMS_HSC4_FrP01(aDlc, data);break;
    default :;//write("Node:DMS ::No Cyclic event");
           break;
  }
  return 1; // don't prevent sending of the message
}

on sysvar CAN_ADAS::DMS_HSC4_FrP01::DMS_HSC4_FrP01_ON_OFF
{
  if (@this == 1)
  {
    ILFaultInjectionEnableMsg(CAN_ADAS::DMS_HSC4_FrP01);
  }
  else{
         ILFaultInjectionDisableMsg(CAN_ADAS::DMS_HSC4_FrP01);
      }
}

void cfg_Msg_DMS_HSC4_FrP01(dword aDlc, byte data[])
{
   int64 i,k;//For looping
   byte xor,data_byte;
   dword crcTemp;
   byte DataLength;
   dword Msg_id;
   
   DataLength = Msg_DMS_HSC4_FrP01.DataLength;//Message Data Length
   Msg_id  = Msg_DMS_HSC4_FrP01.id;//Message ID
   
    if (@CAN_ADAS::DMS_HSC4_FrP01::DMS_FrP01_RolingCounterHSC4_FaultInject != 3)//AC: user defined value
    {

    clearBitsInByteArrayBE(data,48,51,4); //Motorola / Big-endian

    }
    if (@CAN_ADAS::DMS_HSC4_FrP01::DMS_FrP01_RolingCounterHSC4_FaultInject == 0)//AC: No Error, calculate AC
    {
      ++counter_DMS_HSC4_FrP01_DMS_FrP01_RolingCounterHSC4;
      counter_DMS_HSC4_FrP01_DMS_FrP01_RolingCounterHSC4 %=15;

      copyBitsToByteArrayBE(counter_DMS_HSC4_FrP01_DMS_FrP01_RolingCounterHSC4,data,48,4); //Motorola / Big-endian
    }
    else if (@CAN_ADAS::DMS_HSC4_FrP01::DMS_FrP01_RolingCounterHSC4_FaultInject == 1)//AC: Error sequence: set AC = 0
    {

      copyBitsToByteArrayBE(0,data,48,4); //Motorola / Big-endian
    }
    else if (@CAN_ADAS::DMS_HSC4_FrP01::DMS_FrP01_RolingCounterHSC4_FaultInject == 2)//AC: Error sequence: Freeze last valid value
    {

      copyBitsToByteArrayBE(counter_DMS_HSC4_FrP01_DMS_FrP01_RolingCounterHSC4,data,48,4); //Motorola / Big-endian
    }
    if (@CAN_ADAS::DMS_HSC4_FrP01::DMS_FrP01_ChecksumHSC4_FaultInject != 3)//CRC: user defined value
    {

    clearBitsInByteArrayBE(data,56,63,8); //Motorola / Big-endian

    }
    if(@CAN_ADAS::DMS_HSC4_FrP01::DMS_FrP01_ChecksumHSC4_FaultInject == 0)//CRC: No Error, calculate CRC
    {
      xor = initialization_value;
      for(i = 0; i < DataLength; i++)
      {
        if(i==0)
          xor = CRC8_SAE_J1850_Poly_1D_Lookup[Data_ID_Lookup(Msg_id) ^ xor];
        else
          xor = CRC8_SAE_J1850_Poly_1D_Lookup[ data[i] ^ xor ];
      }
      chksum_DMS_HSC4_FrP01_DMS_FrP01_ChecksumHSC4 = result_XOR_value ^ xor;

      copyBitsToByteArrayBE(chksum_DMS_HSC4_FrP01_DMS_FrP01_ChecksumHSC4,data,56,8); //Motorola / Big-endian
    }
    else if(@CAN_ADAS::DMS_HSC4_FrP01::DMS_FrP01_ChecksumHSC4_FaultInject == 1)//CRC: Error, set to Zero
    {

      copyBitsToByteArrayBE(0,data,56,8); //Motorola / Big-endian
    }
    else if(@CAN_ADAS::DMS_HSC4_FrP01::DMS_FrP01_ChecksumHSC4_FaultInject == 2)//CRC: Error, Freeze last valid value
    {

      copyBitsToByteArrayBE(chksum_DMS_HSC4_FrP01_DMS_FrP01_ChecksumHSC4,data,56,8); //Motorola / Big-endian
    }
}


on sysvar CAN_ADAS::DMS_HSC4_FrP01::DMS_HSC4_FrP01_CycleTime
{
  ILFaultInjectionSetMsgCycleTime(CAN_ADAS::DMS_HSC4_FrP01,@this);
  //ILFaultInjectionResetMsgCycleTime(DMS_HSC4_FrP01);
}

void DMS_sim_SetCycleTimeOffset()
{

//  ILNodeSetPDUTimingCyclic (dbMsg dbMessage, long TrueOrFalse, long offset, long period, long disturbanceCount, long flags);
//  TrueOrFalse ; 0: denotes the False timing; 1: denotes the True timing; 3: denotes the True and the False timing.
//  offset :Defines the delay in [ms] from now when the first cyclic transmission will start.
//  period :Defines the period in [ms] for the cyclic transmission.
//  disturbanceCount :Reserved/unused; should be set to -1 (infinite).
//  flags :Reserved; should be set to 0.

}