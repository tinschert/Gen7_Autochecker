/*@!Encoding:1252*/
// Autogenerated by -> Platform\Classe\Scripts\Rbs_Scripts\create_nodes.py
includes
{
  #pragma library ("C:\ProgramData\Vector\AddOn Packages\Vector AddOn\vModules\AsrPDUIL2.vmodule")
  #include "CAPL\DataHandling.cin" /*DataHandling for IL*/
  #include "CAPL\E2E.cin" /*OD Specific for CRC calculation */
  #include "OSEKTP\OSEKTP.cin"  //common definations for osektp
  #if ADAS_HIL
    #pragma library("..\..\..\Platform\Classe\DLL\star_model\capldll.dll")
    #pragma library("..\..\..\Platform\Classe\DLL\clara_model\Release64\clara_model.dll")
  #endif
  #include "OSEKTP\OSEKTP_CAN_PrivMain_CRadarFL_RFL_Object_NPdu_Data.cin"  ///For handling  pdu RFL_Object_NPdu_Data with OSEKtp
}

variables {
  int Token_FC_RFL_Object = 0;
  message RFL_VehOutput Msg_RFL_VehOutput;

}

on preStart {
  long result;
  result=ARILControlInit ();//Initialization of AUTOSAR PDU IL,to prevent the IL autostart function.
  switch(result)
  {
    case  0    : write("ARILControlInit :: CRadarFL :: No error."); break;
    case -1    : write("ARILControlInit :: CRadarFL :: IL is in a state that ignores the given request: State graph of the IL (Link)."); break;
    case -2    : write("ARILControlInit :: CRadarFL :: Allowed value range of a signal exceeded. (The exceeded value is transmitted to the bus nevertheless).");  break;
    case -50   : write("ARILControlInit :: CRadarFL :: Node layer is not active. Presumably it is deactivated in the node’s configuration dialog."); break;
    case -51   : write("ARILControlInit :: CRadarFL :: The node is connected to another bus like the CAN Bus."); break;
    case -100  : write("ARILControlInit :: CRadarFL :: Signal/message not found in DB, or not mapped to the node."); break;
    case -101  : write("ARILControlInit :: CRadarFL :: Maximum possible value range exceeded. (There is no transmission to the bus)."); break;
    case -102  : write("ARILControlInit :: CRadarFL :: A network management-, diagnostic, or transport protocol signal was set. IL declines such types of signals, because it is not intended to connect these layers to the IL."); break;
    case -103  : write("ARILControlInit :: CRadarFL :: Invalid value supplied (for all types of requests)."); break;
    case -104  : write("ARILControlInit :: CRadarFL :: General error for invalid requests that are not described furthermore."); break;
   }

  CRadarFL_sim_Disable();
  CRadarFL_sim_SetCycleTimeOffset();
}

on start {

  ARILControlSimulationOn();//Starts the simulation of the IL. The IL is operational and started. The IL will send PDUs.
  CRadarFL_sim_DisableMsg();
  CRadarFL_sim_Disable();
  ARILControlStart ();//When the IL is started, then it is fully operating and sending.
  CRadarFL_sim_Reset();
  OnStart_init_CANTP_CRadarFL();
  OnStart_callTx_CRadarFL_RFL_Object_NPdu_Data();
}

OnStart_init_CANTP_CRadarFL()
{
  long dbHandle; 
  dbHandle = CanTpGetDBConnection();
  if (dbHandle > 0) 
  { 
    CanTpCloseConnection(dbHandle); 
  }
}

on stopMeasurement {

  CRadarFL_sim_DisableMsg();
  CRadarFL_sim_Disable();
  ARILControlStop();//Stops sending of PDUs.
  ARILControlSimulationOff();//Stops the simulation of the IL. The IL is not operational. All API function except function ARILControlSimulationOn will not work.

}

on sysvar_update hil_ctrl::ra6_fl_sgu_obj_sim
{
  CRadarFL_sim_Reset();
}

on sysvar_update hil_ctrl::variant
{
  CRadarFL_sim_Reset();
}

on sysvar_update Cus_bus::bus_CAN_PrivMain_ON_OFF
{
  CRadarFL_sim_Reset();
}

void CRadarFL_sim_Reset()
{

  CRadarFL_sim_DisableMsg();
  CRadarFL_sim_Disable();

  if ((@Cus_bus::bus_CAN_PrivMain_ON_OFF == 1) && (@hil_ctrl::ra6_fl_sgu_obj_sim == 1))
  {
    switch(@hil_ctrl::variant)
    {
      case a_variant:CRadarFL_sim_start_a_variant();break;
      case b_variant:CRadarFL_sim_start_b_variant();break;
    }
    if (@hil_ctrl::hil_mode == @hil_ctrl::hil_mode::Restbus) 
    {
       CRadarFL_sim_EnableEventMsg();
    }
    else
    {
       CRadarFL_sim_DisableEventMsg();
    }
  }
}

void CRadarFL_sim_start_a_variant()
{
  @CAN_PrivMain::RFL_VehOutput::RFL_VehOutput_ON_OFF = 1;
  //@CAN_PrivMain::RFL_Object::RFL_Object_ON_OFF = 1;
}

void CRadarFL_sim_start_b_variant()
{
  @CAN_PrivMain::RFL_VehOutput::RFL_VehOutput_ON_OFF = 1;
  //@CAN_PrivMain::RFL_Object::RFL_Object_ON_OFF = 1;
}

void CRadarFL_sim_Disable()
{
  @CAN_PrivMain::RFL_VehOutput::RFL_VehOutput_ON_OFF = 0;
  @CAN_PrivMain::RFL_Object::RFL_Object_ON_OFF = 0;
}

void CRadarFL_sim_DisableMsg()
{
   ARILFaultInjectionDisablePDU(RFL_VehOutput);
}
on sysvar hil_ctrl::hil_mode
{
  CRadarFL_sim_Reset();
}

void CRadarFL_sim_DisableEventMsg()
{

}

void CRadarFL_sim_EnableEventMsg()
{

}

dword applPDUILTxPending (dword busContext, dword shortID, dword longID, char name[], dword & aPDULength, byte data[])//This callback is being called before the IL sends a PDU to the bus
{
  if(strncmp(name, "RFL_VehOutput", elcount(name)) == 0)
  {
    cfg_Pdu_RFL_VehOutput(aPDULength, data);
    return 1; // don't prevent sending of the pdu
  }
  return 1; // don't prevent sending of the pdu
}

on sysvar CAN_PrivMain::RFL_Object::RFL_Object_ON_OFF
{
  if ((@this == 1)&& (@hil_ctrl::ra6_fl_sgu_obj_sim == 1))
   {
      Transmit_Pdu_CRadarFL_RFL_Object();
      @sysvar::CAN_PrivMain::RFL_Object::RFL_Object_ON_OFF= 0;
   }
}
 


void RXX_Object_Obj49_write(byte byteArray[])
{
    qword raw_value;

    raw_value = convertPhysicalToRaw(@CAN_PrivMain::RFL_Object::RXX_Object_Obj49.Ay, 0.0625, -16.0);
    copyBitsToByteArrayLE(raw_value, byteArray, 25750, 9);

    raw_value = convertPhysicalToRaw(@CAN_PrivMain::RFL_Object::RXX_Object_Obj49.OrientationYawVnce, 0.0003, 0.0);
    copyBitsToByteArrayLE(raw_value, byteArray, 25708, 12);

    raw_value = convertPhysicalToRaw(@CAN_PrivMain::RFL_Object::RXX_Object_Obj49.ExistProb, 2.0, 0.0);
    copyBitsToByteArrayLE(raw_value, byteArray, 25816, 6);

    raw_value = convertPhysicalToRaw(@CAN_PrivMain::RFL_Object::RXX_Object_Obj49.MovingStatus, 1.0, 0.0);
    copyBitsToByteArrayLE(raw_value, byteArray, 25804, 2);

    raw_value = convertPhysicalToRaw(@CAN_PrivMain::RFL_Object::RXX_Object_Obj49.VxVnce, 0.01, 0.0);
    copyBitsToByteArrayLE(raw_value, byteArray, 25792, 12);

    raw_value = convertPhysicalToRaw(@CAN_PrivMain::RFL_Object::RXX_Object_Obj49.ObjId, 1.0, 0.0);
    copyBitsToByteArrayLE(raw_value, byteArray, 25784, 7);

    raw_value = convertPhysicalToRaw(@CAN_PrivMain::RFL_Object::RXX_Object_Obj49.Vx, 0.0625, -128.0);
    copyBitsToByteArrayLE(raw_value, byteArray, 25772, 12);

    raw_value = convertPhysicalToRaw(@CAN_PrivMain::RFL_Object::RXX_Object_Obj49.AyVnce, 0.01, 0.0);
    copyBitsToByteArrayLE(raw_value, byteArray, 25760, 12);

    raw_value = convertPhysicalToRaw(@CAN_PrivMain::RFL_Object::RXX_Object_Obj49.RCS, 0.2, -102.4);
    copyBitsToByteArrayLE(raw_value, byteArray, 25740, 10);

    raw_value = convertPhysicalToRaw(@CAN_PrivMain::RFL_Object::RXX_Object_Obj49.WidthVnce, 0.01, 0.0);
    copyBitsToByteArrayLE(raw_value, byteArray, 25728, 12);

    raw_value = convertPhysicalToRaw(@CAN_PrivMain::RFL_Object::RXX_Object_Obj49.Width, 0.125, 0.0);
    copyBitsToByteArrayLE(raw_value, byteArray, 25720, 7);

    raw_value = convertPhysicalToRaw(@CAN_PrivMain::RFL_Object::RXX_Object_Obj49.AxVnce, 0.01, 0.0);
    copyBitsToByteArrayLE(raw_value, byteArray, 25696, 12);

    raw_value = convertPhysicalToRaw(@CAN_PrivMain::RFL_Object::RXX_Object_Obj49.PxPyCoVnce, 0.01, 0.0);
    copyBitsToByteArrayLE(raw_value, byteArray, 25836, 12);

    raw_value = convertPhysicalToRaw(@CAN_PrivMain::RFL_Object::RXX_Object_Obj49.OrientationYaw, 0.0175, -4.48);
    copyBitsToByteArrayLE(raw_value, byteArray, 25686, 9);

    raw_value = convertPhysicalToRaw(@CAN_PrivMain::RFL_Object::RXX_Object_Obj49.Ax, 0.03125, -16.0);
    copyBitsToByteArrayLE(raw_value, byteArray, 25676, 10);

    raw_value = convertPhysicalToRaw(@CAN_PrivMain::RFL_Object::RXX_Object_Obj49.LengthVnce, 0.01, 0.0);
    copyBitsToByteArrayLE(raw_value, byteArray, 25664, 12);

    raw_value = convertPhysicalToRaw(@CAN_PrivMain::RFL_Object::RXX_Object_Obj49.Length, 0.125, 0.0);
    copyBitsToByteArrayLE(raw_value, byteArray, 25656, 7);

    raw_value = convertPhysicalToRaw(@CAN_PrivMain::RFL_Object::RXX_Object_Obj49.PyVnce, 0.1, 0.0);
    copyBitsToByteArrayLE(raw_value, byteArray, 25644, 12);

    raw_value = convertPhysicalToRaw(@CAN_PrivMain::RFL_Object::RXX_Object_Obj49.Py, 0.0625, -128.0);
    copyBitsToByteArrayLE(raw_value, byteArray, 25632, 12);

    raw_value = convertPhysicalToRaw(@CAN_PrivMain::RFL_Object::RXX_Object_Obj49.PxVnce, 0.1, 0.0);
    copyBitsToByteArrayLE(raw_value, byteArray, 25620, 12);

    raw_value = convertPhysicalToRaw(@CAN_PrivMain::RFL_Object::RXX_Object_Obj49.Px, 0.0625, -512.0);
    copyBitsToByteArrayLE(raw_value, byteArray, 25606, 14);

    raw_value = convertPhysicalToRaw(@CAN_PrivMain::RFL_Object::RXX_Object_Obj49.ProbClassConfidence, 2.0, 0.0);
    copyBitsToByteArrayLE(raw_value, byteArray, 25600, 6);

    raw_value = convertPhysicalToRaw(@CAN_PrivMain::RFL_Object::RXX_Object_Obj49.VyVnce, 0.01, 0.0);
    copyBitsToByteArrayLE(raw_value, byteArray, 25824, 12);

    raw_value = convertPhysicalToRaw(@CAN_PrivMain::RFL_Object::RXX_Object_Obj49.Vy, 0.125, -64.0);
    copyBitsToByteArrayLE(raw_value, byteArray, 25806, 10);

    raw_value = convertPhysicalToRaw(@CAN_PrivMain::RFL_Object::RXX_Object_Obj49.MeasurementStatus, 1.0, 0.0);
    copyBitsToByteArrayLE(raw_value, byteArray, 25848, 3);

    raw_value = convertPhysicalToRaw(@CAN_PrivMain::RFL_Object::RXX_Object_Obj49.PxAyCoVnce, 0.01, 0.0);
    copyBitsToByteArrayLE(raw_value, byteArray, 25932, 12);

    raw_value = convertPhysicalToRaw(@CAN_PrivMain::RFL_Object::RXX_Object_Obj49.Age, 1.0, 0.0);
    copyBitsToByteArrayLE(raw_value, byteArray, 26080, 32);

    raw_value = convertPhysicalToRaw(@CAN_PrivMain::RFL_Object::RXX_Object_Obj49.AxAyCoVnce, 0.01, 0.0);
    copyBitsToByteArrayLE(raw_value, byteArray, 26060, 12);

    raw_value = convertPhysicalToRaw(@CAN_PrivMain::RFL_Object::RXX_Object_Obj49.VyAyCoVnce, 0.01, 0.0);
    copyBitsToByteArrayLE(raw_value, byteArray, 26048, 12);

    raw_value = convertPhysicalToRaw(@CAN_PrivMain::RFL_Object::RXX_Object_Obj49.VyAxCoVnce, 0.01, 0.0);
    copyBitsToByteArrayLE(raw_value, byteArray, 26028, 12);

    raw_value = convertPhysicalToRaw(@CAN_PrivMain::RFL_Object::RXX_Object_Obj49.VxAyCoVnce, 0.01, 0.0);
    copyBitsToByteArrayLE(raw_value, byteArray, 26016, 12);

    raw_value = convertPhysicalToRaw(@CAN_PrivMain::RFL_Object::RXX_Object_Obj49.ProbClassType, 1.0, 0.0);
    copyBitsToByteArrayLE(raw_value, byteArray, 25851, 4);

    raw_value = convertPhysicalToRaw(@CAN_PrivMain::RFL_Object::RXX_Object_Obj49.VxVyCoVnce, 0.01, 0.0);
    copyBitsToByteArrayLE(raw_value, byteArray, 25984, 12);

    raw_value = convertPhysicalToRaw(@CAN_PrivMain::RFL_Object::RXX_Object_Obj49.PyAyCoVnce, 0.01, 0.0);
    copyBitsToByteArrayLE(raw_value, byteArray, 25964, 12);

    raw_value = convertPhysicalToRaw(@CAN_PrivMain::RFL_Object::RXX_Object_Obj49.PyAxCoVnce, 0.01, 0.0);
    copyBitsToByteArrayLE(raw_value, byteArray, 25952, 12);

    raw_value = convertPhysicalToRaw(@CAN_PrivMain::RFL_Object::RXX_Object_Obj49.VxAxCoVnce, 0.01, 0.0);
    copyBitsToByteArrayLE(raw_value, byteArray, 25996, 12);

    raw_value = convertPhysicalToRaw(@CAN_PrivMain::RFL_Object::RXX_Object_Obj49.PxAxCoVnce, 0.01, 0.0);
    copyBitsToByteArrayLE(raw_value, byteArray, 25920, 12);

    raw_value = convertPhysicalToRaw(@CAN_PrivMain::RFL_Object::RXX_Object_Obj49.ReferencePoint, 1.0, 0.0);
    copyBitsToByteArrayLE(raw_value, byteArray, 25912, 4);

    raw_value = convertPhysicalToRaw(@CAN_PrivMain::RFL_Object::RXX_Object_Obj49.PyVyCoVnce, 0.01, 0.0);
    copyBitsToByteArrayLE(raw_value, byteArray, 25900, 12);

    raw_value = convertPhysicalToRaw(@CAN_PrivMain::RFL_Object::RXX_Object_Obj49.PyVxCoVnce, 0.01, 0.0);
    copyBitsToByteArrayLE(raw_value, byteArray, 25888, 12);

    raw_value = convertPhysicalToRaw(@CAN_PrivMain::RFL_Object::RXX_Object_Obj49.FilterInformation, 1.0, 0.0);
    copyBitsToByteArrayLE(raw_value, byteArray, 25880, 8);

    raw_value = convertPhysicalToRaw(@CAN_PrivMain::RFL_Object::RXX_Object_Obj49.PxVyCoVnce, 0.01, 0.0);
    copyBitsToByteArrayLE(raw_value, byteArray, 25868, 12);

    raw_value = convertPhysicalToRaw(@CAN_PrivMain::RFL_Object::RXX_Object_Obj49.PxVxCoVnce, 0.01, 0.0);
    copyBitsToByteArrayLE(raw_value, byteArray, 25856, 12);
}


void RXX_Object_Obj48_write(byte byteArray[])
{
    qword raw_value;

    raw_value = convertPhysicalToRaw(@CAN_PrivMain::RFL_Object::RXX_Object_Obj48.ObjId, 1.0, 0.0);
    copyBitsToByteArrayLE(raw_value, byteArray, 25272, 7);

    raw_value = convertPhysicalToRaw(@CAN_PrivMain::RFL_Object::RXX_Object_Obj48.WidthVnce, 0.01, 0.0);
    copyBitsToByteArrayLE(raw_value, byteArray, 25216, 12);

    raw_value = convertPhysicalToRaw(@CAN_PrivMain::RFL_Object::RXX_Object_Obj48.RCS, 0.2, -102.4);
    copyBitsToByteArrayLE(raw_value, byteArray, 25228, 10);

    raw_value = convertPhysicalToRaw(@CAN_PrivMain::RFL_Object::RXX_Object_Obj48.Ay, 0.0625, -16.0);
    copyBitsToByteArrayLE(raw_value, byteArray, 25238, 9);

    raw_value = convertPhysicalToRaw(@CAN_PrivMain::RFL_Object::RXX_Object_Obj48.Vx, 0.0625, -128.0);
    copyBitsToByteArrayLE(raw_value, byteArray, 25260, 12);

    raw_value = convertPhysicalToRaw(@CAN_PrivMain::RFL_Object::RXX_Object_Obj48.MovingStatus, 1.0, 0.0);
    copyBitsToByteArrayLE(raw_value, byteArray, 25292, 2);

    raw_value = convertPhysicalToRaw(@CAN_PrivMain::RFL_Object::RXX_Object_Obj48.ExistProb, 2.0, 0.0);
    copyBitsToByteArrayLE(raw_value, byteArray, 25304, 6);

    raw_value = convertPhysicalToRaw(@CAN_PrivMain::RFL_Object::RXX_Object_Obj48.Vy, 0.125, -64.0);
    copyBitsToByteArrayLE(raw_value, byteArray, 25294, 10);

    raw_value = convertPhysicalToRaw(@CAN_PrivMain::RFL_Object::RXX_Object_Obj48.VxVnce, 0.01, 0.0);
    copyBitsToByteArrayLE(raw_value, byteArray, 25280, 12);

    raw_value = convertPhysicalToRaw(@CAN_PrivMain::RFL_Object::RXX_Object_Obj48.OrientationYawVnce, 0.0003, 0.0);
    copyBitsToByteArrayLE(raw_value, byteArray, 25196, 12);

    raw_value = convertPhysicalToRaw(@CAN_PrivMain::RFL_Object::RXX_Object_Obj48.Width, 0.125, 0.0);
    copyBitsToByteArrayLE(raw_value, byteArray, 25208, 7);

    raw_value = convertPhysicalToRaw(@CAN_PrivMain::RFL_Object::RXX_Object_Obj48.AyVnce, 0.01, 0.0);
    copyBitsToByteArrayLE(raw_value, byteArray, 25248, 12);

    raw_value = convertPhysicalToRaw(@CAN_PrivMain::RFL_Object::RXX_Object_Obj48.AxVnce, 0.01, 0.0);
    copyBitsToByteArrayLE(raw_value, byteArray, 25184, 12);

    raw_value = convertPhysicalToRaw(@CAN_PrivMain::RFL_Object::RXX_Object_Obj48.OrientationYaw, 0.0175, -4.48);
    copyBitsToByteArrayLE(raw_value, byteArray, 25174, 9);

    raw_value = convertPhysicalToRaw(@CAN_PrivMain::RFL_Object::RXX_Object_Obj48.Ax, 0.03125, -16.0);
    copyBitsToByteArrayLE(raw_value, byteArray, 25164, 10);

    raw_value = convertPhysicalToRaw(@CAN_PrivMain::RFL_Object::RXX_Object_Obj48.LengthVnce, 0.01, 0.0);
    copyBitsToByteArrayLE(raw_value, byteArray, 25152, 12);

    raw_value = convertPhysicalToRaw(@CAN_PrivMain::RFL_Object::RXX_Object_Obj48.Length, 0.125, 0.0);
    copyBitsToByteArrayLE(raw_value, byteArray, 25144, 7);

    raw_value = convertPhysicalToRaw(@CAN_PrivMain::RFL_Object::RXX_Object_Obj48.PyVnce, 0.1, 0.0);
    copyBitsToByteArrayLE(raw_value, byteArray, 25132, 12);

    raw_value = convertPhysicalToRaw(@CAN_PrivMain::RFL_Object::RXX_Object_Obj48.Py, 0.0625, -128.0);
    copyBitsToByteArrayLE(raw_value, byteArray, 25120, 12);

    raw_value = convertPhysicalToRaw(@CAN_PrivMain::RFL_Object::RXX_Object_Obj48.PxPyCoVnce, 0.01, 0.0);
    copyBitsToByteArrayLE(raw_value, byteArray, 25324, 12);

    raw_value = convertPhysicalToRaw(@CAN_PrivMain::RFL_Object::RXX_Object_Obj48.PxVnce, 0.1, 0.0);
    copyBitsToByteArrayLE(raw_value, byteArray, 25108, 12);

    raw_value = convertPhysicalToRaw(@CAN_PrivMain::RFL_Object::RXX_Object_Obj48.Px, 0.0625, -512.0);
    copyBitsToByteArrayLE(raw_value, byteArray, 25094, 14);

    raw_value = convertPhysicalToRaw(@CAN_PrivMain::RFL_Object::RXX_Object_Obj48.ProbClassConfidence, 2.0, 0.0);
    copyBitsToByteArrayLE(raw_value, byteArray, 25088, 6);

    raw_value = convertPhysicalToRaw(@CAN_PrivMain::RFL_Object::RXX_Object_Obj48.VyVnce, 0.01, 0.0);
    copyBitsToByteArrayLE(raw_value, byteArray, 25312, 12);

    raw_value = convertPhysicalToRaw(@CAN_PrivMain::RFL_Object::RXX_Object_Obj48.VxVyCoVnce, 0.01, 0.0);
    copyBitsToByteArrayLE(raw_value, byteArray, 25472, 12);

    raw_value = convertPhysicalToRaw(@CAN_PrivMain::RFL_Object::RXX_Object_Obj48.MeasurementStatus, 1.0, 0.0);
    copyBitsToByteArrayLE(raw_value, byteArray, 25336, 3);

    raw_value = convertPhysicalToRaw(@CAN_PrivMain::RFL_Object::RXX_Object_Obj48.PxAyCoVnce, 0.01, 0.0);
    copyBitsToByteArrayLE(raw_value, byteArray, 25420, 12);

    raw_value = convertPhysicalToRaw(@CAN_PrivMain::RFL_Object::RXX_Object_Obj48.ProbClassType, 1.0, 0.0);
    copyBitsToByteArrayLE(raw_value, byteArray, 25339, 4);

    raw_value = convertPhysicalToRaw(@CAN_PrivMain::RFL_Object::RXX_Object_Obj48.Age, 1.0, 0.0);
    copyBitsToByteArrayLE(raw_value, byteArray, 25568, 32);

    raw_value = convertPhysicalToRaw(@CAN_PrivMain::RFL_Object::RXX_Object_Obj48.AxAyCoVnce, 0.01, 0.0);
    copyBitsToByteArrayLE(raw_value, byteArray, 25548, 12);

    raw_value = convertPhysicalToRaw(@CAN_PrivMain::RFL_Object::RXX_Object_Obj48.VyAyCoVnce, 0.01, 0.0);
    copyBitsToByteArrayLE(raw_value, byteArray, 25536, 12);

    raw_value = convertPhysicalToRaw(@CAN_PrivMain::RFL_Object::RXX_Object_Obj48.VyAxCoVnce, 0.01, 0.0);
    copyBitsToByteArrayLE(raw_value, byteArray, 25516, 12);

    raw_value = convertPhysicalToRaw(@CAN_PrivMain::RFL_Object::RXX_Object_Obj48.VxAyCoVnce, 0.01, 0.0);
    copyBitsToByteArrayLE(raw_value, byteArray, 25504, 12);

    raw_value = convertPhysicalToRaw(@CAN_PrivMain::RFL_Object::RXX_Object_Obj48.PyAyCoVnce, 0.01, 0.0);
    copyBitsToByteArrayLE(raw_value, byteArray, 25452, 12);

    raw_value = convertPhysicalToRaw(@CAN_PrivMain::RFL_Object::RXX_Object_Obj48.PyAxCoVnce, 0.01, 0.0);
    copyBitsToByteArrayLE(raw_value, byteArray, 25440, 12);

    raw_value = convertPhysicalToRaw(@CAN_PrivMain::RFL_Object::RXX_Object_Obj48.VxAxCoVnce, 0.01, 0.0);
    copyBitsToByteArrayLE(raw_value, byteArray, 25484, 12);

    raw_value = convertPhysicalToRaw(@CAN_PrivMain::RFL_Object::RXX_Object_Obj48.PxAxCoVnce, 0.01, 0.0);
    copyBitsToByteArrayLE(raw_value, byteArray, 25408, 12);

    raw_value = convertPhysicalToRaw(@CAN_PrivMain::RFL_Object::RXX_Object_Obj48.PyVxCoVnce, 0.01, 0.0);
    copyBitsToByteArrayLE(raw_value, byteArray, 25376, 12);

    raw_value = convertPhysicalToRaw(@CAN_PrivMain::RFL_Object::RXX_Object_Obj48.PxVxCoVnce, 0.01, 0.0);
    copyBitsToByteArrayLE(raw_value, byteArray, 25344, 12);

    raw_value = convertPhysicalToRaw(@CAN_PrivMain::RFL_Object::RXX_Object_Obj48.ReferencePoint, 1.0, 0.0);
    copyBitsToByteArrayLE(raw_value, byteArray, 25400, 4);

    raw_value = convertPhysicalToRaw(@CAN_PrivMain::RFL_Object::RXX_Object_Obj48.FilterInformation, 1.0, 0.0);
    copyBitsToByteArrayLE(raw_value, byteArray, 25368, 8);

    raw_value = convertPhysicalToRaw(@CAN_PrivMain::RFL_Object::RXX_Object_Obj48.PxVyCoVnce, 0.01, 0.0);
    copyBitsToByteArrayLE(raw_value, byteArray, 25356, 12);

    raw_value = convertPhysicalToRaw(@CAN_PrivMain::RFL_Object::RXX_Object_Obj48.PyVyCoVnce, 0.01, 0.0);
    copyBitsToByteArrayLE(raw_value, byteArray, 25388, 12);
}


void RXX_Object_Obj47_write(byte byteArray[])
{
    qword raw_value;

    raw_value = convertPhysicalToRaw(@CAN_PrivMain::RFL_Object::RXX_Object_Obj47.ObjId, 1.0, 0.0);
    copyBitsToByteArrayLE(raw_value, byteArray, 24760, 7);

    raw_value = convertPhysicalToRaw(@CAN_PrivMain::RFL_Object::RXX_Object_Obj47.OrientationYaw, 0.0175, -4.48);
    copyBitsToByteArrayLE(raw_value, byteArray, 24662, 9);

    raw_value = convertPhysicalToRaw(@CAN_PrivMain::RFL_Object::RXX_Object_Obj47.Vx, 0.0625, -128.0);
    copyBitsToByteArrayLE(raw_value, byteArray, 24748, 12);

    raw_value = convertPhysicalToRaw(@CAN_PrivMain::RFL_Object::RXX_Object_Obj47.AyVnce, 0.01, 0.0);
    copyBitsToByteArrayLE(raw_value, byteArray, 24736, 12);

    raw_value = convertPhysicalToRaw(@CAN_PrivMain::RFL_Object::RXX_Object_Obj47.Ay, 0.0625, -16.0);
    copyBitsToByteArrayLE(raw_value, byteArray, 24726, 9);

    raw_value = convertPhysicalToRaw(@CAN_PrivMain::RFL_Object::RXX_Object_Obj47.RCS, 0.2, -102.4);
    copyBitsToByteArrayLE(raw_value, byteArray, 24716, 10);

    raw_value = convertPhysicalToRaw(@CAN_PrivMain::RFL_Object::RXX_Object_Obj47.WidthVnce, 0.01, 0.0);
    copyBitsToByteArrayLE(raw_value, byteArray, 24704, 12);

    raw_value = convertPhysicalToRaw(@CAN_PrivMain::RFL_Object::RXX_Object_Obj47.Width, 0.125, 0.0);
    copyBitsToByteArrayLE(raw_value, byteArray, 24696, 7);

    raw_value = convertPhysicalToRaw(@CAN_PrivMain::RFL_Object::RXX_Object_Obj47.OrientationYawVnce, 0.0003, 0.0);
    copyBitsToByteArrayLE(raw_value, byteArray, 24684, 12);

    raw_value = convertPhysicalToRaw(@CAN_PrivMain::RFL_Object::RXX_Object_Obj47.AxVnce, 0.01, 0.0);
    copyBitsToByteArrayLE(raw_value, byteArray, 24672, 12);

    raw_value = convertPhysicalToRaw(@CAN_PrivMain::RFL_Object::RXX_Object_Obj47.ProbClassConfidence, 2.0, 0.0);
    copyBitsToByteArrayLE(raw_value, byteArray, 24576, 6);

    raw_value = convertPhysicalToRaw(@CAN_PrivMain::RFL_Object::RXX_Object_Obj47.Ax, 0.03125, -16.0);
    copyBitsToByteArrayLE(raw_value, byteArray, 24652, 10);

    raw_value = convertPhysicalToRaw(@CAN_PrivMain::RFL_Object::RXX_Object_Obj47.LengthVnce, 0.01, 0.0);
    copyBitsToByteArrayLE(raw_value, byteArray, 24640, 12);

    raw_value = convertPhysicalToRaw(@CAN_PrivMain::RFL_Object::RXX_Object_Obj47.Length, 0.125, 0.0);
    copyBitsToByteArrayLE(raw_value, byteArray, 24632, 7);

    raw_value = convertPhysicalToRaw(@CAN_PrivMain::RFL_Object::RXX_Object_Obj47.PyVnce, 0.1, 0.0);
    copyBitsToByteArrayLE(raw_value, byteArray, 24620, 12);

    raw_value = convertPhysicalToRaw(@CAN_PrivMain::RFL_Object::RXX_Object_Obj47.Py, 0.0625, -128.0);
    copyBitsToByteArrayLE(raw_value, byteArray, 24608, 12);

    raw_value = convertPhysicalToRaw(@CAN_PrivMain::RFL_Object::RXX_Object_Obj47.PxVnce, 0.1, 0.0);
    copyBitsToByteArrayLE(raw_value, byteArray, 24596, 12);

    raw_value = convertPhysicalToRaw(@CAN_PrivMain::RFL_Object::RXX_Object_Obj47.PxPyCoVnce, 0.01, 0.0);
    copyBitsToByteArrayLE(raw_value, byteArray, 24812, 12);

    raw_value = convertPhysicalToRaw(@CAN_PrivMain::RFL_Object::RXX_Object_Obj47.MeasurementStatus, 1.0, 0.0);
    copyBitsToByteArrayLE(raw_value, byteArray, 24824, 3);

    raw_value = convertPhysicalToRaw(@CAN_PrivMain::RFL_Object::RXX_Object_Obj47.ProbClassType, 1.0, 0.0);
    copyBitsToByteArrayLE(raw_value, byteArray, 24827, 4);

    raw_value = convertPhysicalToRaw(@CAN_PrivMain::RFL_Object::RXX_Object_Obj47.Px, 0.0625, -512.0);
    copyBitsToByteArrayLE(raw_value, byteArray, 24582, 14);

    raw_value = convertPhysicalToRaw(@CAN_PrivMain::RFL_Object::RXX_Object_Obj47.VxVnce, 0.01, 0.0);
    copyBitsToByteArrayLE(raw_value, byteArray, 24768, 12);

    raw_value = convertPhysicalToRaw(@CAN_PrivMain::RFL_Object::RXX_Object_Obj47.VyVnce, 0.01, 0.0);
    copyBitsToByteArrayLE(raw_value, byteArray, 24800, 12);

    raw_value = convertPhysicalToRaw(@CAN_PrivMain::RFL_Object::RXX_Object_Obj47.PxVxCoVnce, 0.01, 0.0);
    copyBitsToByteArrayLE(raw_value, byteArray, 24832, 12);

    raw_value = convertPhysicalToRaw(@CAN_PrivMain::RFL_Object::RXX_Object_Obj47.VxAxCoVnce, 0.01, 0.0);
    copyBitsToByteArrayLE(raw_value, byteArray, 24972, 12);

    raw_value = convertPhysicalToRaw(@CAN_PrivMain::RFL_Object::RXX_Object_Obj47.PxVyCoVnce, 0.01, 0.0);
    copyBitsToByteArrayLE(raw_value, byteArray, 24844, 12);

    raw_value = convertPhysicalToRaw(@CAN_PrivMain::RFL_Object::RXX_Object_Obj47.Vy, 0.125, -64.0);
    copyBitsToByteArrayLE(raw_value, byteArray, 24782, 10);

    raw_value = convertPhysicalToRaw(@CAN_PrivMain::RFL_Object::RXX_Object_Obj47.MovingStatus, 1.0, 0.0);
    copyBitsToByteArrayLE(raw_value, byteArray, 24780, 2);

    raw_value = convertPhysicalToRaw(@CAN_PrivMain::RFL_Object::RXX_Object_Obj47.Age, 1.0, 0.0);
    copyBitsToByteArrayLE(raw_value, byteArray, 25056, 32);

    raw_value = convertPhysicalToRaw(@CAN_PrivMain::RFL_Object::RXX_Object_Obj47.AxAyCoVnce, 0.01, 0.0);
    copyBitsToByteArrayLE(raw_value, byteArray, 25036, 12);

    raw_value = convertPhysicalToRaw(@CAN_PrivMain::RFL_Object::RXX_Object_Obj47.VyAyCoVnce, 0.01, 0.0);
    copyBitsToByteArrayLE(raw_value, byteArray, 25024, 12);

    raw_value = convertPhysicalToRaw(@CAN_PrivMain::RFL_Object::RXX_Object_Obj47.VyAxCoVnce, 0.01, 0.0);
    copyBitsToByteArrayLE(raw_value, byteArray, 25004, 12);

    raw_value = convertPhysicalToRaw(@CAN_PrivMain::RFL_Object::RXX_Object_Obj47.VxAyCoVnce, 0.01, 0.0);
    copyBitsToByteArrayLE(raw_value, byteArray, 24992, 12);

    raw_value = convertPhysicalToRaw(@CAN_PrivMain::RFL_Object::RXX_Object_Obj47.ExistProb, 2.0, 0.0);
    copyBitsToByteArrayLE(raw_value, byteArray, 24792, 6);

    raw_value = convertPhysicalToRaw(@CAN_PrivMain::RFL_Object::RXX_Object_Obj47.VxVyCoVnce, 0.01, 0.0);
    copyBitsToByteArrayLE(raw_value, byteArray, 24960, 12);

    raw_value = convertPhysicalToRaw(@CAN_PrivMain::RFL_Object::RXX_Object_Obj47.ReferencePoint, 1.0, 0.0);
    copyBitsToByteArrayLE(raw_value, byteArray, 24888, 4);

    raw_value = convertPhysicalToRaw(@CAN_PrivMain::RFL_Object::RXX_Object_Obj47.PyAyCoVnce, 0.01, 0.0);
    copyBitsToByteArrayLE(raw_value, byteArray, 24940, 12);

    raw_value = convertPhysicalToRaw(@CAN_PrivMain::RFL_Object::RXX_Object_Obj47.PyVxCoVnce, 0.01, 0.0);
    copyBitsToByteArrayLE(raw_value, byteArray, 24864, 12);

    raw_value = convertPhysicalToRaw(@CAN_PrivMain::RFL_Object::RXX_Object_Obj47.PyVyCoVnce, 0.01, 0.0);
    copyBitsToByteArrayLE(raw_value, byteArray, 24876, 12);

    raw_value = convertPhysicalToRaw(@CAN_PrivMain::RFL_Object::RXX_Object_Obj47.FilterInformation, 1.0, 0.0);
    copyBitsToByteArrayLE(raw_value, byteArray, 24856, 8);

    raw_value = convertPhysicalToRaw(@CAN_PrivMain::RFL_Object::RXX_Object_Obj47.PxAxCoVnce, 0.01, 0.0);
    copyBitsToByteArrayLE(raw_value, byteArray, 24896, 12);

    raw_value = convertPhysicalToRaw(@CAN_PrivMain::RFL_Object::RXX_Object_Obj47.PxAyCoVnce, 0.01, 0.0);
    copyBitsToByteArrayLE(raw_value, byteArray, 24908, 12);

    raw_value = convertPhysicalToRaw(@CAN_PrivMain::RFL_Object::RXX_Object_Obj47.PyAxCoVnce, 0.01, 0.0);
    copyBitsToByteArrayLE(raw_value, byteArray, 24928, 12);
}


void RXX_Object_Obj46_write(byte byteArray[])
{
    qword raw_value;

    raw_value = convertPhysicalToRaw(@CAN_PrivMain::RFL_Object::RXX_Object_Obj46.VxVnce, 0.01, 0.0);
    copyBitsToByteArrayLE(raw_value, byteArray, 24256, 12);

    raw_value = convertPhysicalToRaw(@CAN_PrivMain::RFL_Object::RXX_Object_Obj46.AxVnce, 0.01, 0.0);
    copyBitsToByteArrayLE(raw_value, byteArray, 24160, 12);

    raw_value = convertPhysicalToRaw(@CAN_PrivMain::RFL_Object::RXX_Object_Obj46.ObjId, 1.0, 0.0);
    copyBitsToByteArrayLE(raw_value, byteArray, 24248, 7);

    raw_value = convertPhysicalToRaw(@CAN_PrivMain::RFL_Object::RXX_Object_Obj46.Vx, 0.0625, -128.0);
    copyBitsToByteArrayLE(raw_value, byteArray, 24236, 12);

    raw_value = convertPhysicalToRaw(@CAN_PrivMain::RFL_Object::RXX_Object_Obj46.AyVnce, 0.01, 0.0);
    copyBitsToByteArrayLE(raw_value, byteArray, 24224, 12);

    raw_value = convertPhysicalToRaw(@CAN_PrivMain::RFL_Object::RXX_Object_Obj46.Ay, 0.0625, -16.0);
    copyBitsToByteArrayLE(raw_value, byteArray, 24214, 9);

    raw_value = convertPhysicalToRaw(@CAN_PrivMain::RFL_Object::RXX_Object_Obj46.RCS, 0.2, -102.4);
    copyBitsToByteArrayLE(raw_value, byteArray, 24204, 10);

    raw_value = convertPhysicalToRaw(@CAN_PrivMain::RFL_Object::RXX_Object_Obj46.WidthVnce, 0.01, 0.0);
    copyBitsToByteArrayLE(raw_value, byteArray, 24192, 12);

    raw_value = convertPhysicalToRaw(@CAN_PrivMain::RFL_Object::RXX_Object_Obj46.Width, 0.125, 0.0);
    copyBitsToByteArrayLE(raw_value, byteArray, 24184, 7);

    raw_value = convertPhysicalToRaw(@CAN_PrivMain::RFL_Object::RXX_Object_Obj46.OrientationYawVnce, 0.0003, 0.0);
    copyBitsToByteArrayLE(raw_value, byteArray, 24172, 12);

    raw_value = convertPhysicalToRaw(@CAN_PrivMain::RFL_Object::RXX_Object_Obj46.Length, 0.125, 0.0);
    copyBitsToByteArrayLE(raw_value, byteArray, 24120, 7);

    raw_value = convertPhysicalToRaw(@CAN_PrivMain::RFL_Object::RXX_Object_Obj46.OrientationYaw, 0.0175, -4.48);
    copyBitsToByteArrayLE(raw_value, byteArray, 24150, 9);

    raw_value = convertPhysicalToRaw(@CAN_PrivMain::RFL_Object::RXX_Object_Obj46.Ax, 0.03125, -16.0);
    copyBitsToByteArrayLE(raw_value, byteArray, 24140, 10);

    raw_value = convertPhysicalToRaw(@CAN_PrivMain::RFL_Object::RXX_Object_Obj46.LengthVnce, 0.01, 0.0);
    copyBitsToByteArrayLE(raw_value, byteArray, 24128, 12);

    raw_value = convertPhysicalToRaw(@CAN_PrivMain::RFL_Object::RXX_Object_Obj46.PyVnce, 0.1, 0.0);
    copyBitsToByteArrayLE(raw_value, byteArray, 24108, 12);

    raw_value = convertPhysicalToRaw(@CAN_PrivMain::RFL_Object::RXX_Object_Obj46.Py, 0.0625, -128.0);
    copyBitsToByteArrayLE(raw_value, byteArray, 24096, 12);

    raw_value = convertPhysicalToRaw(@CAN_PrivMain::RFL_Object::RXX_Object_Obj46.PxVnce, 0.1, 0.0);
    copyBitsToByteArrayLE(raw_value, byteArray, 24084, 12);

    raw_value = convertPhysicalToRaw(@CAN_PrivMain::RFL_Object::RXX_Object_Obj46.Px, 0.0625, -512.0);
    copyBitsToByteArrayLE(raw_value, byteArray, 24070, 14);

    raw_value = convertPhysicalToRaw(@CAN_PrivMain::RFL_Object::RXX_Object_Obj46.ProbClassConfidence, 2.0, 0.0);
    copyBitsToByteArrayLE(raw_value, byteArray, 24064, 6);

    raw_value = convertPhysicalToRaw(@CAN_PrivMain::RFL_Object::RXX_Object_Obj46.Vy, 0.125, -64.0);
    copyBitsToByteArrayLE(raw_value, byteArray, 24270, 10);

    raw_value = convertPhysicalToRaw(@CAN_PrivMain::RFL_Object::RXX_Object_Obj46.MovingStatus, 1.0, 0.0);
    copyBitsToByteArrayLE(raw_value, byteArray, 24268, 2);

    raw_value = convertPhysicalToRaw(@CAN_PrivMain::RFL_Object::RXX_Object_Obj46.ReferencePoint, 1.0, 0.0);
    copyBitsToByteArrayLE(raw_value, byteArray, 24376, 4);

    raw_value = convertPhysicalToRaw(@CAN_PrivMain::RFL_Object::RXX_Object_Obj46.ExistProb, 2.0, 0.0);
    copyBitsToByteArrayLE(raw_value, byteArray, 24280, 6);

    raw_value = convertPhysicalToRaw(@CAN_PrivMain::RFL_Object::RXX_Object_Obj46.PxAxCoVnce, 0.01, 0.0);
    copyBitsToByteArrayLE(raw_value, byteArray, 24384, 12);

    raw_value = convertPhysicalToRaw(@CAN_PrivMain::RFL_Object::RXX_Object_Obj46.AxAyCoVnce, 0.01, 0.0);
    copyBitsToByteArrayLE(raw_value, byteArray, 24524, 12);

    raw_value = convertPhysicalToRaw(@CAN_PrivMain::RFL_Object::RXX_Object_Obj46.VyAyCoVnce, 0.01, 0.0);
    copyBitsToByteArrayLE(raw_value, byteArray, 24512, 12);

    raw_value = convertPhysicalToRaw(@CAN_PrivMain::RFL_Object::RXX_Object_Obj46.VyAxCoVnce, 0.01, 0.0);
    copyBitsToByteArrayLE(raw_value, byteArray, 24492, 12);

    raw_value = convertPhysicalToRaw(@CAN_PrivMain::RFL_Object::RXX_Object_Obj46.VxAyCoVnce, 0.01, 0.0);
    copyBitsToByteArrayLE(raw_value, byteArray, 24480, 12);

    raw_value = convertPhysicalToRaw(@CAN_PrivMain::RFL_Object::RXX_Object_Obj46.VxAxCoVnce, 0.01, 0.0);
    copyBitsToByteArrayLE(raw_value, byteArray, 24460, 12);

    raw_value = convertPhysicalToRaw(@CAN_PrivMain::RFL_Object::RXX_Object_Obj46.VxVyCoVnce, 0.01, 0.0);
    copyBitsToByteArrayLE(raw_value, byteArray, 24448, 12);

    raw_value = convertPhysicalToRaw(@CAN_PrivMain::RFL_Object::RXX_Object_Obj46.PyAyCoVnce, 0.01, 0.0);
    copyBitsToByteArrayLE(raw_value, byteArray, 24428, 12);

    raw_value = convertPhysicalToRaw(@CAN_PrivMain::RFL_Object::RXX_Object_Obj46.PyAxCoVnce, 0.01, 0.0);
    copyBitsToByteArrayLE(raw_value, byteArray, 24416, 12);

    raw_value = convertPhysicalToRaw(@CAN_PrivMain::RFL_Object::RXX_Object_Obj46.PxAyCoVnce, 0.01, 0.0);
    copyBitsToByteArrayLE(raw_value, byteArray, 24396, 12);

    raw_value = convertPhysicalToRaw(@CAN_PrivMain::RFL_Object::RXX_Object_Obj46.VyVnce, 0.01, 0.0);
    copyBitsToByteArrayLE(raw_value, byteArray, 24288, 12);

    raw_value = convertPhysicalToRaw(@CAN_PrivMain::RFL_Object::RXX_Object_Obj46.Age, 1.0, 0.0);
    copyBitsToByteArrayLE(raw_value, byteArray, 24544, 32);

    raw_value = convertPhysicalToRaw(@CAN_PrivMain::RFL_Object::RXX_Object_Obj46.PxVxCoVnce, 0.01, 0.0);
    copyBitsToByteArrayLE(raw_value, byteArray, 24320, 12);

    raw_value = convertPhysicalToRaw(@CAN_PrivMain::RFL_Object::RXX_Object_Obj46.PyVyCoVnce, 0.01, 0.0);
    copyBitsToByteArrayLE(raw_value, byteArray, 24364, 12);

    raw_value = convertPhysicalToRaw(@CAN_PrivMain::RFL_Object::RXX_Object_Obj46.MeasurementStatus, 1.0, 0.0);
    copyBitsToByteArrayLE(raw_value, byteArray, 24312, 3);

    raw_value = convertPhysicalToRaw(@CAN_PrivMain::RFL_Object::RXX_Object_Obj46.ProbClassType, 1.0, 0.0);
    copyBitsToByteArrayLE(raw_value, byteArray, 24315, 4);

    raw_value = convertPhysicalToRaw(@CAN_PrivMain::RFL_Object::RXX_Object_Obj46.PxPyCoVnce, 0.01, 0.0);
    copyBitsToByteArrayLE(raw_value, byteArray, 24300, 12);

    raw_value = convertPhysicalToRaw(@CAN_PrivMain::RFL_Object::RXX_Object_Obj46.PxVyCoVnce, 0.01, 0.0);
    copyBitsToByteArrayLE(raw_value, byteArray, 24332, 12);

    raw_value = convertPhysicalToRaw(@CAN_PrivMain::RFL_Object::RXX_Object_Obj46.FilterInformation, 1.0, 0.0);
    copyBitsToByteArrayLE(raw_value, byteArray, 24344, 8);

    raw_value = convertPhysicalToRaw(@CAN_PrivMain::RFL_Object::RXX_Object_Obj46.PyVxCoVnce, 0.01, 0.0);
    copyBitsToByteArrayLE(raw_value, byteArray, 24352, 12);
}


void RXX_Object_Obj45_write(byte byteArray[])
{
    qword raw_value;

    raw_value = convertPhysicalToRaw(@CAN_PrivMain::RFL_Object::RXX_Object_Obj45.ObjId, 1.0, 0.0);
    copyBitsToByteArrayLE(raw_value, byteArray, 23736, 7);

    raw_value = convertPhysicalToRaw(@CAN_PrivMain::RFL_Object::RXX_Object_Obj45.AxVnce, 0.01, 0.0);
    copyBitsToByteArrayLE(raw_value, byteArray, 23648, 12);

    raw_value = convertPhysicalToRaw(@CAN_PrivMain::RFL_Object::RXX_Object_Obj45.Vx, 0.0625, -128.0);
    copyBitsToByteArrayLE(raw_value, byteArray, 23724, 12);

    raw_value = convertPhysicalToRaw(@CAN_PrivMain::RFL_Object::RXX_Object_Obj45.AyVnce, 0.01, 0.0);
    copyBitsToByteArrayLE(raw_value, byteArray, 23712, 12);

    raw_value = convertPhysicalToRaw(@CAN_PrivMain::RFL_Object::RXX_Object_Obj45.Ay, 0.0625, -16.0);
    copyBitsToByteArrayLE(raw_value, byteArray, 23702, 9);

    raw_value = convertPhysicalToRaw(@CAN_PrivMain::RFL_Object::RXX_Object_Obj45.RCS, 0.2, -102.4);
    copyBitsToByteArrayLE(raw_value, byteArray, 23692, 10);

    raw_value = convertPhysicalToRaw(@CAN_PrivMain::RFL_Object::RXX_Object_Obj45.WidthVnce, 0.01, 0.0);
    copyBitsToByteArrayLE(raw_value, byteArray, 23680, 12);

    raw_value = convertPhysicalToRaw(@CAN_PrivMain::RFL_Object::RXX_Object_Obj45.Width, 0.125, 0.0);
    copyBitsToByteArrayLE(raw_value, byteArray, 23672, 7);

    raw_value = convertPhysicalToRaw(@CAN_PrivMain::RFL_Object::RXX_Object_Obj45.OrientationYawVnce, 0.0003, 0.0);
    copyBitsToByteArrayLE(raw_value, byteArray, 23660, 12);

    raw_value = convertPhysicalToRaw(@CAN_PrivMain::RFL_Object::RXX_Object_Obj45.PyVnce, 0.1, 0.0);
    copyBitsToByteArrayLE(raw_value, byteArray, 23596, 12);

    raw_value = convertPhysicalToRaw(@CAN_PrivMain::RFL_Object::RXX_Object_Obj45.OrientationYaw, 0.0175, -4.48);
    copyBitsToByteArrayLE(raw_value, byteArray, 23638, 9);

    raw_value = convertPhysicalToRaw(@CAN_PrivMain::RFL_Object::RXX_Object_Obj45.Ax, 0.03125, -16.0);
    copyBitsToByteArrayLE(raw_value, byteArray, 23628, 10);

    raw_value = convertPhysicalToRaw(@CAN_PrivMain::RFL_Object::RXX_Object_Obj45.LengthVnce, 0.01, 0.0);
    copyBitsToByteArrayLE(raw_value, byteArray, 23616, 12);

    raw_value = convertPhysicalToRaw(@CAN_PrivMain::RFL_Object::RXX_Object_Obj45.Length, 0.125, 0.0);
    copyBitsToByteArrayLE(raw_value, byteArray, 23608, 7);

    raw_value = convertPhysicalToRaw(@CAN_PrivMain::RFL_Object::RXX_Object_Obj45.Py, 0.0625, -128.0);
    copyBitsToByteArrayLE(raw_value, byteArray, 23584, 12);

    raw_value = convertPhysicalToRaw(@CAN_PrivMain::RFL_Object::RXX_Object_Obj45.PxVnce, 0.1, 0.0);
    copyBitsToByteArrayLE(raw_value, byteArray, 23572, 12);

    raw_value = convertPhysicalToRaw(@CAN_PrivMain::RFL_Object::RXX_Object_Obj45.Px, 0.0625, -512.0);
    copyBitsToByteArrayLE(raw_value, byteArray, 23558, 14);

    raw_value = convertPhysicalToRaw(@CAN_PrivMain::RFL_Object::RXX_Object_Obj45.ProbClassConfidence, 2.0, 0.0);
    copyBitsToByteArrayLE(raw_value, byteArray, 23552, 6);

    raw_value = convertPhysicalToRaw(@CAN_PrivMain::RFL_Object::RXX_Object_Obj45.MovingStatus, 1.0, 0.0);
    copyBitsToByteArrayLE(raw_value, byteArray, 23756, 2);

    raw_value = convertPhysicalToRaw(@CAN_PrivMain::RFL_Object::RXX_Object_Obj45.VxVnce, 0.01, 0.0);
    copyBitsToByteArrayLE(raw_value, byteArray, 23744, 12);

    raw_value = convertPhysicalToRaw(@CAN_PrivMain::RFL_Object::RXX_Object_Obj45.Vy, 0.125, -64.0);
    copyBitsToByteArrayLE(raw_value, byteArray, 23758, 10);

    raw_value = convertPhysicalToRaw(@CAN_PrivMain::RFL_Object::RXX_Object_Obj45.AxAyCoVnce, 0.01, 0.0);
    copyBitsToByteArrayLE(raw_value, byteArray, 24012, 12);

    raw_value = convertPhysicalToRaw(@CAN_PrivMain::RFL_Object::RXX_Object_Obj45.PxAxCoVnce, 0.01, 0.0);
    copyBitsToByteArrayLE(raw_value, byteArray, 23872, 12);

    raw_value = convertPhysicalToRaw(@CAN_PrivMain::RFL_Object::RXX_Object_Obj45.Age, 1.0, 0.0);
    copyBitsToByteArrayLE(raw_value, byteArray, 24032, 32);

    raw_value = convertPhysicalToRaw(@CAN_PrivMain::RFL_Object::RXX_Object_Obj45.ExistProb, 2.0, 0.0);
    copyBitsToByteArrayLE(raw_value, byteArray, 23768, 6);

    raw_value = convertPhysicalToRaw(@CAN_PrivMain::RFL_Object::RXX_Object_Obj45.VyAyCoVnce, 0.01, 0.0);
    copyBitsToByteArrayLE(raw_value, byteArray, 24000, 12);

    raw_value = convertPhysicalToRaw(@CAN_PrivMain::RFL_Object::RXX_Object_Obj45.VyAxCoVnce, 0.01, 0.0);
    copyBitsToByteArrayLE(raw_value, byteArray, 23980, 12);

    raw_value = convertPhysicalToRaw(@CAN_PrivMain::RFL_Object::RXX_Object_Obj45.VxAyCoVnce, 0.01, 0.0);
    copyBitsToByteArrayLE(raw_value, byteArray, 23968, 12);

    raw_value = convertPhysicalToRaw(@CAN_PrivMain::RFL_Object::RXX_Object_Obj45.VxAxCoVnce, 0.01, 0.0);
    copyBitsToByteArrayLE(raw_value, byteArray, 23948, 12);

    raw_value = convertPhysicalToRaw(@CAN_PrivMain::RFL_Object::RXX_Object_Obj45.PyAyCoVnce, 0.01, 0.0);
    copyBitsToByteArrayLE(raw_value, byteArray, 23916, 12);

    raw_value = convertPhysicalToRaw(@CAN_PrivMain::RFL_Object::RXX_Object_Obj45.PyAxCoVnce, 0.01, 0.0);
    copyBitsToByteArrayLE(raw_value, byteArray, 23904, 12);

    raw_value = convertPhysicalToRaw(@CAN_PrivMain::RFL_Object::RXX_Object_Obj45.PxAyCoVnce, 0.01, 0.0);
    copyBitsToByteArrayLE(raw_value, byteArray, 23884, 12);

    raw_value = convertPhysicalToRaw(@CAN_PrivMain::RFL_Object::RXX_Object_Obj45.VxVyCoVnce, 0.01, 0.0);
    copyBitsToByteArrayLE(raw_value, byteArray, 23936, 12);

    raw_value = convertPhysicalToRaw(@CAN_PrivMain::RFL_Object::RXX_Object_Obj45.ReferencePoint, 1.0, 0.0);
    copyBitsToByteArrayLE(raw_value, byteArray, 23864, 4);

    raw_value = convertPhysicalToRaw(@CAN_PrivMain::RFL_Object::RXX_Object_Obj45.PxVxCoVnce, 0.01, 0.0);
    copyBitsToByteArrayLE(raw_value, byteArray, 23808, 12);

    raw_value = convertPhysicalToRaw(@CAN_PrivMain::RFL_Object::RXX_Object_Obj45.PyVyCoVnce, 0.01, 0.0);
    copyBitsToByteArrayLE(raw_value, byteArray, 23852, 12);

    raw_value = convertPhysicalToRaw(@CAN_PrivMain::RFL_Object::RXX_Object_Obj45.PxPyCoVnce, 0.01, 0.0);
    copyBitsToByteArrayLE(raw_value, byteArray, 23788, 12);

    raw_value = convertPhysicalToRaw(@CAN_PrivMain::RFL_Object::RXX_Object_Obj45.MeasurementStatus, 1.0, 0.0);
    copyBitsToByteArrayLE(raw_value, byteArray, 23800, 3);

    raw_value = convertPhysicalToRaw(@CAN_PrivMain::RFL_Object::RXX_Object_Obj45.ProbClassType, 1.0, 0.0);
    copyBitsToByteArrayLE(raw_value, byteArray, 23803, 4);

    raw_value = convertPhysicalToRaw(@CAN_PrivMain::RFL_Object::RXX_Object_Obj45.VyVnce, 0.01, 0.0);
    copyBitsToByteArrayLE(raw_value, byteArray, 23776, 12);

    raw_value = convertPhysicalToRaw(@CAN_PrivMain::RFL_Object::RXX_Object_Obj45.PxVyCoVnce, 0.01, 0.0);
    copyBitsToByteArrayLE(raw_value, byteArray, 23820, 12);

    raw_value = convertPhysicalToRaw(@CAN_PrivMain::RFL_Object::RXX_Object_Obj45.FilterInformation, 1.0, 0.0);
    copyBitsToByteArrayLE(raw_value, byteArray, 23832, 8);

    raw_value = convertPhysicalToRaw(@CAN_PrivMain::RFL_Object::RXX_Object_Obj45.PyVxCoVnce, 0.01, 0.0);
    copyBitsToByteArrayLE(raw_value, byteArray, 23840, 12);
}


void RXX_Object_Obj44_write(byte byteArray[])
{
    qword raw_value;

    raw_value = convertPhysicalToRaw(@CAN_PrivMain::RFL_Object::RXX_Object_Obj44.AxVnce, 0.01, 0.0);
    copyBitsToByteArrayLE(raw_value, byteArray, 23136, 12);

    raw_value = convertPhysicalToRaw(@CAN_PrivMain::RFL_Object::RXX_Object_Obj44.VxVnce, 0.01, 0.0);
    copyBitsToByteArrayLE(raw_value, byteArray, 23232, 12);

    raw_value = convertPhysicalToRaw(@CAN_PrivMain::RFL_Object::RXX_Object_Obj44.ObjId, 1.0, 0.0);
    copyBitsToByteArrayLE(raw_value, byteArray, 23224, 7);

    raw_value = convertPhysicalToRaw(@CAN_PrivMain::RFL_Object::RXX_Object_Obj44.Vx, 0.0625, -128.0);
    copyBitsToByteArrayLE(raw_value, byteArray, 23212, 12);

    raw_value = convertPhysicalToRaw(@CAN_PrivMain::RFL_Object::RXX_Object_Obj44.AyVnce, 0.01, 0.0);
    copyBitsToByteArrayLE(raw_value, byteArray, 23200, 12);

    raw_value = convertPhysicalToRaw(@CAN_PrivMain::RFL_Object::RXX_Object_Obj44.Ay, 0.0625, -16.0);
    copyBitsToByteArrayLE(raw_value, byteArray, 23190, 9);

    raw_value = convertPhysicalToRaw(@CAN_PrivMain::RFL_Object::RXX_Object_Obj44.RCS, 0.2, -102.4);
    copyBitsToByteArrayLE(raw_value, byteArray, 23180, 10);

    raw_value = convertPhysicalToRaw(@CAN_PrivMain::RFL_Object::RXX_Object_Obj44.WidthVnce, 0.01, 0.0);
    copyBitsToByteArrayLE(raw_value, byteArray, 23168, 12);

    raw_value = convertPhysicalToRaw(@CAN_PrivMain::RFL_Object::RXX_Object_Obj44.Width, 0.125, 0.0);
    copyBitsToByteArrayLE(raw_value, byteArray, 23160, 7);

    raw_value = convertPhysicalToRaw(@CAN_PrivMain::RFL_Object::RXX_Object_Obj44.OrientationYawVnce, 0.0003, 0.0);
    copyBitsToByteArrayLE(raw_value, byteArray, 23148, 12);

    raw_value = convertPhysicalToRaw(@CAN_PrivMain::RFL_Object::RXX_Object_Obj44.Vy, 0.125, -64.0);
    copyBitsToByteArrayLE(raw_value, byteArray, 23246, 10);

    raw_value = convertPhysicalToRaw(@CAN_PrivMain::RFL_Object::RXX_Object_Obj44.OrientationYaw, 0.0175, -4.48);
    copyBitsToByteArrayLE(raw_value, byteArray, 23126, 9);

    raw_value = convertPhysicalToRaw(@CAN_PrivMain::RFL_Object::RXX_Object_Obj44.Ax, 0.03125, -16.0);
    copyBitsToByteArrayLE(raw_value, byteArray, 23116, 10);

    raw_value = convertPhysicalToRaw(@CAN_PrivMain::RFL_Object::RXX_Object_Obj44.LengthVnce, 0.01, 0.0);
    copyBitsToByteArrayLE(raw_value, byteArray, 23104, 12);

    raw_value = convertPhysicalToRaw(@CAN_PrivMain::RFL_Object::RXX_Object_Obj44.Length, 0.125, 0.0);
    copyBitsToByteArrayLE(raw_value, byteArray, 23096, 7);

    raw_value = convertPhysicalToRaw(@CAN_PrivMain::RFL_Object::RXX_Object_Obj44.PyVnce, 0.1, 0.0);
    copyBitsToByteArrayLE(raw_value, byteArray, 23084, 12);

    raw_value = convertPhysicalToRaw(@CAN_PrivMain::RFL_Object::RXX_Object_Obj44.Py, 0.0625, -128.0);
    copyBitsToByteArrayLE(raw_value, byteArray, 23072, 12);

    raw_value = convertPhysicalToRaw(@CAN_PrivMain::RFL_Object::RXX_Object_Obj44.PxVnce, 0.1, 0.0);
    copyBitsToByteArrayLE(raw_value, byteArray, 23060, 12);

    raw_value = convertPhysicalToRaw(@CAN_PrivMain::RFL_Object::RXX_Object_Obj44.Px, 0.0625, -512.0);
    copyBitsToByteArrayLE(raw_value, byteArray, 23046, 14);

    raw_value = convertPhysicalToRaw(@CAN_PrivMain::RFL_Object::RXX_Object_Obj44.ProbClassConfidence, 2.0, 0.0);
    copyBitsToByteArrayLE(raw_value, byteArray, 23040, 6);

    raw_value = convertPhysicalToRaw(@CAN_PrivMain::RFL_Object::RXX_Object_Obj44.MovingStatus, 1.0, 0.0);
    copyBitsToByteArrayLE(raw_value, byteArray, 23244, 2);

    raw_value = convertPhysicalToRaw(@CAN_PrivMain::RFL_Object::RXX_Object_Obj44.AxAyCoVnce, 0.01, 0.0);
    copyBitsToByteArrayLE(raw_value, byteArray, 23500, 12);

    raw_value = convertPhysicalToRaw(@CAN_PrivMain::RFL_Object::RXX_Object_Obj44.ExistProb, 2.0, 0.0);
    copyBitsToByteArrayLE(raw_value, byteArray, 23256, 6);

    raw_value = convertPhysicalToRaw(@CAN_PrivMain::RFL_Object::RXX_Object_Obj44.PxAxCoVnce, 0.01, 0.0);
    copyBitsToByteArrayLE(raw_value, byteArray, 23360, 12);

    raw_value = convertPhysicalToRaw(@CAN_PrivMain::RFL_Object::RXX_Object_Obj44.VyVnce, 0.01, 0.0);
    copyBitsToByteArrayLE(raw_value, byteArray, 23264, 12);

    raw_value = convertPhysicalToRaw(@CAN_PrivMain::RFL_Object::RXX_Object_Obj44.Age, 1.0, 0.0);
    copyBitsToByteArrayLE(raw_value, byteArray, 23520, 32);

    raw_value = convertPhysicalToRaw(@CAN_PrivMain::RFL_Object::RXX_Object_Obj44.VyAyCoVnce, 0.01, 0.0);
    copyBitsToByteArrayLE(raw_value, byteArray, 23488, 12);

    raw_value = convertPhysicalToRaw(@CAN_PrivMain::RFL_Object::RXX_Object_Obj44.VyAxCoVnce, 0.01, 0.0);
    copyBitsToByteArrayLE(raw_value, byteArray, 23468, 12);

    raw_value = convertPhysicalToRaw(@CAN_PrivMain::RFL_Object::RXX_Object_Obj44.VxAyCoVnce, 0.01, 0.0);
    copyBitsToByteArrayLE(raw_value, byteArray, 23456, 12);

    raw_value = convertPhysicalToRaw(@CAN_PrivMain::RFL_Object::RXX_Object_Obj44.VxAxCoVnce, 0.01, 0.0);
    copyBitsToByteArrayLE(raw_value, byteArray, 23436, 12);

    raw_value = convertPhysicalToRaw(@CAN_PrivMain::RFL_Object::RXX_Object_Obj44.PyAyCoVnce, 0.01, 0.0);
    copyBitsToByteArrayLE(raw_value, byteArray, 23404, 12);

    raw_value = convertPhysicalToRaw(@CAN_PrivMain::RFL_Object::RXX_Object_Obj44.PyAxCoVnce, 0.01, 0.0);
    copyBitsToByteArrayLE(raw_value, byteArray, 23392, 12);

    raw_value = convertPhysicalToRaw(@CAN_PrivMain::RFL_Object::RXX_Object_Obj44.PxAyCoVnce, 0.01, 0.0);
    copyBitsToByteArrayLE(raw_value, byteArray, 23372, 12);

    raw_value = convertPhysicalToRaw(@CAN_PrivMain::RFL_Object::RXX_Object_Obj44.VxVyCoVnce, 0.01, 0.0);
    copyBitsToByteArrayLE(raw_value, byteArray, 23424, 12);

    raw_value = convertPhysicalToRaw(@CAN_PrivMain::RFL_Object::RXX_Object_Obj44.ReferencePoint, 1.0, 0.0);
    copyBitsToByteArrayLE(raw_value, byteArray, 23352, 4);

    raw_value = convertPhysicalToRaw(@CAN_PrivMain::RFL_Object::RXX_Object_Obj44.PxVxCoVnce, 0.01, 0.0);
    copyBitsToByteArrayLE(raw_value, byteArray, 23296, 12);

    raw_value = convertPhysicalToRaw(@CAN_PrivMain::RFL_Object::RXX_Object_Obj44.PyVyCoVnce, 0.01, 0.0);
    copyBitsToByteArrayLE(raw_value, byteArray, 23340, 12);

    raw_value = convertPhysicalToRaw(@CAN_PrivMain::RFL_Object::RXX_Object_Obj44.MeasurementStatus, 1.0, 0.0);
    copyBitsToByteArrayLE(raw_value, byteArray, 23288, 3);

    raw_value = convertPhysicalToRaw(@CAN_PrivMain::RFL_Object::RXX_Object_Obj44.ProbClassType, 1.0, 0.0);
    copyBitsToByteArrayLE(raw_value, byteArray, 23291, 4);

    raw_value = convertPhysicalToRaw(@CAN_PrivMain::RFL_Object::RXX_Object_Obj44.PxPyCoVnce, 0.01, 0.0);
    copyBitsToByteArrayLE(raw_value, byteArray, 23276, 12);

    raw_value = convertPhysicalToRaw(@CAN_PrivMain::RFL_Object::RXX_Object_Obj44.PxVyCoVnce, 0.01, 0.0);
    copyBitsToByteArrayLE(raw_value, byteArray, 23308, 12);

    raw_value = convertPhysicalToRaw(@CAN_PrivMain::RFL_Object::RXX_Object_Obj44.FilterInformation, 1.0, 0.0);
    copyBitsToByteArrayLE(raw_value, byteArray, 23320, 8);

    raw_value = convertPhysicalToRaw(@CAN_PrivMain::RFL_Object::RXX_Object_Obj44.PyVxCoVnce, 0.01, 0.0);
    copyBitsToByteArrayLE(raw_value, byteArray, 23328, 12);
}


void RXX_Object_Obj43_write(byte byteArray[])
{
    qword raw_value;

    raw_value = convertPhysicalToRaw(@CAN_PrivMain::RFL_Object::RXX_Object_Obj43.AxVnce, 0.01, 0.0);
    copyBitsToByteArrayLE(raw_value, byteArray, 22624, 12);

    raw_value = convertPhysicalToRaw(@CAN_PrivMain::RFL_Object::RXX_Object_Obj43.VxVnce, 0.01, 0.0);
    copyBitsToByteArrayLE(raw_value, byteArray, 22720, 12);

    raw_value = convertPhysicalToRaw(@CAN_PrivMain::RFL_Object::RXX_Object_Obj43.ObjId, 1.0, 0.0);
    copyBitsToByteArrayLE(raw_value, byteArray, 22712, 7);

    raw_value = convertPhysicalToRaw(@CAN_PrivMain::RFL_Object::RXX_Object_Obj43.Vx, 0.0625, -128.0);
    copyBitsToByteArrayLE(raw_value, byteArray, 22700, 12);

    raw_value = convertPhysicalToRaw(@CAN_PrivMain::RFL_Object::RXX_Object_Obj43.AyVnce, 0.01, 0.0);
    copyBitsToByteArrayLE(raw_value, byteArray, 22688, 12);

    raw_value = convertPhysicalToRaw(@CAN_PrivMain::RFL_Object::RXX_Object_Obj43.Ay, 0.0625, -16.0);
    copyBitsToByteArrayLE(raw_value, byteArray, 22678, 9);

    raw_value = convertPhysicalToRaw(@CAN_PrivMain::RFL_Object::RXX_Object_Obj43.RCS, 0.2, -102.4);
    copyBitsToByteArrayLE(raw_value, byteArray, 22668, 10);

    raw_value = convertPhysicalToRaw(@CAN_PrivMain::RFL_Object::RXX_Object_Obj43.WidthVnce, 0.01, 0.0);
    copyBitsToByteArrayLE(raw_value, byteArray, 22656, 12);

    raw_value = convertPhysicalToRaw(@CAN_PrivMain::RFL_Object::RXX_Object_Obj43.Width, 0.125, 0.0);
    copyBitsToByteArrayLE(raw_value, byteArray, 22648, 7);

    raw_value = convertPhysicalToRaw(@CAN_PrivMain::RFL_Object::RXX_Object_Obj43.OrientationYawVnce, 0.0003, 0.0);
    copyBitsToByteArrayLE(raw_value, byteArray, 22636, 12);

    raw_value = convertPhysicalToRaw(@CAN_PrivMain::RFL_Object::RXX_Object_Obj43.Vy, 0.125, -64.0);
    copyBitsToByteArrayLE(raw_value, byteArray, 22734, 10);

    raw_value = convertPhysicalToRaw(@CAN_PrivMain::RFL_Object::RXX_Object_Obj43.OrientationYaw, 0.0175, -4.48);
    copyBitsToByteArrayLE(raw_value, byteArray, 22614, 9);

    raw_value = convertPhysicalToRaw(@CAN_PrivMain::RFL_Object::RXX_Object_Obj43.Ax, 0.03125, -16.0);
    copyBitsToByteArrayLE(raw_value, byteArray, 22604, 10);

    raw_value = convertPhysicalToRaw(@CAN_PrivMain::RFL_Object::RXX_Object_Obj43.LengthVnce, 0.01, 0.0);
    copyBitsToByteArrayLE(raw_value, byteArray, 22592, 12);

    raw_value = convertPhysicalToRaw(@CAN_PrivMain::RFL_Object::RXX_Object_Obj43.Length, 0.125, 0.0);
    copyBitsToByteArrayLE(raw_value, byteArray, 22584, 7);

    raw_value = convertPhysicalToRaw(@CAN_PrivMain::RFL_Object::RXX_Object_Obj43.PyVnce, 0.1, 0.0);
    copyBitsToByteArrayLE(raw_value, byteArray, 22572, 12);

    raw_value = convertPhysicalToRaw(@CAN_PrivMain::RFL_Object::RXX_Object_Obj43.Py, 0.0625, -128.0);
    copyBitsToByteArrayLE(raw_value, byteArray, 22560, 12);

    raw_value = convertPhysicalToRaw(@CAN_PrivMain::RFL_Object::RXX_Object_Obj43.PxVnce, 0.1, 0.0);
    copyBitsToByteArrayLE(raw_value, byteArray, 22548, 12);

    raw_value = convertPhysicalToRaw(@CAN_PrivMain::RFL_Object::RXX_Object_Obj43.Px, 0.0625, -512.0);
    copyBitsToByteArrayLE(raw_value, byteArray, 22534, 14);

    raw_value = convertPhysicalToRaw(@CAN_PrivMain::RFL_Object::RXX_Object_Obj43.ProbClassConfidence, 2.0, 0.0);
    copyBitsToByteArrayLE(raw_value, byteArray, 22528, 6);

    raw_value = convertPhysicalToRaw(@CAN_PrivMain::RFL_Object::RXX_Object_Obj43.MovingStatus, 1.0, 0.0);
    copyBitsToByteArrayLE(raw_value, byteArray, 22732, 2);

    raw_value = convertPhysicalToRaw(@CAN_PrivMain::RFL_Object::RXX_Object_Obj43.ReferencePoint, 1.0, 0.0);
    copyBitsToByteArrayLE(raw_value, byteArray, 22840, 4);

    raw_value = convertPhysicalToRaw(@CAN_PrivMain::RFL_Object::RXX_Object_Obj43.ExistProb, 2.0, 0.0);
    copyBitsToByteArrayLE(raw_value, byteArray, 22744, 6);

    raw_value = convertPhysicalToRaw(@CAN_PrivMain::RFL_Object::RXX_Object_Obj43.PxAxCoVnce, 0.01, 0.0);
    copyBitsToByteArrayLE(raw_value, byteArray, 22848, 12);

    raw_value = convertPhysicalToRaw(@CAN_PrivMain::RFL_Object::RXX_Object_Obj43.VyVnce, 0.01, 0.0);
    copyBitsToByteArrayLE(raw_value, byteArray, 22752, 12);

    raw_value = convertPhysicalToRaw(@CAN_PrivMain::RFL_Object::RXX_Object_Obj43.VyAyCoVnce, 0.01, 0.0);
    copyBitsToByteArrayLE(raw_value, byteArray, 22976, 12);

    raw_value = convertPhysicalToRaw(@CAN_PrivMain::RFL_Object::RXX_Object_Obj43.VyAxCoVnce, 0.01, 0.0);
    copyBitsToByteArrayLE(raw_value, byteArray, 22956, 12);

    raw_value = convertPhysicalToRaw(@CAN_PrivMain::RFL_Object::RXX_Object_Obj43.VxAyCoVnce, 0.01, 0.0);
    copyBitsToByteArrayLE(raw_value, byteArray, 22944, 12);

    raw_value = convertPhysicalToRaw(@CAN_PrivMain::RFL_Object::RXX_Object_Obj43.VxAxCoVnce, 0.01, 0.0);
    copyBitsToByteArrayLE(raw_value, byteArray, 22924, 12);

    raw_value = convertPhysicalToRaw(@CAN_PrivMain::RFL_Object::RXX_Object_Obj43.VxVyCoVnce, 0.01, 0.0);
    copyBitsToByteArrayLE(raw_value, byteArray, 22912, 12);

    raw_value = convertPhysicalToRaw(@CAN_PrivMain::RFL_Object::RXX_Object_Obj43.PyAyCoVnce, 0.01, 0.0);
    copyBitsToByteArrayLE(raw_value, byteArray, 22892, 12);

    raw_value = convertPhysicalToRaw(@CAN_PrivMain::RFL_Object::RXX_Object_Obj43.PyAxCoVnce, 0.01, 0.0);
    copyBitsToByteArrayLE(raw_value, byteArray, 22880, 12);

    raw_value = convertPhysicalToRaw(@CAN_PrivMain::RFL_Object::RXX_Object_Obj43.PxAyCoVnce, 0.01, 0.0);
    copyBitsToByteArrayLE(raw_value, byteArray, 22860, 12);

    raw_value = convertPhysicalToRaw(@CAN_PrivMain::RFL_Object::RXX_Object_Obj43.AxAyCoVnce, 0.01, 0.0);
    copyBitsToByteArrayLE(raw_value, byteArray, 22988, 12);

    raw_value = convertPhysicalToRaw(@CAN_PrivMain::RFL_Object::RXX_Object_Obj43.Age, 1.0, 0.0);
    copyBitsToByteArrayLE(raw_value, byteArray, 23008, 32);

    raw_value = convertPhysicalToRaw(@CAN_PrivMain::RFL_Object::RXX_Object_Obj43.PxVxCoVnce, 0.01, 0.0);
    copyBitsToByteArrayLE(raw_value, byteArray, 22784, 12);

    raw_value = convertPhysicalToRaw(@CAN_PrivMain::RFL_Object::RXX_Object_Obj43.PyVyCoVnce, 0.01, 0.0);
    copyBitsToByteArrayLE(raw_value, byteArray, 22828, 12);

    raw_value = convertPhysicalToRaw(@CAN_PrivMain::RFL_Object::RXX_Object_Obj43.MeasurementStatus, 1.0, 0.0);
    copyBitsToByteArrayLE(raw_value, byteArray, 22776, 3);

    raw_value = convertPhysicalToRaw(@CAN_PrivMain::RFL_Object::RXX_Object_Obj43.ProbClassType, 1.0, 0.0);
    copyBitsToByteArrayLE(raw_value, byteArray, 22779, 4);

    raw_value = convertPhysicalToRaw(@CAN_PrivMain::RFL_Object::RXX_Object_Obj43.PxPyCoVnce, 0.01, 0.0);
    copyBitsToByteArrayLE(raw_value, byteArray, 22764, 12);

    raw_value = convertPhysicalToRaw(@CAN_PrivMain::RFL_Object::RXX_Object_Obj43.PxVyCoVnce, 0.01, 0.0);
    copyBitsToByteArrayLE(raw_value, byteArray, 22796, 12);

    raw_value = convertPhysicalToRaw(@CAN_PrivMain::RFL_Object::RXX_Object_Obj43.FilterInformation, 1.0, 0.0);
    copyBitsToByteArrayLE(raw_value, byteArray, 22808, 8);

    raw_value = convertPhysicalToRaw(@CAN_PrivMain::RFL_Object::RXX_Object_Obj43.PyVxCoVnce, 0.01, 0.0);
    copyBitsToByteArrayLE(raw_value, byteArray, 22816, 12);
}


void RXX_Object_Obj42_write(byte byteArray[])
{
    qword raw_value;

    raw_value = convertPhysicalToRaw(@CAN_PrivMain::RFL_Object::RXX_Object_Obj42.ObjId, 1.0, 0.0);
    copyBitsToByteArrayLE(raw_value, byteArray, 22200, 7);

    raw_value = convertPhysicalToRaw(@CAN_PrivMain::RFL_Object::RXX_Object_Obj42.AxVnce, 0.01, 0.0);
    copyBitsToByteArrayLE(raw_value, byteArray, 22112, 12);

    raw_value = convertPhysicalToRaw(@CAN_PrivMain::RFL_Object::RXX_Object_Obj42.Vx, 0.0625, -128.0);
    copyBitsToByteArrayLE(raw_value, byteArray, 22188, 12);

    raw_value = convertPhysicalToRaw(@CAN_PrivMain::RFL_Object::RXX_Object_Obj42.AyVnce, 0.01, 0.0);
    copyBitsToByteArrayLE(raw_value, byteArray, 22176, 12);

    raw_value = convertPhysicalToRaw(@CAN_PrivMain::RFL_Object::RXX_Object_Obj42.Ay, 0.0625, -16.0);
    copyBitsToByteArrayLE(raw_value, byteArray, 22166, 9);

    raw_value = convertPhysicalToRaw(@CAN_PrivMain::RFL_Object::RXX_Object_Obj42.RCS, 0.2, -102.4);
    copyBitsToByteArrayLE(raw_value, byteArray, 22156, 10);

    raw_value = convertPhysicalToRaw(@CAN_PrivMain::RFL_Object::RXX_Object_Obj42.WidthVnce, 0.01, 0.0);
    copyBitsToByteArrayLE(raw_value, byteArray, 22144, 12);

    raw_value = convertPhysicalToRaw(@CAN_PrivMain::RFL_Object::RXX_Object_Obj42.Width, 0.125, 0.0);
    copyBitsToByteArrayLE(raw_value, byteArray, 22136, 7);

    raw_value = convertPhysicalToRaw(@CAN_PrivMain::RFL_Object::RXX_Object_Obj42.OrientationYawVnce, 0.0003, 0.0);
    copyBitsToByteArrayLE(raw_value, byteArray, 22124, 12);

    raw_value = convertPhysicalToRaw(@CAN_PrivMain::RFL_Object::RXX_Object_Obj42.PyVnce, 0.1, 0.0);
    copyBitsToByteArrayLE(raw_value, byteArray, 22060, 12);

    raw_value = convertPhysicalToRaw(@CAN_PrivMain::RFL_Object::RXX_Object_Obj42.OrientationYaw, 0.0175, -4.48);
    copyBitsToByteArrayLE(raw_value, byteArray, 22102, 9);

    raw_value = convertPhysicalToRaw(@CAN_PrivMain::RFL_Object::RXX_Object_Obj42.Ax, 0.03125, -16.0);
    copyBitsToByteArrayLE(raw_value, byteArray, 22092, 10);

    raw_value = convertPhysicalToRaw(@CAN_PrivMain::RFL_Object::RXX_Object_Obj42.LengthVnce, 0.01, 0.0);
    copyBitsToByteArrayLE(raw_value, byteArray, 22080, 12);

    raw_value = convertPhysicalToRaw(@CAN_PrivMain::RFL_Object::RXX_Object_Obj42.Length, 0.125, 0.0);
    copyBitsToByteArrayLE(raw_value, byteArray, 22072, 7);

    raw_value = convertPhysicalToRaw(@CAN_PrivMain::RFL_Object::RXX_Object_Obj42.Py, 0.0625, -128.0);
    copyBitsToByteArrayLE(raw_value, byteArray, 22048, 12);

    raw_value = convertPhysicalToRaw(@CAN_PrivMain::RFL_Object::RXX_Object_Obj42.PxVnce, 0.1, 0.0);
    copyBitsToByteArrayLE(raw_value, byteArray, 22036, 12);

    raw_value = convertPhysicalToRaw(@CAN_PrivMain::RFL_Object::RXX_Object_Obj42.Px, 0.0625, -512.0);
    copyBitsToByteArrayLE(raw_value, byteArray, 22022, 14);

    raw_value = convertPhysicalToRaw(@CAN_PrivMain::RFL_Object::RXX_Object_Obj42.ProbClassConfidence, 2.0, 0.0);
    copyBitsToByteArrayLE(raw_value, byteArray, 22016, 6);

    raw_value = convertPhysicalToRaw(@CAN_PrivMain::RFL_Object::RXX_Object_Obj42.MovingStatus, 1.0, 0.0);
    copyBitsToByteArrayLE(raw_value, byteArray, 22220, 2);

    raw_value = convertPhysicalToRaw(@CAN_PrivMain::RFL_Object::RXX_Object_Obj42.VxVnce, 0.01, 0.0);
    copyBitsToByteArrayLE(raw_value, byteArray, 22208, 12);

    raw_value = convertPhysicalToRaw(@CAN_PrivMain::RFL_Object::RXX_Object_Obj42.Vy, 0.125, -64.0);
    copyBitsToByteArrayLE(raw_value, byteArray, 22222, 10);

    raw_value = convertPhysicalToRaw(@CAN_PrivMain::RFL_Object::RXX_Object_Obj42.AxAyCoVnce, 0.01, 0.0);
    copyBitsToByteArrayLE(raw_value, byteArray, 22476, 12);

    raw_value = convertPhysicalToRaw(@CAN_PrivMain::RFL_Object::RXX_Object_Obj42.PxAxCoVnce, 0.01, 0.0);
    copyBitsToByteArrayLE(raw_value, byteArray, 22336, 12);

    raw_value = convertPhysicalToRaw(@CAN_PrivMain::RFL_Object::RXX_Object_Obj42.Age, 1.0, 0.0);
    copyBitsToByteArrayLE(raw_value, byteArray, 22496, 32);

    raw_value = convertPhysicalToRaw(@CAN_PrivMain::RFL_Object::RXX_Object_Obj42.ExistProb, 2.0, 0.0);
    copyBitsToByteArrayLE(raw_value, byteArray, 22232, 6);

    raw_value = convertPhysicalToRaw(@CAN_PrivMain::RFL_Object::RXX_Object_Obj42.VyAyCoVnce, 0.01, 0.0);
    copyBitsToByteArrayLE(raw_value, byteArray, 22464, 12);

    raw_value = convertPhysicalToRaw(@CAN_PrivMain::RFL_Object::RXX_Object_Obj42.VyAxCoVnce, 0.01, 0.0);
    copyBitsToByteArrayLE(raw_value, byteArray, 22444, 12);

    raw_value = convertPhysicalToRaw(@CAN_PrivMain::RFL_Object::RXX_Object_Obj42.VxAyCoVnce, 0.01, 0.0);
    copyBitsToByteArrayLE(raw_value, byteArray, 22432, 12);

    raw_value = convertPhysicalToRaw(@CAN_PrivMain::RFL_Object::RXX_Object_Obj42.VxAxCoVnce, 0.01, 0.0);
    copyBitsToByteArrayLE(raw_value, byteArray, 22412, 12);

    raw_value = convertPhysicalToRaw(@CAN_PrivMain::RFL_Object::RXX_Object_Obj42.PyAyCoVnce, 0.01, 0.0);
    copyBitsToByteArrayLE(raw_value, byteArray, 22380, 12);

    raw_value = convertPhysicalToRaw(@CAN_PrivMain::RFL_Object::RXX_Object_Obj42.PyAxCoVnce, 0.01, 0.0);
    copyBitsToByteArrayLE(raw_value, byteArray, 22368, 12);

    raw_value = convertPhysicalToRaw(@CAN_PrivMain::RFL_Object::RXX_Object_Obj42.PxAyCoVnce, 0.01, 0.0);
    copyBitsToByteArrayLE(raw_value, byteArray, 22348, 12);

    raw_value = convertPhysicalToRaw(@CAN_PrivMain::RFL_Object::RXX_Object_Obj42.VxVyCoVnce, 0.01, 0.0);
    copyBitsToByteArrayLE(raw_value, byteArray, 22400, 12);

    raw_value = convertPhysicalToRaw(@CAN_PrivMain::RFL_Object::RXX_Object_Obj42.ReferencePoint, 1.0, 0.0);
    copyBitsToByteArrayLE(raw_value, byteArray, 22328, 4);

    raw_value = convertPhysicalToRaw(@CAN_PrivMain::RFL_Object::RXX_Object_Obj42.PxVxCoVnce, 0.01, 0.0);
    copyBitsToByteArrayLE(raw_value, byteArray, 22272, 12);

    raw_value = convertPhysicalToRaw(@CAN_PrivMain::RFL_Object::RXX_Object_Obj42.PyVyCoVnce, 0.01, 0.0);
    copyBitsToByteArrayLE(raw_value, byteArray, 22316, 12);

    raw_value = convertPhysicalToRaw(@CAN_PrivMain::RFL_Object::RXX_Object_Obj42.PxPyCoVnce, 0.01, 0.0);
    copyBitsToByteArrayLE(raw_value, byteArray, 22252, 12);

    raw_value = convertPhysicalToRaw(@CAN_PrivMain::RFL_Object::RXX_Object_Obj42.MeasurementStatus, 1.0, 0.0);
    copyBitsToByteArrayLE(raw_value, byteArray, 22264, 3);

    raw_value = convertPhysicalToRaw(@CAN_PrivMain::RFL_Object::RXX_Object_Obj42.ProbClassType, 1.0, 0.0);
    copyBitsToByteArrayLE(raw_value, byteArray, 22267, 4);

    raw_value = convertPhysicalToRaw(@CAN_PrivMain::RFL_Object::RXX_Object_Obj42.VyVnce, 0.01, 0.0);
    copyBitsToByteArrayLE(raw_value, byteArray, 22240, 12);

    raw_value = convertPhysicalToRaw(@CAN_PrivMain::RFL_Object::RXX_Object_Obj42.PxVyCoVnce, 0.01, 0.0);
    copyBitsToByteArrayLE(raw_value, byteArray, 22284, 12);

    raw_value = convertPhysicalToRaw(@CAN_PrivMain::RFL_Object::RXX_Object_Obj42.FilterInformation, 1.0, 0.0);
    copyBitsToByteArrayLE(raw_value, byteArray, 22296, 8);

    raw_value = convertPhysicalToRaw(@CAN_PrivMain::RFL_Object::RXX_Object_Obj42.PyVxCoVnce, 0.01, 0.0);
    copyBitsToByteArrayLE(raw_value, byteArray, 22304, 12);
}


void RXX_Object_Obj41_write(byte byteArray[])
{
    qword raw_value;

    raw_value = convertPhysicalToRaw(@CAN_PrivMain::RFL_Object::RXX_Object_Obj41.AxVnce, 0.01, 0.0);
    copyBitsToByteArrayLE(raw_value, byteArray, 21600, 12);

    raw_value = convertPhysicalToRaw(@CAN_PrivMain::RFL_Object::RXX_Object_Obj41.VxVnce, 0.01, 0.0);
    copyBitsToByteArrayLE(raw_value, byteArray, 21696, 12);

    raw_value = convertPhysicalToRaw(@CAN_PrivMain::RFL_Object::RXX_Object_Obj41.ObjId, 1.0, 0.0);
    copyBitsToByteArrayLE(raw_value, byteArray, 21688, 7);

    raw_value = convertPhysicalToRaw(@CAN_PrivMain::RFL_Object::RXX_Object_Obj41.Vx, 0.0625, -128.0);
    copyBitsToByteArrayLE(raw_value, byteArray, 21676, 12);

    raw_value = convertPhysicalToRaw(@CAN_PrivMain::RFL_Object::RXX_Object_Obj41.AyVnce, 0.01, 0.0);
    copyBitsToByteArrayLE(raw_value, byteArray, 21664, 12);

    raw_value = convertPhysicalToRaw(@CAN_PrivMain::RFL_Object::RXX_Object_Obj41.Ay, 0.0625, -16.0);
    copyBitsToByteArrayLE(raw_value, byteArray, 21654, 9);

    raw_value = convertPhysicalToRaw(@CAN_PrivMain::RFL_Object::RXX_Object_Obj41.RCS, 0.2, -102.4);
    copyBitsToByteArrayLE(raw_value, byteArray, 21644, 10);

    raw_value = convertPhysicalToRaw(@CAN_PrivMain::RFL_Object::RXX_Object_Obj41.WidthVnce, 0.01, 0.0);
    copyBitsToByteArrayLE(raw_value, byteArray, 21632, 12);

    raw_value = convertPhysicalToRaw(@CAN_PrivMain::RFL_Object::RXX_Object_Obj41.Width, 0.125, 0.0);
    copyBitsToByteArrayLE(raw_value, byteArray, 21624, 7);

    raw_value = convertPhysicalToRaw(@CAN_PrivMain::RFL_Object::RXX_Object_Obj41.OrientationYawVnce, 0.0003, 0.0);
    copyBitsToByteArrayLE(raw_value, byteArray, 21612, 12);

    raw_value = convertPhysicalToRaw(@CAN_PrivMain::RFL_Object::RXX_Object_Obj41.Vy, 0.125, -64.0);
    copyBitsToByteArrayLE(raw_value, byteArray, 21710, 10);

    raw_value = convertPhysicalToRaw(@CAN_PrivMain::RFL_Object::RXX_Object_Obj41.OrientationYaw, 0.0175, -4.48);
    copyBitsToByteArrayLE(raw_value, byteArray, 21590, 9);

    raw_value = convertPhysicalToRaw(@CAN_PrivMain::RFL_Object::RXX_Object_Obj41.Ax, 0.03125, -16.0);
    copyBitsToByteArrayLE(raw_value, byteArray, 21580, 10);

    raw_value = convertPhysicalToRaw(@CAN_PrivMain::RFL_Object::RXX_Object_Obj41.LengthVnce, 0.01, 0.0);
    copyBitsToByteArrayLE(raw_value, byteArray, 21568, 12);

    raw_value = convertPhysicalToRaw(@CAN_PrivMain::RFL_Object::RXX_Object_Obj41.Length, 0.125, 0.0);
    copyBitsToByteArrayLE(raw_value, byteArray, 21560, 7);

    raw_value = convertPhysicalToRaw(@CAN_PrivMain::RFL_Object::RXX_Object_Obj41.PyVnce, 0.1, 0.0);
    copyBitsToByteArrayLE(raw_value, byteArray, 21548, 12);

    raw_value = convertPhysicalToRaw(@CAN_PrivMain::RFL_Object::RXX_Object_Obj41.Py, 0.0625, -128.0);
    copyBitsToByteArrayLE(raw_value, byteArray, 21536, 12);

    raw_value = convertPhysicalToRaw(@CAN_PrivMain::RFL_Object::RXX_Object_Obj41.PxVnce, 0.1, 0.0);
    copyBitsToByteArrayLE(raw_value, byteArray, 21524, 12);

    raw_value = convertPhysicalToRaw(@CAN_PrivMain::RFL_Object::RXX_Object_Obj41.Px, 0.0625, -512.0);
    copyBitsToByteArrayLE(raw_value, byteArray, 21510, 14);

    raw_value = convertPhysicalToRaw(@CAN_PrivMain::RFL_Object::RXX_Object_Obj41.ProbClassConfidence, 2.0, 0.0);
    copyBitsToByteArrayLE(raw_value, byteArray, 21504, 6);

    raw_value = convertPhysicalToRaw(@CAN_PrivMain::RFL_Object::RXX_Object_Obj41.MovingStatus, 1.0, 0.0);
    copyBitsToByteArrayLE(raw_value, byteArray, 21708, 2);

    raw_value = convertPhysicalToRaw(@CAN_PrivMain::RFL_Object::RXX_Object_Obj41.Age, 1.0, 0.0);
    copyBitsToByteArrayLE(raw_value, byteArray, 21984, 32);

    raw_value = convertPhysicalToRaw(@CAN_PrivMain::RFL_Object::RXX_Object_Obj41.ExistProb, 2.0, 0.0);
    copyBitsToByteArrayLE(raw_value, byteArray, 21720, 6);

    raw_value = convertPhysicalToRaw(@CAN_PrivMain::RFL_Object::RXX_Object_Obj41.PxAxCoVnce, 0.01, 0.0);
    copyBitsToByteArrayLE(raw_value, byteArray, 21824, 12);

    raw_value = convertPhysicalToRaw(@CAN_PrivMain::RFL_Object::RXX_Object_Obj41.VyVnce, 0.01, 0.0);
    copyBitsToByteArrayLE(raw_value, byteArray, 21728, 12);

    raw_value = convertPhysicalToRaw(@CAN_PrivMain::RFL_Object::RXX_Object_Obj41.VyAyCoVnce, 0.01, 0.0);
    copyBitsToByteArrayLE(raw_value, byteArray, 21952, 12);

    raw_value = convertPhysicalToRaw(@CAN_PrivMain::RFL_Object::RXX_Object_Obj41.VyAxCoVnce, 0.01, 0.0);
    copyBitsToByteArrayLE(raw_value, byteArray, 21932, 12);

    raw_value = convertPhysicalToRaw(@CAN_PrivMain::RFL_Object::RXX_Object_Obj41.VxAyCoVnce, 0.01, 0.0);
    copyBitsToByteArrayLE(raw_value, byteArray, 21920, 12);

    raw_value = convertPhysicalToRaw(@CAN_PrivMain::RFL_Object::RXX_Object_Obj41.VxAxCoVnce, 0.01, 0.0);
    copyBitsToByteArrayLE(raw_value, byteArray, 21900, 12);

    raw_value = convertPhysicalToRaw(@CAN_PrivMain::RFL_Object::RXX_Object_Obj41.VxVyCoVnce, 0.01, 0.0);
    copyBitsToByteArrayLE(raw_value, byteArray, 21888, 12);

    raw_value = convertPhysicalToRaw(@CAN_PrivMain::RFL_Object::RXX_Object_Obj41.PyAyCoVnce, 0.01, 0.0);
    copyBitsToByteArrayLE(raw_value, byteArray, 21868, 12);

    raw_value = convertPhysicalToRaw(@CAN_PrivMain::RFL_Object::RXX_Object_Obj41.PyAxCoVnce, 0.01, 0.0);
    copyBitsToByteArrayLE(raw_value, byteArray, 21856, 12);

    raw_value = convertPhysicalToRaw(@CAN_PrivMain::RFL_Object::RXX_Object_Obj41.PxAyCoVnce, 0.01, 0.0);
    copyBitsToByteArrayLE(raw_value, byteArray, 21836, 12);

    raw_value = convertPhysicalToRaw(@CAN_PrivMain::RFL_Object::RXX_Object_Obj41.AxAyCoVnce, 0.01, 0.0);
    copyBitsToByteArrayLE(raw_value, byteArray, 21964, 12);

    raw_value = convertPhysicalToRaw(@CAN_PrivMain::RFL_Object::RXX_Object_Obj41.ReferencePoint, 1.0, 0.0);
    copyBitsToByteArrayLE(raw_value, byteArray, 21816, 4);

    raw_value = convertPhysicalToRaw(@CAN_PrivMain::RFL_Object::RXX_Object_Obj41.PyVxCoVnce, 0.01, 0.0);
    copyBitsToByteArrayLE(raw_value, byteArray, 21792, 12);

    raw_value = convertPhysicalToRaw(@CAN_PrivMain::RFL_Object::RXX_Object_Obj41.FilterInformation, 1.0, 0.0);
    copyBitsToByteArrayLE(raw_value, byteArray, 21784, 8);

    raw_value = convertPhysicalToRaw(@CAN_PrivMain::RFL_Object::RXX_Object_Obj41.PxVyCoVnce, 0.01, 0.0);
    copyBitsToByteArrayLE(raw_value, byteArray, 21772, 12);

    raw_value = convertPhysicalToRaw(@CAN_PrivMain::RFL_Object::RXX_Object_Obj41.PxVxCoVnce, 0.01, 0.0);
    copyBitsToByteArrayLE(raw_value, byteArray, 21760, 12);

    raw_value = convertPhysicalToRaw(@CAN_PrivMain::RFL_Object::RXX_Object_Obj41.ProbClassType, 1.0, 0.0);
    copyBitsToByteArrayLE(raw_value, byteArray, 21755, 4);

    raw_value = convertPhysicalToRaw(@CAN_PrivMain::RFL_Object::RXX_Object_Obj41.MeasurementStatus, 1.0, 0.0);
    copyBitsToByteArrayLE(raw_value, byteArray, 21752, 3);

    raw_value = convertPhysicalToRaw(@CAN_PrivMain::RFL_Object::RXX_Object_Obj41.PxPyCoVnce, 0.01, 0.0);
    copyBitsToByteArrayLE(raw_value, byteArray, 21740, 12);

    raw_value = convertPhysicalToRaw(@CAN_PrivMain::RFL_Object::RXX_Object_Obj41.PyVyCoVnce, 0.01, 0.0);
    copyBitsToByteArrayLE(raw_value, byteArray, 21804, 12);
}


void RXX_Object_Obj40_write(byte byteArray[])
{
    qword raw_value;

    raw_value = convertPhysicalToRaw(@CAN_PrivMain::RFL_Object::RXX_Object_Obj40.Ay, 0.0625, -16.0);
    copyBitsToByteArrayLE(raw_value, byteArray, 21142, 9);

    raw_value = convertPhysicalToRaw(@CAN_PrivMain::RFL_Object::RXX_Object_Obj40.WidthVnce, 0.01, 0.0);
    copyBitsToByteArrayLE(raw_value, byteArray, 21120, 12);

    raw_value = convertPhysicalToRaw(@CAN_PrivMain::RFL_Object::RXX_Object_Obj40.RCS, 0.2, -102.4);
    copyBitsToByteArrayLE(raw_value, byteArray, 21132, 10);

    raw_value = convertPhysicalToRaw(@CAN_PrivMain::RFL_Object::RXX_Object_Obj40.VxVnce, 0.01, 0.0);
    copyBitsToByteArrayLE(raw_value, byteArray, 21184, 12);

    raw_value = convertPhysicalToRaw(@CAN_PrivMain::RFL_Object::RXX_Object_Obj40.AyVnce, 0.01, 0.0);
    copyBitsToByteArrayLE(raw_value, byteArray, 21152, 12);

    raw_value = convertPhysicalToRaw(@CAN_PrivMain::RFL_Object::RXX_Object_Obj40.Vx, 0.0625, -128.0);
    copyBitsToByteArrayLE(raw_value, byteArray, 21164, 12);

    raw_value = convertPhysicalToRaw(@CAN_PrivMain::RFL_Object::RXX_Object_Obj40.ObjId, 1.0, 0.0);
    copyBitsToByteArrayLE(raw_value, byteArray, 21176, 7);

    raw_value = convertPhysicalToRaw(@CAN_PrivMain::RFL_Object::RXX_Object_Obj40.OrientationYawVnce, 0.0003, 0.0);
    copyBitsToByteArrayLE(raw_value, byteArray, 21100, 12);

    raw_value = convertPhysicalToRaw(@CAN_PrivMain::RFL_Object::RXX_Object_Obj40.Width, 0.125, 0.0);
    copyBitsToByteArrayLE(raw_value, byteArray, 21112, 7);

    raw_value = convertPhysicalToRaw(@CAN_PrivMain::RFL_Object::RXX_Object_Obj40.Length, 0.125, 0.0);
    copyBitsToByteArrayLE(raw_value, byteArray, 21048, 7);

    raw_value = convertPhysicalToRaw(@CAN_PrivMain::RFL_Object::RXX_Object_Obj40.AxVnce, 0.01, 0.0);
    copyBitsToByteArrayLE(raw_value, byteArray, 21088, 12);

    raw_value = convertPhysicalToRaw(@CAN_PrivMain::RFL_Object::RXX_Object_Obj40.OrientationYaw, 0.0175, -4.48);
    copyBitsToByteArrayLE(raw_value, byteArray, 21078, 9);

    raw_value = convertPhysicalToRaw(@CAN_PrivMain::RFL_Object::RXX_Object_Obj40.Ax, 0.03125, -16.0);
    copyBitsToByteArrayLE(raw_value, byteArray, 21068, 10);

    raw_value = convertPhysicalToRaw(@CAN_PrivMain::RFL_Object::RXX_Object_Obj40.LengthVnce, 0.01, 0.0);
    copyBitsToByteArrayLE(raw_value, byteArray, 21056, 12);

    raw_value = convertPhysicalToRaw(@CAN_PrivMain::RFL_Object::RXX_Object_Obj40.PyVnce, 0.1, 0.0);
    copyBitsToByteArrayLE(raw_value, byteArray, 21036, 12);

    raw_value = convertPhysicalToRaw(@CAN_PrivMain::RFL_Object::RXX_Object_Obj40.Py, 0.0625, -128.0);
    copyBitsToByteArrayLE(raw_value, byteArray, 21024, 12);

    raw_value = convertPhysicalToRaw(@CAN_PrivMain::RFL_Object::RXX_Object_Obj40.PxVnce, 0.1, 0.0);
    copyBitsToByteArrayLE(raw_value, byteArray, 21012, 12);

    raw_value = convertPhysicalToRaw(@CAN_PrivMain::RFL_Object::RXX_Object_Obj40.Px, 0.0625, -512.0);
    copyBitsToByteArrayLE(raw_value, byteArray, 20998, 14);

    raw_value = convertPhysicalToRaw(@CAN_PrivMain::RFL_Object::RXX_Object_Obj40.ProbClassConfidence, 2.0, 0.0);
    copyBitsToByteArrayLE(raw_value, byteArray, 20992, 6);

    raw_value = convertPhysicalToRaw(@CAN_PrivMain::RFL_Object::RXX_Object_Obj40.MovingStatus, 1.0, 0.0);
    copyBitsToByteArrayLE(raw_value, byteArray, 21196, 2);

    raw_value = convertPhysicalToRaw(@CAN_PrivMain::RFL_Object::RXX_Object_Obj40.Vy, 0.125, -64.0);
    copyBitsToByteArrayLE(raw_value, byteArray, 21198, 10);

    raw_value = convertPhysicalToRaw(@CAN_PrivMain::RFL_Object::RXX_Object_Obj40.ExistProb, 2.0, 0.0);
    copyBitsToByteArrayLE(raw_value, byteArray, 21208, 6);

    raw_value = convertPhysicalToRaw(@CAN_PrivMain::RFL_Object::RXX_Object_Obj40.PxAyCoVnce, 0.01, 0.0);
    copyBitsToByteArrayLE(raw_value, byteArray, 21324, 12);

    raw_value = convertPhysicalToRaw(@CAN_PrivMain::RFL_Object::RXX_Object_Obj40.VyVnce, 0.01, 0.0);
    copyBitsToByteArrayLE(raw_value, byteArray, 21216, 12);

    raw_value = convertPhysicalToRaw(@CAN_PrivMain::RFL_Object::RXX_Object_Obj40.AxAyCoVnce, 0.01, 0.0);
    copyBitsToByteArrayLE(raw_value, byteArray, 21452, 12);

    raw_value = convertPhysicalToRaw(@CAN_PrivMain::RFL_Object::RXX_Object_Obj40.VyAyCoVnce, 0.01, 0.0);
    copyBitsToByteArrayLE(raw_value, byteArray, 21440, 12);

    raw_value = convertPhysicalToRaw(@CAN_PrivMain::RFL_Object::RXX_Object_Obj40.VyAxCoVnce, 0.01, 0.0);
    copyBitsToByteArrayLE(raw_value, byteArray, 21420, 12);

    raw_value = convertPhysicalToRaw(@CAN_PrivMain::RFL_Object::RXX_Object_Obj40.VxAyCoVnce, 0.01, 0.0);
    copyBitsToByteArrayLE(raw_value, byteArray, 21408, 12);

    raw_value = convertPhysicalToRaw(@CAN_PrivMain::RFL_Object::RXX_Object_Obj40.VxAxCoVnce, 0.01, 0.0);
    copyBitsToByteArrayLE(raw_value, byteArray, 21388, 12);

    raw_value = convertPhysicalToRaw(@CAN_PrivMain::RFL_Object::RXX_Object_Obj40.VxVyCoVnce, 0.01, 0.0);
    copyBitsToByteArrayLE(raw_value, byteArray, 21376, 12);

    raw_value = convertPhysicalToRaw(@CAN_PrivMain::RFL_Object::RXX_Object_Obj40.PyAyCoVnce, 0.01, 0.0);
    copyBitsToByteArrayLE(raw_value, byteArray, 21356, 12);

    raw_value = convertPhysicalToRaw(@CAN_PrivMain::RFL_Object::RXX_Object_Obj40.PyAxCoVnce, 0.01, 0.0);
    copyBitsToByteArrayLE(raw_value, byteArray, 21344, 12);

    raw_value = convertPhysicalToRaw(@CAN_PrivMain::RFL_Object::RXX_Object_Obj40.Age, 1.0, 0.0);
    copyBitsToByteArrayLE(raw_value, byteArray, 21472, 32);

    raw_value = convertPhysicalToRaw(@CAN_PrivMain::RFL_Object::RXX_Object_Obj40.PxAxCoVnce, 0.01, 0.0);
    copyBitsToByteArrayLE(raw_value, byteArray, 21312, 12);

    raw_value = convertPhysicalToRaw(@CAN_PrivMain::RFL_Object::RXX_Object_Obj40.PyVyCoVnce, 0.01, 0.0);
    copyBitsToByteArrayLE(raw_value, byteArray, 21292, 12);

    raw_value = convertPhysicalToRaw(@CAN_PrivMain::RFL_Object::RXX_Object_Obj40.PyVxCoVnce, 0.01, 0.0);
    copyBitsToByteArrayLE(raw_value, byteArray, 21280, 12);

    raw_value = convertPhysicalToRaw(@CAN_PrivMain::RFL_Object::RXX_Object_Obj40.FilterInformation, 1.0, 0.0);
    copyBitsToByteArrayLE(raw_value, byteArray, 21272, 8);

    raw_value = convertPhysicalToRaw(@CAN_PrivMain::RFL_Object::RXX_Object_Obj40.PxVyCoVnce, 0.01, 0.0);
    copyBitsToByteArrayLE(raw_value, byteArray, 21260, 12);

    raw_value = convertPhysicalToRaw(@CAN_PrivMain::RFL_Object::RXX_Object_Obj40.PxVxCoVnce, 0.01, 0.0);
    copyBitsToByteArrayLE(raw_value, byteArray, 21248, 12);

    raw_value = convertPhysicalToRaw(@CAN_PrivMain::RFL_Object::RXX_Object_Obj40.ProbClassType, 1.0, 0.0);
    copyBitsToByteArrayLE(raw_value, byteArray, 21243, 4);

    raw_value = convertPhysicalToRaw(@CAN_PrivMain::RFL_Object::RXX_Object_Obj40.MeasurementStatus, 1.0, 0.0);
    copyBitsToByteArrayLE(raw_value, byteArray, 21240, 3);

    raw_value = convertPhysicalToRaw(@CAN_PrivMain::RFL_Object::RXX_Object_Obj40.PxPyCoVnce, 0.01, 0.0);
    copyBitsToByteArrayLE(raw_value, byteArray, 21228, 12);

    raw_value = convertPhysicalToRaw(@CAN_PrivMain::RFL_Object::RXX_Object_Obj40.ReferencePoint, 1.0, 0.0);
    copyBitsToByteArrayLE(raw_value, byteArray, 21304, 4);
}


void RXX_Object_Obj39_write(byte byteArray[])
{
    qword raw_value;

    raw_value = convertPhysicalToRaw(@CAN_PrivMain::RFL_Object::RXX_Object_Obj39.RCS, 0.2, -102.4);
    copyBitsToByteArrayLE(raw_value, byteArray, 20620, 10);

    raw_value = convertPhysicalToRaw(@CAN_PrivMain::RFL_Object::RXX_Object_Obj39.Width, 0.125, 0.0);
    copyBitsToByteArrayLE(raw_value, byteArray, 20600, 7);

    raw_value = convertPhysicalToRaw(@CAN_PrivMain::RFL_Object::RXX_Object_Obj39.WidthVnce, 0.01, 0.0);
    copyBitsToByteArrayLE(raw_value, byteArray, 20608, 12);

    raw_value = convertPhysicalToRaw(@CAN_PrivMain::RFL_Object::RXX_Object_Obj39.ObjId, 1.0, 0.0);
    copyBitsToByteArrayLE(raw_value, byteArray, 20664, 7);

    raw_value = convertPhysicalToRaw(@CAN_PrivMain::RFL_Object::RXX_Object_Obj39.Ay, 0.0625, -16.0);
    copyBitsToByteArrayLE(raw_value, byteArray, 20630, 9);

    raw_value = convertPhysicalToRaw(@CAN_PrivMain::RFL_Object::RXX_Object_Obj39.AyVnce, 0.01, 0.0);
    copyBitsToByteArrayLE(raw_value, byteArray, 20640, 12);

    raw_value = convertPhysicalToRaw(@CAN_PrivMain::RFL_Object::RXX_Object_Obj39.Vx, 0.0625, -128.0);
    copyBitsToByteArrayLE(raw_value, byteArray, 20652, 12);

    raw_value = convertPhysicalToRaw(@CAN_PrivMain::RFL_Object::RXX_Object_Obj39.AxVnce, 0.01, 0.0);
    copyBitsToByteArrayLE(raw_value, byteArray, 20576, 12);

    raw_value = convertPhysicalToRaw(@CAN_PrivMain::RFL_Object::RXX_Object_Obj39.OrientationYawVnce, 0.0003, 0.0);
    copyBitsToByteArrayLE(raw_value, byteArray, 20588, 12);

    raw_value = convertPhysicalToRaw(@CAN_PrivMain::RFL_Object::RXX_Object_Obj39.PyVnce, 0.1, 0.0);
    copyBitsToByteArrayLE(raw_value, byteArray, 20524, 12);

    raw_value = convertPhysicalToRaw(@CAN_PrivMain::RFL_Object::RXX_Object_Obj39.OrientationYaw, 0.0175, -4.48);
    copyBitsToByteArrayLE(raw_value, byteArray, 20566, 9);

    raw_value = convertPhysicalToRaw(@CAN_PrivMain::RFL_Object::RXX_Object_Obj39.Ax, 0.03125, -16.0);
    copyBitsToByteArrayLE(raw_value, byteArray, 20556, 10);

    raw_value = convertPhysicalToRaw(@CAN_PrivMain::RFL_Object::RXX_Object_Obj39.LengthVnce, 0.01, 0.0);
    copyBitsToByteArrayLE(raw_value, byteArray, 20544, 12);

    raw_value = convertPhysicalToRaw(@CAN_PrivMain::RFL_Object::RXX_Object_Obj39.Length, 0.125, 0.0);
    copyBitsToByteArrayLE(raw_value, byteArray, 20536, 7);

    raw_value = convertPhysicalToRaw(@CAN_PrivMain::RFL_Object::RXX_Object_Obj39.Py, 0.0625, -128.0);
    copyBitsToByteArrayLE(raw_value, byteArray, 20512, 12);

    raw_value = convertPhysicalToRaw(@CAN_PrivMain::RFL_Object::RXX_Object_Obj39.PxVnce, 0.1, 0.0);
    copyBitsToByteArrayLE(raw_value, byteArray, 20500, 12);

    raw_value = convertPhysicalToRaw(@CAN_PrivMain::RFL_Object::RXX_Object_Obj39.Px, 0.0625, -512.0);
    copyBitsToByteArrayLE(raw_value, byteArray, 20486, 14);

    raw_value = convertPhysicalToRaw(@CAN_PrivMain::RFL_Object::RXX_Object_Obj39.ProbClassConfidence, 2.0, 0.0);
    copyBitsToByteArrayLE(raw_value, byteArray, 20480, 6);

    raw_value = convertPhysicalToRaw(@CAN_PrivMain::RFL_Object::RXX_Object_Obj39.MovingStatus, 1.0, 0.0);
    copyBitsToByteArrayLE(raw_value, byteArray, 20684, 2);

    raw_value = convertPhysicalToRaw(@CAN_PrivMain::RFL_Object::RXX_Object_Obj39.VxVnce, 0.01, 0.0);
    copyBitsToByteArrayLE(raw_value, byteArray, 20672, 12);

    raw_value = convertPhysicalToRaw(@CAN_PrivMain::RFL_Object::RXX_Object_Obj39.Vy, 0.125, -64.0);
    copyBitsToByteArrayLE(raw_value, byteArray, 20686, 10);

    raw_value = convertPhysicalToRaw(@CAN_PrivMain::RFL_Object::RXX_Object_Obj39.AxAyCoVnce, 0.01, 0.0);
    copyBitsToByteArrayLE(raw_value, byteArray, 20940, 12);

    raw_value = convertPhysicalToRaw(@CAN_PrivMain::RFL_Object::RXX_Object_Obj39.PxAxCoVnce, 0.01, 0.0);
    copyBitsToByteArrayLE(raw_value, byteArray, 20800, 12);

    raw_value = convertPhysicalToRaw(@CAN_PrivMain::RFL_Object::RXX_Object_Obj39.Age, 1.0, 0.0);
    copyBitsToByteArrayLE(raw_value, byteArray, 20960, 32);

    raw_value = convertPhysicalToRaw(@CAN_PrivMain::RFL_Object::RXX_Object_Obj39.ExistProb, 2.0, 0.0);
    copyBitsToByteArrayLE(raw_value, byteArray, 20696, 6);

    raw_value = convertPhysicalToRaw(@CAN_PrivMain::RFL_Object::RXX_Object_Obj39.VyAyCoVnce, 0.01, 0.0);
    copyBitsToByteArrayLE(raw_value, byteArray, 20928, 12);

    raw_value = convertPhysicalToRaw(@CAN_PrivMain::RFL_Object::RXX_Object_Obj39.VyAxCoVnce, 0.01, 0.0);
    copyBitsToByteArrayLE(raw_value, byteArray, 20908, 12);

    raw_value = convertPhysicalToRaw(@CAN_PrivMain::RFL_Object::RXX_Object_Obj39.VxAyCoVnce, 0.01, 0.0);
    copyBitsToByteArrayLE(raw_value, byteArray, 20896, 12);

    raw_value = convertPhysicalToRaw(@CAN_PrivMain::RFL_Object::RXX_Object_Obj39.VxAxCoVnce, 0.01, 0.0);
    copyBitsToByteArrayLE(raw_value, byteArray, 20876, 12);

    raw_value = convertPhysicalToRaw(@CAN_PrivMain::RFL_Object::RXX_Object_Obj39.PyAyCoVnce, 0.01, 0.0);
    copyBitsToByteArrayLE(raw_value, byteArray, 20844, 12);

    raw_value = convertPhysicalToRaw(@CAN_PrivMain::RFL_Object::RXX_Object_Obj39.PyAxCoVnce, 0.01, 0.0);
    copyBitsToByteArrayLE(raw_value, byteArray, 20832, 12);

    raw_value = convertPhysicalToRaw(@CAN_PrivMain::RFL_Object::RXX_Object_Obj39.PxAyCoVnce, 0.01, 0.0);
    copyBitsToByteArrayLE(raw_value, byteArray, 20812, 12);

    raw_value = convertPhysicalToRaw(@CAN_PrivMain::RFL_Object::RXX_Object_Obj39.VxVyCoVnce, 0.01, 0.0);
    copyBitsToByteArrayLE(raw_value, byteArray, 20864, 12);

    raw_value = convertPhysicalToRaw(@CAN_PrivMain::RFL_Object::RXX_Object_Obj39.ReferencePoint, 1.0, 0.0);
    copyBitsToByteArrayLE(raw_value, byteArray, 20792, 4);

    raw_value = convertPhysicalToRaw(@CAN_PrivMain::RFL_Object::RXX_Object_Obj39.PxVxCoVnce, 0.01, 0.0);
    copyBitsToByteArrayLE(raw_value, byteArray, 20736, 12);

    raw_value = convertPhysicalToRaw(@CAN_PrivMain::RFL_Object::RXX_Object_Obj39.PyVyCoVnce, 0.01, 0.0);
    copyBitsToByteArrayLE(raw_value, byteArray, 20780, 12);

    raw_value = convertPhysicalToRaw(@CAN_PrivMain::RFL_Object::RXX_Object_Obj39.PxPyCoVnce, 0.01, 0.0);
    copyBitsToByteArrayLE(raw_value, byteArray, 20716, 12);

    raw_value = convertPhysicalToRaw(@CAN_PrivMain::RFL_Object::RXX_Object_Obj39.MeasurementStatus, 1.0, 0.0);
    copyBitsToByteArrayLE(raw_value, byteArray, 20728, 3);

    raw_value = convertPhysicalToRaw(@CAN_PrivMain::RFL_Object::RXX_Object_Obj39.ProbClassType, 1.0, 0.0);
    copyBitsToByteArrayLE(raw_value, byteArray, 20731, 4);

    raw_value = convertPhysicalToRaw(@CAN_PrivMain::RFL_Object::RXX_Object_Obj39.VyVnce, 0.01, 0.0);
    copyBitsToByteArrayLE(raw_value, byteArray, 20704, 12);

    raw_value = convertPhysicalToRaw(@CAN_PrivMain::RFL_Object::RXX_Object_Obj39.PxVyCoVnce, 0.01, 0.0);
    copyBitsToByteArrayLE(raw_value, byteArray, 20748, 12);

    raw_value = convertPhysicalToRaw(@CAN_PrivMain::RFL_Object::RXX_Object_Obj39.FilterInformation, 1.0, 0.0);
    copyBitsToByteArrayLE(raw_value, byteArray, 20760, 8);

    raw_value = convertPhysicalToRaw(@CAN_PrivMain::RFL_Object::RXX_Object_Obj39.PyVxCoVnce, 0.01, 0.0);
    copyBitsToByteArrayLE(raw_value, byteArray, 20768, 12);
}


void RXX_Object_Obj38_write(byte byteArray[])
{
    qword raw_value;

    raw_value = convertPhysicalToRaw(@CAN_PrivMain::RFL_Object::RXX_Object_Obj38.AxVnce, 0.01, 0.0);
    copyBitsToByteArrayLE(raw_value, byteArray, 20064, 12);

    raw_value = convertPhysicalToRaw(@CAN_PrivMain::RFL_Object::RXX_Object_Obj38.VxVnce, 0.01, 0.0);
    copyBitsToByteArrayLE(raw_value, byteArray, 20160, 12);

    raw_value = convertPhysicalToRaw(@CAN_PrivMain::RFL_Object::RXX_Object_Obj38.ObjId, 1.0, 0.0);
    copyBitsToByteArrayLE(raw_value, byteArray, 20152, 7);

    raw_value = convertPhysicalToRaw(@CAN_PrivMain::RFL_Object::RXX_Object_Obj38.Vx, 0.0625, -128.0);
    copyBitsToByteArrayLE(raw_value, byteArray, 20140, 12);

    raw_value = convertPhysicalToRaw(@CAN_PrivMain::RFL_Object::RXX_Object_Obj38.AyVnce, 0.01, 0.0);
    copyBitsToByteArrayLE(raw_value, byteArray, 20128, 12);

    raw_value = convertPhysicalToRaw(@CAN_PrivMain::RFL_Object::RXX_Object_Obj38.Ay, 0.0625, -16.0);
    copyBitsToByteArrayLE(raw_value, byteArray, 20118, 9);

    raw_value = convertPhysicalToRaw(@CAN_PrivMain::RFL_Object::RXX_Object_Obj38.RCS, 0.2, -102.4);
    copyBitsToByteArrayLE(raw_value, byteArray, 20108, 10);

    raw_value = convertPhysicalToRaw(@CAN_PrivMain::RFL_Object::RXX_Object_Obj38.WidthVnce, 0.01, 0.0);
    copyBitsToByteArrayLE(raw_value, byteArray, 20096, 12);

    raw_value = convertPhysicalToRaw(@CAN_PrivMain::RFL_Object::RXX_Object_Obj38.Width, 0.125, 0.0);
    copyBitsToByteArrayLE(raw_value, byteArray, 20088, 7);

    raw_value = convertPhysicalToRaw(@CAN_PrivMain::RFL_Object::RXX_Object_Obj38.OrientationYawVnce, 0.0003, 0.0);
    copyBitsToByteArrayLE(raw_value, byteArray, 20076, 12);

    raw_value = convertPhysicalToRaw(@CAN_PrivMain::RFL_Object::RXX_Object_Obj38.Vy, 0.125, -64.0);
    copyBitsToByteArrayLE(raw_value, byteArray, 20174, 10);

    raw_value = convertPhysicalToRaw(@CAN_PrivMain::RFL_Object::RXX_Object_Obj38.OrientationYaw, 0.0175, -4.48);
    copyBitsToByteArrayLE(raw_value, byteArray, 20054, 9);

    raw_value = convertPhysicalToRaw(@CAN_PrivMain::RFL_Object::RXX_Object_Obj38.Ax, 0.03125, -16.0);
    copyBitsToByteArrayLE(raw_value, byteArray, 20044, 10);

    raw_value = convertPhysicalToRaw(@CAN_PrivMain::RFL_Object::RXX_Object_Obj38.LengthVnce, 0.01, 0.0);
    copyBitsToByteArrayLE(raw_value, byteArray, 20032, 12);

    raw_value = convertPhysicalToRaw(@CAN_PrivMain::RFL_Object::RXX_Object_Obj38.Length, 0.125, 0.0);
    copyBitsToByteArrayLE(raw_value, byteArray, 20024, 7);

    raw_value = convertPhysicalToRaw(@CAN_PrivMain::RFL_Object::RXX_Object_Obj38.PyVnce, 0.1, 0.0);
    copyBitsToByteArrayLE(raw_value, byteArray, 20012, 12);

    raw_value = convertPhysicalToRaw(@CAN_PrivMain::RFL_Object::RXX_Object_Obj38.Py, 0.0625, -128.0);
    copyBitsToByteArrayLE(raw_value, byteArray, 20000, 12);

    raw_value = convertPhysicalToRaw(@CAN_PrivMain::RFL_Object::RXX_Object_Obj38.PxVnce, 0.1, 0.0);
    copyBitsToByteArrayLE(raw_value, byteArray, 19988, 12);

    raw_value = convertPhysicalToRaw(@CAN_PrivMain::RFL_Object::RXX_Object_Obj38.Px, 0.0625, -512.0);
    copyBitsToByteArrayLE(raw_value, byteArray, 19974, 14);

    raw_value = convertPhysicalToRaw(@CAN_PrivMain::RFL_Object::RXX_Object_Obj38.ProbClassConfidence, 2.0, 0.0);
    copyBitsToByteArrayLE(raw_value, byteArray, 19968, 6);

    raw_value = convertPhysicalToRaw(@CAN_PrivMain::RFL_Object::RXX_Object_Obj38.MovingStatus, 1.0, 0.0);
    copyBitsToByteArrayLE(raw_value, byteArray, 20172, 2);

    raw_value = convertPhysicalToRaw(@CAN_PrivMain::RFL_Object::RXX_Object_Obj38.Age, 1.0, 0.0);
    copyBitsToByteArrayLE(raw_value, byteArray, 20448, 32);

    raw_value = convertPhysicalToRaw(@CAN_PrivMain::RFL_Object::RXX_Object_Obj38.ExistProb, 2.0, 0.0);
    copyBitsToByteArrayLE(raw_value, byteArray, 20184, 6);

    raw_value = convertPhysicalToRaw(@CAN_PrivMain::RFL_Object::RXX_Object_Obj38.PxAxCoVnce, 0.01, 0.0);
    copyBitsToByteArrayLE(raw_value, byteArray, 20288, 12);

    raw_value = convertPhysicalToRaw(@CAN_PrivMain::RFL_Object::RXX_Object_Obj38.VyVnce, 0.01, 0.0);
    copyBitsToByteArrayLE(raw_value, byteArray, 20192, 12);

    raw_value = convertPhysicalToRaw(@CAN_PrivMain::RFL_Object::RXX_Object_Obj38.VyAyCoVnce, 0.01, 0.0);
    copyBitsToByteArrayLE(raw_value, byteArray, 20416, 12);

    raw_value = convertPhysicalToRaw(@CAN_PrivMain::RFL_Object::RXX_Object_Obj38.VyAxCoVnce, 0.01, 0.0);
    copyBitsToByteArrayLE(raw_value, byteArray, 20396, 12);

    raw_value = convertPhysicalToRaw(@CAN_PrivMain::RFL_Object::RXX_Object_Obj38.VxAyCoVnce, 0.01, 0.0);
    copyBitsToByteArrayLE(raw_value, byteArray, 20384, 12);

    raw_value = convertPhysicalToRaw(@CAN_PrivMain::RFL_Object::RXX_Object_Obj38.VxAxCoVnce, 0.01, 0.0);
    copyBitsToByteArrayLE(raw_value, byteArray, 20364, 12);

    raw_value = convertPhysicalToRaw(@CAN_PrivMain::RFL_Object::RXX_Object_Obj38.VxVyCoVnce, 0.01, 0.0);
    copyBitsToByteArrayLE(raw_value, byteArray, 20352, 12);

    raw_value = convertPhysicalToRaw(@CAN_PrivMain::RFL_Object::RXX_Object_Obj38.PyAyCoVnce, 0.01, 0.0);
    copyBitsToByteArrayLE(raw_value, byteArray, 20332, 12);

    raw_value = convertPhysicalToRaw(@CAN_PrivMain::RFL_Object::RXX_Object_Obj38.PyAxCoVnce, 0.01, 0.0);
    copyBitsToByteArrayLE(raw_value, byteArray, 20320, 12);

    raw_value = convertPhysicalToRaw(@CAN_PrivMain::RFL_Object::RXX_Object_Obj38.PxAyCoVnce, 0.01, 0.0);
    copyBitsToByteArrayLE(raw_value, byteArray, 20300, 12);

    raw_value = convertPhysicalToRaw(@CAN_PrivMain::RFL_Object::RXX_Object_Obj38.AxAyCoVnce, 0.01, 0.0);
    copyBitsToByteArrayLE(raw_value, byteArray, 20428, 12);

    raw_value = convertPhysicalToRaw(@CAN_PrivMain::RFL_Object::RXX_Object_Obj38.ReferencePoint, 1.0, 0.0);
    copyBitsToByteArrayLE(raw_value, byteArray, 20280, 4);

    raw_value = convertPhysicalToRaw(@CAN_PrivMain::RFL_Object::RXX_Object_Obj38.PyVxCoVnce, 0.01, 0.0);
    copyBitsToByteArrayLE(raw_value, byteArray, 20256, 12);

    raw_value = convertPhysicalToRaw(@CAN_PrivMain::RFL_Object::RXX_Object_Obj38.FilterInformation, 1.0, 0.0);
    copyBitsToByteArrayLE(raw_value, byteArray, 20248, 8);

    raw_value = convertPhysicalToRaw(@CAN_PrivMain::RFL_Object::RXX_Object_Obj38.PxVyCoVnce, 0.01, 0.0);
    copyBitsToByteArrayLE(raw_value, byteArray, 20236, 12);

    raw_value = convertPhysicalToRaw(@CAN_PrivMain::RFL_Object::RXX_Object_Obj38.PxVxCoVnce, 0.01, 0.0);
    copyBitsToByteArrayLE(raw_value, byteArray, 20224, 12);

    raw_value = convertPhysicalToRaw(@CAN_PrivMain::RFL_Object::RXX_Object_Obj38.ProbClassType, 1.0, 0.0);
    copyBitsToByteArrayLE(raw_value, byteArray, 20219, 4);

    raw_value = convertPhysicalToRaw(@CAN_PrivMain::RFL_Object::RXX_Object_Obj38.MeasurementStatus, 1.0, 0.0);
    copyBitsToByteArrayLE(raw_value, byteArray, 20216, 3);

    raw_value = convertPhysicalToRaw(@CAN_PrivMain::RFL_Object::RXX_Object_Obj38.PxPyCoVnce, 0.01, 0.0);
    copyBitsToByteArrayLE(raw_value, byteArray, 20204, 12);

    raw_value = convertPhysicalToRaw(@CAN_PrivMain::RFL_Object::RXX_Object_Obj38.PyVyCoVnce, 0.01, 0.0);
    copyBitsToByteArrayLE(raw_value, byteArray, 20268, 12);
}


void RXX_Object_Obj37_write(byte byteArray[])
{
    qword raw_value;

    raw_value = convertPhysicalToRaw(@CAN_PrivMain::RFL_Object::RXX_Object_Obj37.Ay, 0.0625, -16.0);
    copyBitsToByteArrayLE(raw_value, byteArray, 19606, 9);

    raw_value = convertPhysicalToRaw(@CAN_PrivMain::RFL_Object::RXX_Object_Obj37.WidthVnce, 0.01, 0.0);
    copyBitsToByteArrayLE(raw_value, byteArray, 19584, 12);

    raw_value = convertPhysicalToRaw(@CAN_PrivMain::RFL_Object::RXX_Object_Obj37.RCS, 0.2, -102.4);
    copyBitsToByteArrayLE(raw_value, byteArray, 19596, 10);

    raw_value = convertPhysicalToRaw(@CAN_PrivMain::RFL_Object::RXX_Object_Obj37.VxVnce, 0.01, 0.0);
    copyBitsToByteArrayLE(raw_value, byteArray, 19648, 12);

    raw_value = convertPhysicalToRaw(@CAN_PrivMain::RFL_Object::RXX_Object_Obj37.AyVnce, 0.01, 0.0);
    copyBitsToByteArrayLE(raw_value, byteArray, 19616, 12);

    raw_value = convertPhysicalToRaw(@CAN_PrivMain::RFL_Object::RXX_Object_Obj37.Vx, 0.0625, -128.0);
    copyBitsToByteArrayLE(raw_value, byteArray, 19628, 12);

    raw_value = convertPhysicalToRaw(@CAN_PrivMain::RFL_Object::RXX_Object_Obj37.ObjId, 1.0, 0.0);
    copyBitsToByteArrayLE(raw_value, byteArray, 19640, 7);

    raw_value = convertPhysicalToRaw(@CAN_PrivMain::RFL_Object::RXX_Object_Obj37.OrientationYawVnce, 0.0003, 0.0);
    copyBitsToByteArrayLE(raw_value, byteArray, 19564, 12);

    raw_value = convertPhysicalToRaw(@CAN_PrivMain::RFL_Object::RXX_Object_Obj37.Width, 0.125, 0.0);
    copyBitsToByteArrayLE(raw_value, byteArray, 19576, 7);

    raw_value = convertPhysicalToRaw(@CAN_PrivMain::RFL_Object::RXX_Object_Obj37.Length, 0.125, 0.0);
    copyBitsToByteArrayLE(raw_value, byteArray, 19512, 7);

    raw_value = convertPhysicalToRaw(@CAN_PrivMain::RFL_Object::RXX_Object_Obj37.AxVnce, 0.01, 0.0);
    copyBitsToByteArrayLE(raw_value, byteArray, 19552, 12);

    raw_value = convertPhysicalToRaw(@CAN_PrivMain::RFL_Object::RXX_Object_Obj37.OrientationYaw, 0.0175, -4.48);
    copyBitsToByteArrayLE(raw_value, byteArray, 19542, 9);

    raw_value = convertPhysicalToRaw(@CAN_PrivMain::RFL_Object::RXX_Object_Obj37.Ax, 0.03125, -16.0);
    copyBitsToByteArrayLE(raw_value, byteArray, 19532, 10);

    raw_value = convertPhysicalToRaw(@CAN_PrivMain::RFL_Object::RXX_Object_Obj37.LengthVnce, 0.01, 0.0);
    copyBitsToByteArrayLE(raw_value, byteArray, 19520, 12);

    raw_value = convertPhysicalToRaw(@CAN_PrivMain::RFL_Object::RXX_Object_Obj37.Py, 0.0625, -128.0);
    copyBitsToByteArrayLE(raw_value, byteArray, 19488, 12);

    raw_value = convertPhysicalToRaw(@CAN_PrivMain::RFL_Object::RXX_Object_Obj37.PxVnce, 0.1, 0.0);
    copyBitsToByteArrayLE(raw_value, byteArray, 19476, 12);

    raw_value = convertPhysicalToRaw(@CAN_PrivMain::RFL_Object::RXX_Object_Obj37.Px, 0.0625, -512.0);
    copyBitsToByteArrayLE(raw_value, byteArray, 19462, 14);

    raw_value = convertPhysicalToRaw(@CAN_PrivMain::RFL_Object::RXX_Object_Obj37.ProbClassConfidence, 2.0, 0.0);
    copyBitsToByteArrayLE(raw_value, byteArray, 19456, 6);

    raw_value = convertPhysicalToRaw(@CAN_PrivMain::RFL_Object::RXX_Object_Obj37.Vy, 0.125, -64.0);
    copyBitsToByteArrayLE(raw_value, byteArray, 19662, 10);

    raw_value = convertPhysicalToRaw(@CAN_PrivMain::RFL_Object::RXX_Object_Obj37.MovingStatus, 1.0, 0.0);
    copyBitsToByteArrayLE(raw_value, byteArray, 19660, 2);

    raw_value = convertPhysicalToRaw(@CAN_PrivMain::RFL_Object::RXX_Object_Obj37.PyVnce, 0.1, 0.0);
    copyBitsToByteArrayLE(raw_value, byteArray, 19500, 12);

    raw_value = convertPhysicalToRaw(@CAN_PrivMain::RFL_Object::RXX_Object_Obj37.ExistProb, 2.0, 0.0);
    copyBitsToByteArrayLE(raw_value, byteArray, 19672, 6);

    raw_value = convertPhysicalToRaw(@CAN_PrivMain::RFL_Object::RXX_Object_Obj37.PxAyCoVnce, 0.01, 0.0);
    copyBitsToByteArrayLE(raw_value, byteArray, 19788, 12);

    raw_value = convertPhysicalToRaw(@CAN_PrivMain::RFL_Object::RXX_Object_Obj37.AxAyCoVnce, 0.01, 0.0);
    copyBitsToByteArrayLE(raw_value, byteArray, 19916, 12);

    raw_value = convertPhysicalToRaw(@CAN_PrivMain::RFL_Object::RXX_Object_Obj37.VyAyCoVnce, 0.01, 0.0);
    copyBitsToByteArrayLE(raw_value, byteArray, 19904, 12);

    raw_value = convertPhysicalToRaw(@CAN_PrivMain::RFL_Object::RXX_Object_Obj37.VyAxCoVnce, 0.01, 0.0);
    copyBitsToByteArrayLE(raw_value, byteArray, 19884, 12);

    raw_value = convertPhysicalToRaw(@CAN_PrivMain::RFL_Object::RXX_Object_Obj37.VxAyCoVnce, 0.01, 0.0);
    copyBitsToByteArrayLE(raw_value, byteArray, 19872, 12);

    raw_value = convertPhysicalToRaw(@CAN_PrivMain::RFL_Object::RXX_Object_Obj37.VxAxCoVnce, 0.01, 0.0);
    copyBitsToByteArrayLE(raw_value, byteArray, 19852, 12);

    raw_value = convertPhysicalToRaw(@CAN_PrivMain::RFL_Object::RXX_Object_Obj37.Age, 1.0, 0.0);
    copyBitsToByteArrayLE(raw_value, byteArray, 19936, 32);

    raw_value = convertPhysicalToRaw(@CAN_PrivMain::RFL_Object::RXX_Object_Obj37.VxVyCoVnce, 0.01, 0.0);
    copyBitsToByteArrayLE(raw_value, byteArray, 19840, 12);

    raw_value = convertPhysicalToRaw(@CAN_PrivMain::RFL_Object::RXX_Object_Obj37.PyAyCoVnce, 0.01, 0.0);
    copyBitsToByteArrayLE(raw_value, byteArray, 19820, 12);

    raw_value = convertPhysicalToRaw(@CAN_PrivMain::RFL_Object::RXX_Object_Obj37.PyAxCoVnce, 0.01, 0.0);
    copyBitsToByteArrayLE(raw_value, byteArray, 19808, 12);

    raw_value = convertPhysicalToRaw(@CAN_PrivMain::RFL_Object::RXX_Object_Obj37.VyVnce, 0.01, 0.0);
    copyBitsToByteArrayLE(raw_value, byteArray, 19680, 12);

    raw_value = convertPhysicalToRaw(@CAN_PrivMain::RFL_Object::RXX_Object_Obj37.PxAxCoVnce, 0.01, 0.0);
    copyBitsToByteArrayLE(raw_value, byteArray, 19776, 12);

    raw_value = convertPhysicalToRaw(@CAN_PrivMain::RFL_Object::RXX_Object_Obj37.PxVxCoVnce, 0.01, 0.0);
    copyBitsToByteArrayLE(raw_value, byteArray, 19712, 12);

    raw_value = convertPhysicalToRaw(@CAN_PrivMain::RFL_Object::RXX_Object_Obj37.ReferencePoint, 1.0, 0.0);
    copyBitsToByteArrayLE(raw_value, byteArray, 19768, 4);

    raw_value = convertPhysicalToRaw(@CAN_PrivMain::RFL_Object::RXX_Object_Obj37.MeasurementStatus, 1.0, 0.0);
    copyBitsToByteArrayLE(raw_value, byteArray, 19704, 3);

    raw_value = convertPhysicalToRaw(@CAN_PrivMain::RFL_Object::RXX_Object_Obj37.ProbClassType, 1.0, 0.0);
    copyBitsToByteArrayLE(raw_value, byteArray, 19707, 4);

    raw_value = convertPhysicalToRaw(@CAN_PrivMain::RFL_Object::RXX_Object_Obj37.PxPyCoVnce, 0.01, 0.0);
    copyBitsToByteArrayLE(raw_value, byteArray, 19692, 12);

    raw_value = convertPhysicalToRaw(@CAN_PrivMain::RFL_Object::RXX_Object_Obj37.PxVyCoVnce, 0.01, 0.0);
    copyBitsToByteArrayLE(raw_value, byteArray, 19724, 12);

    raw_value = convertPhysicalToRaw(@CAN_PrivMain::RFL_Object::RXX_Object_Obj37.FilterInformation, 1.0, 0.0);
    copyBitsToByteArrayLE(raw_value, byteArray, 19736, 8);

    raw_value = convertPhysicalToRaw(@CAN_PrivMain::RFL_Object::RXX_Object_Obj37.PyVxCoVnce, 0.01, 0.0);
    copyBitsToByteArrayLE(raw_value, byteArray, 19744, 12);

    raw_value = convertPhysicalToRaw(@CAN_PrivMain::RFL_Object::RXX_Object_Obj37.PyVyCoVnce, 0.01, 0.0);
    copyBitsToByteArrayLE(raw_value, byteArray, 19756, 12);
}


void RXX_Object_Obj36_write(byte byteArray[])
{
    qword raw_value;

    raw_value = convertPhysicalToRaw(@CAN_PrivMain::RFL_Object::RXX_Object_Obj36.VxVnce, 0.01, 0.0);
    copyBitsToByteArrayLE(raw_value, byteArray, 19136, 12);

    raw_value = convertPhysicalToRaw(@CAN_PrivMain::RFL_Object::RXX_Object_Obj36.AxVnce, 0.01, 0.0);
    copyBitsToByteArrayLE(raw_value, byteArray, 19040, 12);

    raw_value = convertPhysicalToRaw(@CAN_PrivMain::RFL_Object::RXX_Object_Obj36.ObjId, 1.0, 0.0);
    copyBitsToByteArrayLE(raw_value, byteArray, 19128, 7);

    raw_value = convertPhysicalToRaw(@CAN_PrivMain::RFL_Object::RXX_Object_Obj36.Vx, 0.0625, -128.0);
    copyBitsToByteArrayLE(raw_value, byteArray, 19116, 12);

    raw_value = convertPhysicalToRaw(@CAN_PrivMain::RFL_Object::RXX_Object_Obj36.AyVnce, 0.01, 0.0);
    copyBitsToByteArrayLE(raw_value, byteArray, 19104, 12);

    raw_value = convertPhysicalToRaw(@CAN_PrivMain::RFL_Object::RXX_Object_Obj36.Ay, 0.0625, -16.0);
    copyBitsToByteArrayLE(raw_value, byteArray, 19094, 9);

    raw_value = convertPhysicalToRaw(@CAN_PrivMain::RFL_Object::RXX_Object_Obj36.RCS, 0.2, -102.4);
    copyBitsToByteArrayLE(raw_value, byteArray, 19084, 10);

    raw_value = convertPhysicalToRaw(@CAN_PrivMain::RFL_Object::RXX_Object_Obj36.WidthVnce, 0.01, 0.0);
    copyBitsToByteArrayLE(raw_value, byteArray, 19072, 12);

    raw_value = convertPhysicalToRaw(@CAN_PrivMain::RFL_Object::RXX_Object_Obj36.Width, 0.125, 0.0);
    copyBitsToByteArrayLE(raw_value, byteArray, 19064, 7);

    raw_value = convertPhysicalToRaw(@CAN_PrivMain::RFL_Object::RXX_Object_Obj36.OrientationYawVnce, 0.0003, 0.0);
    copyBitsToByteArrayLE(raw_value, byteArray, 19052, 12);

    raw_value = convertPhysicalToRaw(@CAN_PrivMain::RFL_Object::RXX_Object_Obj36.PyVnce, 0.1, 0.0);
    copyBitsToByteArrayLE(raw_value, byteArray, 18988, 12);

    raw_value = convertPhysicalToRaw(@CAN_PrivMain::RFL_Object::RXX_Object_Obj36.OrientationYaw, 0.0175, -4.48);
    copyBitsToByteArrayLE(raw_value, byteArray, 19030, 9);

    raw_value = convertPhysicalToRaw(@CAN_PrivMain::RFL_Object::RXX_Object_Obj36.Ax, 0.03125, -16.0);
    copyBitsToByteArrayLE(raw_value, byteArray, 19020, 10);

    raw_value = convertPhysicalToRaw(@CAN_PrivMain::RFL_Object::RXX_Object_Obj36.LengthVnce, 0.01, 0.0);
    copyBitsToByteArrayLE(raw_value, byteArray, 19008, 12);

    raw_value = convertPhysicalToRaw(@CAN_PrivMain::RFL_Object::RXX_Object_Obj36.Length, 0.125, 0.0);
    copyBitsToByteArrayLE(raw_value, byteArray, 19000, 7);

    raw_value = convertPhysicalToRaw(@CAN_PrivMain::RFL_Object::RXX_Object_Obj36.Py, 0.0625, -128.0);
    copyBitsToByteArrayLE(raw_value, byteArray, 18976, 12);

    raw_value = convertPhysicalToRaw(@CAN_PrivMain::RFL_Object::RXX_Object_Obj36.PxVnce, 0.1, 0.0);
    copyBitsToByteArrayLE(raw_value, byteArray, 18964, 12);

    raw_value = convertPhysicalToRaw(@CAN_PrivMain::RFL_Object::RXX_Object_Obj36.Px, 0.0625, -512.0);
    copyBitsToByteArrayLE(raw_value, byteArray, 18950, 14);

    raw_value = convertPhysicalToRaw(@CAN_PrivMain::RFL_Object::RXX_Object_Obj36.ProbClassConfidence, 2.0, 0.0);
    copyBitsToByteArrayLE(raw_value, byteArray, 18944, 6);

    raw_value = convertPhysicalToRaw(@CAN_PrivMain::RFL_Object::RXX_Object_Obj36.Vy, 0.125, -64.0);
    copyBitsToByteArrayLE(raw_value, byteArray, 19150, 10);

    raw_value = convertPhysicalToRaw(@CAN_PrivMain::RFL_Object::RXX_Object_Obj36.MovingStatus, 1.0, 0.0);
    copyBitsToByteArrayLE(raw_value, byteArray, 19148, 2);

    raw_value = convertPhysicalToRaw(@CAN_PrivMain::RFL_Object::RXX_Object_Obj36.ExistProb, 2.0, 0.0);
    copyBitsToByteArrayLE(raw_value, byteArray, 19160, 6);

    raw_value = convertPhysicalToRaw(@CAN_PrivMain::RFL_Object::RXX_Object_Obj36.AxAyCoVnce, 0.01, 0.0);
    copyBitsToByteArrayLE(raw_value, byteArray, 19404, 12);

    raw_value = convertPhysicalToRaw(@CAN_PrivMain::RFL_Object::RXX_Object_Obj36.PxAxCoVnce, 0.01, 0.0);
    copyBitsToByteArrayLE(raw_value, byteArray, 19264, 12);

    raw_value = convertPhysicalToRaw(@CAN_PrivMain::RFL_Object::RXX_Object_Obj36.Age, 1.0, 0.0);
    copyBitsToByteArrayLE(raw_value, byteArray, 19424, 32);

    raw_value = convertPhysicalToRaw(@CAN_PrivMain::RFL_Object::RXX_Object_Obj36.VyVnce, 0.01, 0.0);
    copyBitsToByteArrayLE(raw_value, byteArray, 19168, 12);

    raw_value = convertPhysicalToRaw(@CAN_PrivMain::RFL_Object::RXX_Object_Obj36.VyAyCoVnce, 0.01, 0.0);
    copyBitsToByteArrayLE(raw_value, byteArray, 19392, 12);

    raw_value = convertPhysicalToRaw(@CAN_PrivMain::RFL_Object::RXX_Object_Obj36.VyAxCoVnce, 0.01, 0.0);
    copyBitsToByteArrayLE(raw_value, byteArray, 19372, 12);

    raw_value = convertPhysicalToRaw(@CAN_PrivMain::RFL_Object::RXX_Object_Obj36.VxAyCoVnce, 0.01, 0.0);
    copyBitsToByteArrayLE(raw_value, byteArray, 19360, 12);

    raw_value = convertPhysicalToRaw(@CAN_PrivMain::RFL_Object::RXX_Object_Obj36.VxAxCoVnce, 0.01, 0.0);
    copyBitsToByteArrayLE(raw_value, byteArray, 19340, 12);

    raw_value = convertPhysicalToRaw(@CAN_PrivMain::RFL_Object::RXX_Object_Obj36.PyAyCoVnce, 0.01, 0.0);
    copyBitsToByteArrayLE(raw_value, byteArray, 19308, 12);

    raw_value = convertPhysicalToRaw(@CAN_PrivMain::RFL_Object::RXX_Object_Obj36.PyAxCoVnce, 0.01, 0.0);
    copyBitsToByteArrayLE(raw_value, byteArray, 19296, 12);

    raw_value = convertPhysicalToRaw(@CAN_PrivMain::RFL_Object::RXX_Object_Obj36.PxAyCoVnce, 0.01, 0.0);
    copyBitsToByteArrayLE(raw_value, byteArray, 19276, 12);

    raw_value = convertPhysicalToRaw(@CAN_PrivMain::RFL_Object::RXX_Object_Obj36.VxVyCoVnce, 0.01, 0.0);
    copyBitsToByteArrayLE(raw_value, byteArray, 19328, 12);

    raw_value = convertPhysicalToRaw(@CAN_PrivMain::RFL_Object::RXX_Object_Obj36.ReferencePoint, 1.0, 0.0);
    copyBitsToByteArrayLE(raw_value, byteArray, 19256, 4);

    raw_value = convertPhysicalToRaw(@CAN_PrivMain::RFL_Object::RXX_Object_Obj36.PxVxCoVnce, 0.01, 0.0);
    copyBitsToByteArrayLE(raw_value, byteArray, 19200, 12);

    raw_value = convertPhysicalToRaw(@CAN_PrivMain::RFL_Object::RXX_Object_Obj36.PyVyCoVnce, 0.01, 0.0);
    copyBitsToByteArrayLE(raw_value, byteArray, 19244, 12);

    raw_value = convertPhysicalToRaw(@CAN_PrivMain::RFL_Object::RXX_Object_Obj36.MeasurementStatus, 1.0, 0.0);
    copyBitsToByteArrayLE(raw_value, byteArray, 19192, 3);

    raw_value = convertPhysicalToRaw(@CAN_PrivMain::RFL_Object::RXX_Object_Obj36.ProbClassType, 1.0, 0.0);
    copyBitsToByteArrayLE(raw_value, byteArray, 19195, 4);

    raw_value = convertPhysicalToRaw(@CAN_PrivMain::RFL_Object::RXX_Object_Obj36.PxPyCoVnce, 0.01, 0.0);
    copyBitsToByteArrayLE(raw_value, byteArray, 19180, 12);

    raw_value = convertPhysicalToRaw(@CAN_PrivMain::RFL_Object::RXX_Object_Obj36.PxVyCoVnce, 0.01, 0.0);
    copyBitsToByteArrayLE(raw_value, byteArray, 19212, 12);

    raw_value = convertPhysicalToRaw(@CAN_PrivMain::RFL_Object::RXX_Object_Obj36.FilterInformation, 1.0, 0.0);
    copyBitsToByteArrayLE(raw_value, byteArray, 19224, 8);

    raw_value = convertPhysicalToRaw(@CAN_PrivMain::RFL_Object::RXX_Object_Obj36.PyVxCoVnce, 0.01, 0.0);
    copyBitsToByteArrayLE(raw_value, byteArray, 19232, 12);
}


void RXX_Object_Obj35_write(byte byteArray[])
{
    qword raw_value;

    raw_value = convertPhysicalToRaw(@CAN_PrivMain::RFL_Object::RXX_Object_Obj35.AxVnce, 0.01, 0.0);
    copyBitsToByteArrayLE(raw_value, byteArray, 18528, 12);

    raw_value = convertPhysicalToRaw(@CAN_PrivMain::RFL_Object::RXX_Object_Obj35.ObjId, 1.0, 0.0);
    copyBitsToByteArrayLE(raw_value, byteArray, 18616, 7);

    raw_value = convertPhysicalToRaw(@CAN_PrivMain::RFL_Object::RXX_Object_Obj35.Vx, 0.0625, -128.0);
    copyBitsToByteArrayLE(raw_value, byteArray, 18604, 12);

    raw_value = convertPhysicalToRaw(@CAN_PrivMain::RFL_Object::RXX_Object_Obj35.AyVnce, 0.01, 0.0);
    copyBitsToByteArrayLE(raw_value, byteArray, 18592, 12);

    raw_value = convertPhysicalToRaw(@CAN_PrivMain::RFL_Object::RXX_Object_Obj35.Ay, 0.0625, -16.0);
    copyBitsToByteArrayLE(raw_value, byteArray, 18582, 9);

    raw_value = convertPhysicalToRaw(@CAN_PrivMain::RFL_Object::RXX_Object_Obj35.RCS, 0.2, -102.4);
    copyBitsToByteArrayLE(raw_value, byteArray, 18572, 10);

    raw_value = convertPhysicalToRaw(@CAN_PrivMain::RFL_Object::RXX_Object_Obj35.WidthVnce, 0.01, 0.0);
    copyBitsToByteArrayLE(raw_value, byteArray, 18560, 12);

    raw_value = convertPhysicalToRaw(@CAN_PrivMain::RFL_Object::RXX_Object_Obj35.Width, 0.125, 0.0);
    copyBitsToByteArrayLE(raw_value, byteArray, 18552, 7);

    raw_value = convertPhysicalToRaw(@CAN_PrivMain::RFL_Object::RXX_Object_Obj35.OrientationYawVnce, 0.0003, 0.0);
    copyBitsToByteArrayLE(raw_value, byteArray, 18540, 12);

    raw_value = convertPhysicalToRaw(@CAN_PrivMain::RFL_Object::RXX_Object_Obj35.MovingStatus, 1.0, 0.0);
    copyBitsToByteArrayLE(raw_value, byteArray, 18636, 2);

    raw_value = convertPhysicalToRaw(@CAN_PrivMain::RFL_Object::RXX_Object_Obj35.OrientationYaw, 0.0175, -4.48);
    copyBitsToByteArrayLE(raw_value, byteArray, 18518, 9);

    raw_value = convertPhysicalToRaw(@CAN_PrivMain::RFL_Object::RXX_Object_Obj35.Ax, 0.03125, -16.0);
    copyBitsToByteArrayLE(raw_value, byteArray, 18508, 10);

    raw_value = convertPhysicalToRaw(@CAN_PrivMain::RFL_Object::RXX_Object_Obj35.LengthVnce, 0.01, 0.0);
    copyBitsToByteArrayLE(raw_value, byteArray, 18496, 12);

    raw_value = convertPhysicalToRaw(@CAN_PrivMain::RFL_Object::RXX_Object_Obj35.Length, 0.125, 0.0);
    copyBitsToByteArrayLE(raw_value, byteArray, 18488, 7);

    raw_value = convertPhysicalToRaw(@CAN_PrivMain::RFL_Object::RXX_Object_Obj35.PyVnce, 0.1, 0.0);
    copyBitsToByteArrayLE(raw_value, byteArray, 18476, 12);

    raw_value = convertPhysicalToRaw(@CAN_PrivMain::RFL_Object::RXX_Object_Obj35.Py, 0.0625, -128.0);
    copyBitsToByteArrayLE(raw_value, byteArray, 18464, 12);

    raw_value = convertPhysicalToRaw(@CAN_PrivMain::RFL_Object::RXX_Object_Obj35.PxVnce, 0.1, 0.0);
    copyBitsToByteArrayLE(raw_value, byteArray, 18452, 12);

    raw_value = convertPhysicalToRaw(@CAN_PrivMain::RFL_Object::RXX_Object_Obj35.Px, 0.0625, -512.0);
    copyBitsToByteArrayLE(raw_value, byteArray, 18438, 14);

    raw_value = convertPhysicalToRaw(@CAN_PrivMain::RFL_Object::RXX_Object_Obj35.ProbClassConfidence, 2.0, 0.0);
    copyBitsToByteArrayLE(raw_value, byteArray, 18432, 6);

    raw_value = convertPhysicalToRaw(@CAN_PrivMain::RFL_Object::RXX_Object_Obj35.VxVnce, 0.01, 0.0);
    copyBitsToByteArrayLE(raw_value, byteArray, 18624, 12);

    raw_value = convertPhysicalToRaw(@CAN_PrivMain::RFL_Object::RXX_Object_Obj35.Vy, 0.125, -64.0);
    copyBitsToByteArrayLE(raw_value, byteArray, 18638, 10);

    raw_value = convertPhysicalToRaw(@CAN_PrivMain::RFL_Object::RXX_Object_Obj35.Age, 1.0, 0.0);
    copyBitsToByteArrayLE(raw_value, byteArray, 18912, 32);

    raw_value = convertPhysicalToRaw(@CAN_PrivMain::RFL_Object::RXX_Object_Obj35.PxAxCoVnce, 0.01, 0.0);
    copyBitsToByteArrayLE(raw_value, byteArray, 18752, 12);

    raw_value = convertPhysicalToRaw(@CAN_PrivMain::RFL_Object::RXX_Object_Obj35.AxAyCoVnce, 0.01, 0.0);
    copyBitsToByteArrayLE(raw_value, byteArray, 18892, 12);

    raw_value = convertPhysicalToRaw(@CAN_PrivMain::RFL_Object::RXX_Object_Obj35.ExistProb, 2.0, 0.0);
    copyBitsToByteArrayLE(raw_value, byteArray, 18648, 6);

    raw_value = convertPhysicalToRaw(@CAN_PrivMain::RFL_Object::RXX_Object_Obj35.VyAyCoVnce, 0.01, 0.0);
    copyBitsToByteArrayLE(raw_value, byteArray, 18880, 12);

    raw_value = convertPhysicalToRaw(@CAN_PrivMain::RFL_Object::RXX_Object_Obj35.VyAxCoVnce, 0.01, 0.0);
    copyBitsToByteArrayLE(raw_value, byteArray, 18860, 12);

    raw_value = convertPhysicalToRaw(@CAN_PrivMain::RFL_Object::RXX_Object_Obj35.VxAyCoVnce, 0.01, 0.0);
    copyBitsToByteArrayLE(raw_value, byteArray, 18848, 12);

    raw_value = convertPhysicalToRaw(@CAN_PrivMain::RFL_Object::RXX_Object_Obj35.VxAxCoVnce, 0.01, 0.0);
    copyBitsToByteArrayLE(raw_value, byteArray, 18828, 12);

    raw_value = convertPhysicalToRaw(@CAN_PrivMain::RFL_Object::RXX_Object_Obj35.PyAyCoVnce, 0.01, 0.0);
    copyBitsToByteArrayLE(raw_value, byteArray, 18796, 12);

    raw_value = convertPhysicalToRaw(@CAN_PrivMain::RFL_Object::RXX_Object_Obj35.PyAxCoVnce, 0.01, 0.0);
    copyBitsToByteArrayLE(raw_value, byteArray, 18784, 12);

    raw_value = convertPhysicalToRaw(@CAN_PrivMain::RFL_Object::RXX_Object_Obj35.PxAyCoVnce, 0.01, 0.0);
    copyBitsToByteArrayLE(raw_value, byteArray, 18764, 12);

    raw_value = convertPhysicalToRaw(@CAN_PrivMain::RFL_Object::RXX_Object_Obj35.VxVyCoVnce, 0.01, 0.0);
    copyBitsToByteArrayLE(raw_value, byteArray, 18816, 12);

    raw_value = convertPhysicalToRaw(@CAN_PrivMain::RFL_Object::RXX_Object_Obj35.ReferencePoint, 1.0, 0.0);
    copyBitsToByteArrayLE(raw_value, byteArray, 18744, 4);

    raw_value = convertPhysicalToRaw(@CAN_PrivMain::RFL_Object::RXX_Object_Obj35.PxVxCoVnce, 0.01, 0.0);
    copyBitsToByteArrayLE(raw_value, byteArray, 18688, 12);

    raw_value = convertPhysicalToRaw(@CAN_PrivMain::RFL_Object::RXX_Object_Obj35.PyVyCoVnce, 0.01, 0.0);
    copyBitsToByteArrayLE(raw_value, byteArray, 18732, 12);

    raw_value = convertPhysicalToRaw(@CAN_PrivMain::RFL_Object::RXX_Object_Obj35.PxPyCoVnce, 0.01, 0.0);
    copyBitsToByteArrayLE(raw_value, byteArray, 18668, 12);

    raw_value = convertPhysicalToRaw(@CAN_PrivMain::RFL_Object::RXX_Object_Obj35.MeasurementStatus, 1.0, 0.0);
    copyBitsToByteArrayLE(raw_value, byteArray, 18680, 3);

    raw_value = convertPhysicalToRaw(@CAN_PrivMain::RFL_Object::RXX_Object_Obj35.ProbClassType, 1.0, 0.0);
    copyBitsToByteArrayLE(raw_value, byteArray, 18683, 4);

    raw_value = convertPhysicalToRaw(@CAN_PrivMain::RFL_Object::RXX_Object_Obj35.VyVnce, 0.01, 0.0);
    copyBitsToByteArrayLE(raw_value, byteArray, 18656, 12);

    raw_value = convertPhysicalToRaw(@CAN_PrivMain::RFL_Object::RXX_Object_Obj35.PxVyCoVnce, 0.01, 0.0);
    copyBitsToByteArrayLE(raw_value, byteArray, 18700, 12);

    raw_value = convertPhysicalToRaw(@CAN_PrivMain::RFL_Object::RXX_Object_Obj35.FilterInformation, 1.0, 0.0);
    copyBitsToByteArrayLE(raw_value, byteArray, 18712, 8);

    raw_value = convertPhysicalToRaw(@CAN_PrivMain::RFL_Object::RXX_Object_Obj35.PyVxCoVnce, 0.01, 0.0);
    copyBitsToByteArrayLE(raw_value, byteArray, 18720, 12);
}


void RXX_Object_Obj34_write(byte byteArray[])
{
    qword raw_value;

    raw_value = convertPhysicalToRaw(@CAN_PrivMain::RFL_Object::RXX_Object_Obj34.AxVnce, 0.01, 0.0);
    copyBitsToByteArrayLE(raw_value, byteArray, 18016, 12);

    raw_value = convertPhysicalToRaw(@CAN_PrivMain::RFL_Object::RXX_Object_Obj34.VxVnce, 0.01, 0.0);
    copyBitsToByteArrayLE(raw_value, byteArray, 18112, 12);

    raw_value = convertPhysicalToRaw(@CAN_PrivMain::RFL_Object::RXX_Object_Obj34.ObjId, 1.0, 0.0);
    copyBitsToByteArrayLE(raw_value, byteArray, 18104, 7);

    raw_value = convertPhysicalToRaw(@CAN_PrivMain::RFL_Object::RXX_Object_Obj34.Vx, 0.0625, -128.0);
    copyBitsToByteArrayLE(raw_value, byteArray, 18092, 12);

    raw_value = convertPhysicalToRaw(@CAN_PrivMain::RFL_Object::RXX_Object_Obj34.AyVnce, 0.01, 0.0);
    copyBitsToByteArrayLE(raw_value, byteArray, 18080, 12);

    raw_value = convertPhysicalToRaw(@CAN_PrivMain::RFL_Object::RXX_Object_Obj34.Ay, 0.0625, -16.0);
    copyBitsToByteArrayLE(raw_value, byteArray, 18070, 9);

    raw_value = convertPhysicalToRaw(@CAN_PrivMain::RFL_Object::RXX_Object_Obj34.RCS, 0.2, -102.4);
    copyBitsToByteArrayLE(raw_value, byteArray, 18060, 10);

    raw_value = convertPhysicalToRaw(@CAN_PrivMain::RFL_Object::RXX_Object_Obj34.WidthVnce, 0.01, 0.0);
    copyBitsToByteArrayLE(raw_value, byteArray, 18048, 12);

    raw_value = convertPhysicalToRaw(@CAN_PrivMain::RFL_Object::RXX_Object_Obj34.Width, 0.125, 0.0);
    copyBitsToByteArrayLE(raw_value, byteArray, 18040, 7);

    raw_value = convertPhysicalToRaw(@CAN_PrivMain::RFL_Object::RXX_Object_Obj34.OrientationYawVnce, 0.0003, 0.0);
    copyBitsToByteArrayLE(raw_value, byteArray, 18028, 12);

    raw_value = convertPhysicalToRaw(@CAN_PrivMain::RFL_Object::RXX_Object_Obj34.Vy, 0.125, -64.0);
    copyBitsToByteArrayLE(raw_value, byteArray, 18126, 10);

    raw_value = convertPhysicalToRaw(@CAN_PrivMain::RFL_Object::RXX_Object_Obj34.OrientationYaw, 0.0175, -4.48);
    copyBitsToByteArrayLE(raw_value, byteArray, 18006, 9);

    raw_value = convertPhysicalToRaw(@CAN_PrivMain::RFL_Object::RXX_Object_Obj34.Ax, 0.03125, -16.0);
    copyBitsToByteArrayLE(raw_value, byteArray, 17996, 10);

    raw_value = convertPhysicalToRaw(@CAN_PrivMain::RFL_Object::RXX_Object_Obj34.LengthVnce, 0.01, 0.0);
    copyBitsToByteArrayLE(raw_value, byteArray, 17984, 12);

    raw_value = convertPhysicalToRaw(@CAN_PrivMain::RFL_Object::RXX_Object_Obj34.Length, 0.125, 0.0);
    copyBitsToByteArrayLE(raw_value, byteArray, 17976, 7);

    raw_value = convertPhysicalToRaw(@CAN_PrivMain::RFL_Object::RXX_Object_Obj34.PyVnce, 0.1, 0.0);
    copyBitsToByteArrayLE(raw_value, byteArray, 17964, 12);

    raw_value = convertPhysicalToRaw(@CAN_PrivMain::RFL_Object::RXX_Object_Obj34.Py, 0.0625, -128.0);
    copyBitsToByteArrayLE(raw_value, byteArray, 17952, 12);

    raw_value = convertPhysicalToRaw(@CAN_PrivMain::RFL_Object::RXX_Object_Obj34.PxVnce, 0.1, 0.0);
    copyBitsToByteArrayLE(raw_value, byteArray, 17940, 12);

    raw_value = convertPhysicalToRaw(@CAN_PrivMain::RFL_Object::RXX_Object_Obj34.Px, 0.0625, -512.0);
    copyBitsToByteArrayLE(raw_value, byteArray, 17926, 14);

    raw_value = convertPhysicalToRaw(@CAN_PrivMain::RFL_Object::RXX_Object_Obj34.ProbClassConfidence, 2.0, 0.0);
    copyBitsToByteArrayLE(raw_value, byteArray, 17920, 6);

    raw_value = convertPhysicalToRaw(@CAN_PrivMain::RFL_Object::RXX_Object_Obj34.MovingStatus, 1.0, 0.0);
    copyBitsToByteArrayLE(raw_value, byteArray, 18124, 2);

    raw_value = convertPhysicalToRaw(@CAN_PrivMain::RFL_Object::RXX_Object_Obj34.PxVxCoVnce, 0.01, 0.0);
    copyBitsToByteArrayLE(raw_value, byteArray, 18176, 12);

    raw_value = convertPhysicalToRaw(@CAN_PrivMain::RFL_Object::RXX_Object_Obj34.ExistProb, 2.0, 0.0);
    copyBitsToByteArrayLE(raw_value, byteArray, 18136, 6);

    raw_value = convertPhysicalToRaw(@CAN_PrivMain::RFL_Object::RXX_Object_Obj34.PxAyCoVnce, 0.01, 0.0);
    copyBitsToByteArrayLE(raw_value, byteArray, 18252, 12);

    raw_value = convertPhysicalToRaw(@CAN_PrivMain::RFL_Object::RXX_Object_Obj34.Age, 1.0, 0.0);
    copyBitsToByteArrayLE(raw_value, byteArray, 18400, 32);

    raw_value = convertPhysicalToRaw(@CAN_PrivMain::RFL_Object::RXX_Object_Obj34.AxAyCoVnce, 0.01, 0.0);
    copyBitsToByteArrayLE(raw_value, byteArray, 18380, 12);

    raw_value = convertPhysicalToRaw(@CAN_PrivMain::RFL_Object::RXX_Object_Obj34.VyAyCoVnce, 0.01, 0.0);
    copyBitsToByteArrayLE(raw_value, byteArray, 18368, 12);

    raw_value = convertPhysicalToRaw(@CAN_PrivMain::RFL_Object::RXX_Object_Obj34.VyAxCoVnce, 0.01, 0.0);
    copyBitsToByteArrayLE(raw_value, byteArray, 18348, 12);

    raw_value = convertPhysicalToRaw(@CAN_PrivMain::RFL_Object::RXX_Object_Obj34.VxAyCoVnce, 0.01, 0.0);
    copyBitsToByteArrayLE(raw_value, byteArray, 18336, 12);

    raw_value = convertPhysicalToRaw(@CAN_PrivMain::RFL_Object::RXX_Object_Obj34.VxAxCoVnce, 0.01, 0.0);
    copyBitsToByteArrayLE(raw_value, byteArray, 18316, 12);

    raw_value = convertPhysicalToRaw(@CAN_PrivMain::RFL_Object::RXX_Object_Obj34.VyVnce, 0.01, 0.0);
    copyBitsToByteArrayLE(raw_value, byteArray, 18144, 12);

    raw_value = convertPhysicalToRaw(@CAN_PrivMain::RFL_Object::RXX_Object_Obj34.PyAyCoVnce, 0.01, 0.0);
    copyBitsToByteArrayLE(raw_value, byteArray, 18284, 12);

    raw_value = convertPhysicalToRaw(@CAN_PrivMain::RFL_Object::RXX_Object_Obj34.PyAxCoVnce, 0.01, 0.0);
    copyBitsToByteArrayLE(raw_value, byteArray, 18272, 12);

    raw_value = convertPhysicalToRaw(@CAN_PrivMain::RFL_Object::RXX_Object_Obj34.VxVyCoVnce, 0.01, 0.0);
    copyBitsToByteArrayLE(raw_value, byteArray, 18304, 12);

    raw_value = convertPhysicalToRaw(@CAN_PrivMain::RFL_Object::RXX_Object_Obj34.PxAxCoVnce, 0.01, 0.0);
    copyBitsToByteArrayLE(raw_value, byteArray, 18240, 12);

    raw_value = convertPhysicalToRaw(@CAN_PrivMain::RFL_Object::RXX_Object_Obj34.PxVyCoVnce, 0.01, 0.0);
    copyBitsToByteArrayLE(raw_value, byteArray, 18188, 12);

    raw_value = convertPhysicalToRaw(@CAN_PrivMain::RFL_Object::RXX_Object_Obj34.ReferencePoint, 1.0, 0.0);
    copyBitsToByteArrayLE(raw_value, byteArray, 18232, 4);

    raw_value = convertPhysicalToRaw(@CAN_PrivMain::RFL_Object::RXX_Object_Obj34.MeasurementStatus, 1.0, 0.0);
    copyBitsToByteArrayLE(raw_value, byteArray, 18168, 3);

    raw_value = convertPhysicalToRaw(@CAN_PrivMain::RFL_Object::RXX_Object_Obj34.ProbClassType, 1.0, 0.0);
    copyBitsToByteArrayLE(raw_value, byteArray, 18171, 4);

    raw_value = convertPhysicalToRaw(@CAN_PrivMain::RFL_Object::RXX_Object_Obj34.PxPyCoVnce, 0.01, 0.0);
    copyBitsToByteArrayLE(raw_value, byteArray, 18156, 12);

    raw_value = convertPhysicalToRaw(@CAN_PrivMain::RFL_Object::RXX_Object_Obj34.FilterInformation, 1.0, 0.0);
    copyBitsToByteArrayLE(raw_value, byteArray, 18200, 8);

    raw_value = convertPhysicalToRaw(@CAN_PrivMain::RFL_Object::RXX_Object_Obj34.PyVxCoVnce, 0.01, 0.0);
    copyBitsToByteArrayLE(raw_value, byteArray, 18208, 12);

    raw_value = convertPhysicalToRaw(@CAN_PrivMain::RFL_Object::RXX_Object_Obj34.PyVyCoVnce, 0.01, 0.0);
    copyBitsToByteArrayLE(raw_value, byteArray, 18220, 12);
}


void RXX_Object_Obj33_write(byte byteArray[])
{
    qword raw_value;

    raw_value = convertPhysicalToRaw(@CAN_PrivMain::RFL_Object::RXX_Object_Obj33.AxVnce, 0.01, 0.0);
    copyBitsToByteArrayLE(raw_value, byteArray, 17504, 12);

    raw_value = convertPhysicalToRaw(@CAN_PrivMain::RFL_Object::RXX_Object_Obj33.VxVnce, 0.01, 0.0);
    copyBitsToByteArrayLE(raw_value, byteArray, 17600, 12);

    raw_value = convertPhysicalToRaw(@CAN_PrivMain::RFL_Object::RXX_Object_Obj33.ObjId, 1.0, 0.0);
    copyBitsToByteArrayLE(raw_value, byteArray, 17592, 7);

    raw_value = convertPhysicalToRaw(@CAN_PrivMain::RFL_Object::RXX_Object_Obj33.Vx, 0.0625, -128.0);
    copyBitsToByteArrayLE(raw_value, byteArray, 17580, 12);

    raw_value = convertPhysicalToRaw(@CAN_PrivMain::RFL_Object::RXX_Object_Obj33.AyVnce, 0.01, 0.0);
    copyBitsToByteArrayLE(raw_value, byteArray, 17568, 12);

    raw_value = convertPhysicalToRaw(@CAN_PrivMain::RFL_Object::RXX_Object_Obj33.Ay, 0.0625, -16.0);
    copyBitsToByteArrayLE(raw_value, byteArray, 17558, 9);

    raw_value = convertPhysicalToRaw(@CAN_PrivMain::RFL_Object::RXX_Object_Obj33.RCS, 0.2, -102.4);
    copyBitsToByteArrayLE(raw_value, byteArray, 17548, 10);

    raw_value = convertPhysicalToRaw(@CAN_PrivMain::RFL_Object::RXX_Object_Obj33.WidthVnce, 0.01, 0.0);
    copyBitsToByteArrayLE(raw_value, byteArray, 17536, 12);

    raw_value = convertPhysicalToRaw(@CAN_PrivMain::RFL_Object::RXX_Object_Obj33.Width, 0.125, 0.0);
    copyBitsToByteArrayLE(raw_value, byteArray, 17528, 7);

    raw_value = convertPhysicalToRaw(@CAN_PrivMain::RFL_Object::RXX_Object_Obj33.OrientationYawVnce, 0.0003, 0.0);
    copyBitsToByteArrayLE(raw_value, byteArray, 17516, 12);

    raw_value = convertPhysicalToRaw(@CAN_PrivMain::RFL_Object::RXX_Object_Obj33.Vy, 0.125, -64.0);
    copyBitsToByteArrayLE(raw_value, byteArray, 17614, 10);

    raw_value = convertPhysicalToRaw(@CAN_PrivMain::RFL_Object::RXX_Object_Obj33.OrientationYaw, 0.0175, -4.48);
    copyBitsToByteArrayLE(raw_value, byteArray, 17494, 9);

    raw_value = convertPhysicalToRaw(@CAN_PrivMain::RFL_Object::RXX_Object_Obj33.Ax, 0.03125, -16.0);
    copyBitsToByteArrayLE(raw_value, byteArray, 17484, 10);

    raw_value = convertPhysicalToRaw(@CAN_PrivMain::RFL_Object::RXX_Object_Obj33.LengthVnce, 0.01, 0.0);
    copyBitsToByteArrayLE(raw_value, byteArray, 17472, 12);

    raw_value = convertPhysicalToRaw(@CAN_PrivMain::RFL_Object::RXX_Object_Obj33.Length, 0.125, 0.0);
    copyBitsToByteArrayLE(raw_value, byteArray, 17464, 7);

    raw_value = convertPhysicalToRaw(@CAN_PrivMain::RFL_Object::RXX_Object_Obj33.PyVnce, 0.1, 0.0);
    copyBitsToByteArrayLE(raw_value, byteArray, 17452, 12);

    raw_value = convertPhysicalToRaw(@CAN_PrivMain::RFL_Object::RXX_Object_Obj33.Py, 0.0625, -128.0);
    copyBitsToByteArrayLE(raw_value, byteArray, 17440, 12);

    raw_value = convertPhysicalToRaw(@CAN_PrivMain::RFL_Object::RXX_Object_Obj33.PxVnce, 0.1, 0.0);
    copyBitsToByteArrayLE(raw_value, byteArray, 17428, 12);

    raw_value = convertPhysicalToRaw(@CAN_PrivMain::RFL_Object::RXX_Object_Obj33.Px, 0.0625, -512.0);
    copyBitsToByteArrayLE(raw_value, byteArray, 17414, 14);

    raw_value = convertPhysicalToRaw(@CAN_PrivMain::RFL_Object::RXX_Object_Obj33.ProbClassConfidence, 2.0, 0.0);
    copyBitsToByteArrayLE(raw_value, byteArray, 17408, 6);

    raw_value = convertPhysicalToRaw(@CAN_PrivMain::RFL_Object::RXX_Object_Obj33.MovingStatus, 1.0, 0.0);
    copyBitsToByteArrayLE(raw_value, byteArray, 17612, 2);

    raw_value = convertPhysicalToRaw(@CAN_PrivMain::RFL_Object::RXX_Object_Obj33.Age, 1.0, 0.0);
    copyBitsToByteArrayLE(raw_value, byteArray, 17888, 32);

    raw_value = convertPhysicalToRaw(@CAN_PrivMain::RFL_Object::RXX_Object_Obj33.ExistProb, 2.0, 0.0);
    copyBitsToByteArrayLE(raw_value, byteArray, 17624, 6);

    raw_value = convertPhysicalToRaw(@CAN_PrivMain::RFL_Object::RXX_Object_Obj33.PxAxCoVnce, 0.01, 0.0);
    copyBitsToByteArrayLE(raw_value, byteArray, 17728, 12);

    raw_value = convertPhysicalToRaw(@CAN_PrivMain::RFL_Object::RXX_Object_Obj33.AxAyCoVnce, 0.01, 0.0);
    copyBitsToByteArrayLE(raw_value, byteArray, 17868, 12);

    raw_value = convertPhysicalToRaw(@CAN_PrivMain::RFL_Object::RXX_Object_Obj33.VyAyCoVnce, 0.01, 0.0);
    copyBitsToByteArrayLE(raw_value, byteArray, 17856, 12);

    raw_value = convertPhysicalToRaw(@CAN_PrivMain::RFL_Object::RXX_Object_Obj33.VyAxCoVnce, 0.01, 0.0);
    copyBitsToByteArrayLE(raw_value, byteArray, 17836, 12);

    raw_value = convertPhysicalToRaw(@CAN_PrivMain::RFL_Object::RXX_Object_Obj33.VxAyCoVnce, 0.01, 0.0);
    copyBitsToByteArrayLE(raw_value, byteArray, 17824, 12);

    raw_value = convertPhysicalToRaw(@CAN_PrivMain::RFL_Object::RXX_Object_Obj33.VxAxCoVnce, 0.01, 0.0);
    copyBitsToByteArrayLE(raw_value, byteArray, 17804, 12);

    raw_value = convertPhysicalToRaw(@CAN_PrivMain::RFL_Object::RXX_Object_Obj33.VxVyCoVnce, 0.01, 0.0);
    copyBitsToByteArrayLE(raw_value, byteArray, 17792, 12);

    raw_value = convertPhysicalToRaw(@CAN_PrivMain::RFL_Object::RXX_Object_Obj33.PyAyCoVnce, 0.01, 0.0);
    copyBitsToByteArrayLE(raw_value, byteArray, 17772, 12);

    raw_value = convertPhysicalToRaw(@CAN_PrivMain::RFL_Object::RXX_Object_Obj33.PyAxCoVnce, 0.01, 0.0);
    copyBitsToByteArrayLE(raw_value, byteArray, 17760, 12);

    raw_value = convertPhysicalToRaw(@CAN_PrivMain::RFL_Object::RXX_Object_Obj33.PxAyCoVnce, 0.01, 0.0);
    copyBitsToByteArrayLE(raw_value, byteArray, 17740, 12);

    raw_value = convertPhysicalToRaw(@CAN_PrivMain::RFL_Object::RXX_Object_Obj33.VyVnce, 0.01, 0.0);
    copyBitsToByteArrayLE(raw_value, byteArray, 17632, 12);

    raw_value = convertPhysicalToRaw(@CAN_PrivMain::RFL_Object::RXX_Object_Obj33.ReferencePoint, 1.0, 0.0);
    copyBitsToByteArrayLE(raw_value, byteArray, 17720, 4);

    raw_value = convertPhysicalToRaw(@CAN_PrivMain::RFL_Object::RXX_Object_Obj33.PxVxCoVnce, 0.01, 0.0);
    copyBitsToByteArrayLE(raw_value, byteArray, 17664, 12);

    raw_value = convertPhysicalToRaw(@CAN_PrivMain::RFL_Object::RXX_Object_Obj33.PyVyCoVnce, 0.01, 0.0);
    copyBitsToByteArrayLE(raw_value, byteArray, 17708, 12);

    raw_value = convertPhysicalToRaw(@CAN_PrivMain::RFL_Object::RXX_Object_Obj33.MeasurementStatus, 1.0, 0.0);
    copyBitsToByteArrayLE(raw_value, byteArray, 17656, 3);

    raw_value = convertPhysicalToRaw(@CAN_PrivMain::RFL_Object::RXX_Object_Obj33.ProbClassType, 1.0, 0.0);
    copyBitsToByteArrayLE(raw_value, byteArray, 17659, 4);

    raw_value = convertPhysicalToRaw(@CAN_PrivMain::RFL_Object::RXX_Object_Obj33.PxPyCoVnce, 0.01, 0.0);
    copyBitsToByteArrayLE(raw_value, byteArray, 17644, 12);

    raw_value = convertPhysicalToRaw(@CAN_PrivMain::RFL_Object::RXX_Object_Obj33.PxVyCoVnce, 0.01, 0.0);
    copyBitsToByteArrayLE(raw_value, byteArray, 17676, 12);

    raw_value = convertPhysicalToRaw(@CAN_PrivMain::RFL_Object::RXX_Object_Obj33.FilterInformation, 1.0, 0.0);
    copyBitsToByteArrayLE(raw_value, byteArray, 17688, 8);

    raw_value = convertPhysicalToRaw(@CAN_PrivMain::RFL_Object::RXX_Object_Obj33.PyVxCoVnce, 0.01, 0.0);
    copyBitsToByteArrayLE(raw_value, byteArray, 17696, 12);
}


void RXX_Object_Obj32_write(byte byteArray[])
{
    qword raw_value;

    raw_value = convertPhysicalToRaw(@CAN_PrivMain::RFL_Object::RXX_Object_Obj32.ObjId, 1.0, 0.0);
    copyBitsToByteArrayLE(raw_value, byteArray, 17080, 7);

    raw_value = convertPhysicalToRaw(@CAN_PrivMain::RFL_Object::RXX_Object_Obj32.AxVnce, 0.01, 0.0);
    copyBitsToByteArrayLE(raw_value, byteArray, 16992, 12);

    raw_value = convertPhysicalToRaw(@CAN_PrivMain::RFL_Object::RXX_Object_Obj32.Vx, 0.0625, -128.0);
    copyBitsToByteArrayLE(raw_value, byteArray, 17068, 12);

    raw_value = convertPhysicalToRaw(@CAN_PrivMain::RFL_Object::RXX_Object_Obj32.AyVnce, 0.01, 0.0);
    copyBitsToByteArrayLE(raw_value, byteArray, 17056, 12);

    raw_value = convertPhysicalToRaw(@CAN_PrivMain::RFL_Object::RXX_Object_Obj32.Ay, 0.0625, -16.0);
    copyBitsToByteArrayLE(raw_value, byteArray, 17046, 9);

    raw_value = convertPhysicalToRaw(@CAN_PrivMain::RFL_Object::RXX_Object_Obj32.RCS, 0.2, -102.4);
    copyBitsToByteArrayLE(raw_value, byteArray, 17036, 10);

    raw_value = convertPhysicalToRaw(@CAN_PrivMain::RFL_Object::RXX_Object_Obj32.WidthVnce, 0.01, 0.0);
    copyBitsToByteArrayLE(raw_value, byteArray, 17024, 12);

    raw_value = convertPhysicalToRaw(@CAN_PrivMain::RFL_Object::RXX_Object_Obj32.Width, 0.125, 0.0);
    copyBitsToByteArrayLE(raw_value, byteArray, 17016, 7);

    raw_value = convertPhysicalToRaw(@CAN_PrivMain::RFL_Object::RXX_Object_Obj32.OrientationYawVnce, 0.0003, 0.0);
    copyBitsToByteArrayLE(raw_value, byteArray, 17004, 12);

    raw_value = convertPhysicalToRaw(@CAN_PrivMain::RFL_Object::RXX_Object_Obj32.PyVnce, 0.1, 0.0);
    copyBitsToByteArrayLE(raw_value, byteArray, 16940, 12);

    raw_value = convertPhysicalToRaw(@CAN_PrivMain::RFL_Object::RXX_Object_Obj32.OrientationYaw, 0.0175, -4.48);
    copyBitsToByteArrayLE(raw_value, byteArray, 16982, 9);

    raw_value = convertPhysicalToRaw(@CAN_PrivMain::RFL_Object::RXX_Object_Obj32.Ax, 0.03125, -16.0);
    copyBitsToByteArrayLE(raw_value, byteArray, 16972, 10);

    raw_value = convertPhysicalToRaw(@CAN_PrivMain::RFL_Object::RXX_Object_Obj32.LengthVnce, 0.01, 0.0);
    copyBitsToByteArrayLE(raw_value, byteArray, 16960, 12);

    raw_value = convertPhysicalToRaw(@CAN_PrivMain::RFL_Object::RXX_Object_Obj32.Length, 0.125, 0.0);
    copyBitsToByteArrayLE(raw_value, byteArray, 16952, 7);

    raw_value = convertPhysicalToRaw(@CAN_PrivMain::RFL_Object::RXX_Object_Obj32.Py, 0.0625, -128.0);
    copyBitsToByteArrayLE(raw_value, byteArray, 16928, 12);

    raw_value = convertPhysicalToRaw(@CAN_PrivMain::RFL_Object::RXX_Object_Obj32.PxVnce, 0.1, 0.0);
    copyBitsToByteArrayLE(raw_value, byteArray, 16916, 12);

    raw_value = convertPhysicalToRaw(@CAN_PrivMain::RFL_Object::RXX_Object_Obj32.Px, 0.0625, -512.0);
    copyBitsToByteArrayLE(raw_value, byteArray, 16902, 14);

    raw_value = convertPhysicalToRaw(@CAN_PrivMain::RFL_Object::RXX_Object_Obj32.ProbClassConfidence, 2.0, 0.0);
    copyBitsToByteArrayLE(raw_value, byteArray, 16896, 6);

    raw_value = convertPhysicalToRaw(@CAN_PrivMain::RFL_Object::RXX_Object_Obj32.MovingStatus, 1.0, 0.0);
    copyBitsToByteArrayLE(raw_value, byteArray, 17100, 2);

    raw_value = convertPhysicalToRaw(@CAN_PrivMain::RFL_Object::RXX_Object_Obj32.VxVnce, 0.01, 0.0);
    copyBitsToByteArrayLE(raw_value, byteArray, 17088, 12);

    raw_value = convertPhysicalToRaw(@CAN_PrivMain::RFL_Object::RXX_Object_Obj32.Vy, 0.125, -64.0);
    copyBitsToByteArrayLE(raw_value, byteArray, 17102, 10);

    raw_value = convertPhysicalToRaw(@CAN_PrivMain::RFL_Object::RXX_Object_Obj32.AxAyCoVnce, 0.01, 0.0);
    copyBitsToByteArrayLE(raw_value, byteArray, 17356, 12);

    raw_value = convertPhysicalToRaw(@CAN_PrivMain::RFL_Object::RXX_Object_Obj32.PxAxCoVnce, 0.01, 0.0);
    copyBitsToByteArrayLE(raw_value, byteArray, 17216, 12);

    raw_value = convertPhysicalToRaw(@CAN_PrivMain::RFL_Object::RXX_Object_Obj32.Age, 1.0, 0.0);
    copyBitsToByteArrayLE(raw_value, byteArray, 17376, 32);

    raw_value = convertPhysicalToRaw(@CAN_PrivMain::RFL_Object::RXX_Object_Obj32.ExistProb, 2.0, 0.0);
    copyBitsToByteArrayLE(raw_value, byteArray, 17112, 6);

    raw_value = convertPhysicalToRaw(@CAN_PrivMain::RFL_Object::RXX_Object_Obj32.VyAyCoVnce, 0.01, 0.0);
    copyBitsToByteArrayLE(raw_value, byteArray, 17344, 12);

    raw_value = convertPhysicalToRaw(@CAN_PrivMain::RFL_Object::RXX_Object_Obj32.VyAxCoVnce, 0.01, 0.0);
    copyBitsToByteArrayLE(raw_value, byteArray, 17324, 12);

    raw_value = convertPhysicalToRaw(@CAN_PrivMain::RFL_Object::RXX_Object_Obj32.VxAyCoVnce, 0.01, 0.0);
    copyBitsToByteArrayLE(raw_value, byteArray, 17312, 12);

    raw_value = convertPhysicalToRaw(@CAN_PrivMain::RFL_Object::RXX_Object_Obj32.VxAxCoVnce, 0.01, 0.0);
    copyBitsToByteArrayLE(raw_value, byteArray, 17292, 12);

    raw_value = convertPhysicalToRaw(@CAN_PrivMain::RFL_Object::RXX_Object_Obj32.PyAyCoVnce, 0.01, 0.0);
    copyBitsToByteArrayLE(raw_value, byteArray, 17260, 12);

    raw_value = convertPhysicalToRaw(@CAN_PrivMain::RFL_Object::RXX_Object_Obj32.PyAxCoVnce, 0.01, 0.0);
    copyBitsToByteArrayLE(raw_value, byteArray, 17248, 12);

    raw_value = convertPhysicalToRaw(@CAN_PrivMain::RFL_Object::RXX_Object_Obj32.PxAyCoVnce, 0.01, 0.0);
    copyBitsToByteArrayLE(raw_value, byteArray, 17228, 12);

    raw_value = convertPhysicalToRaw(@CAN_PrivMain::RFL_Object::RXX_Object_Obj32.VxVyCoVnce, 0.01, 0.0);
    copyBitsToByteArrayLE(raw_value, byteArray, 17280, 12);

    raw_value = convertPhysicalToRaw(@CAN_PrivMain::RFL_Object::RXX_Object_Obj32.ReferencePoint, 1.0, 0.0);
    copyBitsToByteArrayLE(raw_value, byteArray, 17208, 4);

    raw_value = convertPhysicalToRaw(@CAN_PrivMain::RFL_Object::RXX_Object_Obj32.PxVxCoVnce, 0.01, 0.0);
    copyBitsToByteArrayLE(raw_value, byteArray, 17152, 12);

    raw_value = convertPhysicalToRaw(@CAN_PrivMain::RFL_Object::RXX_Object_Obj32.PyVyCoVnce, 0.01, 0.0);
    copyBitsToByteArrayLE(raw_value, byteArray, 17196, 12);

    raw_value = convertPhysicalToRaw(@CAN_PrivMain::RFL_Object::RXX_Object_Obj32.PxPyCoVnce, 0.01, 0.0);
    copyBitsToByteArrayLE(raw_value, byteArray, 17132, 12);

    raw_value = convertPhysicalToRaw(@CAN_PrivMain::RFL_Object::RXX_Object_Obj32.MeasurementStatus, 1.0, 0.0);
    copyBitsToByteArrayLE(raw_value, byteArray, 17144, 3);

    raw_value = convertPhysicalToRaw(@CAN_PrivMain::RFL_Object::RXX_Object_Obj32.ProbClassType, 1.0, 0.0);
    copyBitsToByteArrayLE(raw_value, byteArray, 17147, 4);

    raw_value = convertPhysicalToRaw(@CAN_PrivMain::RFL_Object::RXX_Object_Obj32.VyVnce, 0.01, 0.0);
    copyBitsToByteArrayLE(raw_value, byteArray, 17120, 12);

    raw_value = convertPhysicalToRaw(@CAN_PrivMain::RFL_Object::RXX_Object_Obj32.PxVyCoVnce, 0.01, 0.0);
    copyBitsToByteArrayLE(raw_value, byteArray, 17164, 12);

    raw_value = convertPhysicalToRaw(@CAN_PrivMain::RFL_Object::RXX_Object_Obj32.FilterInformation, 1.0, 0.0);
    copyBitsToByteArrayLE(raw_value, byteArray, 17176, 8);

    raw_value = convertPhysicalToRaw(@CAN_PrivMain::RFL_Object::RXX_Object_Obj32.PyVxCoVnce, 0.01, 0.0);
    copyBitsToByteArrayLE(raw_value, byteArray, 17184, 12);
}


void RXX_Object_Obj31_write(byte byteArray[])
{
    qword raw_value;

    raw_value = convertPhysicalToRaw(@CAN_PrivMain::RFL_Object::RXX_Object_Obj31.AxVnce, 0.01, 0.0);
    copyBitsToByteArrayLE(raw_value, byteArray, 16480, 12);

    raw_value = convertPhysicalToRaw(@CAN_PrivMain::RFL_Object::RXX_Object_Obj31.VxVnce, 0.01, 0.0);
    copyBitsToByteArrayLE(raw_value, byteArray, 16576, 12);

    raw_value = convertPhysicalToRaw(@CAN_PrivMain::RFL_Object::RXX_Object_Obj31.ObjId, 1.0, 0.0);
    copyBitsToByteArrayLE(raw_value, byteArray, 16568, 7);

    raw_value = convertPhysicalToRaw(@CAN_PrivMain::RFL_Object::RXX_Object_Obj31.Vx, 0.0625, -128.0);
    copyBitsToByteArrayLE(raw_value, byteArray, 16556, 12);

    raw_value = convertPhysicalToRaw(@CAN_PrivMain::RFL_Object::RXX_Object_Obj31.AyVnce, 0.01, 0.0);
    copyBitsToByteArrayLE(raw_value, byteArray, 16544, 12);

    raw_value = convertPhysicalToRaw(@CAN_PrivMain::RFL_Object::RXX_Object_Obj31.Ay, 0.0625, -16.0);
    copyBitsToByteArrayLE(raw_value, byteArray, 16534, 9);

    raw_value = convertPhysicalToRaw(@CAN_PrivMain::RFL_Object::RXX_Object_Obj31.RCS, 0.2, -102.4);
    copyBitsToByteArrayLE(raw_value, byteArray, 16524, 10);

    raw_value = convertPhysicalToRaw(@CAN_PrivMain::RFL_Object::RXX_Object_Obj31.WidthVnce, 0.01, 0.0);
    copyBitsToByteArrayLE(raw_value, byteArray, 16512, 12);

    raw_value = convertPhysicalToRaw(@CAN_PrivMain::RFL_Object::RXX_Object_Obj31.Width, 0.125, 0.0);
    copyBitsToByteArrayLE(raw_value, byteArray, 16504, 7);

    raw_value = convertPhysicalToRaw(@CAN_PrivMain::RFL_Object::RXX_Object_Obj31.OrientationYawVnce, 0.0003, 0.0);
    copyBitsToByteArrayLE(raw_value, byteArray, 16492, 12);

    raw_value = convertPhysicalToRaw(@CAN_PrivMain::RFL_Object::RXX_Object_Obj31.Vy, 0.125, -64.0);
    copyBitsToByteArrayLE(raw_value, byteArray, 16590, 10);

    raw_value = convertPhysicalToRaw(@CAN_PrivMain::RFL_Object::RXX_Object_Obj31.OrientationYaw, 0.0175, -4.48);
    copyBitsToByteArrayLE(raw_value, byteArray, 16470, 9);

    raw_value = convertPhysicalToRaw(@CAN_PrivMain::RFL_Object::RXX_Object_Obj31.Ax, 0.03125, -16.0);
    copyBitsToByteArrayLE(raw_value, byteArray, 16460, 10);

    raw_value = convertPhysicalToRaw(@CAN_PrivMain::RFL_Object::RXX_Object_Obj31.LengthVnce, 0.01, 0.0);
    copyBitsToByteArrayLE(raw_value, byteArray, 16448, 12);

    raw_value = convertPhysicalToRaw(@CAN_PrivMain::RFL_Object::RXX_Object_Obj31.Length, 0.125, 0.0);
    copyBitsToByteArrayLE(raw_value, byteArray, 16440, 7);

    raw_value = convertPhysicalToRaw(@CAN_PrivMain::RFL_Object::RXX_Object_Obj31.PyVnce, 0.1, 0.0);
    copyBitsToByteArrayLE(raw_value, byteArray, 16428, 12);

    raw_value = convertPhysicalToRaw(@CAN_PrivMain::RFL_Object::RXX_Object_Obj31.Py, 0.0625, -128.0);
    copyBitsToByteArrayLE(raw_value, byteArray, 16416, 12);

    raw_value = convertPhysicalToRaw(@CAN_PrivMain::RFL_Object::RXX_Object_Obj31.PxVnce, 0.1, 0.0);
    copyBitsToByteArrayLE(raw_value, byteArray, 16404, 12);

    raw_value = convertPhysicalToRaw(@CAN_PrivMain::RFL_Object::RXX_Object_Obj31.Px, 0.0625, -512.0);
    copyBitsToByteArrayLE(raw_value, byteArray, 16390, 14);

    raw_value = convertPhysicalToRaw(@CAN_PrivMain::RFL_Object::RXX_Object_Obj31.ProbClassConfidence, 2.0, 0.0);
    copyBitsToByteArrayLE(raw_value, byteArray, 16384, 6);

    raw_value = convertPhysicalToRaw(@CAN_PrivMain::RFL_Object::RXX_Object_Obj31.MovingStatus, 1.0, 0.0);
    copyBitsToByteArrayLE(raw_value, byteArray, 16588, 2);

    raw_value = convertPhysicalToRaw(@CAN_PrivMain::RFL_Object::RXX_Object_Obj31.AxAyCoVnce, 0.01, 0.0);
    copyBitsToByteArrayLE(raw_value, byteArray, 16844, 12);

    raw_value = convertPhysicalToRaw(@CAN_PrivMain::RFL_Object::RXX_Object_Obj31.ExistProb, 2.0, 0.0);
    copyBitsToByteArrayLE(raw_value, byteArray, 16600, 6);

    raw_value = convertPhysicalToRaw(@CAN_PrivMain::RFL_Object::RXX_Object_Obj31.PxAxCoVnce, 0.01, 0.0);
    copyBitsToByteArrayLE(raw_value, byteArray, 16704, 12);

    raw_value = convertPhysicalToRaw(@CAN_PrivMain::RFL_Object::RXX_Object_Obj31.VyVnce, 0.01, 0.0);
    copyBitsToByteArrayLE(raw_value, byteArray, 16608, 12);

    raw_value = convertPhysicalToRaw(@CAN_PrivMain::RFL_Object::RXX_Object_Obj31.Age, 1.0, 0.0);
    copyBitsToByteArrayLE(raw_value, byteArray, 16864, 32);

    raw_value = convertPhysicalToRaw(@CAN_PrivMain::RFL_Object::RXX_Object_Obj31.VyAyCoVnce, 0.01, 0.0);
    copyBitsToByteArrayLE(raw_value, byteArray, 16832, 12);

    raw_value = convertPhysicalToRaw(@CAN_PrivMain::RFL_Object::RXX_Object_Obj31.VyAxCoVnce, 0.01, 0.0);
    copyBitsToByteArrayLE(raw_value, byteArray, 16812, 12);

    raw_value = convertPhysicalToRaw(@CAN_PrivMain::RFL_Object::RXX_Object_Obj31.VxAyCoVnce, 0.01, 0.0);
    copyBitsToByteArrayLE(raw_value, byteArray, 16800, 12);

    raw_value = convertPhysicalToRaw(@CAN_PrivMain::RFL_Object::RXX_Object_Obj31.VxAxCoVnce, 0.01, 0.0);
    copyBitsToByteArrayLE(raw_value, byteArray, 16780, 12);

    raw_value = convertPhysicalToRaw(@CAN_PrivMain::RFL_Object::RXX_Object_Obj31.PyAyCoVnce, 0.01, 0.0);
    copyBitsToByteArrayLE(raw_value, byteArray, 16748, 12);

    raw_value = convertPhysicalToRaw(@CAN_PrivMain::RFL_Object::RXX_Object_Obj31.PyAxCoVnce, 0.01, 0.0);
    copyBitsToByteArrayLE(raw_value, byteArray, 16736, 12);

    raw_value = convertPhysicalToRaw(@CAN_PrivMain::RFL_Object::RXX_Object_Obj31.PxAyCoVnce, 0.01, 0.0);
    copyBitsToByteArrayLE(raw_value, byteArray, 16716, 12);

    raw_value = convertPhysicalToRaw(@CAN_PrivMain::RFL_Object::RXX_Object_Obj31.VxVyCoVnce, 0.01, 0.0);
    copyBitsToByteArrayLE(raw_value, byteArray, 16768, 12);

    raw_value = convertPhysicalToRaw(@CAN_PrivMain::RFL_Object::RXX_Object_Obj31.ReferencePoint, 1.0, 0.0);
    copyBitsToByteArrayLE(raw_value, byteArray, 16696, 4);

    raw_value = convertPhysicalToRaw(@CAN_PrivMain::RFL_Object::RXX_Object_Obj31.PxVxCoVnce, 0.01, 0.0);
    copyBitsToByteArrayLE(raw_value, byteArray, 16640, 12);

    raw_value = convertPhysicalToRaw(@CAN_PrivMain::RFL_Object::RXX_Object_Obj31.PyVyCoVnce, 0.01, 0.0);
    copyBitsToByteArrayLE(raw_value, byteArray, 16684, 12);

    raw_value = convertPhysicalToRaw(@CAN_PrivMain::RFL_Object::RXX_Object_Obj31.MeasurementStatus, 1.0, 0.0);
    copyBitsToByteArrayLE(raw_value, byteArray, 16632, 3);

    raw_value = convertPhysicalToRaw(@CAN_PrivMain::RFL_Object::RXX_Object_Obj31.ProbClassType, 1.0, 0.0);
    copyBitsToByteArrayLE(raw_value, byteArray, 16635, 4);

    raw_value = convertPhysicalToRaw(@CAN_PrivMain::RFL_Object::RXX_Object_Obj31.PxPyCoVnce, 0.01, 0.0);
    copyBitsToByteArrayLE(raw_value, byteArray, 16620, 12);

    raw_value = convertPhysicalToRaw(@CAN_PrivMain::RFL_Object::RXX_Object_Obj31.PxVyCoVnce, 0.01, 0.0);
    copyBitsToByteArrayLE(raw_value, byteArray, 16652, 12);

    raw_value = convertPhysicalToRaw(@CAN_PrivMain::RFL_Object::RXX_Object_Obj31.FilterInformation, 1.0, 0.0);
    copyBitsToByteArrayLE(raw_value, byteArray, 16664, 8);

    raw_value = convertPhysicalToRaw(@CAN_PrivMain::RFL_Object::RXX_Object_Obj31.PyVxCoVnce, 0.01, 0.0);
    copyBitsToByteArrayLE(raw_value, byteArray, 16672, 12);
}


void RXX_Object_Obj30_write(byte byteArray[])
{
    qword raw_value;

    raw_value = convertPhysicalToRaw(@CAN_PrivMain::RFL_Object::RXX_Object_Obj30.AxVnce, 0.01, 0.0);
    copyBitsToByteArrayLE(raw_value, byteArray, 15968, 12);

    raw_value = convertPhysicalToRaw(@CAN_PrivMain::RFL_Object::RXX_Object_Obj30.VxVnce, 0.01, 0.0);
    copyBitsToByteArrayLE(raw_value, byteArray, 16064, 12);

    raw_value = convertPhysicalToRaw(@CAN_PrivMain::RFL_Object::RXX_Object_Obj30.ObjId, 1.0, 0.0);
    copyBitsToByteArrayLE(raw_value, byteArray, 16056, 7);

    raw_value = convertPhysicalToRaw(@CAN_PrivMain::RFL_Object::RXX_Object_Obj30.Vx, 0.0625, -128.0);
    copyBitsToByteArrayLE(raw_value, byteArray, 16044, 12);

    raw_value = convertPhysicalToRaw(@CAN_PrivMain::RFL_Object::RXX_Object_Obj30.AyVnce, 0.01, 0.0);
    copyBitsToByteArrayLE(raw_value, byteArray, 16032, 12);

    raw_value = convertPhysicalToRaw(@CAN_PrivMain::RFL_Object::RXX_Object_Obj30.Ay, 0.0625, -16.0);
    copyBitsToByteArrayLE(raw_value, byteArray, 16022, 9);

    raw_value = convertPhysicalToRaw(@CAN_PrivMain::RFL_Object::RXX_Object_Obj30.RCS, 0.2, -102.4);
    copyBitsToByteArrayLE(raw_value, byteArray, 16012, 10);

    raw_value = convertPhysicalToRaw(@CAN_PrivMain::RFL_Object::RXX_Object_Obj30.WidthVnce, 0.01, 0.0);
    copyBitsToByteArrayLE(raw_value, byteArray, 16000, 12);

    raw_value = convertPhysicalToRaw(@CAN_PrivMain::RFL_Object::RXX_Object_Obj30.Width, 0.125, 0.0);
    copyBitsToByteArrayLE(raw_value, byteArray, 15992, 7);

    raw_value = convertPhysicalToRaw(@CAN_PrivMain::RFL_Object::RXX_Object_Obj30.OrientationYawVnce, 0.0003, 0.0);
    copyBitsToByteArrayLE(raw_value, byteArray, 15980, 12);

    raw_value = convertPhysicalToRaw(@CAN_PrivMain::RFL_Object::RXX_Object_Obj30.ProbClassConfidence, 2.0, 0.0);
    copyBitsToByteArrayLE(raw_value, byteArray, 15872, 6);

    raw_value = convertPhysicalToRaw(@CAN_PrivMain::RFL_Object::RXX_Object_Obj30.OrientationYaw, 0.0175, -4.48);
    copyBitsToByteArrayLE(raw_value, byteArray, 15958, 9);

    raw_value = convertPhysicalToRaw(@CAN_PrivMain::RFL_Object::RXX_Object_Obj30.Ax, 0.03125, -16.0);
    copyBitsToByteArrayLE(raw_value, byteArray, 15948, 10);

    raw_value = convertPhysicalToRaw(@CAN_PrivMain::RFL_Object::RXX_Object_Obj30.LengthVnce, 0.01, 0.0);
    copyBitsToByteArrayLE(raw_value, byteArray, 15936, 12);

    raw_value = convertPhysicalToRaw(@CAN_PrivMain::RFL_Object::RXX_Object_Obj30.Length, 0.125, 0.0);
    copyBitsToByteArrayLE(raw_value, byteArray, 15928, 7);

    raw_value = convertPhysicalToRaw(@CAN_PrivMain::RFL_Object::RXX_Object_Obj30.Vy, 0.125, -64.0);
    copyBitsToByteArrayLE(raw_value, byteArray, 16078, 10);

    raw_value = convertPhysicalToRaw(@CAN_PrivMain::RFL_Object::RXX_Object_Obj30.PyVnce, 0.1, 0.0);
    copyBitsToByteArrayLE(raw_value, byteArray, 15916, 12);

    raw_value = convertPhysicalToRaw(@CAN_PrivMain::RFL_Object::RXX_Object_Obj30.Py, 0.0625, -128.0);
    copyBitsToByteArrayLE(raw_value, byteArray, 15904, 12);

    raw_value = convertPhysicalToRaw(@CAN_PrivMain::RFL_Object::RXX_Object_Obj30.PxVnce, 0.1, 0.0);
    copyBitsToByteArrayLE(raw_value, byteArray, 15892, 12);

    raw_value = convertPhysicalToRaw(@CAN_PrivMain::RFL_Object::RXX_Object_Obj30.Px, 0.0625, -512.0);
    copyBitsToByteArrayLE(raw_value, byteArray, 15878, 14);

    raw_value = convertPhysicalToRaw(@CAN_PrivMain::RFL_Object::RXX_Object_Obj30.MovingStatus, 1.0, 0.0);
    copyBitsToByteArrayLE(raw_value, byteArray, 16076, 2);

    raw_value = convertPhysicalToRaw(@CAN_PrivMain::RFL_Object::RXX_Object_Obj30.VxVyCoVnce, 0.01, 0.0);
    copyBitsToByteArrayLE(raw_value, byteArray, 16256, 12);

    raw_value = convertPhysicalToRaw(@CAN_PrivMain::RFL_Object::RXX_Object_Obj30.ExistProb, 2.0, 0.0);
    copyBitsToByteArrayLE(raw_value, byteArray, 16088, 6);

    raw_value = convertPhysicalToRaw(@CAN_PrivMain::RFL_Object::RXX_Object_Obj30.PxAxCoVnce, 0.01, 0.0);
    copyBitsToByteArrayLE(raw_value, byteArray, 16192, 12);

    raw_value = convertPhysicalToRaw(@CAN_PrivMain::RFL_Object::RXX_Object_Obj30.VyVnce, 0.01, 0.0);
    copyBitsToByteArrayLE(raw_value, byteArray, 16096, 12);

    raw_value = convertPhysicalToRaw(@CAN_PrivMain::RFL_Object::RXX_Object_Obj30.AxAyCoVnce, 0.01, 0.0);
    copyBitsToByteArrayLE(raw_value, byteArray, 16332, 12);

    raw_value = convertPhysicalToRaw(@CAN_PrivMain::RFL_Object::RXX_Object_Obj30.VyAyCoVnce, 0.01, 0.0);
    copyBitsToByteArrayLE(raw_value, byteArray, 16320, 12);

    raw_value = convertPhysicalToRaw(@CAN_PrivMain::RFL_Object::RXX_Object_Obj30.VyAxCoVnce, 0.01, 0.0);
    copyBitsToByteArrayLE(raw_value, byteArray, 16300, 12);

    raw_value = convertPhysicalToRaw(@CAN_PrivMain::RFL_Object::RXX_Object_Obj30.VxAyCoVnce, 0.01, 0.0);
    copyBitsToByteArrayLE(raw_value, byteArray, 16288, 12);

    raw_value = convertPhysicalToRaw(@CAN_PrivMain::RFL_Object::RXX_Object_Obj30.VxAxCoVnce, 0.01, 0.0);
    copyBitsToByteArrayLE(raw_value, byteArray, 16268, 12);

    raw_value = convertPhysicalToRaw(@CAN_PrivMain::RFL_Object::RXX_Object_Obj30.PyAyCoVnce, 0.01, 0.0);
    copyBitsToByteArrayLE(raw_value, byteArray, 16236, 12);

    raw_value = convertPhysicalToRaw(@CAN_PrivMain::RFL_Object::RXX_Object_Obj30.PyAxCoVnce, 0.01, 0.0);
    copyBitsToByteArrayLE(raw_value, byteArray, 16224, 12);

    raw_value = convertPhysicalToRaw(@CAN_PrivMain::RFL_Object::RXX_Object_Obj30.PxAyCoVnce, 0.01, 0.0);
    copyBitsToByteArrayLE(raw_value, byteArray, 16204, 12);

    raw_value = convertPhysicalToRaw(@CAN_PrivMain::RFL_Object::RXX_Object_Obj30.Age, 1.0, 0.0);
    copyBitsToByteArrayLE(raw_value, byteArray, 16352, 32);

    raw_value = convertPhysicalToRaw(@CAN_PrivMain::RFL_Object::RXX_Object_Obj30.ReferencePoint, 1.0, 0.0);
    copyBitsToByteArrayLE(raw_value, byteArray, 16184, 4);

    raw_value = convertPhysicalToRaw(@CAN_PrivMain::RFL_Object::RXX_Object_Obj30.PxVxCoVnce, 0.01, 0.0);
    copyBitsToByteArrayLE(raw_value, byteArray, 16128, 12);

    raw_value = convertPhysicalToRaw(@CAN_PrivMain::RFL_Object::RXX_Object_Obj30.PyVyCoVnce, 0.01, 0.0);
    copyBitsToByteArrayLE(raw_value, byteArray, 16172, 12);

    raw_value = convertPhysicalToRaw(@CAN_PrivMain::RFL_Object::RXX_Object_Obj30.MeasurementStatus, 1.0, 0.0);
    copyBitsToByteArrayLE(raw_value, byteArray, 16120, 3);

    raw_value = convertPhysicalToRaw(@CAN_PrivMain::RFL_Object::RXX_Object_Obj30.ProbClassType, 1.0, 0.0);
    copyBitsToByteArrayLE(raw_value, byteArray, 16123, 4);

    raw_value = convertPhysicalToRaw(@CAN_PrivMain::RFL_Object::RXX_Object_Obj30.PxPyCoVnce, 0.01, 0.0);
    copyBitsToByteArrayLE(raw_value, byteArray, 16108, 12);

    raw_value = convertPhysicalToRaw(@CAN_PrivMain::RFL_Object::RXX_Object_Obj30.PxVyCoVnce, 0.01, 0.0);
    copyBitsToByteArrayLE(raw_value, byteArray, 16140, 12);

    raw_value = convertPhysicalToRaw(@CAN_PrivMain::RFL_Object::RXX_Object_Obj30.FilterInformation, 1.0, 0.0);
    copyBitsToByteArrayLE(raw_value, byteArray, 16152, 8);

    raw_value = convertPhysicalToRaw(@CAN_PrivMain::RFL_Object::RXX_Object_Obj30.PyVxCoVnce, 0.01, 0.0);
    copyBitsToByteArrayLE(raw_value, byteArray, 16160, 12);
}


void RXX_Object_Obj29_write(byte byteArray[])
{
    qword raw_value;

    raw_value = convertPhysicalToRaw(@CAN_PrivMain::RFL_Object::RXX_Object_Obj29.ObjId, 1.0, 0.0);
    copyBitsToByteArrayLE(raw_value, byteArray, 15544, 7);

    raw_value = convertPhysicalToRaw(@CAN_PrivMain::RFL_Object::RXX_Object_Obj29.AxVnce, 0.01, 0.0);
    copyBitsToByteArrayLE(raw_value, byteArray, 15456, 12);

    raw_value = convertPhysicalToRaw(@CAN_PrivMain::RFL_Object::RXX_Object_Obj29.Vx, 0.0625, -128.0);
    copyBitsToByteArrayLE(raw_value, byteArray, 15532, 12);

    raw_value = convertPhysicalToRaw(@CAN_PrivMain::RFL_Object::RXX_Object_Obj29.AyVnce, 0.01, 0.0);
    copyBitsToByteArrayLE(raw_value, byteArray, 15520, 12);

    raw_value = convertPhysicalToRaw(@CAN_PrivMain::RFL_Object::RXX_Object_Obj29.Ay, 0.0625, -16.0);
    copyBitsToByteArrayLE(raw_value, byteArray, 15510, 9);

    raw_value = convertPhysicalToRaw(@CAN_PrivMain::RFL_Object::RXX_Object_Obj29.RCS, 0.2, -102.4);
    copyBitsToByteArrayLE(raw_value, byteArray, 15500, 10);

    raw_value = convertPhysicalToRaw(@CAN_PrivMain::RFL_Object::RXX_Object_Obj29.WidthVnce, 0.01, 0.0);
    copyBitsToByteArrayLE(raw_value, byteArray, 15488, 12);

    raw_value = convertPhysicalToRaw(@CAN_PrivMain::RFL_Object::RXX_Object_Obj29.Width, 0.125, 0.0);
    copyBitsToByteArrayLE(raw_value, byteArray, 15480, 7);

    raw_value = convertPhysicalToRaw(@CAN_PrivMain::RFL_Object::RXX_Object_Obj29.OrientationYawVnce, 0.0003, 0.0);
    copyBitsToByteArrayLE(raw_value, byteArray, 15468, 12);

    raw_value = convertPhysicalToRaw(@CAN_PrivMain::RFL_Object::RXX_Object_Obj29.PyVnce, 0.1, 0.0);
    copyBitsToByteArrayLE(raw_value, byteArray, 15404, 12);

    raw_value = convertPhysicalToRaw(@CAN_PrivMain::RFL_Object::RXX_Object_Obj29.OrientationYaw, 0.0175, -4.48);
    copyBitsToByteArrayLE(raw_value, byteArray, 15446, 9);

    raw_value = convertPhysicalToRaw(@CAN_PrivMain::RFL_Object::RXX_Object_Obj29.Ax, 0.03125, -16.0);
    copyBitsToByteArrayLE(raw_value, byteArray, 15436, 10);

    raw_value = convertPhysicalToRaw(@CAN_PrivMain::RFL_Object::RXX_Object_Obj29.LengthVnce, 0.01, 0.0);
    copyBitsToByteArrayLE(raw_value, byteArray, 15424, 12);

    raw_value = convertPhysicalToRaw(@CAN_PrivMain::RFL_Object::RXX_Object_Obj29.Length, 0.125, 0.0);
    copyBitsToByteArrayLE(raw_value, byteArray, 15416, 7);

    raw_value = convertPhysicalToRaw(@CAN_PrivMain::RFL_Object::RXX_Object_Obj29.Py, 0.0625, -128.0);
    copyBitsToByteArrayLE(raw_value, byteArray, 15392, 12);

    raw_value = convertPhysicalToRaw(@CAN_PrivMain::RFL_Object::RXX_Object_Obj29.PxVnce, 0.1, 0.0);
    copyBitsToByteArrayLE(raw_value, byteArray, 15380, 12);

    raw_value = convertPhysicalToRaw(@CAN_PrivMain::RFL_Object::RXX_Object_Obj29.Px, 0.0625, -512.0);
    copyBitsToByteArrayLE(raw_value, byteArray, 15366, 14);

    raw_value = convertPhysicalToRaw(@CAN_PrivMain::RFL_Object::RXX_Object_Obj29.ProbClassConfidence, 2.0, 0.0);
    copyBitsToByteArrayLE(raw_value, byteArray, 15360, 6);

    raw_value = convertPhysicalToRaw(@CAN_PrivMain::RFL_Object::RXX_Object_Obj29.MovingStatus, 1.0, 0.0);
    copyBitsToByteArrayLE(raw_value, byteArray, 15564, 2);

    raw_value = convertPhysicalToRaw(@CAN_PrivMain::RFL_Object::RXX_Object_Obj29.VxVnce, 0.01, 0.0);
    copyBitsToByteArrayLE(raw_value, byteArray, 15552, 12);

    raw_value = convertPhysicalToRaw(@CAN_PrivMain::RFL_Object::RXX_Object_Obj29.Vy, 0.125, -64.0);
    copyBitsToByteArrayLE(raw_value, byteArray, 15566, 10);

    raw_value = convertPhysicalToRaw(@CAN_PrivMain::RFL_Object::RXX_Object_Obj29.AxAyCoVnce, 0.01, 0.0);
    copyBitsToByteArrayLE(raw_value, byteArray, 15820, 12);

    raw_value = convertPhysicalToRaw(@CAN_PrivMain::RFL_Object::RXX_Object_Obj29.PxAxCoVnce, 0.01, 0.0);
    copyBitsToByteArrayLE(raw_value, byteArray, 15680, 12);

    raw_value = convertPhysicalToRaw(@CAN_PrivMain::RFL_Object::RXX_Object_Obj29.Age, 1.0, 0.0);
    copyBitsToByteArrayLE(raw_value, byteArray, 15840, 32);

    raw_value = convertPhysicalToRaw(@CAN_PrivMain::RFL_Object::RXX_Object_Obj29.ExistProb, 2.0, 0.0);
    copyBitsToByteArrayLE(raw_value, byteArray, 15576, 6);

    raw_value = convertPhysicalToRaw(@CAN_PrivMain::RFL_Object::RXX_Object_Obj29.VyAyCoVnce, 0.01, 0.0);
    copyBitsToByteArrayLE(raw_value, byteArray, 15808, 12);

    raw_value = convertPhysicalToRaw(@CAN_PrivMain::RFL_Object::RXX_Object_Obj29.VyAxCoVnce, 0.01, 0.0);
    copyBitsToByteArrayLE(raw_value, byteArray, 15788, 12);

    raw_value = convertPhysicalToRaw(@CAN_PrivMain::RFL_Object::RXX_Object_Obj29.VxAyCoVnce, 0.01, 0.0);
    copyBitsToByteArrayLE(raw_value, byteArray, 15776, 12);

    raw_value = convertPhysicalToRaw(@CAN_PrivMain::RFL_Object::RXX_Object_Obj29.VxAxCoVnce, 0.01, 0.0);
    copyBitsToByteArrayLE(raw_value, byteArray, 15756, 12);

    raw_value = convertPhysicalToRaw(@CAN_PrivMain::RFL_Object::RXX_Object_Obj29.PyAyCoVnce, 0.01, 0.0);
    copyBitsToByteArrayLE(raw_value, byteArray, 15724, 12);

    raw_value = convertPhysicalToRaw(@CAN_PrivMain::RFL_Object::RXX_Object_Obj29.PyAxCoVnce, 0.01, 0.0);
    copyBitsToByteArrayLE(raw_value, byteArray, 15712, 12);

    raw_value = convertPhysicalToRaw(@CAN_PrivMain::RFL_Object::RXX_Object_Obj29.PxAyCoVnce, 0.01, 0.0);
    copyBitsToByteArrayLE(raw_value, byteArray, 15692, 12);

    raw_value = convertPhysicalToRaw(@CAN_PrivMain::RFL_Object::RXX_Object_Obj29.VxVyCoVnce, 0.01, 0.0);
    copyBitsToByteArrayLE(raw_value, byteArray, 15744, 12);

    raw_value = convertPhysicalToRaw(@CAN_PrivMain::RFL_Object::RXX_Object_Obj29.ReferencePoint, 1.0, 0.0);
    copyBitsToByteArrayLE(raw_value, byteArray, 15672, 4);

    raw_value = convertPhysicalToRaw(@CAN_PrivMain::RFL_Object::RXX_Object_Obj29.PxVxCoVnce, 0.01, 0.0);
    copyBitsToByteArrayLE(raw_value, byteArray, 15616, 12);

    raw_value = convertPhysicalToRaw(@CAN_PrivMain::RFL_Object::RXX_Object_Obj29.PyVyCoVnce, 0.01, 0.0);
    copyBitsToByteArrayLE(raw_value, byteArray, 15660, 12);

    raw_value = convertPhysicalToRaw(@CAN_PrivMain::RFL_Object::RXX_Object_Obj29.PxPyCoVnce, 0.01, 0.0);
    copyBitsToByteArrayLE(raw_value, byteArray, 15596, 12);

    raw_value = convertPhysicalToRaw(@CAN_PrivMain::RFL_Object::RXX_Object_Obj29.MeasurementStatus, 1.0, 0.0);
    copyBitsToByteArrayLE(raw_value, byteArray, 15608, 3);

    raw_value = convertPhysicalToRaw(@CAN_PrivMain::RFL_Object::RXX_Object_Obj29.ProbClassType, 1.0, 0.0);
    copyBitsToByteArrayLE(raw_value, byteArray, 15611, 4);

    raw_value = convertPhysicalToRaw(@CAN_PrivMain::RFL_Object::RXX_Object_Obj29.VyVnce, 0.01, 0.0);
    copyBitsToByteArrayLE(raw_value, byteArray, 15584, 12);

    raw_value = convertPhysicalToRaw(@CAN_PrivMain::RFL_Object::RXX_Object_Obj29.PxVyCoVnce, 0.01, 0.0);
    copyBitsToByteArrayLE(raw_value, byteArray, 15628, 12);

    raw_value = convertPhysicalToRaw(@CAN_PrivMain::RFL_Object::RXX_Object_Obj29.FilterInformation, 1.0, 0.0);
    copyBitsToByteArrayLE(raw_value, byteArray, 15640, 8);

    raw_value = convertPhysicalToRaw(@CAN_PrivMain::RFL_Object::RXX_Object_Obj29.PyVxCoVnce, 0.01, 0.0);
    copyBitsToByteArrayLE(raw_value, byteArray, 15648, 12);
}


void RXX_Object_Obj28_write(byte byteArray[])
{
    qword raw_value;

    raw_value = convertPhysicalToRaw(@CAN_PrivMain::RFL_Object::RXX_Object_Obj28.AxVnce, 0.01, 0.0);
    copyBitsToByteArrayLE(raw_value, byteArray, 14944, 12);

    raw_value = convertPhysicalToRaw(@CAN_PrivMain::RFL_Object::RXX_Object_Obj28.VxVnce, 0.01, 0.0);
    copyBitsToByteArrayLE(raw_value, byteArray, 15040, 12);

    raw_value = convertPhysicalToRaw(@CAN_PrivMain::RFL_Object::RXX_Object_Obj28.ObjId, 1.0, 0.0);
    copyBitsToByteArrayLE(raw_value, byteArray, 15032, 7);

    raw_value = convertPhysicalToRaw(@CAN_PrivMain::RFL_Object::RXX_Object_Obj28.Vx, 0.0625, -128.0);
    copyBitsToByteArrayLE(raw_value, byteArray, 15020, 12);

    raw_value = convertPhysicalToRaw(@CAN_PrivMain::RFL_Object::RXX_Object_Obj28.AyVnce, 0.01, 0.0);
    copyBitsToByteArrayLE(raw_value, byteArray, 15008, 12);

    raw_value = convertPhysicalToRaw(@CAN_PrivMain::RFL_Object::RXX_Object_Obj28.Ay, 0.0625, -16.0);
    copyBitsToByteArrayLE(raw_value, byteArray, 14998, 9);

    raw_value = convertPhysicalToRaw(@CAN_PrivMain::RFL_Object::RXX_Object_Obj28.RCS, 0.2, -102.4);
    copyBitsToByteArrayLE(raw_value, byteArray, 14988, 10);

    raw_value = convertPhysicalToRaw(@CAN_PrivMain::RFL_Object::RXX_Object_Obj28.WidthVnce, 0.01, 0.0);
    copyBitsToByteArrayLE(raw_value, byteArray, 14976, 12);

    raw_value = convertPhysicalToRaw(@CAN_PrivMain::RFL_Object::RXX_Object_Obj28.Width, 0.125, 0.0);
    copyBitsToByteArrayLE(raw_value, byteArray, 14968, 7);

    raw_value = convertPhysicalToRaw(@CAN_PrivMain::RFL_Object::RXX_Object_Obj28.OrientationYawVnce, 0.0003, 0.0);
    copyBitsToByteArrayLE(raw_value, byteArray, 14956, 12);

    raw_value = convertPhysicalToRaw(@CAN_PrivMain::RFL_Object::RXX_Object_Obj28.Vy, 0.125, -64.0);
    copyBitsToByteArrayLE(raw_value, byteArray, 15054, 10);

    raw_value = convertPhysicalToRaw(@CAN_PrivMain::RFL_Object::RXX_Object_Obj28.OrientationYaw, 0.0175, -4.48);
    copyBitsToByteArrayLE(raw_value, byteArray, 14934, 9);

    raw_value = convertPhysicalToRaw(@CAN_PrivMain::RFL_Object::RXX_Object_Obj28.Ax, 0.03125, -16.0);
    copyBitsToByteArrayLE(raw_value, byteArray, 14924, 10);

    raw_value = convertPhysicalToRaw(@CAN_PrivMain::RFL_Object::RXX_Object_Obj28.LengthVnce, 0.01, 0.0);
    copyBitsToByteArrayLE(raw_value, byteArray, 14912, 12);

    raw_value = convertPhysicalToRaw(@CAN_PrivMain::RFL_Object::RXX_Object_Obj28.Length, 0.125, 0.0);
    copyBitsToByteArrayLE(raw_value, byteArray, 14904, 7);

    raw_value = convertPhysicalToRaw(@CAN_PrivMain::RFL_Object::RXX_Object_Obj28.PyVnce, 0.1, 0.0);
    copyBitsToByteArrayLE(raw_value, byteArray, 14892, 12);

    raw_value = convertPhysicalToRaw(@CAN_PrivMain::RFL_Object::RXX_Object_Obj28.Py, 0.0625, -128.0);
    copyBitsToByteArrayLE(raw_value, byteArray, 14880, 12);

    raw_value = convertPhysicalToRaw(@CAN_PrivMain::RFL_Object::RXX_Object_Obj28.PxVnce, 0.1, 0.0);
    copyBitsToByteArrayLE(raw_value, byteArray, 14868, 12);

    raw_value = convertPhysicalToRaw(@CAN_PrivMain::RFL_Object::RXX_Object_Obj28.Px, 0.0625, -512.0);
    copyBitsToByteArrayLE(raw_value, byteArray, 14854, 14);

    raw_value = convertPhysicalToRaw(@CAN_PrivMain::RFL_Object::RXX_Object_Obj28.ProbClassConfidence, 2.0, 0.0);
    copyBitsToByteArrayLE(raw_value, byteArray, 14848, 6);

    raw_value = convertPhysicalToRaw(@CAN_PrivMain::RFL_Object::RXX_Object_Obj28.MovingStatus, 1.0, 0.0);
    copyBitsToByteArrayLE(raw_value, byteArray, 15052, 2);

    raw_value = convertPhysicalToRaw(@CAN_PrivMain::RFL_Object::RXX_Object_Obj28.Age, 1.0, 0.0);
    copyBitsToByteArrayLE(raw_value, byteArray, 15328, 32);

    raw_value = convertPhysicalToRaw(@CAN_PrivMain::RFL_Object::RXX_Object_Obj28.ExistProb, 2.0, 0.0);
    copyBitsToByteArrayLE(raw_value, byteArray, 15064, 6);

    raw_value = convertPhysicalToRaw(@CAN_PrivMain::RFL_Object::RXX_Object_Obj28.PxAxCoVnce, 0.01, 0.0);
    copyBitsToByteArrayLE(raw_value, byteArray, 15168, 12);

    raw_value = convertPhysicalToRaw(@CAN_PrivMain::RFL_Object::RXX_Object_Obj28.VyVnce, 0.01, 0.0);
    copyBitsToByteArrayLE(raw_value, byteArray, 15072, 12);

    raw_value = convertPhysicalToRaw(@CAN_PrivMain::RFL_Object::RXX_Object_Obj28.VyAyCoVnce, 0.01, 0.0);
    copyBitsToByteArrayLE(raw_value, byteArray, 15296, 12);

    raw_value = convertPhysicalToRaw(@CAN_PrivMain::RFL_Object::RXX_Object_Obj28.VyAxCoVnce, 0.01, 0.0);
    copyBitsToByteArrayLE(raw_value, byteArray, 15276, 12);

    raw_value = convertPhysicalToRaw(@CAN_PrivMain::RFL_Object::RXX_Object_Obj28.VxAyCoVnce, 0.01, 0.0);
    copyBitsToByteArrayLE(raw_value, byteArray, 15264, 12);

    raw_value = convertPhysicalToRaw(@CAN_PrivMain::RFL_Object::RXX_Object_Obj28.VxAxCoVnce, 0.01, 0.0);
    copyBitsToByteArrayLE(raw_value, byteArray, 15244, 12);

    raw_value = convertPhysicalToRaw(@CAN_PrivMain::RFL_Object::RXX_Object_Obj28.VxVyCoVnce, 0.01, 0.0);
    copyBitsToByteArrayLE(raw_value, byteArray, 15232, 12);

    raw_value = convertPhysicalToRaw(@CAN_PrivMain::RFL_Object::RXX_Object_Obj28.PyAyCoVnce, 0.01, 0.0);
    copyBitsToByteArrayLE(raw_value, byteArray, 15212, 12);

    raw_value = convertPhysicalToRaw(@CAN_PrivMain::RFL_Object::RXX_Object_Obj28.PyAxCoVnce, 0.01, 0.0);
    copyBitsToByteArrayLE(raw_value, byteArray, 15200, 12);

    raw_value = convertPhysicalToRaw(@CAN_PrivMain::RFL_Object::RXX_Object_Obj28.PxAyCoVnce, 0.01, 0.0);
    copyBitsToByteArrayLE(raw_value, byteArray, 15180, 12);

    raw_value = convertPhysicalToRaw(@CAN_PrivMain::RFL_Object::RXX_Object_Obj28.AxAyCoVnce, 0.01, 0.0);
    copyBitsToByteArrayLE(raw_value, byteArray, 15308, 12);

    raw_value = convertPhysicalToRaw(@CAN_PrivMain::RFL_Object::RXX_Object_Obj28.ReferencePoint, 1.0, 0.0);
    copyBitsToByteArrayLE(raw_value, byteArray, 15160, 4);

    raw_value = convertPhysicalToRaw(@CAN_PrivMain::RFL_Object::RXX_Object_Obj28.PyVxCoVnce, 0.01, 0.0);
    copyBitsToByteArrayLE(raw_value, byteArray, 15136, 12);

    raw_value = convertPhysicalToRaw(@CAN_PrivMain::RFL_Object::RXX_Object_Obj28.FilterInformation, 1.0, 0.0);
    copyBitsToByteArrayLE(raw_value, byteArray, 15128, 8);

    raw_value = convertPhysicalToRaw(@CAN_PrivMain::RFL_Object::RXX_Object_Obj28.PxVyCoVnce, 0.01, 0.0);
    copyBitsToByteArrayLE(raw_value, byteArray, 15116, 12);

    raw_value = convertPhysicalToRaw(@CAN_PrivMain::RFL_Object::RXX_Object_Obj28.PxVxCoVnce, 0.01, 0.0);
    copyBitsToByteArrayLE(raw_value, byteArray, 15104, 12);

    raw_value = convertPhysicalToRaw(@CAN_PrivMain::RFL_Object::RXX_Object_Obj28.ProbClassType, 1.0, 0.0);
    copyBitsToByteArrayLE(raw_value, byteArray, 15099, 4);

    raw_value = convertPhysicalToRaw(@CAN_PrivMain::RFL_Object::RXX_Object_Obj28.MeasurementStatus, 1.0, 0.0);
    copyBitsToByteArrayLE(raw_value, byteArray, 15096, 3);

    raw_value = convertPhysicalToRaw(@CAN_PrivMain::RFL_Object::RXX_Object_Obj28.PxPyCoVnce, 0.01, 0.0);
    copyBitsToByteArrayLE(raw_value, byteArray, 15084, 12);

    raw_value = convertPhysicalToRaw(@CAN_PrivMain::RFL_Object::RXX_Object_Obj28.PyVyCoVnce, 0.01, 0.0);
    copyBitsToByteArrayLE(raw_value, byteArray, 15148, 12);
}


void RXX_Object_Obj27_write(byte byteArray[])
{
    qword raw_value;

    raw_value = convertPhysicalToRaw(@CAN_PrivMain::RFL_Object::RXX_Object_Obj27.Vy, 0.125, -64.0);
    copyBitsToByteArrayLE(raw_value, byteArray, 14542, 10);

    raw_value = convertPhysicalToRaw(@CAN_PrivMain::RFL_Object::RXX_Object_Obj27.WidthVnce, 0.01, 0.0);
    copyBitsToByteArrayLE(raw_value, byteArray, 14464, 12);

    raw_value = convertPhysicalToRaw(@CAN_PrivMain::RFL_Object::RXX_Object_Obj27.RCS, 0.2, -102.4);
    copyBitsToByteArrayLE(raw_value, byteArray, 14476, 10);

    raw_value = convertPhysicalToRaw(@CAN_PrivMain::RFL_Object::RXX_Object_Obj27.VxVnce, 0.01, 0.0);
    copyBitsToByteArrayLE(raw_value, byteArray, 14528, 12);

    raw_value = convertPhysicalToRaw(@CAN_PrivMain::RFL_Object::RXX_Object_Obj27.AyVnce, 0.01, 0.0);
    copyBitsToByteArrayLE(raw_value, byteArray, 14496, 12);

    raw_value = convertPhysicalToRaw(@CAN_PrivMain::RFL_Object::RXX_Object_Obj27.Vx, 0.0625, -128.0);
    copyBitsToByteArrayLE(raw_value, byteArray, 14508, 12);

    raw_value = convertPhysicalToRaw(@CAN_PrivMain::RFL_Object::RXX_Object_Obj27.ObjId, 1.0, 0.0);
    copyBitsToByteArrayLE(raw_value, byteArray, 14520, 7);

    raw_value = convertPhysicalToRaw(@CAN_PrivMain::RFL_Object::RXX_Object_Obj27.OrientationYawVnce, 0.0003, 0.0);
    copyBitsToByteArrayLE(raw_value, byteArray, 14444, 12);

    raw_value = convertPhysicalToRaw(@CAN_PrivMain::RFL_Object::RXX_Object_Obj27.Width, 0.125, 0.0);
    copyBitsToByteArrayLE(raw_value, byteArray, 14456, 7);

    raw_value = convertPhysicalToRaw(@CAN_PrivMain::RFL_Object::RXX_Object_Obj27.Length, 0.125, 0.0);
    copyBitsToByteArrayLE(raw_value, byteArray, 14392, 7);

    raw_value = convertPhysicalToRaw(@CAN_PrivMain::RFL_Object::RXX_Object_Obj27.AxVnce, 0.01, 0.0);
    copyBitsToByteArrayLE(raw_value, byteArray, 14432, 12);

    raw_value = convertPhysicalToRaw(@CAN_PrivMain::RFL_Object::RXX_Object_Obj27.OrientationYaw, 0.0175, -4.48);
    copyBitsToByteArrayLE(raw_value, byteArray, 14422, 9);

    raw_value = convertPhysicalToRaw(@CAN_PrivMain::RFL_Object::RXX_Object_Obj27.Ax, 0.03125, -16.0);
    copyBitsToByteArrayLE(raw_value, byteArray, 14412, 10);

    raw_value = convertPhysicalToRaw(@CAN_PrivMain::RFL_Object::RXX_Object_Obj27.LengthVnce, 0.01, 0.0);
    copyBitsToByteArrayLE(raw_value, byteArray, 14400, 12);

    raw_value = convertPhysicalToRaw(@CAN_PrivMain::RFL_Object::RXX_Object_Obj27.PyVnce, 0.1, 0.0);
    copyBitsToByteArrayLE(raw_value, byteArray, 14380, 12);

    raw_value = convertPhysicalToRaw(@CAN_PrivMain::RFL_Object::RXX_Object_Obj27.Py, 0.0625, -128.0);
    copyBitsToByteArrayLE(raw_value, byteArray, 14368, 12);

    raw_value = convertPhysicalToRaw(@CAN_PrivMain::RFL_Object::RXX_Object_Obj27.PxVnce, 0.1, 0.0);
    copyBitsToByteArrayLE(raw_value, byteArray, 14356, 12);

    raw_value = convertPhysicalToRaw(@CAN_PrivMain::RFL_Object::RXX_Object_Obj27.Px, 0.0625, -512.0);
    copyBitsToByteArrayLE(raw_value, byteArray, 14342, 14);

    raw_value = convertPhysicalToRaw(@CAN_PrivMain::RFL_Object::RXX_Object_Obj27.ProbClassConfidence, 2.0, 0.0);
    copyBitsToByteArrayLE(raw_value, byteArray, 14336, 6);

    raw_value = convertPhysicalToRaw(@CAN_PrivMain::RFL_Object::RXX_Object_Obj27.MovingStatus, 1.0, 0.0);
    copyBitsToByteArrayLE(raw_value, byteArray, 14540, 2);

    raw_value = convertPhysicalToRaw(@CAN_PrivMain::RFL_Object::RXX_Object_Obj27.Ay, 0.0625, -16.0);
    copyBitsToByteArrayLE(raw_value, byteArray, 14486, 9);

    raw_value = convertPhysicalToRaw(@CAN_PrivMain::RFL_Object::RXX_Object_Obj27.ExistProb, 2.0, 0.0);
    copyBitsToByteArrayLE(raw_value, byteArray, 14552, 6);

    raw_value = convertPhysicalToRaw(@CAN_PrivMain::RFL_Object::RXX_Object_Obj27.PxAyCoVnce, 0.01, 0.0);
    copyBitsToByteArrayLE(raw_value, byteArray, 14668, 12);

    raw_value = convertPhysicalToRaw(@CAN_PrivMain::RFL_Object::RXX_Object_Obj27.VyVnce, 0.01, 0.0);
    copyBitsToByteArrayLE(raw_value, byteArray, 14560, 12);

    raw_value = convertPhysicalToRaw(@CAN_PrivMain::RFL_Object::RXX_Object_Obj27.AxAyCoVnce, 0.01, 0.0);
    copyBitsToByteArrayLE(raw_value, byteArray, 14796, 12);

    raw_value = convertPhysicalToRaw(@CAN_PrivMain::RFL_Object::RXX_Object_Obj27.VyAyCoVnce, 0.01, 0.0);
    copyBitsToByteArrayLE(raw_value, byteArray, 14784, 12);

    raw_value = convertPhysicalToRaw(@CAN_PrivMain::RFL_Object::RXX_Object_Obj27.VyAxCoVnce, 0.01, 0.0);
    copyBitsToByteArrayLE(raw_value, byteArray, 14764, 12);

    raw_value = convertPhysicalToRaw(@CAN_PrivMain::RFL_Object::RXX_Object_Obj27.VxAyCoVnce, 0.01, 0.0);
    copyBitsToByteArrayLE(raw_value, byteArray, 14752, 12);

    raw_value = convertPhysicalToRaw(@CAN_PrivMain::RFL_Object::RXX_Object_Obj27.VxAxCoVnce, 0.01, 0.0);
    copyBitsToByteArrayLE(raw_value, byteArray, 14732, 12);

    raw_value = convertPhysicalToRaw(@CAN_PrivMain::RFL_Object::RXX_Object_Obj27.VxVyCoVnce, 0.01, 0.0);
    copyBitsToByteArrayLE(raw_value, byteArray, 14720, 12);

    raw_value = convertPhysicalToRaw(@CAN_PrivMain::RFL_Object::RXX_Object_Obj27.PyAyCoVnce, 0.01, 0.0);
    copyBitsToByteArrayLE(raw_value, byteArray, 14700, 12);

    raw_value = convertPhysicalToRaw(@CAN_PrivMain::RFL_Object::RXX_Object_Obj27.PyAxCoVnce, 0.01, 0.0);
    copyBitsToByteArrayLE(raw_value, byteArray, 14688, 12);

    raw_value = convertPhysicalToRaw(@CAN_PrivMain::RFL_Object::RXX_Object_Obj27.Age, 1.0, 0.0);
    copyBitsToByteArrayLE(raw_value, byteArray, 14816, 32);

    raw_value = convertPhysicalToRaw(@CAN_PrivMain::RFL_Object::RXX_Object_Obj27.PxAxCoVnce, 0.01, 0.0);
    copyBitsToByteArrayLE(raw_value, byteArray, 14656, 12);

    raw_value = convertPhysicalToRaw(@CAN_PrivMain::RFL_Object::RXX_Object_Obj27.PyVyCoVnce, 0.01, 0.0);
    copyBitsToByteArrayLE(raw_value, byteArray, 14636, 12);

    raw_value = convertPhysicalToRaw(@CAN_PrivMain::RFL_Object::RXX_Object_Obj27.PyVxCoVnce, 0.01, 0.0);
    copyBitsToByteArrayLE(raw_value, byteArray, 14624, 12);

    raw_value = convertPhysicalToRaw(@CAN_PrivMain::RFL_Object::RXX_Object_Obj27.FilterInformation, 1.0, 0.0);
    copyBitsToByteArrayLE(raw_value, byteArray, 14616, 8);

    raw_value = convertPhysicalToRaw(@CAN_PrivMain::RFL_Object::RXX_Object_Obj27.PxVyCoVnce, 0.01, 0.0);
    copyBitsToByteArrayLE(raw_value, byteArray, 14604, 12);

    raw_value = convertPhysicalToRaw(@CAN_PrivMain::RFL_Object::RXX_Object_Obj27.PxVxCoVnce, 0.01, 0.0);
    copyBitsToByteArrayLE(raw_value, byteArray, 14592, 12);

    raw_value = convertPhysicalToRaw(@CAN_PrivMain::RFL_Object::RXX_Object_Obj27.ProbClassType, 1.0, 0.0);
    copyBitsToByteArrayLE(raw_value, byteArray, 14587, 4);

    raw_value = convertPhysicalToRaw(@CAN_PrivMain::RFL_Object::RXX_Object_Obj27.MeasurementStatus, 1.0, 0.0);
    copyBitsToByteArrayLE(raw_value, byteArray, 14584, 3);

    raw_value = convertPhysicalToRaw(@CAN_PrivMain::RFL_Object::RXX_Object_Obj27.PxPyCoVnce, 0.01, 0.0);
    copyBitsToByteArrayLE(raw_value, byteArray, 14572, 12);

    raw_value = convertPhysicalToRaw(@CAN_PrivMain::RFL_Object::RXX_Object_Obj27.ReferencePoint, 1.0, 0.0);
    copyBitsToByteArrayLE(raw_value, byteArray, 14648, 4);
}


void RXX_Object_Obj26_write(byte byteArray[])
{
    qword raw_value;

    raw_value = convertPhysicalToRaw(@CAN_PrivMain::RFL_Object::RXX_Object_Obj26.RCS, 0.2, -102.4);
    copyBitsToByteArrayLE(raw_value, byteArray, 13964, 10);

    raw_value = convertPhysicalToRaw(@CAN_PrivMain::RFL_Object::RXX_Object_Obj26.Width, 0.125, 0.0);
    copyBitsToByteArrayLE(raw_value, byteArray, 13944, 7);

    raw_value = convertPhysicalToRaw(@CAN_PrivMain::RFL_Object::RXX_Object_Obj26.WidthVnce, 0.01, 0.0);
    copyBitsToByteArrayLE(raw_value, byteArray, 13952, 12);

    raw_value = convertPhysicalToRaw(@CAN_PrivMain::RFL_Object::RXX_Object_Obj26.ObjId, 1.0, 0.0);
    copyBitsToByteArrayLE(raw_value, byteArray, 14008, 7);

    raw_value = convertPhysicalToRaw(@CAN_PrivMain::RFL_Object::RXX_Object_Obj26.Ay, 0.0625, -16.0);
    copyBitsToByteArrayLE(raw_value, byteArray, 13974, 9);

    raw_value = convertPhysicalToRaw(@CAN_PrivMain::RFL_Object::RXX_Object_Obj26.AyVnce, 0.01, 0.0);
    copyBitsToByteArrayLE(raw_value, byteArray, 13984, 12);

    raw_value = convertPhysicalToRaw(@CAN_PrivMain::RFL_Object::RXX_Object_Obj26.Vx, 0.0625, -128.0);
    copyBitsToByteArrayLE(raw_value, byteArray, 13996, 12);

    raw_value = convertPhysicalToRaw(@CAN_PrivMain::RFL_Object::RXX_Object_Obj26.AxVnce, 0.01, 0.0);
    copyBitsToByteArrayLE(raw_value, byteArray, 13920, 12);

    raw_value = convertPhysicalToRaw(@CAN_PrivMain::RFL_Object::RXX_Object_Obj26.OrientationYawVnce, 0.0003, 0.0);
    copyBitsToByteArrayLE(raw_value, byteArray, 13932, 12);

    raw_value = convertPhysicalToRaw(@CAN_PrivMain::RFL_Object::RXX_Object_Obj26.PyVnce, 0.1, 0.0);
    copyBitsToByteArrayLE(raw_value, byteArray, 13868, 12);

    raw_value = convertPhysicalToRaw(@CAN_PrivMain::RFL_Object::RXX_Object_Obj26.OrientationYaw, 0.0175, -4.48);
    copyBitsToByteArrayLE(raw_value, byteArray, 13910, 9);

    raw_value = convertPhysicalToRaw(@CAN_PrivMain::RFL_Object::RXX_Object_Obj26.Ax, 0.03125, -16.0);
    copyBitsToByteArrayLE(raw_value, byteArray, 13900, 10);

    raw_value = convertPhysicalToRaw(@CAN_PrivMain::RFL_Object::RXX_Object_Obj26.LengthVnce, 0.01, 0.0);
    copyBitsToByteArrayLE(raw_value, byteArray, 13888, 12);

    raw_value = convertPhysicalToRaw(@CAN_PrivMain::RFL_Object::RXX_Object_Obj26.Length, 0.125, 0.0);
    copyBitsToByteArrayLE(raw_value, byteArray, 13880, 7);

    raw_value = convertPhysicalToRaw(@CAN_PrivMain::RFL_Object::RXX_Object_Obj26.Py, 0.0625, -128.0);
    copyBitsToByteArrayLE(raw_value, byteArray, 13856, 12);

    raw_value = convertPhysicalToRaw(@CAN_PrivMain::RFL_Object::RXX_Object_Obj26.PxVnce, 0.1, 0.0);
    copyBitsToByteArrayLE(raw_value, byteArray, 13844, 12);

    raw_value = convertPhysicalToRaw(@CAN_PrivMain::RFL_Object::RXX_Object_Obj26.Px, 0.0625, -512.0);
    copyBitsToByteArrayLE(raw_value, byteArray, 13830, 14);

    raw_value = convertPhysicalToRaw(@CAN_PrivMain::RFL_Object::RXX_Object_Obj26.ProbClassConfidence, 2.0, 0.0);
    copyBitsToByteArrayLE(raw_value, byteArray, 13824, 6);

    raw_value = convertPhysicalToRaw(@CAN_PrivMain::RFL_Object::RXX_Object_Obj26.MovingStatus, 1.0, 0.0);
    copyBitsToByteArrayLE(raw_value, byteArray, 14028, 2);

    raw_value = convertPhysicalToRaw(@CAN_PrivMain::RFL_Object::RXX_Object_Obj26.VxVnce, 0.01, 0.0);
    copyBitsToByteArrayLE(raw_value, byteArray, 14016, 12);

    raw_value = convertPhysicalToRaw(@CAN_PrivMain::RFL_Object::RXX_Object_Obj26.Vy, 0.125, -64.0);
    copyBitsToByteArrayLE(raw_value, byteArray, 14030, 10);

    raw_value = convertPhysicalToRaw(@CAN_PrivMain::RFL_Object::RXX_Object_Obj26.VxVyCoVnce, 0.01, 0.0);
    copyBitsToByteArrayLE(raw_value, byteArray, 14208, 12);

    raw_value = convertPhysicalToRaw(@CAN_PrivMain::RFL_Object::RXX_Object_Obj26.ReferencePoint, 1.0, 0.0);
    copyBitsToByteArrayLE(raw_value, byteArray, 14136, 4);

    raw_value = convertPhysicalToRaw(@CAN_PrivMain::RFL_Object::RXX_Object_Obj26.Age, 1.0, 0.0);
    copyBitsToByteArrayLE(raw_value, byteArray, 14304, 32);

    raw_value = convertPhysicalToRaw(@CAN_PrivMain::RFL_Object::RXX_Object_Obj26.ExistProb, 2.0, 0.0);
    copyBitsToByteArrayLE(raw_value, byteArray, 14040, 6);

    raw_value = convertPhysicalToRaw(@CAN_PrivMain::RFL_Object::RXX_Object_Obj26.VyAyCoVnce, 0.01, 0.0);
    copyBitsToByteArrayLE(raw_value, byteArray, 14272, 12);

    raw_value = convertPhysicalToRaw(@CAN_PrivMain::RFL_Object::RXX_Object_Obj26.VyAxCoVnce, 0.01, 0.0);
    copyBitsToByteArrayLE(raw_value, byteArray, 14252, 12);

    raw_value = convertPhysicalToRaw(@CAN_PrivMain::RFL_Object::RXX_Object_Obj26.VxAyCoVnce, 0.01, 0.0);
    copyBitsToByteArrayLE(raw_value, byteArray, 14240, 12);

    raw_value = convertPhysicalToRaw(@CAN_PrivMain::RFL_Object::RXX_Object_Obj26.VxAxCoVnce, 0.01, 0.0);
    copyBitsToByteArrayLE(raw_value, byteArray, 14220, 12);

    raw_value = convertPhysicalToRaw(@CAN_PrivMain::RFL_Object::RXX_Object_Obj26.PyAyCoVnce, 0.01, 0.0);
    copyBitsToByteArrayLE(raw_value, byteArray, 14188, 12);

    raw_value = convertPhysicalToRaw(@CAN_PrivMain::RFL_Object::RXX_Object_Obj26.PyAxCoVnce, 0.01, 0.0);
    copyBitsToByteArrayLE(raw_value, byteArray, 14176, 12);

    raw_value = convertPhysicalToRaw(@CAN_PrivMain::RFL_Object::RXX_Object_Obj26.PxAxCoVnce, 0.01, 0.0);
    copyBitsToByteArrayLE(raw_value, byteArray, 14144, 12);

    raw_value = convertPhysicalToRaw(@CAN_PrivMain::RFL_Object::RXX_Object_Obj26.PxAyCoVnce, 0.01, 0.0);
    copyBitsToByteArrayLE(raw_value, byteArray, 14156, 12);

    raw_value = convertPhysicalToRaw(@CAN_PrivMain::RFL_Object::RXX_Object_Obj26.PyVyCoVnce, 0.01, 0.0);
    copyBitsToByteArrayLE(raw_value, byteArray, 14124, 12);

    raw_value = convertPhysicalToRaw(@CAN_PrivMain::RFL_Object::RXX_Object_Obj26.PyVxCoVnce, 0.01, 0.0);
    copyBitsToByteArrayLE(raw_value, byteArray, 14112, 12);

    raw_value = convertPhysicalToRaw(@CAN_PrivMain::RFL_Object::RXX_Object_Obj26.FilterInformation, 1.0, 0.0);
    copyBitsToByteArrayLE(raw_value, byteArray, 14104, 8);

    raw_value = convertPhysicalToRaw(@CAN_PrivMain::RFL_Object::RXX_Object_Obj26.PxVyCoVnce, 0.01, 0.0);
    copyBitsToByteArrayLE(raw_value, byteArray, 14092, 12);

    raw_value = convertPhysicalToRaw(@CAN_PrivMain::RFL_Object::RXX_Object_Obj26.PxVxCoVnce, 0.01, 0.0);
    copyBitsToByteArrayLE(raw_value, byteArray, 14080, 12);

    raw_value = convertPhysicalToRaw(@CAN_PrivMain::RFL_Object::RXX_Object_Obj26.ProbClassType, 1.0, 0.0);
    copyBitsToByteArrayLE(raw_value, byteArray, 14075, 4);

    raw_value = convertPhysicalToRaw(@CAN_PrivMain::RFL_Object::RXX_Object_Obj26.MeasurementStatus, 1.0, 0.0);
    copyBitsToByteArrayLE(raw_value, byteArray, 14072, 3);

    raw_value = convertPhysicalToRaw(@CAN_PrivMain::RFL_Object::RXX_Object_Obj26.PxPyCoVnce, 0.01, 0.0);
    copyBitsToByteArrayLE(raw_value, byteArray, 14060, 12);

    raw_value = convertPhysicalToRaw(@CAN_PrivMain::RFL_Object::RXX_Object_Obj26.VyVnce, 0.01, 0.0);
    copyBitsToByteArrayLE(raw_value, byteArray, 14048, 12);

    raw_value = convertPhysicalToRaw(@CAN_PrivMain::RFL_Object::RXX_Object_Obj26.AxAyCoVnce, 0.01, 0.0);
    copyBitsToByteArrayLE(raw_value, byteArray, 14284, 12);
}


void RXX_Object_Obj25_write(byte byteArray[])
{
    qword raw_value;

    raw_value = convertPhysicalToRaw(@CAN_PrivMain::RFL_Object::RXX_Object_Obj25.AyVnce, 0.01, 0.0);
    copyBitsToByteArrayLE(raw_value, byteArray, 13472, 12);

    raw_value = convertPhysicalToRaw(@CAN_PrivMain::RFL_Object::RXX_Object_Obj25.WidthVnce, 0.01, 0.0);
    copyBitsToByteArrayLE(raw_value, byteArray, 13440, 12);

    raw_value = convertPhysicalToRaw(@CAN_PrivMain::RFL_Object::RXX_Object_Obj25.RCS, 0.2, -102.4);
    copyBitsToByteArrayLE(raw_value, byteArray, 13452, 10);

    raw_value = convertPhysicalToRaw(@CAN_PrivMain::RFL_Object::RXX_Object_Obj25.Ay, 0.0625, -16.0);
    copyBitsToByteArrayLE(raw_value, byteArray, 13462, 9);

    raw_value = convertPhysicalToRaw(@CAN_PrivMain::RFL_Object::RXX_Object_Obj25.Vy, 0.125, -64.0);
    copyBitsToByteArrayLE(raw_value, byteArray, 13518, 10);

    raw_value = convertPhysicalToRaw(@CAN_PrivMain::RFL_Object::RXX_Object_Obj25.Vx, 0.0625, -128.0);
    copyBitsToByteArrayLE(raw_value, byteArray, 13484, 12);

    raw_value = convertPhysicalToRaw(@CAN_PrivMain::RFL_Object::RXX_Object_Obj25.ObjId, 1.0, 0.0);
    copyBitsToByteArrayLE(raw_value, byteArray, 13496, 7);

    raw_value = convertPhysicalToRaw(@CAN_PrivMain::RFL_Object::RXX_Object_Obj25.VxVnce, 0.01, 0.0);
    copyBitsToByteArrayLE(raw_value, byteArray, 13504, 12);

    raw_value = convertPhysicalToRaw(@CAN_PrivMain::RFL_Object::RXX_Object_Obj25.OrientationYawVnce, 0.0003, 0.0);
    copyBitsToByteArrayLE(raw_value, byteArray, 13420, 12);

    raw_value = convertPhysicalToRaw(@CAN_PrivMain::RFL_Object::RXX_Object_Obj25.Width, 0.125, 0.0);
    copyBitsToByteArrayLE(raw_value, byteArray, 13432, 7);

    raw_value = convertPhysicalToRaw(@CAN_PrivMain::RFL_Object::RXX_Object_Obj25.ProbClassConfidence, 2.0, 0.0);
    copyBitsToByteArrayLE(raw_value, byteArray, 13312, 6);

    raw_value = convertPhysicalToRaw(@CAN_PrivMain::RFL_Object::RXX_Object_Obj25.AxVnce, 0.01, 0.0);
    copyBitsToByteArrayLE(raw_value, byteArray, 13408, 12);

    raw_value = convertPhysicalToRaw(@CAN_PrivMain::RFL_Object::RXX_Object_Obj25.OrientationYaw, 0.0175, -4.48);
    copyBitsToByteArrayLE(raw_value, byteArray, 13398, 9);

    raw_value = convertPhysicalToRaw(@CAN_PrivMain::RFL_Object::RXX_Object_Obj25.Ax, 0.03125, -16.0);
    copyBitsToByteArrayLE(raw_value, byteArray, 13388, 10);

    raw_value = convertPhysicalToRaw(@CAN_PrivMain::RFL_Object::RXX_Object_Obj25.LengthVnce, 0.01, 0.0);
    copyBitsToByteArrayLE(raw_value, byteArray, 13376, 12);

    raw_value = convertPhysicalToRaw(@CAN_PrivMain::RFL_Object::RXX_Object_Obj25.Length, 0.125, 0.0);
    copyBitsToByteArrayLE(raw_value, byteArray, 13368, 7);

    raw_value = convertPhysicalToRaw(@CAN_PrivMain::RFL_Object::RXX_Object_Obj25.PyVnce, 0.1, 0.0);
    copyBitsToByteArrayLE(raw_value, byteArray, 13356, 12);

    raw_value = convertPhysicalToRaw(@CAN_PrivMain::RFL_Object::RXX_Object_Obj25.Py, 0.0625, -128.0);
    copyBitsToByteArrayLE(raw_value, byteArray, 13344, 12);

    raw_value = convertPhysicalToRaw(@CAN_PrivMain::RFL_Object::RXX_Object_Obj25.PxVnce, 0.1, 0.0);
    copyBitsToByteArrayLE(raw_value, byteArray, 13332, 12);

    raw_value = convertPhysicalToRaw(@CAN_PrivMain::RFL_Object::RXX_Object_Obj25.Px, 0.0625, -512.0);
    copyBitsToByteArrayLE(raw_value, byteArray, 13318, 14);

    raw_value = convertPhysicalToRaw(@CAN_PrivMain::RFL_Object::RXX_Object_Obj25.MovingStatus, 1.0, 0.0);
    copyBitsToByteArrayLE(raw_value, byteArray, 13516, 2);

    raw_value = convertPhysicalToRaw(@CAN_PrivMain::RFL_Object::RXX_Object_Obj25.VxVyCoVnce, 0.01, 0.0);
    copyBitsToByteArrayLE(raw_value, byteArray, 13696, 12);

    raw_value = convertPhysicalToRaw(@CAN_PrivMain::RFL_Object::RXX_Object_Obj25.ExistProb, 2.0, 0.0);
    copyBitsToByteArrayLE(raw_value, byteArray, 13528, 6);

    raw_value = convertPhysicalToRaw(@CAN_PrivMain::RFL_Object::RXX_Object_Obj25.PxAxCoVnce, 0.01, 0.0);
    copyBitsToByteArrayLE(raw_value, byteArray, 13632, 12);

    raw_value = convertPhysicalToRaw(@CAN_PrivMain::RFL_Object::RXX_Object_Obj25.VyVnce, 0.01, 0.0);
    copyBitsToByteArrayLE(raw_value, byteArray, 13536, 12);

    raw_value = convertPhysicalToRaw(@CAN_PrivMain::RFL_Object::RXX_Object_Obj25.Age, 1.0, 0.0);
    copyBitsToByteArrayLE(raw_value, byteArray, 13792, 32);

    raw_value = convertPhysicalToRaw(@CAN_PrivMain::RFL_Object::RXX_Object_Obj25.AxAyCoVnce, 0.01, 0.0);
    copyBitsToByteArrayLE(raw_value, byteArray, 13772, 12);

    raw_value = convertPhysicalToRaw(@CAN_PrivMain::RFL_Object::RXX_Object_Obj25.VyAxCoVnce, 0.01, 0.0);
    copyBitsToByteArrayLE(raw_value, byteArray, 13740, 12);

    raw_value = convertPhysicalToRaw(@CAN_PrivMain::RFL_Object::RXX_Object_Obj25.VxAyCoVnce, 0.01, 0.0);
    copyBitsToByteArrayLE(raw_value, byteArray, 13728, 12);

    raw_value = convertPhysicalToRaw(@CAN_PrivMain::RFL_Object::RXX_Object_Obj25.VxAxCoVnce, 0.01, 0.0);
    copyBitsToByteArrayLE(raw_value, byteArray, 13708, 12);

    raw_value = convertPhysicalToRaw(@CAN_PrivMain::RFL_Object::RXX_Object_Obj25.PyAyCoVnce, 0.01, 0.0);
    copyBitsToByteArrayLE(raw_value, byteArray, 13676, 12);

    raw_value = convertPhysicalToRaw(@CAN_PrivMain::RFL_Object::RXX_Object_Obj25.PyAxCoVnce, 0.01, 0.0);
    copyBitsToByteArrayLE(raw_value, byteArray, 13664, 12);

    raw_value = convertPhysicalToRaw(@CAN_PrivMain::RFL_Object::RXX_Object_Obj25.PxAyCoVnce, 0.01, 0.0);
    copyBitsToByteArrayLE(raw_value, byteArray, 13644, 12);

    raw_value = convertPhysicalToRaw(@CAN_PrivMain::RFL_Object::RXX_Object_Obj25.VyAyCoVnce, 0.01, 0.0);
    copyBitsToByteArrayLE(raw_value, byteArray, 13760, 12);

    raw_value = convertPhysicalToRaw(@CAN_PrivMain::RFL_Object::RXX_Object_Obj25.ReferencePoint, 1.0, 0.0);
    copyBitsToByteArrayLE(raw_value, byteArray, 13624, 4);

    raw_value = convertPhysicalToRaw(@CAN_PrivMain::RFL_Object::RXX_Object_Obj25.PyVxCoVnce, 0.01, 0.0);
    copyBitsToByteArrayLE(raw_value, byteArray, 13600, 12);

    raw_value = convertPhysicalToRaw(@CAN_PrivMain::RFL_Object::RXX_Object_Obj25.FilterInformation, 1.0, 0.0);
    copyBitsToByteArrayLE(raw_value, byteArray, 13592, 8);

    raw_value = convertPhysicalToRaw(@CAN_PrivMain::RFL_Object::RXX_Object_Obj25.PxVyCoVnce, 0.01, 0.0);
    copyBitsToByteArrayLE(raw_value, byteArray, 13580, 12);

    raw_value = convertPhysicalToRaw(@CAN_PrivMain::RFL_Object::RXX_Object_Obj25.PxVxCoVnce, 0.01, 0.0);
    copyBitsToByteArrayLE(raw_value, byteArray, 13568, 12);

    raw_value = convertPhysicalToRaw(@CAN_PrivMain::RFL_Object::RXX_Object_Obj25.ProbClassType, 1.0, 0.0);
    copyBitsToByteArrayLE(raw_value, byteArray, 13563, 4);

    raw_value = convertPhysicalToRaw(@CAN_PrivMain::RFL_Object::RXX_Object_Obj25.MeasurementStatus, 1.0, 0.0);
    copyBitsToByteArrayLE(raw_value, byteArray, 13560, 3);

    raw_value = convertPhysicalToRaw(@CAN_PrivMain::RFL_Object::RXX_Object_Obj25.PyVyCoVnce, 0.01, 0.0);
    copyBitsToByteArrayLE(raw_value, byteArray, 13612, 12);

    raw_value = convertPhysicalToRaw(@CAN_PrivMain::RFL_Object::RXX_Object_Obj25.PxPyCoVnce, 0.01, 0.0);
    copyBitsToByteArrayLE(raw_value, byteArray, 13548, 12);
}


void RXX_Object_Obj24_write(byte byteArray[])
{
    qword raw_value;

    raw_value = convertPhysicalToRaw(@CAN_PrivMain::RFL_Object::RXX_Object_Obj24.VxVnce, 0.01, 0.0);
    copyBitsToByteArrayLE(raw_value, byteArray, 12992, 12);

    raw_value = convertPhysicalToRaw(@CAN_PrivMain::RFL_Object::RXX_Object_Obj24.MeasurementStatus, 1.0, 0.0);
    copyBitsToByteArrayLE(raw_value, byteArray, 13048, 3);

    raw_value = convertPhysicalToRaw(@CAN_PrivMain::RFL_Object::RXX_Object_Obj24.PxPyCoVnce, 0.01, 0.0);
    copyBitsToByteArrayLE(raw_value, byteArray, 13036, 12);

    raw_value = convertPhysicalToRaw(@CAN_PrivMain::RFL_Object::RXX_Object_Obj24.VyVnce, 0.01, 0.0);
    copyBitsToByteArrayLE(raw_value, byteArray, 13024, 12);

    raw_value = convertPhysicalToRaw(@CAN_PrivMain::RFL_Object::RXX_Object_Obj24.ExistProb, 2.0, 0.0);
    copyBitsToByteArrayLE(raw_value, byteArray, 13016, 6);

    raw_value = convertPhysicalToRaw(@CAN_PrivMain::RFL_Object::RXX_Object_Obj24.Vy, 0.125, -64.0);
    copyBitsToByteArrayLE(raw_value, byteArray, 13006, 10);

    raw_value = convertPhysicalToRaw(@CAN_PrivMain::RFL_Object::RXX_Object_Obj24.MovingStatus, 1.0, 0.0);
    copyBitsToByteArrayLE(raw_value, byteArray, 13004, 2);

    raw_value = convertPhysicalToRaw(@CAN_PrivMain::RFL_Object::RXX_Object_Obj24.AyVnce, 0.01, 0.0);
    copyBitsToByteArrayLE(raw_value, byteArray, 12960, 12);

    raw_value = convertPhysicalToRaw(@CAN_PrivMain::RFL_Object::RXX_Object_Obj24.ObjId, 1.0, 0.0);
    copyBitsToByteArrayLE(raw_value, byteArray, 12984, 7);

    raw_value = convertPhysicalToRaw(@CAN_PrivMain::RFL_Object::RXX_Object_Obj24.Vx, 0.0625, -128.0);
    copyBitsToByteArrayLE(raw_value, byteArray, 12972, 12);

    raw_value = convertPhysicalToRaw(@CAN_PrivMain::RFL_Object::RXX_Object_Obj24.Ay, 0.0625, -16.0);
    copyBitsToByteArrayLE(raw_value, byteArray, 12950, 9);

    raw_value = convertPhysicalToRaw(@CAN_PrivMain::RFL_Object::RXX_Object_Obj24.RCS, 0.2, -102.4);
    copyBitsToByteArrayLE(raw_value, byteArray, 12940, 10);

    raw_value = convertPhysicalToRaw(@CAN_PrivMain::RFL_Object::RXX_Object_Obj24.OrientationYawVnce, 0.0003, 0.0);
    copyBitsToByteArrayLE(raw_value, byteArray, 12908, 12);

    raw_value = convertPhysicalToRaw(@CAN_PrivMain::RFL_Object::RXX_Object_Obj24.PxVxCoVnce, 0.01, 0.0);
    copyBitsToByteArrayLE(raw_value, byteArray, 13056, 12);

    raw_value = convertPhysicalToRaw(@CAN_PrivMain::RFL_Object::RXX_Object_Obj24.ProbClassType, 1.0, 0.0);
    copyBitsToByteArrayLE(raw_value, byteArray, 13051, 4);

    raw_value = convertPhysicalToRaw(@CAN_PrivMain::RFL_Object::RXX_Object_Obj24.VxAxCoVnce, 0.01, 0.0);
    copyBitsToByteArrayLE(raw_value, byteArray, 13196, 12);

    raw_value = convertPhysicalToRaw(@CAN_PrivMain::RFL_Object::RXX_Object_Obj24.PxVyCoVnce, 0.01, 0.0);
    copyBitsToByteArrayLE(raw_value, byteArray, 13068, 12);

    raw_value = convertPhysicalToRaw(@CAN_PrivMain::RFL_Object::RXX_Object_Obj24.FilterInformation, 1.0, 0.0);
    copyBitsToByteArrayLE(raw_value, byteArray, 13080, 8);

    raw_value = convertPhysicalToRaw(@CAN_PrivMain::RFL_Object::RXX_Object_Obj24.PyVxCoVnce, 0.01, 0.0);
    copyBitsToByteArrayLE(raw_value, byteArray, 13088, 12);

    raw_value = convertPhysicalToRaw(@CAN_PrivMain::RFL_Object::RXX_Object_Obj24.PyVyCoVnce, 0.01, 0.0);
    copyBitsToByteArrayLE(raw_value, byteArray, 13100, 12);

    raw_value = convertPhysicalToRaw(@CAN_PrivMain::RFL_Object::RXX_Object_Obj24.ReferencePoint, 1.0, 0.0);
    copyBitsToByteArrayLE(raw_value, byteArray, 13112, 4);

    raw_value = convertPhysicalToRaw(@CAN_PrivMain::RFL_Object::RXX_Object_Obj24.PxAxCoVnce, 0.01, 0.0);
    copyBitsToByteArrayLE(raw_value, byteArray, 13120, 12);

    raw_value = convertPhysicalToRaw(@CAN_PrivMain::RFL_Object::RXX_Object_Obj24.PxAyCoVnce, 0.01, 0.0);
    copyBitsToByteArrayLE(raw_value, byteArray, 13132, 12);

    raw_value = convertPhysicalToRaw(@CAN_PrivMain::RFL_Object::RXX_Object_Obj24.PyAxCoVnce, 0.01, 0.0);
    copyBitsToByteArrayLE(raw_value, byteArray, 13152, 12);

    raw_value = convertPhysicalToRaw(@CAN_PrivMain::RFL_Object::RXX_Object_Obj24.PyAyCoVnce, 0.01, 0.0);
    copyBitsToByteArrayLE(raw_value, byteArray, 13164, 12);

    raw_value = convertPhysicalToRaw(@CAN_PrivMain::RFL_Object::RXX_Object_Obj24.VxVyCoVnce, 0.01, 0.0);
    copyBitsToByteArrayLE(raw_value, byteArray, 13184, 12);

    raw_value = convertPhysicalToRaw(@CAN_PrivMain::RFL_Object::RXX_Object_Obj24.VxAyCoVnce, 0.01, 0.0);
    copyBitsToByteArrayLE(raw_value, byteArray, 13216, 12);

    raw_value = convertPhysicalToRaw(@CAN_PrivMain::RFL_Object::RXX_Object_Obj24.VyAxCoVnce, 0.01, 0.0);
    copyBitsToByteArrayLE(raw_value, byteArray, 13228, 12);

    raw_value = convertPhysicalToRaw(@CAN_PrivMain::RFL_Object::RXX_Object_Obj24.VyAyCoVnce, 0.01, 0.0);
    copyBitsToByteArrayLE(raw_value, byteArray, 13248, 12);

    raw_value = convertPhysicalToRaw(@CAN_PrivMain::RFL_Object::RXX_Object_Obj24.AxAyCoVnce, 0.01, 0.0);
    copyBitsToByteArrayLE(raw_value, byteArray, 13260, 12);

    raw_value = convertPhysicalToRaw(@CAN_PrivMain::RFL_Object::RXX_Object_Obj24.Age, 1.0, 0.0);
    copyBitsToByteArrayLE(raw_value, byteArray, 13280, 32);

    raw_value = convertPhysicalToRaw(@CAN_PrivMain::RFL_Object::RXX_Object_Obj24.Width, 0.125, 0.0);
    copyBitsToByteArrayLE(raw_value, byteArray, 12920, 7);

    raw_value = convertPhysicalToRaw(@CAN_PrivMain::RFL_Object::RXX_Object_Obj24.WidthVnce, 0.01, 0.0);
    copyBitsToByteArrayLE(raw_value, byteArray, 12928, 12);

    raw_value = convertPhysicalToRaw(@CAN_PrivMain::RFL_Object::RXX_Object_Obj24.AxVnce, 0.01, 0.0);
    copyBitsToByteArrayLE(raw_value, byteArray, 12896, 12);

    raw_value = convertPhysicalToRaw(@CAN_PrivMain::RFL_Object::RXX_Object_Obj24.Py, 0.0625, -128.0);
    copyBitsToByteArrayLE(raw_value, byteArray, 12832, 12);

    raw_value = convertPhysicalToRaw(@CAN_PrivMain::RFL_Object::RXX_Object_Obj24.ProbClassConfidence, 2.0, 0.0);
    copyBitsToByteArrayLE(raw_value, byteArray, 12800, 6);

    raw_value = convertPhysicalToRaw(@CAN_PrivMain::RFL_Object::RXX_Object_Obj24.Px, 0.0625, -512.0);
    copyBitsToByteArrayLE(raw_value, byteArray, 12806, 14);

    raw_value = convertPhysicalToRaw(@CAN_PrivMain::RFL_Object::RXX_Object_Obj24.PxVnce, 0.1, 0.0);
    copyBitsToByteArrayLE(raw_value, byteArray, 12820, 12);

    raw_value = convertPhysicalToRaw(@CAN_PrivMain::RFL_Object::RXX_Object_Obj24.OrientationYaw, 0.0175, -4.48);
    copyBitsToByteArrayLE(raw_value, byteArray, 12886, 9);

    raw_value = convertPhysicalToRaw(@CAN_PrivMain::RFL_Object::RXX_Object_Obj24.PyVnce, 0.1, 0.0);
    copyBitsToByteArrayLE(raw_value, byteArray, 12844, 12);

    raw_value = convertPhysicalToRaw(@CAN_PrivMain::RFL_Object::RXX_Object_Obj24.Length, 0.125, 0.0);
    copyBitsToByteArrayLE(raw_value, byteArray, 12856, 7);

    raw_value = convertPhysicalToRaw(@CAN_PrivMain::RFL_Object::RXX_Object_Obj24.LengthVnce, 0.01, 0.0);
    copyBitsToByteArrayLE(raw_value, byteArray, 12864, 12);

    raw_value = convertPhysicalToRaw(@CAN_PrivMain::RFL_Object::RXX_Object_Obj24.Ax, 0.03125, -16.0);
    copyBitsToByteArrayLE(raw_value, byteArray, 12876, 10);
}


void RXX_Object_Obj23_write(byte byteArray[])
{
    qword raw_value;

    raw_value = convertPhysicalToRaw(@CAN_PrivMain::RFL_Object::RXX_Object_Obj23.OrientationYawVnce, 0.0003, 0.0);
    copyBitsToByteArrayLE(raw_value, byteArray, 12396, 12);

    raw_value = convertPhysicalToRaw(@CAN_PrivMain::RFL_Object::RXX_Object_Obj23.MovingStatus, 1.0, 0.0);
    copyBitsToByteArrayLE(raw_value, byteArray, 12492, 2);

    raw_value = convertPhysicalToRaw(@CAN_PrivMain::RFL_Object::RXX_Object_Obj23.VxVnce, 0.01, 0.0);
    copyBitsToByteArrayLE(raw_value, byteArray, 12480, 12);

    raw_value = convertPhysicalToRaw(@CAN_PrivMain::RFL_Object::RXX_Object_Obj23.ObjId, 1.0, 0.0);
    copyBitsToByteArrayLE(raw_value, byteArray, 12472, 7);

    raw_value = convertPhysicalToRaw(@CAN_PrivMain::RFL_Object::RXX_Object_Obj23.Vx, 0.0625, -128.0);
    copyBitsToByteArrayLE(raw_value, byteArray, 12460, 12);

    raw_value = convertPhysicalToRaw(@CAN_PrivMain::RFL_Object::RXX_Object_Obj23.AyVnce, 0.01, 0.0);
    copyBitsToByteArrayLE(raw_value, byteArray, 12448, 12);

    raw_value = convertPhysicalToRaw(@CAN_PrivMain::RFL_Object::RXX_Object_Obj23.Ay, 0.0625, -16.0);
    copyBitsToByteArrayLE(raw_value, byteArray, 12438, 9);

    raw_value = convertPhysicalToRaw(@CAN_PrivMain::RFL_Object::RXX_Object_Obj23.RCS, 0.2, -102.4);
    copyBitsToByteArrayLE(raw_value, byteArray, 12428, 10);

    raw_value = convertPhysicalToRaw(@CAN_PrivMain::RFL_Object::RXX_Object_Obj23.WidthVnce, 0.01, 0.0);
    copyBitsToByteArrayLE(raw_value, byteArray, 12416, 12);

    raw_value = convertPhysicalToRaw(@CAN_PrivMain::RFL_Object::RXX_Object_Obj23.Width, 0.125, 0.0);
    copyBitsToByteArrayLE(raw_value, byteArray, 12408, 7);

    raw_value = convertPhysicalToRaw(@CAN_PrivMain::RFL_Object::RXX_Object_Obj23.Length, 0.125, 0.0);
    copyBitsToByteArrayLE(raw_value, byteArray, 12344, 7);

    raw_value = convertPhysicalToRaw(@CAN_PrivMain::RFL_Object::RXX_Object_Obj23.AxVnce, 0.01, 0.0);
    copyBitsToByteArrayLE(raw_value, byteArray, 12384, 12);

    raw_value = convertPhysicalToRaw(@CAN_PrivMain::RFL_Object::RXX_Object_Obj23.OrientationYaw, 0.0175, -4.48);
    copyBitsToByteArrayLE(raw_value, byteArray, 12374, 9);

    raw_value = convertPhysicalToRaw(@CAN_PrivMain::RFL_Object::RXX_Object_Obj23.Ax, 0.03125, -16.0);
    copyBitsToByteArrayLE(raw_value, byteArray, 12364, 10);

    raw_value = convertPhysicalToRaw(@CAN_PrivMain::RFL_Object::RXX_Object_Obj23.LengthVnce, 0.01, 0.0);
    copyBitsToByteArrayLE(raw_value, byteArray, 12352, 12);

    raw_value = convertPhysicalToRaw(@CAN_PrivMain::RFL_Object::RXX_Object_Obj23.ExistProb, 2.0, 0.0);
    copyBitsToByteArrayLE(raw_value, byteArray, 12504, 6);

    raw_value = convertPhysicalToRaw(@CAN_PrivMain::RFL_Object::RXX_Object_Obj23.PyVnce, 0.1, 0.0);
    copyBitsToByteArrayLE(raw_value, byteArray, 12332, 12);

    raw_value = convertPhysicalToRaw(@CAN_PrivMain::RFL_Object::RXX_Object_Obj23.Py, 0.0625, -128.0);
    copyBitsToByteArrayLE(raw_value, byteArray, 12320, 12);

    raw_value = convertPhysicalToRaw(@CAN_PrivMain::RFL_Object::RXX_Object_Obj23.PxVnce, 0.1, 0.0);
    copyBitsToByteArrayLE(raw_value, byteArray, 12308, 12);

    raw_value = convertPhysicalToRaw(@CAN_PrivMain::RFL_Object::RXX_Object_Obj23.Px, 0.0625, -512.0);
    copyBitsToByteArrayLE(raw_value, byteArray, 12294, 14);

    raw_value = convertPhysicalToRaw(@CAN_PrivMain::RFL_Object::RXX_Object_Obj23.Vy, 0.125, -64.0);
    copyBitsToByteArrayLE(raw_value, byteArray, 12494, 10);

    raw_value = convertPhysicalToRaw(@CAN_PrivMain::RFL_Object::RXX_Object_Obj23.ProbClassConfidence, 2.0, 0.0);
    copyBitsToByteArrayLE(raw_value, byteArray, 12288, 6);

    raw_value = convertPhysicalToRaw(@CAN_PrivMain::RFL_Object::RXX_Object_Obj23.VyVnce, 0.01, 0.0);
    copyBitsToByteArrayLE(raw_value, byteArray, 12512, 12);

    raw_value = convertPhysicalToRaw(@CAN_PrivMain::RFL_Object::RXX_Object_Obj23.PxAyCoVnce, 0.01, 0.0);
    copyBitsToByteArrayLE(raw_value, byteArray, 12620, 12);

    raw_value = convertPhysicalToRaw(@CAN_PrivMain::RFL_Object::RXX_Object_Obj23.Age, 1.0, 0.0);
    copyBitsToByteArrayLE(raw_value, byteArray, 12768, 32);

    raw_value = convertPhysicalToRaw(@CAN_PrivMain::RFL_Object::RXX_Object_Obj23.AxAyCoVnce, 0.01, 0.0);
    copyBitsToByteArrayLE(raw_value, byteArray, 12748, 12);

    raw_value = convertPhysicalToRaw(@CAN_PrivMain::RFL_Object::RXX_Object_Obj23.VyAyCoVnce, 0.01, 0.0);
    copyBitsToByteArrayLE(raw_value, byteArray, 12736, 12);

    raw_value = convertPhysicalToRaw(@CAN_PrivMain::RFL_Object::RXX_Object_Obj23.VyAxCoVnce, 0.01, 0.0);
    copyBitsToByteArrayLE(raw_value, byteArray, 12716, 12);

    raw_value = convertPhysicalToRaw(@CAN_PrivMain::RFL_Object::RXX_Object_Obj23.VxAyCoVnce, 0.01, 0.0);
    copyBitsToByteArrayLE(raw_value, byteArray, 12704, 12);

    raw_value = convertPhysicalToRaw(@CAN_PrivMain::RFL_Object::RXX_Object_Obj23.VxAxCoVnce, 0.01, 0.0);
    copyBitsToByteArrayLE(raw_value, byteArray, 12684, 12);

    raw_value = convertPhysicalToRaw(@CAN_PrivMain::RFL_Object::RXX_Object_Obj23.VxVyCoVnce, 0.01, 0.0);
    copyBitsToByteArrayLE(raw_value, byteArray, 12672, 12);

    raw_value = convertPhysicalToRaw(@CAN_PrivMain::RFL_Object::RXX_Object_Obj23.PyAyCoVnce, 0.01, 0.0);
    copyBitsToByteArrayLE(raw_value, byteArray, 12652, 12);

    raw_value = convertPhysicalToRaw(@CAN_PrivMain::RFL_Object::RXX_Object_Obj23.PyAxCoVnce, 0.01, 0.0);
    copyBitsToByteArrayLE(raw_value, byteArray, 12640, 12);

    raw_value = convertPhysicalToRaw(@CAN_PrivMain::RFL_Object::RXX_Object_Obj23.PxPyCoVnce, 0.01, 0.0);
    copyBitsToByteArrayLE(raw_value, byteArray, 12524, 12);

    raw_value = convertPhysicalToRaw(@CAN_PrivMain::RFL_Object::RXX_Object_Obj23.PxAxCoVnce, 0.01, 0.0);
    copyBitsToByteArrayLE(raw_value, byteArray, 12608, 12);

    raw_value = convertPhysicalToRaw(@CAN_PrivMain::RFL_Object::RXX_Object_Obj23.PxVyCoVnce, 0.01, 0.0);
    copyBitsToByteArrayLE(raw_value, byteArray, 12556, 12);

    raw_value = convertPhysicalToRaw(@CAN_PrivMain::RFL_Object::RXX_Object_Obj23.ReferencePoint, 1.0, 0.0);
    copyBitsToByteArrayLE(raw_value, byteArray, 12600, 4);

    raw_value = convertPhysicalToRaw(@CAN_PrivMain::RFL_Object::RXX_Object_Obj23.ProbClassType, 1.0, 0.0);
    copyBitsToByteArrayLE(raw_value, byteArray, 12539, 4);

    raw_value = convertPhysicalToRaw(@CAN_PrivMain::RFL_Object::RXX_Object_Obj23.PxVxCoVnce, 0.01, 0.0);
    copyBitsToByteArrayLE(raw_value, byteArray, 12544, 12);

    raw_value = convertPhysicalToRaw(@CAN_PrivMain::RFL_Object::RXX_Object_Obj23.MeasurementStatus, 1.0, 0.0);
    copyBitsToByteArrayLE(raw_value, byteArray, 12536, 3);

    raw_value = convertPhysicalToRaw(@CAN_PrivMain::RFL_Object::RXX_Object_Obj23.FilterInformation, 1.0, 0.0);
    copyBitsToByteArrayLE(raw_value, byteArray, 12568, 8);

    raw_value = convertPhysicalToRaw(@CAN_PrivMain::RFL_Object::RXX_Object_Obj23.PyVxCoVnce, 0.01, 0.0);
    copyBitsToByteArrayLE(raw_value, byteArray, 12576, 12);

    raw_value = convertPhysicalToRaw(@CAN_PrivMain::RFL_Object::RXX_Object_Obj23.PyVyCoVnce, 0.01, 0.0);
    copyBitsToByteArrayLE(raw_value, byteArray, 12588, 12);
}


void RXX_Object_Obj22_write(byte byteArray[])
{
    qword raw_value;

    raw_value = convertPhysicalToRaw(@CAN_PrivMain::RFL_Object::RXX_Object_Obj22.ObjId, 1.0, 0.0);
    copyBitsToByteArrayLE(raw_value, byteArray, 11960, 7);

    raw_value = convertPhysicalToRaw(@CAN_PrivMain::RFL_Object::RXX_Object_Obj22.AxVnce, 0.01, 0.0);
    copyBitsToByteArrayLE(raw_value, byteArray, 11872, 12);

    raw_value = convertPhysicalToRaw(@CAN_PrivMain::RFL_Object::RXX_Object_Obj22.Vx, 0.0625, -128.0);
    copyBitsToByteArrayLE(raw_value, byteArray, 11948, 12);

    raw_value = convertPhysicalToRaw(@CAN_PrivMain::RFL_Object::RXX_Object_Obj22.AyVnce, 0.01, 0.0);
    copyBitsToByteArrayLE(raw_value, byteArray, 11936, 12);

    raw_value = convertPhysicalToRaw(@CAN_PrivMain::RFL_Object::RXX_Object_Obj22.Ay, 0.0625, -16.0);
    copyBitsToByteArrayLE(raw_value, byteArray, 11926, 9);

    raw_value = convertPhysicalToRaw(@CAN_PrivMain::RFL_Object::RXX_Object_Obj22.RCS, 0.2, -102.4);
    copyBitsToByteArrayLE(raw_value, byteArray, 11916, 10);

    raw_value = convertPhysicalToRaw(@CAN_PrivMain::RFL_Object::RXX_Object_Obj22.WidthVnce, 0.01, 0.0);
    copyBitsToByteArrayLE(raw_value, byteArray, 11904, 12);

    raw_value = convertPhysicalToRaw(@CAN_PrivMain::RFL_Object::RXX_Object_Obj22.Width, 0.125, 0.0);
    copyBitsToByteArrayLE(raw_value, byteArray, 11896, 7);

    raw_value = convertPhysicalToRaw(@CAN_PrivMain::RFL_Object::RXX_Object_Obj22.OrientationYawVnce, 0.0003, 0.0);
    copyBitsToByteArrayLE(raw_value, byteArray, 11884, 12);

    raw_value = convertPhysicalToRaw(@CAN_PrivMain::RFL_Object::RXX_Object_Obj22.PyVnce, 0.1, 0.0);
    copyBitsToByteArrayLE(raw_value, byteArray, 11820, 12);

    raw_value = convertPhysicalToRaw(@CAN_PrivMain::RFL_Object::RXX_Object_Obj22.OrientationYaw, 0.0175, -4.48);
    copyBitsToByteArrayLE(raw_value, byteArray, 11862, 9);

    raw_value = convertPhysicalToRaw(@CAN_PrivMain::RFL_Object::RXX_Object_Obj22.Ax, 0.03125, -16.0);
    copyBitsToByteArrayLE(raw_value, byteArray, 11852, 10);

    raw_value = convertPhysicalToRaw(@CAN_PrivMain::RFL_Object::RXX_Object_Obj22.LengthVnce, 0.01, 0.0);
    copyBitsToByteArrayLE(raw_value, byteArray, 11840, 12);

    raw_value = convertPhysicalToRaw(@CAN_PrivMain::RFL_Object::RXX_Object_Obj22.Length, 0.125, 0.0);
    copyBitsToByteArrayLE(raw_value, byteArray, 11832, 7);

    raw_value = convertPhysicalToRaw(@CAN_PrivMain::RFL_Object::RXX_Object_Obj22.Py, 0.0625, -128.0);
    copyBitsToByteArrayLE(raw_value, byteArray, 11808, 12);

    raw_value = convertPhysicalToRaw(@CAN_PrivMain::RFL_Object::RXX_Object_Obj22.PxVnce, 0.1, 0.0);
    copyBitsToByteArrayLE(raw_value, byteArray, 11796, 12);

    raw_value = convertPhysicalToRaw(@CAN_PrivMain::RFL_Object::RXX_Object_Obj22.Px, 0.0625, -512.0);
    copyBitsToByteArrayLE(raw_value, byteArray, 11782, 14);

    raw_value = convertPhysicalToRaw(@CAN_PrivMain::RFL_Object::RXX_Object_Obj22.ProbClassConfidence, 2.0, 0.0);
    copyBitsToByteArrayLE(raw_value, byteArray, 11776, 6);

    raw_value = convertPhysicalToRaw(@CAN_PrivMain::RFL_Object::RXX_Object_Obj22.MovingStatus, 1.0, 0.0);
    copyBitsToByteArrayLE(raw_value, byteArray, 11980, 2);

    raw_value = convertPhysicalToRaw(@CAN_PrivMain::RFL_Object::RXX_Object_Obj22.VxVnce, 0.01, 0.0);
    copyBitsToByteArrayLE(raw_value, byteArray, 11968, 12);

    raw_value = convertPhysicalToRaw(@CAN_PrivMain::RFL_Object::RXX_Object_Obj22.Vy, 0.125, -64.0);
    copyBitsToByteArrayLE(raw_value, byteArray, 11982, 10);

    raw_value = convertPhysicalToRaw(@CAN_PrivMain::RFL_Object::RXX_Object_Obj22.AxAyCoVnce, 0.01, 0.0);
    copyBitsToByteArrayLE(raw_value, byteArray, 12236, 12);

    raw_value = convertPhysicalToRaw(@CAN_PrivMain::RFL_Object::RXX_Object_Obj22.PxAxCoVnce, 0.01, 0.0);
    copyBitsToByteArrayLE(raw_value, byteArray, 12096, 12);

    raw_value = convertPhysicalToRaw(@CAN_PrivMain::RFL_Object::RXX_Object_Obj22.Age, 1.0, 0.0);
    copyBitsToByteArrayLE(raw_value, byteArray, 12256, 32);

    raw_value = convertPhysicalToRaw(@CAN_PrivMain::RFL_Object::RXX_Object_Obj22.ExistProb, 2.0, 0.0);
    copyBitsToByteArrayLE(raw_value, byteArray, 11992, 6);

    raw_value = convertPhysicalToRaw(@CAN_PrivMain::RFL_Object::RXX_Object_Obj22.VyAyCoVnce, 0.01, 0.0);
    copyBitsToByteArrayLE(raw_value, byteArray, 12224, 12);

    raw_value = convertPhysicalToRaw(@CAN_PrivMain::RFL_Object::RXX_Object_Obj22.VyAxCoVnce, 0.01, 0.0);
    copyBitsToByteArrayLE(raw_value, byteArray, 12204, 12);

    raw_value = convertPhysicalToRaw(@CAN_PrivMain::RFL_Object::RXX_Object_Obj22.VxAyCoVnce, 0.01, 0.0);
    copyBitsToByteArrayLE(raw_value, byteArray, 12192, 12);

    raw_value = convertPhysicalToRaw(@CAN_PrivMain::RFL_Object::RXX_Object_Obj22.VxAxCoVnce, 0.01, 0.0);
    copyBitsToByteArrayLE(raw_value, byteArray, 12172, 12);

    raw_value = convertPhysicalToRaw(@CAN_PrivMain::RFL_Object::RXX_Object_Obj22.PyAyCoVnce, 0.01, 0.0);
    copyBitsToByteArrayLE(raw_value, byteArray, 12140, 12);

    raw_value = convertPhysicalToRaw(@CAN_PrivMain::RFL_Object::RXX_Object_Obj22.PyAxCoVnce, 0.01, 0.0);
    copyBitsToByteArrayLE(raw_value, byteArray, 12128, 12);

    raw_value = convertPhysicalToRaw(@CAN_PrivMain::RFL_Object::RXX_Object_Obj22.PxAyCoVnce, 0.01, 0.0);
    copyBitsToByteArrayLE(raw_value, byteArray, 12108, 12);

    raw_value = convertPhysicalToRaw(@CAN_PrivMain::RFL_Object::RXX_Object_Obj22.VxVyCoVnce, 0.01, 0.0);
    copyBitsToByteArrayLE(raw_value, byteArray, 12160, 12);

    raw_value = convertPhysicalToRaw(@CAN_PrivMain::RFL_Object::RXX_Object_Obj22.ReferencePoint, 1.0, 0.0);
    copyBitsToByteArrayLE(raw_value, byteArray, 12088, 4);

    raw_value = convertPhysicalToRaw(@CAN_PrivMain::RFL_Object::RXX_Object_Obj22.PxVxCoVnce, 0.01, 0.0);
    copyBitsToByteArrayLE(raw_value, byteArray, 12032, 12);

    raw_value = convertPhysicalToRaw(@CAN_PrivMain::RFL_Object::RXX_Object_Obj22.PyVyCoVnce, 0.01, 0.0);
    copyBitsToByteArrayLE(raw_value, byteArray, 12076, 12);

    raw_value = convertPhysicalToRaw(@CAN_PrivMain::RFL_Object::RXX_Object_Obj22.PxPyCoVnce, 0.01, 0.0);
    copyBitsToByteArrayLE(raw_value, byteArray, 12012, 12);

    raw_value = convertPhysicalToRaw(@CAN_PrivMain::RFL_Object::RXX_Object_Obj22.MeasurementStatus, 1.0, 0.0);
    copyBitsToByteArrayLE(raw_value, byteArray, 12024, 3);

    raw_value = convertPhysicalToRaw(@CAN_PrivMain::RFL_Object::RXX_Object_Obj22.ProbClassType, 1.0, 0.0);
    copyBitsToByteArrayLE(raw_value, byteArray, 12027, 4);

    raw_value = convertPhysicalToRaw(@CAN_PrivMain::RFL_Object::RXX_Object_Obj22.VyVnce, 0.01, 0.0);
    copyBitsToByteArrayLE(raw_value, byteArray, 12000, 12);

    raw_value = convertPhysicalToRaw(@CAN_PrivMain::RFL_Object::RXX_Object_Obj22.PxVyCoVnce, 0.01, 0.0);
    copyBitsToByteArrayLE(raw_value, byteArray, 12044, 12);

    raw_value = convertPhysicalToRaw(@CAN_PrivMain::RFL_Object::RXX_Object_Obj22.FilterInformation, 1.0, 0.0);
    copyBitsToByteArrayLE(raw_value, byteArray, 12056, 8);

    raw_value = convertPhysicalToRaw(@CAN_PrivMain::RFL_Object::RXX_Object_Obj22.PyVxCoVnce, 0.01, 0.0);
    copyBitsToByteArrayLE(raw_value, byteArray, 12064, 12);
}


void RXX_Object_Obj21_write(byte byteArray[])
{
    qword raw_value;

    raw_value = convertPhysicalToRaw(@CAN_PrivMain::RFL_Object::RXX_Object_Obj21.AxVnce, 0.01, 0.0);
    copyBitsToByteArrayLE(raw_value, byteArray, 11360, 12);

    raw_value = convertPhysicalToRaw(@CAN_PrivMain::RFL_Object::RXX_Object_Obj21.VxVnce, 0.01, 0.0);
    copyBitsToByteArrayLE(raw_value, byteArray, 11456, 12);

    raw_value = convertPhysicalToRaw(@CAN_PrivMain::RFL_Object::RXX_Object_Obj21.ObjId, 1.0, 0.0);
    copyBitsToByteArrayLE(raw_value, byteArray, 11448, 7);

    raw_value = convertPhysicalToRaw(@CAN_PrivMain::RFL_Object::RXX_Object_Obj21.Vx, 0.0625, -128.0);
    copyBitsToByteArrayLE(raw_value, byteArray, 11436, 12);

    raw_value = convertPhysicalToRaw(@CAN_PrivMain::RFL_Object::RXX_Object_Obj21.AyVnce, 0.01, 0.0);
    copyBitsToByteArrayLE(raw_value, byteArray, 11424, 12);

    raw_value = convertPhysicalToRaw(@CAN_PrivMain::RFL_Object::RXX_Object_Obj21.Ay, 0.0625, -16.0);
    copyBitsToByteArrayLE(raw_value, byteArray, 11414, 9);

    raw_value = convertPhysicalToRaw(@CAN_PrivMain::RFL_Object::RXX_Object_Obj21.RCS, 0.2, -102.4);
    copyBitsToByteArrayLE(raw_value, byteArray, 11404, 10);

    raw_value = convertPhysicalToRaw(@CAN_PrivMain::RFL_Object::RXX_Object_Obj21.WidthVnce, 0.01, 0.0);
    copyBitsToByteArrayLE(raw_value, byteArray, 11392, 12);

    raw_value = convertPhysicalToRaw(@CAN_PrivMain::RFL_Object::RXX_Object_Obj21.Width, 0.125, 0.0);
    copyBitsToByteArrayLE(raw_value, byteArray, 11384, 7);

    raw_value = convertPhysicalToRaw(@CAN_PrivMain::RFL_Object::RXX_Object_Obj21.OrientationYawVnce, 0.0003, 0.0);
    copyBitsToByteArrayLE(raw_value, byteArray, 11372, 12);

    raw_value = convertPhysicalToRaw(@CAN_PrivMain::RFL_Object::RXX_Object_Obj21.Vy, 0.125, -64.0);
    copyBitsToByteArrayLE(raw_value, byteArray, 11470, 10);

    raw_value = convertPhysicalToRaw(@CAN_PrivMain::RFL_Object::RXX_Object_Obj21.OrientationYaw, 0.0175, -4.48);
    copyBitsToByteArrayLE(raw_value, byteArray, 11350, 9);

    raw_value = convertPhysicalToRaw(@CAN_PrivMain::RFL_Object::RXX_Object_Obj21.Ax, 0.03125, -16.0);
    copyBitsToByteArrayLE(raw_value, byteArray, 11340, 10);

    raw_value = convertPhysicalToRaw(@CAN_PrivMain::RFL_Object::RXX_Object_Obj21.LengthVnce, 0.01, 0.0);
    copyBitsToByteArrayLE(raw_value, byteArray, 11328, 12);

    raw_value = convertPhysicalToRaw(@CAN_PrivMain::RFL_Object::RXX_Object_Obj21.Length, 0.125, 0.0);
    copyBitsToByteArrayLE(raw_value, byteArray, 11320, 7);

    raw_value = convertPhysicalToRaw(@CAN_PrivMain::RFL_Object::RXX_Object_Obj21.PyVnce, 0.1, 0.0);
    copyBitsToByteArrayLE(raw_value, byteArray, 11308, 12);

    raw_value = convertPhysicalToRaw(@CAN_PrivMain::RFL_Object::RXX_Object_Obj21.Py, 0.0625, -128.0);
    copyBitsToByteArrayLE(raw_value, byteArray, 11296, 12);

    raw_value = convertPhysicalToRaw(@CAN_PrivMain::RFL_Object::RXX_Object_Obj21.PxVnce, 0.1, 0.0);
    copyBitsToByteArrayLE(raw_value, byteArray, 11284, 12);

    raw_value = convertPhysicalToRaw(@CAN_PrivMain::RFL_Object::RXX_Object_Obj21.Px, 0.0625, -512.0);
    copyBitsToByteArrayLE(raw_value, byteArray, 11270, 14);

    raw_value = convertPhysicalToRaw(@CAN_PrivMain::RFL_Object::RXX_Object_Obj21.ProbClassConfidence, 2.0, 0.0);
    copyBitsToByteArrayLE(raw_value, byteArray, 11264, 6);

    raw_value = convertPhysicalToRaw(@CAN_PrivMain::RFL_Object::RXX_Object_Obj21.MovingStatus, 1.0, 0.0);
    copyBitsToByteArrayLE(raw_value, byteArray, 11468, 2);

    raw_value = convertPhysicalToRaw(@CAN_PrivMain::RFL_Object::RXX_Object_Obj21.Age, 1.0, 0.0);
    copyBitsToByteArrayLE(raw_value, byteArray, 11744, 32);

    raw_value = convertPhysicalToRaw(@CAN_PrivMain::RFL_Object::RXX_Object_Obj21.ExistProb, 2.0, 0.0);
    copyBitsToByteArrayLE(raw_value, byteArray, 11480, 6);

    raw_value = convertPhysicalToRaw(@CAN_PrivMain::RFL_Object::RXX_Object_Obj21.PxAxCoVnce, 0.01, 0.0);
    copyBitsToByteArrayLE(raw_value, byteArray, 11584, 12);

    raw_value = convertPhysicalToRaw(@CAN_PrivMain::RFL_Object::RXX_Object_Obj21.VyVnce, 0.01, 0.0);
    copyBitsToByteArrayLE(raw_value, byteArray, 11488, 12);

    raw_value = convertPhysicalToRaw(@CAN_PrivMain::RFL_Object::RXX_Object_Obj21.VyAyCoVnce, 0.01, 0.0);
    copyBitsToByteArrayLE(raw_value, byteArray, 11712, 12);

    raw_value = convertPhysicalToRaw(@CAN_PrivMain::RFL_Object::RXX_Object_Obj21.VyAxCoVnce, 0.01, 0.0);
    copyBitsToByteArrayLE(raw_value, byteArray, 11692, 12);

    raw_value = convertPhysicalToRaw(@CAN_PrivMain::RFL_Object::RXX_Object_Obj21.VxAyCoVnce, 0.01, 0.0);
    copyBitsToByteArrayLE(raw_value, byteArray, 11680, 12);

    raw_value = convertPhysicalToRaw(@CAN_PrivMain::RFL_Object::RXX_Object_Obj21.VxAxCoVnce, 0.01, 0.0);
    copyBitsToByteArrayLE(raw_value, byteArray, 11660, 12);

    raw_value = convertPhysicalToRaw(@CAN_PrivMain::RFL_Object::RXX_Object_Obj21.VxVyCoVnce, 0.01, 0.0);
    copyBitsToByteArrayLE(raw_value, byteArray, 11648, 12);

    raw_value = convertPhysicalToRaw(@CAN_PrivMain::RFL_Object::RXX_Object_Obj21.PyAyCoVnce, 0.01, 0.0);
    copyBitsToByteArrayLE(raw_value, byteArray, 11628, 12);

    raw_value = convertPhysicalToRaw(@CAN_PrivMain::RFL_Object::RXX_Object_Obj21.PyAxCoVnce, 0.01, 0.0);
    copyBitsToByteArrayLE(raw_value, byteArray, 11616, 12);

    raw_value = convertPhysicalToRaw(@CAN_PrivMain::RFL_Object::RXX_Object_Obj21.PxAyCoVnce, 0.01, 0.0);
    copyBitsToByteArrayLE(raw_value, byteArray, 11596, 12);

    raw_value = convertPhysicalToRaw(@CAN_PrivMain::RFL_Object::RXX_Object_Obj21.AxAyCoVnce, 0.01, 0.0);
    copyBitsToByteArrayLE(raw_value, byteArray, 11724, 12);

    raw_value = convertPhysicalToRaw(@CAN_PrivMain::RFL_Object::RXX_Object_Obj21.ReferencePoint, 1.0, 0.0);
    copyBitsToByteArrayLE(raw_value, byteArray, 11576, 4);

    raw_value = convertPhysicalToRaw(@CAN_PrivMain::RFL_Object::RXX_Object_Obj21.PyVxCoVnce, 0.01, 0.0);
    copyBitsToByteArrayLE(raw_value, byteArray, 11552, 12);

    raw_value = convertPhysicalToRaw(@CAN_PrivMain::RFL_Object::RXX_Object_Obj21.FilterInformation, 1.0, 0.0);
    copyBitsToByteArrayLE(raw_value, byteArray, 11544, 8);

    raw_value = convertPhysicalToRaw(@CAN_PrivMain::RFL_Object::RXX_Object_Obj21.PxVyCoVnce, 0.01, 0.0);
    copyBitsToByteArrayLE(raw_value, byteArray, 11532, 12);

    raw_value = convertPhysicalToRaw(@CAN_PrivMain::RFL_Object::RXX_Object_Obj21.PxVxCoVnce, 0.01, 0.0);
    copyBitsToByteArrayLE(raw_value, byteArray, 11520, 12);

    raw_value = convertPhysicalToRaw(@CAN_PrivMain::RFL_Object::RXX_Object_Obj21.ProbClassType, 1.0, 0.0);
    copyBitsToByteArrayLE(raw_value, byteArray, 11515, 4);

    raw_value = convertPhysicalToRaw(@CAN_PrivMain::RFL_Object::RXX_Object_Obj21.MeasurementStatus, 1.0, 0.0);
    copyBitsToByteArrayLE(raw_value, byteArray, 11512, 3);

    raw_value = convertPhysicalToRaw(@CAN_PrivMain::RFL_Object::RXX_Object_Obj21.PxPyCoVnce, 0.01, 0.0);
    copyBitsToByteArrayLE(raw_value, byteArray, 11500, 12);

    raw_value = convertPhysicalToRaw(@CAN_PrivMain::RFL_Object::RXX_Object_Obj21.PyVyCoVnce, 0.01, 0.0);
    copyBitsToByteArrayLE(raw_value, byteArray, 11564, 12);
}


void RXX_Object_Obj20_write(byte byteArray[])
{
    qword raw_value;

    raw_value = convertPhysicalToRaw(@CAN_PrivMain::RFL_Object::RXX_Object_Obj20.RCS, 0.2, -102.4);
    copyBitsToByteArrayLE(raw_value, byteArray, 10892, 10);

    raw_value = convertPhysicalToRaw(@CAN_PrivMain::RFL_Object::RXX_Object_Obj20.Width, 0.125, 0.0);
    copyBitsToByteArrayLE(raw_value, byteArray, 10872, 7);

    raw_value = convertPhysicalToRaw(@CAN_PrivMain::RFL_Object::RXX_Object_Obj20.WidthVnce, 0.01, 0.0);
    copyBitsToByteArrayLE(raw_value, byteArray, 10880, 12);

    raw_value = convertPhysicalToRaw(@CAN_PrivMain::RFL_Object::RXX_Object_Obj20.ObjId, 1.0, 0.0);
    copyBitsToByteArrayLE(raw_value, byteArray, 10936, 7);

    raw_value = convertPhysicalToRaw(@CAN_PrivMain::RFL_Object::RXX_Object_Obj20.Ay, 0.0625, -16.0);
    copyBitsToByteArrayLE(raw_value, byteArray, 10902, 9);

    raw_value = convertPhysicalToRaw(@CAN_PrivMain::RFL_Object::RXX_Object_Obj20.AyVnce, 0.01, 0.0);
    copyBitsToByteArrayLE(raw_value, byteArray, 10912, 12);

    raw_value = convertPhysicalToRaw(@CAN_PrivMain::RFL_Object::RXX_Object_Obj20.Vx, 0.0625, -128.0);
    copyBitsToByteArrayLE(raw_value, byteArray, 10924, 12);

    raw_value = convertPhysicalToRaw(@CAN_PrivMain::RFL_Object::RXX_Object_Obj20.AxVnce, 0.01, 0.0);
    copyBitsToByteArrayLE(raw_value, byteArray, 10848, 12);

    raw_value = convertPhysicalToRaw(@CAN_PrivMain::RFL_Object::RXX_Object_Obj20.OrientationYawVnce, 0.0003, 0.0);
    copyBitsToByteArrayLE(raw_value, byteArray, 10860, 12);

    raw_value = convertPhysicalToRaw(@CAN_PrivMain::RFL_Object::RXX_Object_Obj20.PyVnce, 0.1, 0.0);
    copyBitsToByteArrayLE(raw_value, byteArray, 10796, 12);

    raw_value = convertPhysicalToRaw(@CAN_PrivMain::RFL_Object::RXX_Object_Obj20.OrientationYaw, 0.0175, -4.48);
    copyBitsToByteArrayLE(raw_value, byteArray, 10838, 9);

    raw_value = convertPhysicalToRaw(@CAN_PrivMain::RFL_Object::RXX_Object_Obj20.Ax, 0.03125, -16.0);
    copyBitsToByteArrayLE(raw_value, byteArray, 10828, 10);

    raw_value = convertPhysicalToRaw(@CAN_PrivMain::RFL_Object::RXX_Object_Obj20.LengthVnce, 0.01, 0.0);
    copyBitsToByteArrayLE(raw_value, byteArray, 10816, 12);

    raw_value = convertPhysicalToRaw(@CAN_PrivMain::RFL_Object::RXX_Object_Obj20.Length, 0.125, 0.0);
    copyBitsToByteArrayLE(raw_value, byteArray, 10808, 7);

    raw_value = convertPhysicalToRaw(@CAN_PrivMain::RFL_Object::RXX_Object_Obj20.Py, 0.0625, -128.0);
    copyBitsToByteArrayLE(raw_value, byteArray, 10784, 12);

    raw_value = convertPhysicalToRaw(@CAN_PrivMain::RFL_Object::RXX_Object_Obj20.PxVnce, 0.1, 0.0);
    copyBitsToByteArrayLE(raw_value, byteArray, 10772, 12);

    raw_value = convertPhysicalToRaw(@CAN_PrivMain::RFL_Object::RXX_Object_Obj20.Px, 0.0625, -512.0);
    copyBitsToByteArrayLE(raw_value, byteArray, 10758, 14);

    raw_value = convertPhysicalToRaw(@CAN_PrivMain::RFL_Object::RXX_Object_Obj20.ProbClassConfidence, 2.0, 0.0);
    copyBitsToByteArrayLE(raw_value, byteArray, 10752, 6);

    raw_value = convertPhysicalToRaw(@CAN_PrivMain::RFL_Object::RXX_Object_Obj20.MovingStatus, 1.0, 0.0);
    copyBitsToByteArrayLE(raw_value, byteArray, 10956, 2);

    raw_value = convertPhysicalToRaw(@CAN_PrivMain::RFL_Object::RXX_Object_Obj20.VxVnce, 0.01, 0.0);
    copyBitsToByteArrayLE(raw_value, byteArray, 10944, 12);

    raw_value = convertPhysicalToRaw(@CAN_PrivMain::RFL_Object::RXX_Object_Obj20.Vy, 0.125, -64.0);
    copyBitsToByteArrayLE(raw_value, byteArray, 10958, 10);

    raw_value = convertPhysicalToRaw(@CAN_PrivMain::RFL_Object::RXX_Object_Obj20.AxAyCoVnce, 0.01, 0.0);
    copyBitsToByteArrayLE(raw_value, byteArray, 11212, 12);

    raw_value = convertPhysicalToRaw(@CAN_PrivMain::RFL_Object::RXX_Object_Obj20.PxAxCoVnce, 0.01, 0.0);
    copyBitsToByteArrayLE(raw_value, byteArray, 11072, 12);

    raw_value = convertPhysicalToRaw(@CAN_PrivMain::RFL_Object::RXX_Object_Obj20.Age, 1.0, 0.0);
    copyBitsToByteArrayLE(raw_value, byteArray, 11232, 32);

    raw_value = convertPhysicalToRaw(@CAN_PrivMain::RFL_Object::RXX_Object_Obj20.ExistProb, 2.0, 0.0);
    copyBitsToByteArrayLE(raw_value, byteArray, 10968, 6);

    raw_value = convertPhysicalToRaw(@CAN_PrivMain::RFL_Object::RXX_Object_Obj20.VyAyCoVnce, 0.01, 0.0);
    copyBitsToByteArrayLE(raw_value, byteArray, 11200, 12);

    raw_value = convertPhysicalToRaw(@CAN_PrivMain::RFL_Object::RXX_Object_Obj20.VyAxCoVnce, 0.01, 0.0);
    copyBitsToByteArrayLE(raw_value, byteArray, 11180, 12);

    raw_value = convertPhysicalToRaw(@CAN_PrivMain::RFL_Object::RXX_Object_Obj20.VxAyCoVnce, 0.01, 0.0);
    copyBitsToByteArrayLE(raw_value, byteArray, 11168, 12);

    raw_value = convertPhysicalToRaw(@CAN_PrivMain::RFL_Object::RXX_Object_Obj20.VxAxCoVnce, 0.01, 0.0);
    copyBitsToByteArrayLE(raw_value, byteArray, 11148, 12);

    raw_value = convertPhysicalToRaw(@CAN_PrivMain::RFL_Object::RXX_Object_Obj20.VxVyCoVnce, 0.01, 0.0);
    copyBitsToByteArrayLE(raw_value, byteArray, 11136, 12);

    raw_value = convertPhysicalToRaw(@CAN_PrivMain::RFL_Object::RXX_Object_Obj20.PyAxCoVnce, 0.01, 0.0);
    copyBitsToByteArrayLE(raw_value, byteArray, 11104, 12);

    raw_value = convertPhysicalToRaw(@CAN_PrivMain::RFL_Object::RXX_Object_Obj20.PxAyCoVnce, 0.01, 0.0);
    copyBitsToByteArrayLE(raw_value, byteArray, 11084, 12);

    raw_value = convertPhysicalToRaw(@CAN_PrivMain::RFL_Object::RXX_Object_Obj20.PyAyCoVnce, 0.01, 0.0);
    copyBitsToByteArrayLE(raw_value, byteArray, 11116, 12);

    raw_value = convertPhysicalToRaw(@CAN_PrivMain::RFL_Object::RXX_Object_Obj20.ReferencePoint, 1.0, 0.0);
    copyBitsToByteArrayLE(raw_value, byteArray, 11064, 4);

    raw_value = convertPhysicalToRaw(@CAN_PrivMain::RFL_Object::RXX_Object_Obj20.PyVxCoVnce, 0.01, 0.0);
    copyBitsToByteArrayLE(raw_value, byteArray, 11040, 12);

    raw_value = convertPhysicalToRaw(@CAN_PrivMain::RFL_Object::RXX_Object_Obj20.FilterInformation, 1.0, 0.0);
    copyBitsToByteArrayLE(raw_value, byteArray, 11032, 8);

    raw_value = convertPhysicalToRaw(@CAN_PrivMain::RFL_Object::RXX_Object_Obj20.PxVyCoVnce, 0.01, 0.0);
    copyBitsToByteArrayLE(raw_value, byteArray, 11020, 12);

    raw_value = convertPhysicalToRaw(@CAN_PrivMain::RFL_Object::RXX_Object_Obj20.PxVxCoVnce, 0.01, 0.0);
    copyBitsToByteArrayLE(raw_value, byteArray, 11008, 12);

    raw_value = convertPhysicalToRaw(@CAN_PrivMain::RFL_Object::RXX_Object_Obj20.ProbClassType, 1.0, 0.0);
    copyBitsToByteArrayLE(raw_value, byteArray, 11003, 4);

    raw_value = convertPhysicalToRaw(@CAN_PrivMain::RFL_Object::RXX_Object_Obj20.MeasurementStatus, 1.0, 0.0);
    copyBitsToByteArrayLE(raw_value, byteArray, 11000, 3);

    raw_value = convertPhysicalToRaw(@CAN_PrivMain::RFL_Object::RXX_Object_Obj20.PyVyCoVnce, 0.01, 0.0);
    copyBitsToByteArrayLE(raw_value, byteArray, 11052, 12);

    raw_value = convertPhysicalToRaw(@CAN_PrivMain::RFL_Object::RXX_Object_Obj20.PxPyCoVnce, 0.01, 0.0);
    copyBitsToByteArrayLE(raw_value, byteArray, 10988, 12);

    raw_value = convertPhysicalToRaw(@CAN_PrivMain::RFL_Object::RXX_Object_Obj20.VyVnce, 0.01, 0.0);
    copyBitsToByteArrayLE(raw_value, byteArray, 10976, 12);
}


void RXX_Object_Obj19_write(byte byteArray[])
{
    qword raw_value;

    raw_value = convertPhysicalToRaw(@CAN_PrivMain::RFL_Object::RXX_Object_Obj19.RCS, 0.2, -102.4);
    copyBitsToByteArrayLE(raw_value, byteArray, 10380, 10);

    raw_value = convertPhysicalToRaw(@CAN_PrivMain::RFL_Object::RXX_Object_Obj19.Width, 0.125, 0.0);
    copyBitsToByteArrayLE(raw_value, byteArray, 10360, 7);

    raw_value = convertPhysicalToRaw(@CAN_PrivMain::RFL_Object::RXX_Object_Obj19.WidthVnce, 0.01, 0.0);
    copyBitsToByteArrayLE(raw_value, byteArray, 10368, 12);

    raw_value = convertPhysicalToRaw(@CAN_PrivMain::RFL_Object::RXX_Object_Obj19.ObjId, 1.0, 0.0);
    copyBitsToByteArrayLE(raw_value, byteArray, 10424, 7);

    raw_value = convertPhysicalToRaw(@CAN_PrivMain::RFL_Object::RXX_Object_Obj19.Ay, 0.0625, -16.0);
    copyBitsToByteArrayLE(raw_value, byteArray, 10390, 9);

    raw_value = convertPhysicalToRaw(@CAN_PrivMain::RFL_Object::RXX_Object_Obj19.AyVnce, 0.01, 0.0);
    copyBitsToByteArrayLE(raw_value, byteArray, 10400, 12);

    raw_value = convertPhysicalToRaw(@CAN_PrivMain::RFL_Object::RXX_Object_Obj19.Vx, 0.0625, -128.0);
    copyBitsToByteArrayLE(raw_value, byteArray, 10412, 12);

    raw_value = convertPhysicalToRaw(@CAN_PrivMain::RFL_Object::RXX_Object_Obj19.AxVnce, 0.01, 0.0);
    copyBitsToByteArrayLE(raw_value, byteArray, 10336, 12);

    raw_value = convertPhysicalToRaw(@CAN_PrivMain::RFL_Object::RXX_Object_Obj19.OrientationYawVnce, 0.0003, 0.0);
    copyBitsToByteArrayLE(raw_value, byteArray, 10348, 12);

    raw_value = convertPhysicalToRaw(@CAN_PrivMain::RFL_Object::RXX_Object_Obj19.PyVnce, 0.1, 0.0);
    copyBitsToByteArrayLE(raw_value, byteArray, 10284, 12);

    raw_value = convertPhysicalToRaw(@CAN_PrivMain::RFL_Object::RXX_Object_Obj19.OrientationYaw, 0.0175, -4.48);
    copyBitsToByteArrayLE(raw_value, byteArray, 10326, 9);

    raw_value = convertPhysicalToRaw(@CAN_PrivMain::RFL_Object::RXX_Object_Obj19.Ax, 0.03125, -16.0);
    copyBitsToByteArrayLE(raw_value, byteArray, 10316, 10);

    raw_value = convertPhysicalToRaw(@CAN_PrivMain::RFL_Object::RXX_Object_Obj19.LengthVnce, 0.01, 0.0);
    copyBitsToByteArrayLE(raw_value, byteArray, 10304, 12);

    raw_value = convertPhysicalToRaw(@CAN_PrivMain::RFL_Object::RXX_Object_Obj19.Length, 0.125, 0.0);
    copyBitsToByteArrayLE(raw_value, byteArray, 10296, 7);

    raw_value = convertPhysicalToRaw(@CAN_PrivMain::RFL_Object::RXX_Object_Obj19.Py, 0.0625, -128.0);
    copyBitsToByteArrayLE(raw_value, byteArray, 10272, 12);

    raw_value = convertPhysicalToRaw(@CAN_PrivMain::RFL_Object::RXX_Object_Obj19.PxVnce, 0.1, 0.0);
    copyBitsToByteArrayLE(raw_value, byteArray, 10260, 12);

    raw_value = convertPhysicalToRaw(@CAN_PrivMain::RFL_Object::RXX_Object_Obj19.Px, 0.0625, -512.0);
    copyBitsToByteArrayLE(raw_value, byteArray, 10246, 14);

    raw_value = convertPhysicalToRaw(@CAN_PrivMain::RFL_Object::RXX_Object_Obj19.ProbClassConfidence, 2.0, 0.0);
    copyBitsToByteArrayLE(raw_value, byteArray, 10240, 6);

    raw_value = convertPhysicalToRaw(@CAN_PrivMain::RFL_Object::RXX_Object_Obj19.MovingStatus, 1.0, 0.0);
    copyBitsToByteArrayLE(raw_value, byteArray, 10444, 2);

    raw_value = convertPhysicalToRaw(@CAN_PrivMain::RFL_Object::RXX_Object_Obj19.VxVnce, 0.01, 0.0);
    copyBitsToByteArrayLE(raw_value, byteArray, 10432, 12);

    raw_value = convertPhysicalToRaw(@CAN_PrivMain::RFL_Object::RXX_Object_Obj19.Vy, 0.125, -64.0);
    copyBitsToByteArrayLE(raw_value, byteArray, 10446, 10);

    raw_value = convertPhysicalToRaw(@CAN_PrivMain::RFL_Object::RXX_Object_Obj19.AxAyCoVnce, 0.01, 0.0);
    copyBitsToByteArrayLE(raw_value, byteArray, 10700, 12);

    raw_value = convertPhysicalToRaw(@CAN_PrivMain::RFL_Object::RXX_Object_Obj19.PxAxCoVnce, 0.01, 0.0);
    copyBitsToByteArrayLE(raw_value, byteArray, 10560, 12);

    raw_value = convertPhysicalToRaw(@CAN_PrivMain::RFL_Object::RXX_Object_Obj19.Age, 1.0, 0.0);
    copyBitsToByteArrayLE(raw_value, byteArray, 10720, 32);

    raw_value = convertPhysicalToRaw(@CAN_PrivMain::RFL_Object::RXX_Object_Obj19.ExistProb, 2.0, 0.0);
    copyBitsToByteArrayLE(raw_value, byteArray, 10456, 6);

    raw_value = convertPhysicalToRaw(@CAN_PrivMain::RFL_Object::RXX_Object_Obj19.VyAyCoVnce, 0.01, 0.0);
    copyBitsToByteArrayLE(raw_value, byteArray, 10688, 12);

    raw_value = convertPhysicalToRaw(@CAN_PrivMain::RFL_Object::RXX_Object_Obj19.VyAxCoVnce, 0.01, 0.0);
    copyBitsToByteArrayLE(raw_value, byteArray, 10668, 12);

    raw_value = convertPhysicalToRaw(@CAN_PrivMain::RFL_Object::RXX_Object_Obj19.VxAyCoVnce, 0.01, 0.0);
    copyBitsToByteArrayLE(raw_value, byteArray, 10656, 12);

    raw_value = convertPhysicalToRaw(@CAN_PrivMain::RFL_Object::RXX_Object_Obj19.VxAxCoVnce, 0.01, 0.0);
    copyBitsToByteArrayLE(raw_value, byteArray, 10636, 12);

    raw_value = convertPhysicalToRaw(@CAN_PrivMain::RFL_Object::RXX_Object_Obj19.PyAyCoVnce, 0.01, 0.0);
    copyBitsToByteArrayLE(raw_value, byteArray, 10604, 12);

    raw_value = convertPhysicalToRaw(@CAN_PrivMain::RFL_Object::RXX_Object_Obj19.PyAxCoVnce, 0.01, 0.0);
    copyBitsToByteArrayLE(raw_value, byteArray, 10592, 12);

    raw_value = convertPhysicalToRaw(@CAN_PrivMain::RFL_Object::RXX_Object_Obj19.PxAyCoVnce, 0.01, 0.0);
    copyBitsToByteArrayLE(raw_value, byteArray, 10572, 12);

    raw_value = convertPhysicalToRaw(@CAN_PrivMain::RFL_Object::RXX_Object_Obj19.VxVyCoVnce, 0.01, 0.0);
    copyBitsToByteArrayLE(raw_value, byteArray, 10624, 12);

    raw_value = convertPhysicalToRaw(@CAN_PrivMain::RFL_Object::RXX_Object_Obj19.ReferencePoint, 1.0, 0.0);
    copyBitsToByteArrayLE(raw_value, byteArray, 10552, 4);

    raw_value = convertPhysicalToRaw(@CAN_PrivMain::RFL_Object::RXX_Object_Obj19.PxVxCoVnce, 0.01, 0.0);
    copyBitsToByteArrayLE(raw_value, byteArray, 10496, 12);

    raw_value = convertPhysicalToRaw(@CAN_PrivMain::RFL_Object::RXX_Object_Obj19.PyVyCoVnce, 0.01, 0.0);
    copyBitsToByteArrayLE(raw_value, byteArray, 10540, 12);

    raw_value = convertPhysicalToRaw(@CAN_PrivMain::RFL_Object::RXX_Object_Obj19.PxPyCoVnce, 0.01, 0.0);
    copyBitsToByteArrayLE(raw_value, byteArray, 10476, 12);

    raw_value = convertPhysicalToRaw(@CAN_PrivMain::RFL_Object::RXX_Object_Obj19.MeasurementStatus, 1.0, 0.0);
    copyBitsToByteArrayLE(raw_value, byteArray, 10488, 3);

    raw_value = convertPhysicalToRaw(@CAN_PrivMain::RFL_Object::RXX_Object_Obj19.ProbClassType, 1.0, 0.0);
    copyBitsToByteArrayLE(raw_value, byteArray, 10491, 4);

    raw_value = convertPhysicalToRaw(@CAN_PrivMain::RFL_Object::RXX_Object_Obj19.VyVnce, 0.01, 0.0);
    copyBitsToByteArrayLE(raw_value, byteArray, 10464, 12);

    raw_value = convertPhysicalToRaw(@CAN_PrivMain::RFL_Object::RXX_Object_Obj19.PxVyCoVnce, 0.01, 0.0);
    copyBitsToByteArrayLE(raw_value, byteArray, 10508, 12);

    raw_value = convertPhysicalToRaw(@CAN_PrivMain::RFL_Object::RXX_Object_Obj19.FilterInformation, 1.0, 0.0);
    copyBitsToByteArrayLE(raw_value, byteArray, 10520, 8);

    raw_value = convertPhysicalToRaw(@CAN_PrivMain::RFL_Object::RXX_Object_Obj19.PyVxCoVnce, 0.01, 0.0);
    copyBitsToByteArrayLE(raw_value, byteArray, 10528, 12);
}


void RXX_Object_Obj18_write(byte byteArray[])
{
    qword raw_value;

    raw_value = convertPhysicalToRaw(@CAN_PrivMain::RFL_Object::RXX_Object_Obj18.AxVnce, 0.01, 0.0);
    copyBitsToByteArrayLE(raw_value, byteArray, 9824, 12);

    raw_value = convertPhysicalToRaw(@CAN_PrivMain::RFL_Object::RXX_Object_Obj18.VxVnce, 0.01, 0.0);
    copyBitsToByteArrayLE(raw_value, byteArray, 9920, 12);

    raw_value = convertPhysicalToRaw(@CAN_PrivMain::RFL_Object::RXX_Object_Obj18.ObjId, 1.0, 0.0);
    copyBitsToByteArrayLE(raw_value, byteArray, 9912, 7);

    raw_value = convertPhysicalToRaw(@CAN_PrivMain::RFL_Object::RXX_Object_Obj18.Vx, 0.0625, -128.0);
    copyBitsToByteArrayLE(raw_value, byteArray, 9900, 12);

    raw_value = convertPhysicalToRaw(@CAN_PrivMain::RFL_Object::RXX_Object_Obj18.AyVnce, 0.01, 0.0);
    copyBitsToByteArrayLE(raw_value, byteArray, 9888, 12);

    raw_value = convertPhysicalToRaw(@CAN_PrivMain::RFL_Object::RXX_Object_Obj18.Ay, 0.0625, -16.0);
    copyBitsToByteArrayLE(raw_value, byteArray, 9878, 9);

    raw_value = convertPhysicalToRaw(@CAN_PrivMain::RFL_Object::RXX_Object_Obj18.RCS, 0.2, -102.4);
    copyBitsToByteArrayLE(raw_value, byteArray, 9868, 10);

    raw_value = convertPhysicalToRaw(@CAN_PrivMain::RFL_Object::RXX_Object_Obj18.WidthVnce, 0.01, 0.0);
    copyBitsToByteArrayLE(raw_value, byteArray, 9856, 12);

    raw_value = convertPhysicalToRaw(@CAN_PrivMain::RFL_Object::RXX_Object_Obj18.Width, 0.125, 0.0);
    copyBitsToByteArrayLE(raw_value, byteArray, 9848, 7);

    raw_value = convertPhysicalToRaw(@CAN_PrivMain::RFL_Object::RXX_Object_Obj18.OrientationYawVnce, 0.0003, 0.0);
    copyBitsToByteArrayLE(raw_value, byteArray, 9836, 12);

    raw_value = convertPhysicalToRaw(@CAN_PrivMain::RFL_Object::RXX_Object_Obj18.Vy, 0.125, -64.0);
    copyBitsToByteArrayLE(raw_value, byteArray, 9934, 10);

    raw_value = convertPhysicalToRaw(@CAN_PrivMain::RFL_Object::RXX_Object_Obj18.OrientationYaw, 0.0175, -4.48);
    copyBitsToByteArrayLE(raw_value, byteArray, 9814, 9);

    raw_value = convertPhysicalToRaw(@CAN_PrivMain::RFL_Object::RXX_Object_Obj18.Ax, 0.03125, -16.0);
    copyBitsToByteArrayLE(raw_value, byteArray, 9804, 10);

    raw_value = convertPhysicalToRaw(@CAN_PrivMain::RFL_Object::RXX_Object_Obj18.LengthVnce, 0.01, 0.0);
    copyBitsToByteArrayLE(raw_value, byteArray, 9792, 12);

    raw_value = convertPhysicalToRaw(@CAN_PrivMain::RFL_Object::RXX_Object_Obj18.Length, 0.125, 0.0);
    copyBitsToByteArrayLE(raw_value, byteArray, 9784, 7);

    raw_value = convertPhysicalToRaw(@CAN_PrivMain::RFL_Object::RXX_Object_Obj18.PyVnce, 0.1, 0.0);
    copyBitsToByteArrayLE(raw_value, byteArray, 9772, 12);

    raw_value = convertPhysicalToRaw(@CAN_PrivMain::RFL_Object::RXX_Object_Obj18.Py, 0.0625, -128.0);
    copyBitsToByteArrayLE(raw_value, byteArray, 9760, 12);

    raw_value = convertPhysicalToRaw(@CAN_PrivMain::RFL_Object::RXX_Object_Obj18.PxVnce, 0.1, 0.0);
    copyBitsToByteArrayLE(raw_value, byteArray, 9748, 12);

    raw_value = convertPhysicalToRaw(@CAN_PrivMain::RFL_Object::RXX_Object_Obj18.Px, 0.0625, -512.0);
    copyBitsToByteArrayLE(raw_value, byteArray, 9734, 14);

    raw_value = convertPhysicalToRaw(@CAN_PrivMain::RFL_Object::RXX_Object_Obj18.ProbClassConfidence, 2.0, 0.0);
    copyBitsToByteArrayLE(raw_value, byteArray, 9728, 6);

    raw_value = convertPhysicalToRaw(@CAN_PrivMain::RFL_Object::RXX_Object_Obj18.MovingStatus, 1.0, 0.0);
    copyBitsToByteArrayLE(raw_value, byteArray, 9932, 2);

    raw_value = convertPhysicalToRaw(@CAN_PrivMain::RFL_Object::RXX_Object_Obj18.Age, 1.0, 0.0);
    copyBitsToByteArrayLE(raw_value, byteArray, 10208, 32);

    raw_value = convertPhysicalToRaw(@CAN_PrivMain::RFL_Object::RXX_Object_Obj18.ExistProb, 2.0, 0.0);
    copyBitsToByteArrayLE(raw_value, byteArray, 9944, 6);

    raw_value = convertPhysicalToRaw(@CAN_PrivMain::RFL_Object::RXX_Object_Obj18.PxAxCoVnce, 0.01, 0.0);
    copyBitsToByteArrayLE(raw_value, byteArray, 10048, 12);

    raw_value = convertPhysicalToRaw(@CAN_PrivMain::RFL_Object::RXX_Object_Obj18.AxAyCoVnce, 0.01, 0.0);
    copyBitsToByteArrayLE(raw_value, byteArray, 10188, 12);

    raw_value = convertPhysicalToRaw(@CAN_PrivMain::RFL_Object::RXX_Object_Obj18.VyAyCoVnce, 0.01, 0.0);
    copyBitsToByteArrayLE(raw_value, byteArray, 10176, 12);

    raw_value = convertPhysicalToRaw(@CAN_PrivMain::RFL_Object::RXX_Object_Obj18.VyAxCoVnce, 0.01, 0.0);
    copyBitsToByteArrayLE(raw_value, byteArray, 10156, 12);

    raw_value = convertPhysicalToRaw(@CAN_PrivMain::RFL_Object::RXX_Object_Obj18.VxAyCoVnce, 0.01, 0.0);
    copyBitsToByteArrayLE(raw_value, byteArray, 10144, 12);

    raw_value = convertPhysicalToRaw(@CAN_PrivMain::RFL_Object::RXX_Object_Obj18.VxAxCoVnce, 0.01, 0.0);
    copyBitsToByteArrayLE(raw_value, byteArray, 10124, 12);

    raw_value = convertPhysicalToRaw(@CAN_PrivMain::RFL_Object::RXX_Object_Obj18.VyVnce, 0.01, 0.0);
    copyBitsToByteArrayLE(raw_value, byteArray, 9952, 12);

    raw_value = convertPhysicalToRaw(@CAN_PrivMain::RFL_Object::RXX_Object_Obj18.PyAyCoVnce, 0.01, 0.0);
    copyBitsToByteArrayLE(raw_value, byteArray, 10092, 12);

    raw_value = convertPhysicalToRaw(@CAN_PrivMain::RFL_Object::RXX_Object_Obj18.PyAxCoVnce, 0.01, 0.0);
    copyBitsToByteArrayLE(raw_value, byteArray, 10080, 12);

    raw_value = convertPhysicalToRaw(@CAN_PrivMain::RFL_Object::RXX_Object_Obj18.PxAyCoVnce, 0.01, 0.0);
    copyBitsToByteArrayLE(raw_value, byteArray, 10060, 12);

    raw_value = convertPhysicalToRaw(@CAN_PrivMain::RFL_Object::RXX_Object_Obj18.VxVyCoVnce, 0.01, 0.0);
    copyBitsToByteArrayLE(raw_value, byteArray, 10112, 12);

    raw_value = convertPhysicalToRaw(@CAN_PrivMain::RFL_Object::RXX_Object_Obj18.ReferencePoint, 1.0, 0.0);
    copyBitsToByteArrayLE(raw_value, byteArray, 10040, 4);

    raw_value = convertPhysicalToRaw(@CAN_PrivMain::RFL_Object::RXX_Object_Obj18.PyVxCoVnce, 0.01, 0.0);
    copyBitsToByteArrayLE(raw_value, byteArray, 10016, 12);

    raw_value = convertPhysicalToRaw(@CAN_PrivMain::RFL_Object::RXX_Object_Obj18.FilterInformation, 1.0, 0.0);
    copyBitsToByteArrayLE(raw_value, byteArray, 10008, 8);

    raw_value = convertPhysicalToRaw(@CAN_PrivMain::RFL_Object::RXX_Object_Obj18.PxVyCoVnce, 0.01, 0.0);
    copyBitsToByteArrayLE(raw_value, byteArray, 9996, 12);

    raw_value = convertPhysicalToRaw(@CAN_PrivMain::RFL_Object::RXX_Object_Obj18.PxVxCoVnce, 0.01, 0.0);
    copyBitsToByteArrayLE(raw_value, byteArray, 9984, 12);

    raw_value = convertPhysicalToRaw(@CAN_PrivMain::RFL_Object::RXX_Object_Obj18.ProbClassType, 1.0, 0.0);
    copyBitsToByteArrayLE(raw_value, byteArray, 9979, 4);

    raw_value = convertPhysicalToRaw(@CAN_PrivMain::RFL_Object::RXX_Object_Obj18.MeasurementStatus, 1.0, 0.0);
    copyBitsToByteArrayLE(raw_value, byteArray, 9976, 3);

    raw_value = convertPhysicalToRaw(@CAN_PrivMain::RFL_Object::RXX_Object_Obj18.PxPyCoVnce, 0.01, 0.0);
    copyBitsToByteArrayLE(raw_value, byteArray, 9964, 12);

    raw_value = convertPhysicalToRaw(@CAN_PrivMain::RFL_Object::RXX_Object_Obj18.PyVyCoVnce, 0.01, 0.0);
    copyBitsToByteArrayLE(raw_value, byteArray, 10028, 12);
}


void RXX_Object_Obj17_write(byte byteArray[])
{
    qword raw_value;

    raw_value = convertPhysicalToRaw(@CAN_PrivMain::RFL_Object::RXX_Object_Obj17.Ay, 0.0625, -16.0);
    copyBitsToByteArrayLE(raw_value, byteArray, 9366, 9);

    raw_value = convertPhysicalToRaw(@CAN_PrivMain::RFL_Object::RXX_Object_Obj17.Width, 0.125, 0.0);
    copyBitsToByteArrayLE(raw_value, byteArray, 9336, 7);

    raw_value = convertPhysicalToRaw(@CAN_PrivMain::RFL_Object::RXX_Object_Obj17.WidthVnce, 0.01, 0.0);
    copyBitsToByteArrayLE(raw_value, byteArray, 9344, 12);

    raw_value = convertPhysicalToRaw(@CAN_PrivMain::RFL_Object::RXX_Object_Obj17.RCS, 0.2, -102.4);
    copyBitsToByteArrayLE(raw_value, byteArray, 9356, 10);

    raw_value = convertPhysicalToRaw(@CAN_PrivMain::RFL_Object::RXX_Object_Obj17.AxVnce, 0.01, 0.0);
    copyBitsToByteArrayLE(raw_value, byteArray, 9312, 12);

    raw_value = convertPhysicalToRaw(@CAN_PrivMain::RFL_Object::RXX_Object_Obj17.AyVnce, 0.01, 0.0);
    copyBitsToByteArrayLE(raw_value, byteArray, 9376, 12);

    raw_value = convertPhysicalToRaw(@CAN_PrivMain::RFL_Object::RXX_Object_Obj17.Vx, 0.0625, -128.0);
    copyBitsToByteArrayLE(raw_value, byteArray, 9388, 12);

    raw_value = convertPhysicalToRaw(@CAN_PrivMain::RFL_Object::RXX_Object_Obj17.ObjId, 1.0, 0.0);
    copyBitsToByteArrayLE(raw_value, byteArray, 9400, 7);

    raw_value = convertPhysicalToRaw(@CAN_PrivMain::RFL_Object::RXX_Object_Obj17.VxVnce, 0.01, 0.0);
    copyBitsToByteArrayLE(raw_value, byteArray, 9408, 12);

    raw_value = convertPhysicalToRaw(@CAN_PrivMain::RFL_Object::RXX_Object_Obj17.OrientationYawVnce, 0.0003, 0.0);
    copyBitsToByteArrayLE(raw_value, byteArray, 9324, 12);

    raw_value = convertPhysicalToRaw(@CAN_PrivMain::RFL_Object::RXX_Object_Obj17.Vy, 0.125, -64.0);
    copyBitsToByteArrayLE(raw_value, byteArray, 9422, 10);

    raw_value = convertPhysicalToRaw(@CAN_PrivMain::RFL_Object::RXX_Object_Obj17.OrientationYaw, 0.0175, -4.48);
    copyBitsToByteArrayLE(raw_value, byteArray, 9302, 9);

    raw_value = convertPhysicalToRaw(@CAN_PrivMain::RFL_Object::RXX_Object_Obj17.Ax, 0.03125, -16.0);
    copyBitsToByteArrayLE(raw_value, byteArray, 9292, 10);

    raw_value = convertPhysicalToRaw(@CAN_PrivMain::RFL_Object::RXX_Object_Obj17.LengthVnce, 0.01, 0.0);
    copyBitsToByteArrayLE(raw_value, byteArray, 9280, 12);

    raw_value = convertPhysicalToRaw(@CAN_PrivMain::RFL_Object::RXX_Object_Obj17.Length, 0.125, 0.0);
    copyBitsToByteArrayLE(raw_value, byteArray, 9272, 7);

    raw_value = convertPhysicalToRaw(@CAN_PrivMain::RFL_Object::RXX_Object_Obj17.PyVnce, 0.1, 0.0);
    copyBitsToByteArrayLE(raw_value, byteArray, 9260, 12);

    raw_value = convertPhysicalToRaw(@CAN_PrivMain::RFL_Object::RXX_Object_Obj17.Py, 0.0625, -128.0);
    copyBitsToByteArrayLE(raw_value, byteArray, 9248, 12);

    raw_value = convertPhysicalToRaw(@CAN_PrivMain::RFL_Object::RXX_Object_Obj17.PxVnce, 0.1, 0.0);
    copyBitsToByteArrayLE(raw_value, byteArray, 9236, 12);

    raw_value = convertPhysicalToRaw(@CAN_PrivMain::RFL_Object::RXX_Object_Obj17.Px, 0.0625, -512.0);
    copyBitsToByteArrayLE(raw_value, byteArray, 9222, 14);

    raw_value = convertPhysicalToRaw(@CAN_PrivMain::RFL_Object::RXX_Object_Obj17.ProbClassConfidence, 2.0, 0.0);
    copyBitsToByteArrayLE(raw_value, byteArray, 9216, 6);

    raw_value = convertPhysicalToRaw(@CAN_PrivMain::RFL_Object::RXX_Object_Obj17.MovingStatus, 1.0, 0.0);
    copyBitsToByteArrayLE(raw_value, byteArray, 9420, 2);

    raw_value = convertPhysicalToRaw(@CAN_PrivMain::RFL_Object::RXX_Object_Obj17.Age, 1.0, 0.0);
    copyBitsToByteArrayLE(raw_value, byteArray, 9696, 32);

    raw_value = convertPhysicalToRaw(@CAN_PrivMain::RFL_Object::RXX_Object_Obj17.ExistProb, 2.0, 0.0);
    copyBitsToByteArrayLE(raw_value, byteArray, 9432, 6);

    raw_value = convertPhysicalToRaw(@CAN_PrivMain::RFL_Object::RXX_Object_Obj17.PxAxCoVnce, 0.01, 0.0);
    copyBitsToByteArrayLE(raw_value, byteArray, 9536, 12);

    raw_value = convertPhysicalToRaw(@CAN_PrivMain::RFL_Object::RXX_Object_Obj17.AxAyCoVnce, 0.01, 0.0);
    copyBitsToByteArrayLE(raw_value, byteArray, 9676, 12);

    raw_value = convertPhysicalToRaw(@CAN_PrivMain::RFL_Object::RXX_Object_Obj17.VyAyCoVnce, 0.01, 0.0);
    copyBitsToByteArrayLE(raw_value, byteArray, 9664, 12);

    raw_value = convertPhysicalToRaw(@CAN_PrivMain::RFL_Object::RXX_Object_Obj17.VyAxCoVnce, 0.01, 0.0);
    copyBitsToByteArrayLE(raw_value, byteArray, 9644, 12);

    raw_value = convertPhysicalToRaw(@CAN_PrivMain::RFL_Object::RXX_Object_Obj17.VxAyCoVnce, 0.01, 0.0);
    copyBitsToByteArrayLE(raw_value, byteArray, 9632, 12);

    raw_value = convertPhysicalToRaw(@CAN_PrivMain::RFL_Object::RXX_Object_Obj17.VxAxCoVnce, 0.01, 0.0);
    copyBitsToByteArrayLE(raw_value, byteArray, 9612, 12);

    raw_value = convertPhysicalToRaw(@CAN_PrivMain::RFL_Object::RXX_Object_Obj17.VxVyCoVnce, 0.01, 0.0);
    copyBitsToByteArrayLE(raw_value, byteArray, 9600, 12);

    raw_value = convertPhysicalToRaw(@CAN_PrivMain::RFL_Object::RXX_Object_Obj17.PyAyCoVnce, 0.01, 0.0);
    copyBitsToByteArrayLE(raw_value, byteArray, 9580, 12);

    raw_value = convertPhysicalToRaw(@CAN_PrivMain::RFL_Object::RXX_Object_Obj17.PyAxCoVnce, 0.01, 0.0);
    copyBitsToByteArrayLE(raw_value, byteArray, 9568, 12);

    raw_value = convertPhysicalToRaw(@CAN_PrivMain::RFL_Object::RXX_Object_Obj17.PxAyCoVnce, 0.01, 0.0);
    copyBitsToByteArrayLE(raw_value, byteArray, 9548, 12);

    raw_value = convertPhysicalToRaw(@CAN_PrivMain::RFL_Object::RXX_Object_Obj17.VyVnce, 0.01, 0.0);
    copyBitsToByteArrayLE(raw_value, byteArray, 9440, 12);

    raw_value = convertPhysicalToRaw(@CAN_PrivMain::RFL_Object::RXX_Object_Obj17.ReferencePoint, 1.0, 0.0);
    copyBitsToByteArrayLE(raw_value, byteArray, 9528, 4);

    raw_value = convertPhysicalToRaw(@CAN_PrivMain::RFL_Object::RXX_Object_Obj17.PxVxCoVnce, 0.01, 0.0);
    copyBitsToByteArrayLE(raw_value, byteArray, 9472, 12);

    raw_value = convertPhysicalToRaw(@CAN_PrivMain::RFL_Object::RXX_Object_Obj17.PyVyCoVnce, 0.01, 0.0);
    copyBitsToByteArrayLE(raw_value, byteArray, 9516, 12);

    raw_value = convertPhysicalToRaw(@CAN_PrivMain::RFL_Object::RXX_Object_Obj17.MeasurementStatus, 1.0, 0.0);
    copyBitsToByteArrayLE(raw_value, byteArray, 9464, 3);

    raw_value = convertPhysicalToRaw(@CAN_PrivMain::RFL_Object::RXX_Object_Obj17.ProbClassType, 1.0, 0.0);
    copyBitsToByteArrayLE(raw_value, byteArray, 9467, 4);

    raw_value = convertPhysicalToRaw(@CAN_PrivMain::RFL_Object::RXX_Object_Obj17.PxPyCoVnce, 0.01, 0.0);
    copyBitsToByteArrayLE(raw_value, byteArray, 9452, 12);

    raw_value = convertPhysicalToRaw(@CAN_PrivMain::RFL_Object::RXX_Object_Obj17.PxVyCoVnce, 0.01, 0.0);
    copyBitsToByteArrayLE(raw_value, byteArray, 9484, 12);

    raw_value = convertPhysicalToRaw(@CAN_PrivMain::RFL_Object::RXX_Object_Obj17.FilterInformation, 1.0, 0.0);
    copyBitsToByteArrayLE(raw_value, byteArray, 9496, 8);

    raw_value = convertPhysicalToRaw(@CAN_PrivMain::RFL_Object::RXX_Object_Obj17.PyVxCoVnce, 0.01, 0.0);
    copyBitsToByteArrayLE(raw_value, byteArray, 9504, 12);
}


void RXX_Object_Obj16_write(byte byteArray[])
{
    qword raw_value;

    raw_value = convertPhysicalToRaw(@CAN_PrivMain::RFL_Object::RXX_Object_Obj16.ObjId, 1.0, 0.0);
    copyBitsToByteArrayLE(raw_value, byteArray, 8888, 7);

    raw_value = convertPhysicalToRaw(@CAN_PrivMain::RFL_Object::RXX_Object_Obj16.AxVnce, 0.01, 0.0);
    copyBitsToByteArrayLE(raw_value, byteArray, 8800, 12);

    raw_value = convertPhysicalToRaw(@CAN_PrivMain::RFL_Object::RXX_Object_Obj16.Vx, 0.0625, -128.0);
    copyBitsToByteArrayLE(raw_value, byteArray, 8876, 12);

    raw_value = convertPhysicalToRaw(@CAN_PrivMain::RFL_Object::RXX_Object_Obj16.AyVnce, 0.01, 0.0);
    copyBitsToByteArrayLE(raw_value, byteArray, 8864, 12);

    raw_value = convertPhysicalToRaw(@CAN_PrivMain::RFL_Object::RXX_Object_Obj16.Ay, 0.0625, -16.0);
    copyBitsToByteArrayLE(raw_value, byteArray, 8854, 9);

    raw_value = convertPhysicalToRaw(@CAN_PrivMain::RFL_Object::RXX_Object_Obj16.RCS, 0.2, -102.4);
    copyBitsToByteArrayLE(raw_value, byteArray, 8844, 10);

    raw_value = convertPhysicalToRaw(@CAN_PrivMain::RFL_Object::RXX_Object_Obj16.WidthVnce, 0.01, 0.0);
    copyBitsToByteArrayLE(raw_value, byteArray, 8832, 12);

    raw_value = convertPhysicalToRaw(@CAN_PrivMain::RFL_Object::RXX_Object_Obj16.Width, 0.125, 0.0);
    copyBitsToByteArrayLE(raw_value, byteArray, 8824, 7);

    raw_value = convertPhysicalToRaw(@CAN_PrivMain::RFL_Object::RXX_Object_Obj16.OrientationYawVnce, 0.0003, 0.0);
    copyBitsToByteArrayLE(raw_value, byteArray, 8812, 12);

    raw_value = convertPhysicalToRaw(@CAN_PrivMain::RFL_Object::RXX_Object_Obj16.PyVnce, 0.1, 0.0);
    copyBitsToByteArrayLE(raw_value, byteArray, 8748, 12);

    raw_value = convertPhysicalToRaw(@CAN_PrivMain::RFL_Object::RXX_Object_Obj16.OrientationYaw, 0.0175, -4.48);
    copyBitsToByteArrayLE(raw_value, byteArray, 8790, 9);

    raw_value = convertPhysicalToRaw(@CAN_PrivMain::RFL_Object::RXX_Object_Obj16.Ax, 0.03125, -16.0);
    copyBitsToByteArrayLE(raw_value, byteArray, 8780, 10);

    raw_value = convertPhysicalToRaw(@CAN_PrivMain::RFL_Object::RXX_Object_Obj16.LengthVnce, 0.01, 0.0);
    copyBitsToByteArrayLE(raw_value, byteArray, 8768, 12);

    raw_value = convertPhysicalToRaw(@CAN_PrivMain::RFL_Object::RXX_Object_Obj16.Length, 0.125, 0.0);
    copyBitsToByteArrayLE(raw_value, byteArray, 8760, 7);

    raw_value = convertPhysicalToRaw(@CAN_PrivMain::RFL_Object::RXX_Object_Obj16.Py, 0.0625, -128.0);
    copyBitsToByteArrayLE(raw_value, byteArray, 8736, 12);

    raw_value = convertPhysicalToRaw(@CAN_PrivMain::RFL_Object::RXX_Object_Obj16.PxVnce, 0.1, 0.0);
    copyBitsToByteArrayLE(raw_value, byteArray, 8724, 12);

    raw_value = convertPhysicalToRaw(@CAN_PrivMain::RFL_Object::RXX_Object_Obj16.Px, 0.0625, -512.0);
    copyBitsToByteArrayLE(raw_value, byteArray, 8710, 14);

    raw_value = convertPhysicalToRaw(@CAN_PrivMain::RFL_Object::RXX_Object_Obj16.ProbClassConfidence, 2.0, 0.0);
    copyBitsToByteArrayLE(raw_value, byteArray, 8704, 6);

    raw_value = convertPhysicalToRaw(@CAN_PrivMain::RFL_Object::RXX_Object_Obj16.MovingStatus, 1.0, 0.0);
    copyBitsToByteArrayLE(raw_value, byteArray, 8908, 2);

    raw_value = convertPhysicalToRaw(@CAN_PrivMain::RFL_Object::RXX_Object_Obj16.VxVnce, 0.01, 0.0);
    copyBitsToByteArrayLE(raw_value, byteArray, 8896, 12);

    raw_value = convertPhysicalToRaw(@CAN_PrivMain::RFL_Object::RXX_Object_Obj16.Vy, 0.125, -64.0);
    copyBitsToByteArrayLE(raw_value, byteArray, 8910, 10);

    raw_value = convertPhysicalToRaw(@CAN_PrivMain::RFL_Object::RXX_Object_Obj16.AxAyCoVnce, 0.01, 0.0);
    copyBitsToByteArrayLE(raw_value, byteArray, 9164, 12);

    raw_value = convertPhysicalToRaw(@CAN_PrivMain::RFL_Object::RXX_Object_Obj16.PxAxCoVnce, 0.01, 0.0);
    copyBitsToByteArrayLE(raw_value, byteArray, 9024, 12);

    raw_value = convertPhysicalToRaw(@CAN_PrivMain::RFL_Object::RXX_Object_Obj16.Age, 1.0, 0.0);
    copyBitsToByteArrayLE(raw_value, byteArray, 9184, 32);

    raw_value = convertPhysicalToRaw(@CAN_PrivMain::RFL_Object::RXX_Object_Obj16.ExistProb, 2.0, 0.0);
    copyBitsToByteArrayLE(raw_value, byteArray, 8920, 6);

    raw_value = convertPhysicalToRaw(@CAN_PrivMain::RFL_Object::RXX_Object_Obj16.VyAyCoVnce, 0.01, 0.0);
    copyBitsToByteArrayLE(raw_value, byteArray, 9152, 12);

    raw_value = convertPhysicalToRaw(@CAN_PrivMain::RFL_Object::RXX_Object_Obj16.VyAxCoVnce, 0.01, 0.0);
    copyBitsToByteArrayLE(raw_value, byteArray, 9132, 12);

    raw_value = convertPhysicalToRaw(@CAN_PrivMain::RFL_Object::RXX_Object_Obj16.VxAyCoVnce, 0.01, 0.0);
    copyBitsToByteArrayLE(raw_value, byteArray, 9120, 12);

    raw_value = convertPhysicalToRaw(@CAN_PrivMain::RFL_Object::RXX_Object_Obj16.VxAxCoVnce, 0.01, 0.0);
    copyBitsToByteArrayLE(raw_value, byteArray, 9100, 12);

    raw_value = convertPhysicalToRaw(@CAN_PrivMain::RFL_Object::RXX_Object_Obj16.PyAyCoVnce, 0.01, 0.0);
    copyBitsToByteArrayLE(raw_value, byteArray, 9068, 12);

    raw_value = convertPhysicalToRaw(@CAN_PrivMain::RFL_Object::RXX_Object_Obj16.PyAxCoVnce, 0.01, 0.0);
    copyBitsToByteArrayLE(raw_value, byteArray, 9056, 12);

    raw_value = convertPhysicalToRaw(@CAN_PrivMain::RFL_Object::RXX_Object_Obj16.PxAyCoVnce, 0.01, 0.0);
    copyBitsToByteArrayLE(raw_value, byteArray, 9036, 12);

    raw_value = convertPhysicalToRaw(@CAN_PrivMain::RFL_Object::RXX_Object_Obj16.VxVyCoVnce, 0.01, 0.0);
    copyBitsToByteArrayLE(raw_value, byteArray, 9088, 12);

    raw_value = convertPhysicalToRaw(@CAN_PrivMain::RFL_Object::RXX_Object_Obj16.ReferencePoint, 1.0, 0.0);
    copyBitsToByteArrayLE(raw_value, byteArray, 9016, 4);

    raw_value = convertPhysicalToRaw(@CAN_PrivMain::RFL_Object::RXX_Object_Obj16.PxVxCoVnce, 0.01, 0.0);
    copyBitsToByteArrayLE(raw_value, byteArray, 8960, 12);

    raw_value = convertPhysicalToRaw(@CAN_PrivMain::RFL_Object::RXX_Object_Obj16.PyVyCoVnce, 0.01, 0.0);
    copyBitsToByteArrayLE(raw_value, byteArray, 9004, 12);

    raw_value = convertPhysicalToRaw(@CAN_PrivMain::RFL_Object::RXX_Object_Obj16.PxPyCoVnce, 0.01, 0.0);
    copyBitsToByteArrayLE(raw_value, byteArray, 8940, 12);

    raw_value = convertPhysicalToRaw(@CAN_PrivMain::RFL_Object::RXX_Object_Obj16.MeasurementStatus, 1.0, 0.0);
    copyBitsToByteArrayLE(raw_value, byteArray, 8952, 3);

    raw_value = convertPhysicalToRaw(@CAN_PrivMain::RFL_Object::RXX_Object_Obj16.ProbClassType, 1.0, 0.0);
    copyBitsToByteArrayLE(raw_value, byteArray, 8955, 4);

    raw_value = convertPhysicalToRaw(@CAN_PrivMain::RFL_Object::RXX_Object_Obj16.VyVnce, 0.01, 0.0);
    copyBitsToByteArrayLE(raw_value, byteArray, 8928, 12);

    raw_value = convertPhysicalToRaw(@CAN_PrivMain::RFL_Object::RXX_Object_Obj16.PxVyCoVnce, 0.01, 0.0);
    copyBitsToByteArrayLE(raw_value, byteArray, 8972, 12);

    raw_value = convertPhysicalToRaw(@CAN_PrivMain::RFL_Object::RXX_Object_Obj16.FilterInformation, 1.0, 0.0);
    copyBitsToByteArrayLE(raw_value, byteArray, 8984, 8);

    raw_value = convertPhysicalToRaw(@CAN_PrivMain::RFL_Object::RXX_Object_Obj16.PyVxCoVnce, 0.01, 0.0);
    copyBitsToByteArrayLE(raw_value, byteArray, 8992, 12);
}


void RXX_Object_Obj15_write(byte byteArray[])
{
    qword raw_value;

    raw_value = convertPhysicalToRaw(@CAN_PrivMain::RFL_Object::RXX_Object_Obj15.AxVnce, 0.01, 0.0);
    copyBitsToByteArrayLE(raw_value, byteArray, 8288, 12);

    raw_value = convertPhysicalToRaw(@CAN_PrivMain::RFL_Object::RXX_Object_Obj15.VxVnce, 0.01, 0.0);
    copyBitsToByteArrayLE(raw_value, byteArray, 8384, 12);

    raw_value = convertPhysicalToRaw(@CAN_PrivMain::RFL_Object::RXX_Object_Obj15.ObjId, 1.0, 0.0);
    copyBitsToByteArrayLE(raw_value, byteArray, 8376, 7);

    raw_value = convertPhysicalToRaw(@CAN_PrivMain::RFL_Object::RXX_Object_Obj15.Vx, 0.0625, -128.0);
    copyBitsToByteArrayLE(raw_value, byteArray, 8364, 12);

    raw_value = convertPhysicalToRaw(@CAN_PrivMain::RFL_Object::RXX_Object_Obj15.AyVnce, 0.01, 0.0);
    copyBitsToByteArrayLE(raw_value, byteArray, 8352, 12);

    raw_value = convertPhysicalToRaw(@CAN_PrivMain::RFL_Object::RXX_Object_Obj15.Ay, 0.0625, -16.0);
    copyBitsToByteArrayLE(raw_value, byteArray, 8342, 9);

    raw_value = convertPhysicalToRaw(@CAN_PrivMain::RFL_Object::RXX_Object_Obj15.RCS, 0.2, -102.4);
    copyBitsToByteArrayLE(raw_value, byteArray, 8332, 10);

    raw_value = convertPhysicalToRaw(@CAN_PrivMain::RFL_Object::RXX_Object_Obj15.WidthVnce, 0.01, 0.0);
    copyBitsToByteArrayLE(raw_value, byteArray, 8320, 12);

    raw_value = convertPhysicalToRaw(@CAN_PrivMain::RFL_Object::RXX_Object_Obj15.Width, 0.125, 0.0);
    copyBitsToByteArrayLE(raw_value, byteArray, 8312, 7);

    raw_value = convertPhysicalToRaw(@CAN_PrivMain::RFL_Object::RXX_Object_Obj15.OrientationYawVnce, 0.0003, 0.0);
    copyBitsToByteArrayLE(raw_value, byteArray, 8300, 12);

    raw_value = convertPhysicalToRaw(@CAN_PrivMain::RFL_Object::RXX_Object_Obj15.Vy, 0.125, -64.0);
    copyBitsToByteArrayLE(raw_value, byteArray, 8398, 10);

    raw_value = convertPhysicalToRaw(@CAN_PrivMain::RFL_Object::RXX_Object_Obj15.OrientationYaw, 0.0175, -4.48);
    copyBitsToByteArrayLE(raw_value, byteArray, 8278, 9);

    raw_value = convertPhysicalToRaw(@CAN_PrivMain::RFL_Object::RXX_Object_Obj15.Ax, 0.03125, -16.0);
    copyBitsToByteArrayLE(raw_value, byteArray, 8268, 10);

    raw_value = convertPhysicalToRaw(@CAN_PrivMain::RFL_Object::RXX_Object_Obj15.LengthVnce, 0.01, 0.0);
    copyBitsToByteArrayLE(raw_value, byteArray, 8256, 12);

    raw_value = convertPhysicalToRaw(@CAN_PrivMain::RFL_Object::RXX_Object_Obj15.Length, 0.125, 0.0);
    copyBitsToByteArrayLE(raw_value, byteArray, 8248, 7);

    raw_value = convertPhysicalToRaw(@CAN_PrivMain::RFL_Object::RXX_Object_Obj15.PyVnce, 0.1, 0.0);
    copyBitsToByteArrayLE(raw_value, byteArray, 8236, 12);

    raw_value = convertPhysicalToRaw(@CAN_PrivMain::RFL_Object::RXX_Object_Obj15.Py, 0.0625, -128.0);
    copyBitsToByteArrayLE(raw_value, byteArray, 8224, 12);

    raw_value = convertPhysicalToRaw(@CAN_PrivMain::RFL_Object::RXX_Object_Obj15.PxVnce, 0.1, 0.0);
    copyBitsToByteArrayLE(raw_value, byteArray, 8212, 12);

    raw_value = convertPhysicalToRaw(@CAN_PrivMain::RFL_Object::RXX_Object_Obj15.Px, 0.0625, -512.0);
    copyBitsToByteArrayLE(raw_value, byteArray, 8198, 14);

    raw_value = convertPhysicalToRaw(@CAN_PrivMain::RFL_Object::RXX_Object_Obj15.ProbClassConfidence, 2.0, 0.0);
    copyBitsToByteArrayLE(raw_value, byteArray, 8192, 6);

    raw_value = convertPhysicalToRaw(@CAN_PrivMain::RFL_Object::RXX_Object_Obj15.MovingStatus, 1.0, 0.0);
    copyBitsToByteArrayLE(raw_value, byteArray, 8396, 2);

    raw_value = convertPhysicalToRaw(@CAN_PrivMain::RFL_Object::RXX_Object_Obj15.AxAyCoVnce, 0.01, 0.0);
    copyBitsToByteArrayLE(raw_value, byteArray, 8652, 12);

    raw_value = convertPhysicalToRaw(@CAN_PrivMain::RFL_Object::RXX_Object_Obj15.ExistProb, 2.0, 0.0);
    copyBitsToByteArrayLE(raw_value, byteArray, 8408, 6);

    raw_value = convertPhysicalToRaw(@CAN_PrivMain::RFL_Object::RXX_Object_Obj15.PxAxCoVnce, 0.01, 0.0);
    copyBitsToByteArrayLE(raw_value, byteArray, 8512, 12);

    raw_value = convertPhysicalToRaw(@CAN_PrivMain::RFL_Object::RXX_Object_Obj15.VyVnce, 0.01, 0.0);
    copyBitsToByteArrayLE(raw_value, byteArray, 8416, 12);

    raw_value = convertPhysicalToRaw(@CAN_PrivMain::RFL_Object::RXX_Object_Obj15.VyAyCoVnce, 0.01, 0.0);
    copyBitsToByteArrayLE(raw_value, byteArray, 8640, 12);

    raw_value = convertPhysicalToRaw(@CAN_PrivMain::RFL_Object::RXX_Object_Obj15.VyAxCoVnce, 0.01, 0.0);
    copyBitsToByteArrayLE(raw_value, byteArray, 8620, 12);

    raw_value = convertPhysicalToRaw(@CAN_PrivMain::RFL_Object::RXX_Object_Obj15.VxAyCoVnce, 0.01, 0.0);
    copyBitsToByteArrayLE(raw_value, byteArray, 8608, 12);

    raw_value = convertPhysicalToRaw(@CAN_PrivMain::RFL_Object::RXX_Object_Obj15.VxAxCoVnce, 0.01, 0.0);
    copyBitsToByteArrayLE(raw_value, byteArray, 8588, 12);

    raw_value = convertPhysicalToRaw(@CAN_PrivMain::RFL_Object::RXX_Object_Obj15.VxVyCoVnce, 0.01, 0.0);
    copyBitsToByteArrayLE(raw_value, byteArray, 8576, 12);

    raw_value = convertPhysicalToRaw(@CAN_PrivMain::RFL_Object::RXX_Object_Obj15.PyAyCoVnce, 0.01, 0.0);
    copyBitsToByteArrayLE(raw_value, byteArray, 8556, 12);

    raw_value = convertPhysicalToRaw(@CAN_PrivMain::RFL_Object::RXX_Object_Obj15.PyAxCoVnce, 0.01, 0.0);
    copyBitsToByteArrayLE(raw_value, byteArray, 8544, 12);

    raw_value = convertPhysicalToRaw(@CAN_PrivMain::RFL_Object::RXX_Object_Obj15.PxAyCoVnce, 0.01, 0.0);
    copyBitsToByteArrayLE(raw_value, byteArray, 8524, 12);

    raw_value = convertPhysicalToRaw(@CAN_PrivMain::RFL_Object::RXX_Object_Obj15.Age, 1.0, 0.0);
    copyBitsToByteArrayLE(raw_value, byteArray, 8672, 32);

    raw_value = convertPhysicalToRaw(@CAN_PrivMain::RFL_Object::RXX_Object_Obj15.ReferencePoint, 1.0, 0.0);
    copyBitsToByteArrayLE(raw_value, byteArray, 8504, 4);

    raw_value = convertPhysicalToRaw(@CAN_PrivMain::RFL_Object::RXX_Object_Obj15.PxVxCoVnce, 0.01, 0.0);
    copyBitsToByteArrayLE(raw_value, byteArray, 8448, 12);

    raw_value = convertPhysicalToRaw(@CAN_PrivMain::RFL_Object::RXX_Object_Obj15.PyVyCoVnce, 0.01, 0.0);
    copyBitsToByteArrayLE(raw_value, byteArray, 8492, 12);

    raw_value = convertPhysicalToRaw(@CAN_PrivMain::RFL_Object::RXX_Object_Obj15.MeasurementStatus, 1.0, 0.0);
    copyBitsToByteArrayLE(raw_value, byteArray, 8440, 3);

    raw_value = convertPhysicalToRaw(@CAN_PrivMain::RFL_Object::RXX_Object_Obj15.ProbClassType, 1.0, 0.0);
    copyBitsToByteArrayLE(raw_value, byteArray, 8443, 4);

    raw_value = convertPhysicalToRaw(@CAN_PrivMain::RFL_Object::RXX_Object_Obj15.PxPyCoVnce, 0.01, 0.0);
    copyBitsToByteArrayLE(raw_value, byteArray, 8428, 12);

    raw_value = convertPhysicalToRaw(@CAN_PrivMain::RFL_Object::RXX_Object_Obj15.PxVyCoVnce, 0.01, 0.0);
    copyBitsToByteArrayLE(raw_value, byteArray, 8460, 12);

    raw_value = convertPhysicalToRaw(@CAN_PrivMain::RFL_Object::RXX_Object_Obj15.FilterInformation, 1.0, 0.0);
    copyBitsToByteArrayLE(raw_value, byteArray, 8472, 8);

    raw_value = convertPhysicalToRaw(@CAN_PrivMain::RFL_Object::RXX_Object_Obj15.PyVxCoVnce, 0.01, 0.0);
    copyBitsToByteArrayLE(raw_value, byteArray, 8480, 12);
}


void RXX_Object_Obj14_write(byte byteArray[])
{
    qword raw_value;

    raw_value = convertPhysicalToRaw(@CAN_PrivMain::RFL_Object::RXX_Object_Obj14.VxVnce, 0.01, 0.0);
    copyBitsToByteArrayLE(raw_value, byteArray, 7872, 12);

    raw_value = convertPhysicalToRaw(@CAN_PrivMain::RFL_Object::RXX_Object_Obj14.AxVnce, 0.01, 0.0);
    copyBitsToByteArrayLE(raw_value, byteArray, 7776, 12);

    raw_value = convertPhysicalToRaw(@CAN_PrivMain::RFL_Object::RXX_Object_Obj14.ObjId, 1.0, 0.0);
    copyBitsToByteArrayLE(raw_value, byteArray, 7864, 7);

    raw_value = convertPhysicalToRaw(@CAN_PrivMain::RFL_Object::RXX_Object_Obj14.Vx, 0.0625, -128.0);
    copyBitsToByteArrayLE(raw_value, byteArray, 7852, 12);

    raw_value = convertPhysicalToRaw(@CAN_PrivMain::RFL_Object::RXX_Object_Obj14.AyVnce, 0.01, 0.0);
    copyBitsToByteArrayLE(raw_value, byteArray, 7840, 12);

    raw_value = convertPhysicalToRaw(@CAN_PrivMain::RFL_Object::RXX_Object_Obj14.Ay, 0.0625, -16.0);
    copyBitsToByteArrayLE(raw_value, byteArray, 7830, 9);

    raw_value = convertPhysicalToRaw(@CAN_PrivMain::RFL_Object::RXX_Object_Obj14.RCS, 0.2, -102.4);
    copyBitsToByteArrayLE(raw_value, byteArray, 7820, 10);

    raw_value = convertPhysicalToRaw(@CAN_PrivMain::RFL_Object::RXX_Object_Obj14.WidthVnce, 0.01, 0.0);
    copyBitsToByteArrayLE(raw_value, byteArray, 7808, 12);

    raw_value = convertPhysicalToRaw(@CAN_PrivMain::RFL_Object::RXX_Object_Obj14.Width, 0.125, 0.0);
    copyBitsToByteArrayLE(raw_value, byteArray, 7800, 7);

    raw_value = convertPhysicalToRaw(@CAN_PrivMain::RFL_Object::RXX_Object_Obj14.OrientationYawVnce, 0.0003, 0.0);
    copyBitsToByteArrayLE(raw_value, byteArray, 7788, 12);

    raw_value = convertPhysicalToRaw(@CAN_PrivMain::RFL_Object::RXX_Object_Obj14.Length, 0.125, 0.0);
    copyBitsToByteArrayLE(raw_value, byteArray, 7736, 7);

    raw_value = convertPhysicalToRaw(@CAN_PrivMain::RFL_Object::RXX_Object_Obj14.OrientationYaw, 0.0175, -4.48);
    copyBitsToByteArrayLE(raw_value, byteArray, 7766, 9);

    raw_value = convertPhysicalToRaw(@CAN_PrivMain::RFL_Object::RXX_Object_Obj14.Ax, 0.03125, -16.0);
    copyBitsToByteArrayLE(raw_value, byteArray, 7756, 10);

    raw_value = convertPhysicalToRaw(@CAN_PrivMain::RFL_Object::RXX_Object_Obj14.LengthVnce, 0.01, 0.0);
    copyBitsToByteArrayLE(raw_value, byteArray, 7744, 12);

    raw_value = convertPhysicalToRaw(@CAN_PrivMain::RFL_Object::RXX_Object_Obj14.PyVnce, 0.1, 0.0);
    copyBitsToByteArrayLE(raw_value, byteArray, 7724, 12);

    raw_value = convertPhysicalToRaw(@CAN_PrivMain::RFL_Object::RXX_Object_Obj14.Py, 0.0625, -128.0);
    copyBitsToByteArrayLE(raw_value, byteArray, 7712, 12);

    raw_value = convertPhysicalToRaw(@CAN_PrivMain::RFL_Object::RXX_Object_Obj14.PxVnce, 0.1, 0.0);
    copyBitsToByteArrayLE(raw_value, byteArray, 7700, 12);

    raw_value = convertPhysicalToRaw(@CAN_PrivMain::RFL_Object::RXX_Object_Obj14.Px, 0.0625, -512.0);
    copyBitsToByteArrayLE(raw_value, byteArray, 7686, 14);

    raw_value = convertPhysicalToRaw(@CAN_PrivMain::RFL_Object::RXX_Object_Obj14.ProbClassConfidence, 2.0, 0.0);
    copyBitsToByteArrayLE(raw_value, byteArray, 7680, 6);

    raw_value = convertPhysicalToRaw(@CAN_PrivMain::RFL_Object::RXX_Object_Obj14.Vy, 0.125, -64.0);
    copyBitsToByteArrayLE(raw_value, byteArray, 7886, 10);

    raw_value = convertPhysicalToRaw(@CAN_PrivMain::RFL_Object::RXX_Object_Obj14.MovingStatus, 1.0, 0.0);
    copyBitsToByteArrayLE(raw_value, byteArray, 7884, 2);

    raw_value = convertPhysicalToRaw(@CAN_PrivMain::RFL_Object::RXX_Object_Obj14.Age, 1.0, 0.0);
    copyBitsToByteArrayLE(raw_value, byteArray, 8160, 32);

    raw_value = convertPhysicalToRaw(@CAN_PrivMain::RFL_Object::RXX_Object_Obj14.ExistProb, 2.0, 0.0);
    copyBitsToByteArrayLE(raw_value, byteArray, 7896, 6);

    raw_value = convertPhysicalToRaw(@CAN_PrivMain::RFL_Object::RXX_Object_Obj14.PxAxCoVnce, 0.01, 0.0);
    copyBitsToByteArrayLE(raw_value, byteArray, 8000, 12);

    raw_value = convertPhysicalToRaw(@CAN_PrivMain::RFL_Object::RXX_Object_Obj14.VyVnce, 0.01, 0.0);
    copyBitsToByteArrayLE(raw_value, byteArray, 7904, 12);

    raw_value = convertPhysicalToRaw(@CAN_PrivMain::RFL_Object::RXX_Object_Obj14.VyAyCoVnce, 0.01, 0.0);
    copyBitsToByteArrayLE(raw_value, byteArray, 8128, 12);

    raw_value = convertPhysicalToRaw(@CAN_PrivMain::RFL_Object::RXX_Object_Obj14.VyAxCoVnce, 0.01, 0.0);
    copyBitsToByteArrayLE(raw_value, byteArray, 8108, 12);

    raw_value = convertPhysicalToRaw(@CAN_PrivMain::RFL_Object::RXX_Object_Obj14.VxAyCoVnce, 0.01, 0.0);
    copyBitsToByteArrayLE(raw_value, byteArray, 8096, 12);

    raw_value = convertPhysicalToRaw(@CAN_PrivMain::RFL_Object::RXX_Object_Obj14.VxAxCoVnce, 0.01, 0.0);
    copyBitsToByteArrayLE(raw_value, byteArray, 8076, 12);

    raw_value = convertPhysicalToRaw(@CAN_PrivMain::RFL_Object::RXX_Object_Obj14.VxVyCoVnce, 0.01, 0.0);
    copyBitsToByteArrayLE(raw_value, byteArray, 8064, 12);

    raw_value = convertPhysicalToRaw(@CAN_PrivMain::RFL_Object::RXX_Object_Obj14.PyAyCoVnce, 0.01, 0.0);
    copyBitsToByteArrayLE(raw_value, byteArray, 8044, 12);

    raw_value = convertPhysicalToRaw(@CAN_PrivMain::RFL_Object::RXX_Object_Obj14.PyAxCoVnce, 0.01, 0.0);
    copyBitsToByteArrayLE(raw_value, byteArray, 8032, 12);

    raw_value = convertPhysicalToRaw(@CAN_PrivMain::RFL_Object::RXX_Object_Obj14.PxAyCoVnce, 0.01, 0.0);
    copyBitsToByteArrayLE(raw_value, byteArray, 8012, 12);

    raw_value = convertPhysicalToRaw(@CAN_PrivMain::RFL_Object::RXX_Object_Obj14.AxAyCoVnce, 0.01, 0.0);
    copyBitsToByteArrayLE(raw_value, byteArray, 8140, 12);

    raw_value = convertPhysicalToRaw(@CAN_PrivMain::RFL_Object::RXX_Object_Obj14.ReferencePoint, 1.0, 0.0);
    copyBitsToByteArrayLE(raw_value, byteArray, 7992, 4);

    raw_value = convertPhysicalToRaw(@CAN_PrivMain::RFL_Object::RXX_Object_Obj14.PyVxCoVnce, 0.01, 0.0);
    copyBitsToByteArrayLE(raw_value, byteArray, 7968, 12);

    raw_value = convertPhysicalToRaw(@CAN_PrivMain::RFL_Object::RXX_Object_Obj14.FilterInformation, 1.0, 0.0);
    copyBitsToByteArrayLE(raw_value, byteArray, 7960, 8);

    raw_value = convertPhysicalToRaw(@CAN_PrivMain::RFL_Object::RXX_Object_Obj14.PxVyCoVnce, 0.01, 0.0);
    copyBitsToByteArrayLE(raw_value, byteArray, 7948, 12);

    raw_value = convertPhysicalToRaw(@CAN_PrivMain::RFL_Object::RXX_Object_Obj14.PxVxCoVnce, 0.01, 0.0);
    copyBitsToByteArrayLE(raw_value, byteArray, 7936, 12);

    raw_value = convertPhysicalToRaw(@CAN_PrivMain::RFL_Object::RXX_Object_Obj14.ProbClassType, 1.0, 0.0);
    copyBitsToByteArrayLE(raw_value, byteArray, 7931, 4);

    raw_value = convertPhysicalToRaw(@CAN_PrivMain::RFL_Object::RXX_Object_Obj14.MeasurementStatus, 1.0, 0.0);
    copyBitsToByteArrayLE(raw_value, byteArray, 7928, 3);

    raw_value = convertPhysicalToRaw(@CAN_PrivMain::RFL_Object::RXX_Object_Obj14.PxPyCoVnce, 0.01, 0.0);
    copyBitsToByteArrayLE(raw_value, byteArray, 7916, 12);

    raw_value = convertPhysicalToRaw(@CAN_PrivMain::RFL_Object::RXX_Object_Obj14.PyVyCoVnce, 0.01, 0.0);
    copyBitsToByteArrayLE(raw_value, byteArray, 7980, 12);
}


void RXX_Object_Obj13_write(byte byteArray[])
{
    qword raw_value;

    raw_value = convertPhysicalToRaw(@CAN_PrivMain::RFL_Object::RXX_Object_Obj13.Ay, 0.0625, -16.0);
    copyBitsToByteArrayLE(raw_value, byteArray, 7318, 9);

    raw_value = convertPhysicalToRaw(@CAN_PrivMain::RFL_Object::RXX_Object_Obj13.WidthVnce, 0.01, 0.0);
    copyBitsToByteArrayLE(raw_value, byteArray, 7296, 12);

    raw_value = convertPhysicalToRaw(@CAN_PrivMain::RFL_Object::RXX_Object_Obj13.RCS, 0.2, -102.4);
    copyBitsToByteArrayLE(raw_value, byteArray, 7308, 10);

    raw_value = convertPhysicalToRaw(@CAN_PrivMain::RFL_Object::RXX_Object_Obj13.VxVnce, 0.01, 0.0);
    copyBitsToByteArrayLE(raw_value, byteArray, 7360, 12);

    raw_value = convertPhysicalToRaw(@CAN_PrivMain::RFL_Object::RXX_Object_Obj13.AyVnce, 0.01, 0.0);
    copyBitsToByteArrayLE(raw_value, byteArray, 7328, 12);

    raw_value = convertPhysicalToRaw(@CAN_PrivMain::RFL_Object::RXX_Object_Obj13.Vx, 0.0625, -128.0);
    copyBitsToByteArrayLE(raw_value, byteArray, 7340, 12);

    raw_value = convertPhysicalToRaw(@CAN_PrivMain::RFL_Object::RXX_Object_Obj13.ObjId, 1.0, 0.0);
    copyBitsToByteArrayLE(raw_value, byteArray, 7352, 7);

    raw_value = convertPhysicalToRaw(@CAN_PrivMain::RFL_Object::RXX_Object_Obj13.OrientationYawVnce, 0.0003, 0.0);
    copyBitsToByteArrayLE(raw_value, byteArray, 7276, 12);

    raw_value = convertPhysicalToRaw(@CAN_PrivMain::RFL_Object::RXX_Object_Obj13.Width, 0.125, 0.0);
    copyBitsToByteArrayLE(raw_value, byteArray, 7288, 7);

    raw_value = convertPhysicalToRaw(@CAN_PrivMain::RFL_Object::RXX_Object_Obj13.Length, 0.125, 0.0);
    copyBitsToByteArrayLE(raw_value, byteArray, 7224, 7);

    raw_value = convertPhysicalToRaw(@CAN_PrivMain::RFL_Object::RXX_Object_Obj13.AxVnce, 0.01, 0.0);
    copyBitsToByteArrayLE(raw_value, byteArray, 7264, 12);

    raw_value = convertPhysicalToRaw(@CAN_PrivMain::RFL_Object::RXX_Object_Obj13.OrientationYaw, 0.0175, -4.48);
    copyBitsToByteArrayLE(raw_value, byteArray, 7254, 9);

    raw_value = convertPhysicalToRaw(@CAN_PrivMain::RFL_Object::RXX_Object_Obj13.Ax, 0.03125, -16.0);
    copyBitsToByteArrayLE(raw_value, byteArray, 7244, 10);

    raw_value = convertPhysicalToRaw(@CAN_PrivMain::RFL_Object::RXX_Object_Obj13.LengthVnce, 0.01, 0.0);
    copyBitsToByteArrayLE(raw_value, byteArray, 7232, 12);

    raw_value = convertPhysicalToRaw(@CAN_PrivMain::RFL_Object::RXX_Object_Obj13.PyVnce, 0.1, 0.0);
    copyBitsToByteArrayLE(raw_value, byteArray, 7212, 12);

    raw_value = convertPhysicalToRaw(@CAN_PrivMain::RFL_Object::RXX_Object_Obj13.Py, 0.0625, -128.0);
    copyBitsToByteArrayLE(raw_value, byteArray, 7200, 12);

    raw_value = convertPhysicalToRaw(@CAN_PrivMain::RFL_Object::RXX_Object_Obj13.PxVnce, 0.1, 0.0);
    copyBitsToByteArrayLE(raw_value, byteArray, 7188, 12);

    raw_value = convertPhysicalToRaw(@CAN_PrivMain::RFL_Object::RXX_Object_Obj13.Px, 0.0625, -512.0);
    copyBitsToByteArrayLE(raw_value, byteArray, 7174, 14);

    raw_value = convertPhysicalToRaw(@CAN_PrivMain::RFL_Object::RXX_Object_Obj13.ProbClassConfidence, 2.0, 0.0);
    copyBitsToByteArrayLE(raw_value, byteArray, 7168, 6);

    raw_value = convertPhysicalToRaw(@CAN_PrivMain::RFL_Object::RXX_Object_Obj13.MovingStatus, 1.0, 0.0);
    copyBitsToByteArrayLE(raw_value, byteArray, 7372, 2);

    raw_value = convertPhysicalToRaw(@CAN_PrivMain::RFL_Object::RXX_Object_Obj13.Vy, 0.125, -64.0);
    copyBitsToByteArrayLE(raw_value, byteArray, 7374, 10);

    raw_value = convertPhysicalToRaw(@CAN_PrivMain::RFL_Object::RXX_Object_Obj13.ExistProb, 2.0, 0.0);
    copyBitsToByteArrayLE(raw_value, byteArray, 7384, 6);

    raw_value = convertPhysicalToRaw(@CAN_PrivMain::RFL_Object::RXX_Object_Obj13.PxAyCoVnce, 0.01, 0.0);
    copyBitsToByteArrayLE(raw_value, byteArray, 7500, 12);

    raw_value = convertPhysicalToRaw(@CAN_PrivMain::RFL_Object::RXX_Object_Obj13.Age, 1.0, 0.0);
    copyBitsToByteArrayLE(raw_value, byteArray, 7648, 32);

    raw_value = convertPhysicalToRaw(@CAN_PrivMain::RFL_Object::RXX_Object_Obj13.VyVnce, 0.01, 0.0);
    copyBitsToByteArrayLE(raw_value, byteArray, 7392, 12);

    raw_value = convertPhysicalToRaw(@CAN_PrivMain::RFL_Object::RXX_Object_Obj13.AxAyCoVnce, 0.01, 0.0);
    copyBitsToByteArrayLE(raw_value, byteArray, 7628, 12);

    raw_value = convertPhysicalToRaw(@CAN_PrivMain::RFL_Object::RXX_Object_Obj13.VyAyCoVnce, 0.01, 0.0);
    copyBitsToByteArrayLE(raw_value, byteArray, 7616, 12);

    raw_value = convertPhysicalToRaw(@CAN_PrivMain::RFL_Object::RXX_Object_Obj13.VyAxCoVnce, 0.01, 0.0);
    copyBitsToByteArrayLE(raw_value, byteArray, 7596, 12);

    raw_value = convertPhysicalToRaw(@CAN_PrivMain::RFL_Object::RXX_Object_Obj13.VxAyCoVnce, 0.01, 0.0);
    copyBitsToByteArrayLE(raw_value, byteArray, 7584, 12);

    raw_value = convertPhysicalToRaw(@CAN_PrivMain::RFL_Object::RXX_Object_Obj13.VxAxCoVnce, 0.01, 0.0);
    copyBitsToByteArrayLE(raw_value, byteArray, 7564, 12);

    raw_value = convertPhysicalToRaw(@CAN_PrivMain::RFL_Object::RXX_Object_Obj13.PyAyCoVnce, 0.01, 0.0);
    copyBitsToByteArrayLE(raw_value, byteArray, 7532, 12);

    raw_value = convertPhysicalToRaw(@CAN_PrivMain::RFL_Object::RXX_Object_Obj13.PyAxCoVnce, 0.01, 0.0);
    copyBitsToByteArrayLE(raw_value, byteArray, 7520, 12);

    raw_value = convertPhysicalToRaw(@CAN_PrivMain::RFL_Object::RXX_Object_Obj13.VxVyCoVnce, 0.01, 0.0);
    copyBitsToByteArrayLE(raw_value, byteArray, 7552, 12);

    raw_value = convertPhysicalToRaw(@CAN_PrivMain::RFL_Object::RXX_Object_Obj13.PxAxCoVnce, 0.01, 0.0);
    copyBitsToByteArrayLE(raw_value, byteArray, 7488, 12);

    raw_value = convertPhysicalToRaw(@CAN_PrivMain::RFL_Object::RXX_Object_Obj13.PxVyCoVnce, 0.01, 0.0);
    copyBitsToByteArrayLE(raw_value, byteArray, 7436, 12);

    raw_value = convertPhysicalToRaw(@CAN_PrivMain::RFL_Object::RXX_Object_Obj13.PxPyCoVnce, 0.01, 0.0);
    copyBitsToByteArrayLE(raw_value, byteArray, 7404, 12);

    raw_value = convertPhysicalToRaw(@CAN_PrivMain::RFL_Object::RXX_Object_Obj13.ReferencePoint, 1.0, 0.0);
    copyBitsToByteArrayLE(raw_value, byteArray, 7480, 4);

    raw_value = convertPhysicalToRaw(@CAN_PrivMain::RFL_Object::RXX_Object_Obj13.ProbClassType, 1.0, 0.0);
    copyBitsToByteArrayLE(raw_value, byteArray, 7419, 4);

    raw_value = convertPhysicalToRaw(@CAN_PrivMain::RFL_Object::RXX_Object_Obj13.PxVxCoVnce, 0.01, 0.0);
    copyBitsToByteArrayLE(raw_value, byteArray, 7424, 12);

    raw_value = convertPhysicalToRaw(@CAN_PrivMain::RFL_Object::RXX_Object_Obj13.MeasurementStatus, 1.0, 0.0);
    copyBitsToByteArrayLE(raw_value, byteArray, 7416, 3);

    raw_value = convertPhysicalToRaw(@CAN_PrivMain::RFL_Object::RXX_Object_Obj13.FilterInformation, 1.0, 0.0);
    copyBitsToByteArrayLE(raw_value, byteArray, 7448, 8);

    raw_value = convertPhysicalToRaw(@CAN_PrivMain::RFL_Object::RXX_Object_Obj13.PyVxCoVnce, 0.01, 0.0);
    copyBitsToByteArrayLE(raw_value, byteArray, 7456, 12);

    raw_value = convertPhysicalToRaw(@CAN_PrivMain::RFL_Object::RXX_Object_Obj13.PyVyCoVnce, 0.01, 0.0);
    copyBitsToByteArrayLE(raw_value, byteArray, 7468, 12);
}


void RXX_Object_Obj12_write(byte byteArray[])
{
    qword raw_value;

    raw_value = convertPhysicalToRaw(@CAN_PrivMain::RFL_Object::RXX_Object_Obj12.Width, 0.125, 0.0);
    copyBitsToByteArrayLE(raw_value, byteArray, 6776, 7);

    raw_value = convertPhysicalToRaw(@CAN_PrivMain::RFL_Object::RXX_Object_Obj12.Vy, 0.125, -64.0);
    copyBitsToByteArrayLE(raw_value, byteArray, 6862, 10);

    raw_value = convertPhysicalToRaw(@CAN_PrivMain::RFL_Object::RXX_Object_Obj12.VxVnce, 0.01, 0.0);
    copyBitsToByteArrayLE(raw_value, byteArray, 6848, 12);

    raw_value = convertPhysicalToRaw(@CAN_PrivMain::RFL_Object::RXX_Object_Obj12.ObjId, 1.0, 0.0);
    copyBitsToByteArrayLE(raw_value, byteArray, 6840, 7);

    raw_value = convertPhysicalToRaw(@CAN_PrivMain::RFL_Object::RXX_Object_Obj12.Vx, 0.0625, -128.0);
    copyBitsToByteArrayLE(raw_value, byteArray, 6828, 12);

    raw_value = convertPhysicalToRaw(@CAN_PrivMain::RFL_Object::RXX_Object_Obj12.AyVnce, 0.01, 0.0);
    copyBitsToByteArrayLE(raw_value, byteArray, 6816, 12);

    raw_value = convertPhysicalToRaw(@CAN_PrivMain::RFL_Object::RXX_Object_Obj12.Ay, 0.0625, -16.0);
    copyBitsToByteArrayLE(raw_value, byteArray, 6806, 9);

    raw_value = convertPhysicalToRaw(@CAN_PrivMain::RFL_Object::RXX_Object_Obj12.RCS, 0.2, -102.4);
    copyBitsToByteArrayLE(raw_value, byteArray, 6796, 10);

    raw_value = convertPhysicalToRaw(@CAN_PrivMain::RFL_Object::RXX_Object_Obj12.WidthVnce, 0.01, 0.0);
    copyBitsToByteArrayLE(raw_value, byteArray, 6784, 12);

    raw_value = convertPhysicalToRaw(@CAN_PrivMain::RFL_Object::RXX_Object_Obj12.ProbClassConfidence, 2.0, 0.0);
    copyBitsToByteArrayLE(raw_value, byteArray, 6656, 6);

    raw_value = convertPhysicalToRaw(@CAN_PrivMain::RFL_Object::RXX_Object_Obj12.OrientationYawVnce, 0.0003, 0.0);
    copyBitsToByteArrayLE(raw_value, byteArray, 6764, 12);

    raw_value = convertPhysicalToRaw(@CAN_PrivMain::RFL_Object::RXX_Object_Obj12.AxVnce, 0.01, 0.0);
    copyBitsToByteArrayLE(raw_value, byteArray, 6752, 12);

    raw_value = convertPhysicalToRaw(@CAN_PrivMain::RFL_Object::RXX_Object_Obj12.OrientationYaw, 0.0175, -4.48);
    copyBitsToByteArrayLE(raw_value, byteArray, 6742, 9);

    raw_value = convertPhysicalToRaw(@CAN_PrivMain::RFL_Object::RXX_Object_Obj12.LengthVnce, 0.01, 0.0);
    copyBitsToByteArrayLE(raw_value, byteArray, 6720, 12);

    raw_value = convertPhysicalToRaw(@CAN_PrivMain::RFL_Object::RXX_Object_Obj12.Length, 0.125, 0.0);
    copyBitsToByteArrayLE(raw_value, byteArray, 6712, 7);

    raw_value = convertPhysicalToRaw(@CAN_PrivMain::RFL_Object::RXX_Object_Obj12.PyVnce, 0.1, 0.0);
    copyBitsToByteArrayLE(raw_value, byteArray, 6700, 12);

    raw_value = convertPhysicalToRaw(@CAN_PrivMain::RFL_Object::RXX_Object_Obj12.Py, 0.0625, -128.0);
    copyBitsToByteArrayLE(raw_value, byteArray, 6688, 12);

    raw_value = convertPhysicalToRaw(@CAN_PrivMain::RFL_Object::RXX_Object_Obj12.PxVnce, 0.1, 0.0);
    copyBitsToByteArrayLE(raw_value, byteArray, 6676, 12);

    raw_value = convertPhysicalToRaw(@CAN_PrivMain::RFL_Object::RXX_Object_Obj12.Px, 0.0625, -512.0);
    copyBitsToByteArrayLE(raw_value, byteArray, 6662, 14);

    raw_value = convertPhysicalToRaw(@CAN_PrivMain::RFL_Object::RXX_Object_Obj12.MovingStatus, 1.0, 0.0);
    copyBitsToByteArrayLE(raw_value, byteArray, 6860, 2);

    raw_value = convertPhysicalToRaw(@CAN_PrivMain::RFL_Object::RXX_Object_Obj12.Ax, 0.03125, -16.0);
    copyBitsToByteArrayLE(raw_value, byteArray, 6732, 10);

    raw_value = convertPhysicalToRaw(@CAN_PrivMain::RFL_Object::RXX_Object_Obj12.ExistProb, 2.0, 0.0);
    copyBitsToByteArrayLE(raw_value, byteArray, 6872, 6);

    raw_value = convertPhysicalToRaw(@CAN_PrivMain::RFL_Object::RXX_Object_Obj12.PyAxCoVnce, 0.01, 0.0);
    copyBitsToByteArrayLE(raw_value, byteArray, 7008, 12);

    raw_value = convertPhysicalToRaw(@CAN_PrivMain::RFL_Object::RXX_Object_Obj12.VyVnce, 0.01, 0.0);
    copyBitsToByteArrayLE(raw_value, byteArray, 6880, 12);

    raw_value = convertPhysicalToRaw(@CAN_PrivMain::RFL_Object::RXX_Object_Obj12.Age, 1.0, 0.0);
    copyBitsToByteArrayLE(raw_value, byteArray, 7136, 32);

    raw_value = convertPhysicalToRaw(@CAN_PrivMain::RFL_Object::RXX_Object_Obj12.AxAyCoVnce, 0.01, 0.0);
    copyBitsToByteArrayLE(raw_value, byteArray, 7116, 12);

    raw_value = convertPhysicalToRaw(@CAN_PrivMain::RFL_Object::RXX_Object_Obj12.VyAyCoVnce, 0.01, 0.0);
    copyBitsToByteArrayLE(raw_value, byteArray, 7104, 12);

    raw_value = convertPhysicalToRaw(@CAN_PrivMain::RFL_Object::RXX_Object_Obj12.VyAxCoVnce, 0.01, 0.0);
    copyBitsToByteArrayLE(raw_value, byteArray, 7084, 12);

    raw_value = convertPhysicalToRaw(@CAN_PrivMain::RFL_Object::RXX_Object_Obj12.VxAyCoVnce, 0.01, 0.0);
    copyBitsToByteArrayLE(raw_value, byteArray, 7072, 12);

    raw_value = convertPhysicalToRaw(@CAN_PrivMain::RFL_Object::RXX_Object_Obj12.VxAxCoVnce, 0.01, 0.0);
    copyBitsToByteArrayLE(raw_value, byteArray, 7052, 12);

    raw_value = convertPhysicalToRaw(@CAN_PrivMain::RFL_Object::RXX_Object_Obj12.VxVyCoVnce, 0.01, 0.0);
    copyBitsToByteArrayLE(raw_value, byteArray, 7040, 12);

    raw_value = convertPhysicalToRaw(@CAN_PrivMain::RFL_Object::RXX_Object_Obj12.PyAyCoVnce, 0.01, 0.0);
    copyBitsToByteArrayLE(raw_value, byteArray, 7020, 12);

    raw_value = convertPhysicalToRaw(@CAN_PrivMain::RFL_Object::RXX_Object_Obj12.PxPyCoVnce, 0.01, 0.0);
    copyBitsToByteArrayLE(raw_value, byteArray, 6892, 12);

    raw_value = convertPhysicalToRaw(@CAN_PrivMain::RFL_Object::RXX_Object_Obj12.PxAyCoVnce, 0.01, 0.0);
    copyBitsToByteArrayLE(raw_value, byteArray, 6988, 12);

    raw_value = convertPhysicalToRaw(@CAN_PrivMain::RFL_Object::RXX_Object_Obj12.PxVyCoVnce, 0.01, 0.0);
    copyBitsToByteArrayLE(raw_value, byteArray, 6924, 12);

    raw_value = convertPhysicalToRaw(@CAN_PrivMain::RFL_Object::RXX_Object_Obj12.MeasurementStatus, 1.0, 0.0);
    copyBitsToByteArrayLE(raw_value, byteArray, 6904, 3);

    raw_value = convertPhysicalToRaw(@CAN_PrivMain::RFL_Object::RXX_Object_Obj12.ProbClassType, 1.0, 0.0);
    copyBitsToByteArrayLE(raw_value, byteArray, 6907, 4);

    raw_value = convertPhysicalToRaw(@CAN_PrivMain::RFL_Object::RXX_Object_Obj12.PxVxCoVnce, 0.01, 0.0);
    copyBitsToByteArrayLE(raw_value, byteArray, 6912, 12);

    raw_value = convertPhysicalToRaw(@CAN_PrivMain::RFL_Object::RXX_Object_Obj12.PxAxCoVnce, 0.01, 0.0);
    copyBitsToByteArrayLE(raw_value, byteArray, 6976, 12);

    raw_value = convertPhysicalToRaw(@CAN_PrivMain::RFL_Object::RXX_Object_Obj12.FilterInformation, 1.0, 0.0);
    copyBitsToByteArrayLE(raw_value, byteArray, 6936, 8);

    raw_value = convertPhysicalToRaw(@CAN_PrivMain::RFL_Object::RXX_Object_Obj12.PyVxCoVnce, 0.01, 0.0);
    copyBitsToByteArrayLE(raw_value, byteArray, 6944, 12);

    raw_value = convertPhysicalToRaw(@CAN_PrivMain::RFL_Object::RXX_Object_Obj12.PyVyCoVnce, 0.01, 0.0);
    copyBitsToByteArrayLE(raw_value, byteArray, 6956, 12);

    raw_value = convertPhysicalToRaw(@CAN_PrivMain::RFL_Object::RXX_Object_Obj12.ReferencePoint, 1.0, 0.0);
    copyBitsToByteArrayLE(raw_value, byteArray, 6968, 4);
}


void RXX_Object_Obj11_write(byte byteArray[])
{
    qword raw_value;

    raw_value = convertPhysicalToRaw(@CAN_PrivMain::RFL_Object::RXX_Object_Obj11.AxVnce, 0.01, 0.0);
    copyBitsToByteArrayLE(raw_value, byteArray, 6240, 12);

    raw_value = convertPhysicalToRaw(@CAN_PrivMain::RFL_Object::RXX_Object_Obj11.VxVnce, 0.01, 0.0);
    copyBitsToByteArrayLE(raw_value, byteArray, 6336, 12);

    raw_value = convertPhysicalToRaw(@CAN_PrivMain::RFL_Object::RXX_Object_Obj11.ObjId, 1.0, 0.0);
    copyBitsToByteArrayLE(raw_value, byteArray, 6328, 7);

    raw_value = convertPhysicalToRaw(@CAN_PrivMain::RFL_Object::RXX_Object_Obj11.Vx, 0.0625, -128.0);
    copyBitsToByteArrayLE(raw_value, byteArray, 6316, 12);

    raw_value = convertPhysicalToRaw(@CAN_PrivMain::RFL_Object::RXX_Object_Obj11.AyVnce, 0.01, 0.0);
    copyBitsToByteArrayLE(raw_value, byteArray, 6304, 12);

    raw_value = convertPhysicalToRaw(@CAN_PrivMain::RFL_Object::RXX_Object_Obj11.RCS, 0.2, -102.4);
    copyBitsToByteArrayLE(raw_value, byteArray, 6284, 10);

    raw_value = convertPhysicalToRaw(@CAN_PrivMain::RFL_Object::RXX_Object_Obj11.WidthVnce, 0.01, 0.0);
    copyBitsToByteArrayLE(raw_value, byteArray, 6272, 12);

    raw_value = convertPhysicalToRaw(@CAN_PrivMain::RFL_Object::RXX_Object_Obj11.Width, 0.125, 0.0);
    copyBitsToByteArrayLE(raw_value, byteArray, 6264, 7);

    raw_value = convertPhysicalToRaw(@CAN_PrivMain::RFL_Object::RXX_Object_Obj11.OrientationYawVnce, 0.0003, 0.0);
    copyBitsToByteArrayLE(raw_value, byteArray, 6252, 12);

    raw_value = convertPhysicalToRaw(@CAN_PrivMain::RFL_Object::RXX_Object_Obj11.PyVnce, 0.1, 0.0);
    copyBitsToByteArrayLE(raw_value, byteArray, 6188, 12);

    raw_value = convertPhysicalToRaw(@CAN_PrivMain::RFL_Object::RXX_Object_Obj11.OrientationYaw, 0.0175, -4.48);
    copyBitsToByteArrayLE(raw_value, byteArray, 6230, 9);

    raw_value = convertPhysicalToRaw(@CAN_PrivMain::RFL_Object::RXX_Object_Obj11.Ax, 0.03125, -16.0);
    copyBitsToByteArrayLE(raw_value, byteArray, 6220, 10);

    raw_value = convertPhysicalToRaw(@CAN_PrivMain::RFL_Object::RXX_Object_Obj11.LengthVnce, 0.01, 0.0);
    copyBitsToByteArrayLE(raw_value, byteArray, 6208, 12);

    raw_value = convertPhysicalToRaw(@CAN_PrivMain::RFL_Object::RXX_Object_Obj11.Length, 0.125, 0.0);
    copyBitsToByteArrayLE(raw_value, byteArray, 6200, 7);

    raw_value = convertPhysicalToRaw(@CAN_PrivMain::RFL_Object::RXX_Object_Obj11.Vy, 0.125, -64.0);
    copyBitsToByteArrayLE(raw_value, byteArray, 6350, 10);

    raw_value = convertPhysicalToRaw(@CAN_PrivMain::RFL_Object::RXX_Object_Obj11.Py, 0.0625, -128.0);
    copyBitsToByteArrayLE(raw_value, byteArray, 6176, 12);

    raw_value = convertPhysicalToRaw(@CAN_PrivMain::RFL_Object::RXX_Object_Obj11.PxVnce, 0.1, 0.0);
    copyBitsToByteArrayLE(raw_value, byteArray, 6164, 12);

    raw_value = convertPhysicalToRaw(@CAN_PrivMain::RFL_Object::RXX_Object_Obj11.Px, 0.0625, -512.0);
    copyBitsToByteArrayLE(raw_value, byteArray, 6150, 14);

    raw_value = convertPhysicalToRaw(@CAN_PrivMain::RFL_Object::RXX_Object_Obj11.ProbClassConfidence, 2.0, 0.0);
    copyBitsToByteArrayLE(raw_value, byteArray, 6144, 6);

    raw_value = convertPhysicalToRaw(@CAN_PrivMain::RFL_Object::RXX_Object_Obj11.MovingStatus, 1.0, 0.0);
    copyBitsToByteArrayLE(raw_value, byteArray, 6348, 2);

    raw_value = convertPhysicalToRaw(@CAN_PrivMain::RFL_Object::RXX_Object_Obj11.Ay, 0.0625, -16.0);
    copyBitsToByteArrayLE(raw_value, byteArray, 6294, 9);

    raw_value = convertPhysicalToRaw(@CAN_PrivMain::RFL_Object::RXX_Object_Obj11.ExistProb, 2.0, 0.0);
    copyBitsToByteArrayLE(raw_value, byteArray, 6360, 6);

    raw_value = convertPhysicalToRaw(@CAN_PrivMain::RFL_Object::RXX_Object_Obj11.PxAxCoVnce, 0.01, 0.0);
    copyBitsToByteArrayLE(raw_value, byteArray, 6464, 12);

    raw_value = convertPhysicalToRaw(@CAN_PrivMain::RFL_Object::RXX_Object_Obj11.Age, 1.0, 0.0);
    copyBitsToByteArrayLE(raw_value, byteArray, 6624, 32);

    raw_value = convertPhysicalToRaw(@CAN_PrivMain::RFL_Object::RXX_Object_Obj11.VyVnce, 0.01, 0.0);
    copyBitsToByteArrayLE(raw_value, byteArray, 6368, 12);

    raw_value = convertPhysicalToRaw(@CAN_PrivMain::RFL_Object::RXX_Object_Obj11.VyAyCoVnce, 0.01, 0.0);
    copyBitsToByteArrayLE(raw_value, byteArray, 6592, 12);

    raw_value = convertPhysicalToRaw(@CAN_PrivMain::RFL_Object::RXX_Object_Obj11.VyAxCoVnce, 0.01, 0.0);
    copyBitsToByteArrayLE(raw_value, byteArray, 6572, 12);

    raw_value = convertPhysicalToRaw(@CAN_PrivMain::RFL_Object::RXX_Object_Obj11.VxAyCoVnce, 0.01, 0.0);
    copyBitsToByteArrayLE(raw_value, byteArray, 6560, 12);

    raw_value = convertPhysicalToRaw(@CAN_PrivMain::RFL_Object::RXX_Object_Obj11.VxAxCoVnce, 0.01, 0.0);
    copyBitsToByteArrayLE(raw_value, byteArray, 6540, 12);

    raw_value = convertPhysicalToRaw(@CAN_PrivMain::RFL_Object::RXX_Object_Obj11.VxVyCoVnce, 0.01, 0.0);
    copyBitsToByteArrayLE(raw_value, byteArray, 6528, 12);

    raw_value = convertPhysicalToRaw(@CAN_PrivMain::RFL_Object::RXX_Object_Obj11.PyAyCoVnce, 0.01, 0.0);
    copyBitsToByteArrayLE(raw_value, byteArray, 6508, 12);

    raw_value = convertPhysicalToRaw(@CAN_PrivMain::RFL_Object::RXX_Object_Obj11.PyAxCoVnce, 0.01, 0.0);
    copyBitsToByteArrayLE(raw_value, byteArray, 6496, 12);

    raw_value = convertPhysicalToRaw(@CAN_PrivMain::RFL_Object::RXX_Object_Obj11.PxAyCoVnce, 0.01, 0.0);
    copyBitsToByteArrayLE(raw_value, byteArray, 6476, 12);

    raw_value = convertPhysicalToRaw(@CAN_PrivMain::RFL_Object::RXX_Object_Obj11.AxAyCoVnce, 0.01, 0.0);
    copyBitsToByteArrayLE(raw_value, byteArray, 6604, 12);

    raw_value = convertPhysicalToRaw(@CAN_PrivMain::RFL_Object::RXX_Object_Obj11.ReferencePoint, 1.0, 0.0);
    copyBitsToByteArrayLE(raw_value, byteArray, 6456, 4);

    raw_value = convertPhysicalToRaw(@CAN_PrivMain::RFL_Object::RXX_Object_Obj11.PxVxCoVnce, 0.01, 0.0);
    copyBitsToByteArrayLE(raw_value, byteArray, 6400, 12);

    raw_value = convertPhysicalToRaw(@CAN_PrivMain::RFL_Object::RXX_Object_Obj11.PyVyCoVnce, 0.01, 0.0);
    copyBitsToByteArrayLE(raw_value, byteArray, 6444, 12);

    raw_value = convertPhysicalToRaw(@CAN_PrivMain::RFL_Object::RXX_Object_Obj11.MeasurementStatus, 1.0, 0.0);
    copyBitsToByteArrayLE(raw_value, byteArray, 6392, 3);

    raw_value = convertPhysicalToRaw(@CAN_PrivMain::RFL_Object::RXX_Object_Obj11.ProbClassType, 1.0, 0.0);
    copyBitsToByteArrayLE(raw_value, byteArray, 6395, 4);

    raw_value = convertPhysicalToRaw(@CAN_PrivMain::RFL_Object::RXX_Object_Obj11.PxPyCoVnce, 0.01, 0.0);
    copyBitsToByteArrayLE(raw_value, byteArray, 6380, 12);

    raw_value = convertPhysicalToRaw(@CAN_PrivMain::RFL_Object::RXX_Object_Obj11.PxVyCoVnce, 0.01, 0.0);
    copyBitsToByteArrayLE(raw_value, byteArray, 6412, 12);

    raw_value = convertPhysicalToRaw(@CAN_PrivMain::RFL_Object::RXX_Object_Obj11.FilterInformation, 1.0, 0.0);
    copyBitsToByteArrayLE(raw_value, byteArray, 6424, 8);

    raw_value = convertPhysicalToRaw(@CAN_PrivMain::RFL_Object::RXX_Object_Obj11.PyVxCoVnce, 0.01, 0.0);
    copyBitsToByteArrayLE(raw_value, byteArray, 6432, 12);
}


void RXX_Object_Obj10_write(byte byteArray[])
{
    qword raw_value;

    raw_value = convertPhysicalToRaw(@CAN_PrivMain::RFL_Object::RXX_Object_Obj10.VxVnce, 0.01, 0.0);
    copyBitsToByteArrayLE(raw_value, byteArray, 5824, 12);

    raw_value = convertPhysicalToRaw(@CAN_PrivMain::RFL_Object::RXX_Object_Obj10.AxVnce, 0.01, 0.0);
    copyBitsToByteArrayLE(raw_value, byteArray, 5728, 12);

    raw_value = convertPhysicalToRaw(@CAN_PrivMain::RFL_Object::RXX_Object_Obj10.ObjId, 1.0, 0.0);
    copyBitsToByteArrayLE(raw_value, byteArray, 5816, 7);

    raw_value = convertPhysicalToRaw(@CAN_PrivMain::RFL_Object::RXX_Object_Obj10.Vx, 0.0625, -128.0);
    copyBitsToByteArrayLE(raw_value, byteArray, 5804, 12);

    raw_value = convertPhysicalToRaw(@CAN_PrivMain::RFL_Object::RXX_Object_Obj10.AyVnce, 0.01, 0.0);
    copyBitsToByteArrayLE(raw_value, byteArray, 5792, 12);

    raw_value = convertPhysicalToRaw(@CAN_PrivMain::RFL_Object::RXX_Object_Obj10.Ay, 0.0625, -16.0);
    copyBitsToByteArrayLE(raw_value, byteArray, 5782, 9);

    raw_value = convertPhysicalToRaw(@CAN_PrivMain::RFL_Object::RXX_Object_Obj10.RCS, 0.2, -102.4);
    copyBitsToByteArrayLE(raw_value, byteArray, 5772, 10);

    raw_value = convertPhysicalToRaw(@CAN_PrivMain::RFL_Object::RXX_Object_Obj10.WidthVnce, 0.01, 0.0);
    copyBitsToByteArrayLE(raw_value, byteArray, 5760, 12);

    raw_value = convertPhysicalToRaw(@CAN_PrivMain::RFL_Object::RXX_Object_Obj10.Width, 0.125, 0.0);
    copyBitsToByteArrayLE(raw_value, byteArray, 5752, 7);

    raw_value = convertPhysicalToRaw(@CAN_PrivMain::RFL_Object::RXX_Object_Obj10.OrientationYawVnce, 0.0003, 0.0);
    copyBitsToByteArrayLE(raw_value, byteArray, 5740, 12);

    raw_value = convertPhysicalToRaw(@CAN_PrivMain::RFL_Object::RXX_Object_Obj10.Length, 0.125, 0.0);
    copyBitsToByteArrayLE(raw_value, byteArray, 5688, 7);

    raw_value = convertPhysicalToRaw(@CAN_PrivMain::RFL_Object::RXX_Object_Obj10.OrientationYaw, 0.0175, -4.48);
    copyBitsToByteArrayLE(raw_value, byteArray, 5718, 9);

    raw_value = convertPhysicalToRaw(@CAN_PrivMain::RFL_Object::RXX_Object_Obj10.Ax, 0.03125, -16.0);
    copyBitsToByteArrayLE(raw_value, byteArray, 5708, 10);

    raw_value = convertPhysicalToRaw(@CAN_PrivMain::RFL_Object::RXX_Object_Obj10.LengthVnce, 0.01, 0.0);
    copyBitsToByteArrayLE(raw_value, byteArray, 5696, 12);

    raw_value = convertPhysicalToRaw(@CAN_PrivMain::RFL_Object::RXX_Object_Obj10.PyVnce, 0.1, 0.0);
    copyBitsToByteArrayLE(raw_value, byteArray, 5676, 12);

    raw_value = convertPhysicalToRaw(@CAN_PrivMain::RFL_Object::RXX_Object_Obj10.Py, 0.0625, -128.0);
    copyBitsToByteArrayLE(raw_value, byteArray, 5664, 12);

    raw_value = convertPhysicalToRaw(@CAN_PrivMain::RFL_Object::RXX_Object_Obj10.PxVnce, 0.1, 0.0);
    copyBitsToByteArrayLE(raw_value, byteArray, 5652, 12);

    raw_value = convertPhysicalToRaw(@CAN_PrivMain::RFL_Object::RXX_Object_Obj10.Px, 0.0625, -512.0);
    copyBitsToByteArrayLE(raw_value, byteArray, 5638, 14);

    raw_value = convertPhysicalToRaw(@CAN_PrivMain::RFL_Object::RXX_Object_Obj10.ProbClassConfidence, 2.0, 0.0);
    copyBitsToByteArrayLE(raw_value, byteArray, 5632, 6);

    raw_value = convertPhysicalToRaw(@CAN_PrivMain::RFL_Object::RXX_Object_Obj10.Vy, 0.125, -64.0);
    copyBitsToByteArrayLE(raw_value, byteArray, 5838, 10);

    raw_value = convertPhysicalToRaw(@CAN_PrivMain::RFL_Object::RXX_Object_Obj10.MovingStatus, 1.0, 0.0);
    copyBitsToByteArrayLE(raw_value, byteArray, 5836, 2);

    raw_value = convertPhysicalToRaw(@CAN_PrivMain::RFL_Object::RXX_Object_Obj10.VxVyCoVnce, 0.01, 0.0);
    copyBitsToByteArrayLE(raw_value, byteArray, 6016, 12);

    raw_value = convertPhysicalToRaw(@CAN_PrivMain::RFL_Object::RXX_Object_Obj10.ExistProb, 2.0, 0.0);
    copyBitsToByteArrayLE(raw_value, byteArray, 5848, 6);

    raw_value = convertPhysicalToRaw(@CAN_PrivMain::RFL_Object::RXX_Object_Obj10.PxAxCoVnce, 0.01, 0.0);
    copyBitsToByteArrayLE(raw_value, byteArray, 5952, 12);

    raw_value = convertPhysicalToRaw(@CAN_PrivMain::RFL_Object::RXX_Object_Obj10.Age, 1.0, 0.0);
    copyBitsToByteArrayLE(raw_value, byteArray, 6112, 32);

    raw_value = convertPhysicalToRaw(@CAN_PrivMain::RFL_Object::RXX_Object_Obj10.VyVnce, 0.01, 0.0);
    copyBitsToByteArrayLE(raw_value, byteArray, 5856, 12);

    raw_value = convertPhysicalToRaw(@CAN_PrivMain::RFL_Object::RXX_Object_Obj10.VyAyCoVnce, 0.01, 0.0);
    copyBitsToByteArrayLE(raw_value, byteArray, 6080, 12);

    raw_value = convertPhysicalToRaw(@CAN_PrivMain::RFL_Object::RXX_Object_Obj10.VyAxCoVnce, 0.01, 0.0);
    copyBitsToByteArrayLE(raw_value, byteArray, 6060, 12);

    raw_value = convertPhysicalToRaw(@CAN_PrivMain::RFL_Object::RXX_Object_Obj10.VxAyCoVnce, 0.01, 0.0);
    copyBitsToByteArrayLE(raw_value, byteArray, 6048, 12);

    raw_value = convertPhysicalToRaw(@CAN_PrivMain::RFL_Object::RXX_Object_Obj10.VxAxCoVnce, 0.01, 0.0);
    copyBitsToByteArrayLE(raw_value, byteArray, 6028, 12);

    raw_value = convertPhysicalToRaw(@CAN_PrivMain::RFL_Object::RXX_Object_Obj10.PyAyCoVnce, 0.01, 0.0);
    copyBitsToByteArrayLE(raw_value, byteArray, 5996, 12);

    raw_value = convertPhysicalToRaw(@CAN_PrivMain::RFL_Object::RXX_Object_Obj10.PyAxCoVnce, 0.01, 0.0);
    copyBitsToByteArrayLE(raw_value, byteArray, 5984, 12);

    raw_value = convertPhysicalToRaw(@CAN_PrivMain::RFL_Object::RXX_Object_Obj10.PxAyCoVnce, 0.01, 0.0);
    copyBitsToByteArrayLE(raw_value, byteArray, 5964, 12);

    raw_value = convertPhysicalToRaw(@CAN_PrivMain::RFL_Object::RXX_Object_Obj10.AxAyCoVnce, 0.01, 0.0);
    copyBitsToByteArrayLE(raw_value, byteArray, 6092, 12);

    raw_value = convertPhysicalToRaw(@CAN_PrivMain::RFL_Object::RXX_Object_Obj10.ReferencePoint, 1.0, 0.0);
    copyBitsToByteArrayLE(raw_value, byteArray, 5944, 4);

    raw_value = convertPhysicalToRaw(@CAN_PrivMain::RFL_Object::RXX_Object_Obj10.PxVxCoVnce, 0.01, 0.0);
    copyBitsToByteArrayLE(raw_value, byteArray, 5888, 12);

    raw_value = convertPhysicalToRaw(@CAN_PrivMain::RFL_Object::RXX_Object_Obj10.PyVyCoVnce, 0.01, 0.0);
    copyBitsToByteArrayLE(raw_value, byteArray, 5932, 12);

    raw_value = convertPhysicalToRaw(@CAN_PrivMain::RFL_Object::RXX_Object_Obj10.MeasurementStatus, 1.0, 0.0);
    copyBitsToByteArrayLE(raw_value, byteArray, 5880, 3);

    raw_value = convertPhysicalToRaw(@CAN_PrivMain::RFL_Object::RXX_Object_Obj10.ProbClassType, 1.0, 0.0);
    copyBitsToByteArrayLE(raw_value, byteArray, 5883, 4);

    raw_value = convertPhysicalToRaw(@CAN_PrivMain::RFL_Object::RXX_Object_Obj10.PxPyCoVnce, 0.01, 0.0);
    copyBitsToByteArrayLE(raw_value, byteArray, 5868, 12);

    raw_value = convertPhysicalToRaw(@CAN_PrivMain::RFL_Object::RXX_Object_Obj10.PxVyCoVnce, 0.01, 0.0);
    copyBitsToByteArrayLE(raw_value, byteArray, 5900, 12);

    raw_value = convertPhysicalToRaw(@CAN_PrivMain::RFL_Object::RXX_Object_Obj10.FilterInformation, 1.0, 0.0);
    copyBitsToByteArrayLE(raw_value, byteArray, 5912, 8);

    raw_value = convertPhysicalToRaw(@CAN_PrivMain::RFL_Object::RXX_Object_Obj10.PyVxCoVnce, 0.01, 0.0);
    copyBitsToByteArrayLE(raw_value, byteArray, 5920, 12);
}


void RXX_Object_Obj9_write(byte byteArray[])
{
    qword raw_value;

    raw_value = convertPhysicalToRaw(@CAN_PrivMain::RFL_Object::RXX_Object_Obj9.VxVnce, 0.01, 0.0);
    copyBitsToByteArrayLE(raw_value, byteArray, 5312, 12);

    raw_value = convertPhysicalToRaw(@CAN_PrivMain::RFL_Object::RXX_Object_Obj9.AxVnce, 0.01, 0.0);
    copyBitsToByteArrayLE(raw_value, byteArray, 5216, 12);

    raw_value = convertPhysicalToRaw(@CAN_PrivMain::RFL_Object::RXX_Object_Obj9.ObjId, 1.0, 0.0);
    copyBitsToByteArrayLE(raw_value, byteArray, 5304, 7);

    raw_value = convertPhysicalToRaw(@CAN_PrivMain::RFL_Object::RXX_Object_Obj9.Vx, 0.0625, -128.0);
    copyBitsToByteArrayLE(raw_value, byteArray, 5292, 12);

    raw_value = convertPhysicalToRaw(@CAN_PrivMain::RFL_Object::RXX_Object_Obj9.AyVnce, 0.01, 0.0);
    copyBitsToByteArrayLE(raw_value, byteArray, 5280, 12);

    raw_value = convertPhysicalToRaw(@CAN_PrivMain::RFL_Object::RXX_Object_Obj9.RCS, 0.2, -102.4);
    copyBitsToByteArrayLE(raw_value, byteArray, 5260, 10);

    raw_value = convertPhysicalToRaw(@CAN_PrivMain::RFL_Object::RXX_Object_Obj9.WidthVnce, 0.01, 0.0);
    copyBitsToByteArrayLE(raw_value, byteArray, 5248, 12);

    raw_value = convertPhysicalToRaw(@CAN_PrivMain::RFL_Object::RXX_Object_Obj9.Width, 0.125, 0.0);
    copyBitsToByteArrayLE(raw_value, byteArray, 5240, 7);

    raw_value = convertPhysicalToRaw(@CAN_PrivMain::RFL_Object::RXX_Object_Obj9.OrientationYawVnce, 0.0003, 0.0);
    copyBitsToByteArrayLE(raw_value, byteArray, 5228, 12);

    raw_value = convertPhysicalToRaw(@CAN_PrivMain::RFL_Object::RXX_Object_Obj9.PyVnce, 0.1, 0.0);
    copyBitsToByteArrayLE(raw_value, byteArray, 5164, 12);

    raw_value = convertPhysicalToRaw(@CAN_PrivMain::RFL_Object::RXX_Object_Obj9.OrientationYaw, 0.0175, -4.48);
    copyBitsToByteArrayLE(raw_value, byteArray, 5206, 9);

    raw_value = convertPhysicalToRaw(@CAN_PrivMain::RFL_Object::RXX_Object_Obj9.Ax, 0.03125, -16.0);
    copyBitsToByteArrayLE(raw_value, byteArray, 5196, 10);

    raw_value = convertPhysicalToRaw(@CAN_PrivMain::RFL_Object::RXX_Object_Obj9.LengthVnce, 0.01, 0.0);
    copyBitsToByteArrayLE(raw_value, byteArray, 5184, 12);

    raw_value = convertPhysicalToRaw(@CAN_PrivMain::RFL_Object::RXX_Object_Obj9.Length, 0.125, 0.0);
    copyBitsToByteArrayLE(raw_value, byteArray, 5176, 7);

    raw_value = convertPhysicalToRaw(@CAN_PrivMain::RFL_Object::RXX_Object_Obj9.Py, 0.0625, -128.0);
    copyBitsToByteArrayLE(raw_value, byteArray, 5152, 12);

    raw_value = convertPhysicalToRaw(@CAN_PrivMain::RFL_Object::RXX_Object_Obj9.PxVnce, 0.1, 0.0);
    copyBitsToByteArrayLE(raw_value, byteArray, 5140, 12);

    raw_value = convertPhysicalToRaw(@CAN_PrivMain::RFL_Object::RXX_Object_Obj9.Px, 0.0625, -512.0);
    copyBitsToByteArrayLE(raw_value, byteArray, 5126, 14);

    raw_value = convertPhysicalToRaw(@CAN_PrivMain::RFL_Object::RXX_Object_Obj9.ProbClassConfidence, 2.0, 0.0);
    copyBitsToByteArrayLE(raw_value, byteArray, 5120, 6);

    raw_value = convertPhysicalToRaw(@CAN_PrivMain::RFL_Object::RXX_Object_Obj9.Vy, 0.125, -64.0);
    copyBitsToByteArrayLE(raw_value, byteArray, 5326, 10);

    raw_value = convertPhysicalToRaw(@CAN_PrivMain::RFL_Object::RXX_Object_Obj9.MovingStatus, 1.0, 0.0);
    copyBitsToByteArrayLE(raw_value, byteArray, 5324, 2);

    raw_value = convertPhysicalToRaw(@CAN_PrivMain::RFL_Object::RXX_Object_Obj9.Ay, 0.0625, -16.0);
    copyBitsToByteArrayLE(raw_value, byteArray, 5270, 9);

    raw_value = convertPhysicalToRaw(@CAN_PrivMain::RFL_Object::RXX_Object_Obj9.ExistProb, 2.0, 0.0);
    copyBitsToByteArrayLE(raw_value, byteArray, 5336, 6);

    raw_value = convertPhysicalToRaw(@CAN_PrivMain::RFL_Object::RXX_Object_Obj9.PxAxCoVnce, 0.01, 0.0);
    copyBitsToByteArrayLE(raw_value, byteArray, 5440, 12);

    raw_value = convertPhysicalToRaw(@CAN_PrivMain::RFL_Object::RXX_Object_Obj9.VyVnce, 0.01, 0.0);
    copyBitsToByteArrayLE(raw_value, byteArray, 5344, 12);

    raw_value = convertPhysicalToRaw(@CAN_PrivMain::RFL_Object::RXX_Object_Obj9.VyAyCoVnce, 0.01, 0.0);
    copyBitsToByteArrayLE(raw_value, byteArray, 5568, 12);

    raw_value = convertPhysicalToRaw(@CAN_PrivMain::RFL_Object::RXX_Object_Obj9.VyAxCoVnce, 0.01, 0.0);
    copyBitsToByteArrayLE(raw_value, byteArray, 5548, 12);

    raw_value = convertPhysicalToRaw(@CAN_PrivMain::RFL_Object::RXX_Object_Obj9.VxAyCoVnce, 0.01, 0.0);
    copyBitsToByteArrayLE(raw_value, byteArray, 5536, 12);

    raw_value = convertPhysicalToRaw(@CAN_PrivMain::RFL_Object::RXX_Object_Obj9.VxAxCoVnce, 0.01, 0.0);
    copyBitsToByteArrayLE(raw_value, byteArray, 5516, 12);

    raw_value = convertPhysicalToRaw(@CAN_PrivMain::RFL_Object::RXX_Object_Obj9.VxVyCoVnce, 0.01, 0.0);
    copyBitsToByteArrayLE(raw_value, byteArray, 5504, 12);

    raw_value = convertPhysicalToRaw(@CAN_PrivMain::RFL_Object::RXX_Object_Obj9.PyAyCoVnce, 0.01, 0.0);
    copyBitsToByteArrayLE(raw_value, byteArray, 5484, 12);

    raw_value = convertPhysicalToRaw(@CAN_PrivMain::RFL_Object::RXX_Object_Obj9.PyAxCoVnce, 0.01, 0.0);
    copyBitsToByteArrayLE(raw_value, byteArray, 5472, 12);

    raw_value = convertPhysicalToRaw(@CAN_PrivMain::RFL_Object::RXX_Object_Obj9.PxAyCoVnce, 0.01, 0.0);
    copyBitsToByteArrayLE(raw_value, byteArray, 5452, 12);

    raw_value = convertPhysicalToRaw(@CAN_PrivMain::RFL_Object::RXX_Object_Obj9.AxAyCoVnce, 0.01, 0.0);
    copyBitsToByteArrayLE(raw_value, byteArray, 5580, 12);

    raw_value = convertPhysicalToRaw(@CAN_PrivMain::RFL_Object::RXX_Object_Obj9.ReferencePoint, 1.0, 0.0);
    copyBitsToByteArrayLE(raw_value, byteArray, 5432, 4);

    raw_value = convertPhysicalToRaw(@CAN_PrivMain::RFL_Object::RXX_Object_Obj9.PyVxCoVnce, 0.01, 0.0);
    copyBitsToByteArrayLE(raw_value, byteArray, 5408, 12);

    raw_value = convertPhysicalToRaw(@CAN_PrivMain::RFL_Object::RXX_Object_Obj9.FilterInformation, 1.0, 0.0);
    copyBitsToByteArrayLE(raw_value, byteArray, 5400, 8);

    raw_value = convertPhysicalToRaw(@CAN_PrivMain::RFL_Object::RXX_Object_Obj9.PxVyCoVnce, 0.01, 0.0);
    copyBitsToByteArrayLE(raw_value, byteArray, 5388, 12);

    raw_value = convertPhysicalToRaw(@CAN_PrivMain::RFL_Object::RXX_Object_Obj9.Age, 1.0, 0.0);
    copyBitsToByteArrayLE(raw_value, byteArray, 5600, 32);

    raw_value = convertPhysicalToRaw(@CAN_PrivMain::RFL_Object::RXX_Object_Obj9.PxVxCoVnce, 0.01, 0.0);
    copyBitsToByteArrayLE(raw_value, byteArray, 5376, 12);

    raw_value = convertPhysicalToRaw(@CAN_PrivMain::RFL_Object::RXX_Object_Obj9.ProbClassType, 1.0, 0.0);
    copyBitsToByteArrayLE(raw_value, byteArray, 5371, 4);

    raw_value = convertPhysicalToRaw(@CAN_PrivMain::RFL_Object::RXX_Object_Obj9.MeasurementStatus, 1.0, 0.0);
    copyBitsToByteArrayLE(raw_value, byteArray, 5368, 3);

    raw_value = convertPhysicalToRaw(@CAN_PrivMain::RFL_Object::RXX_Object_Obj9.PxPyCoVnce, 0.01, 0.0);
    copyBitsToByteArrayLE(raw_value, byteArray, 5356, 12);

    raw_value = convertPhysicalToRaw(@CAN_PrivMain::RFL_Object::RXX_Object_Obj9.PyVyCoVnce, 0.01, 0.0);
    copyBitsToByteArrayLE(raw_value, byteArray, 5420, 12);
}


void RXX_Object_Obj8_write(byte byteArray[])
{
    qword raw_value;

    raw_value = convertPhysicalToRaw(@CAN_PrivMain::RFL_Object::RXX_Object_Obj8.RCS, 0.2, -102.4);
    copyBitsToByteArrayLE(raw_value, byteArray, 4748, 10);

    raw_value = convertPhysicalToRaw(@CAN_PrivMain::RFL_Object::RXX_Object_Obj8.Width, 0.125, 0.0);
    copyBitsToByteArrayLE(raw_value, byteArray, 4728, 7);

    raw_value = convertPhysicalToRaw(@CAN_PrivMain::RFL_Object::RXX_Object_Obj8.WidthVnce, 0.01, 0.0);
    copyBitsToByteArrayLE(raw_value, byteArray, 4736, 12);

    raw_value = convertPhysicalToRaw(@CAN_PrivMain::RFL_Object::RXX_Object_Obj8.ObjId, 1.0, 0.0);
    copyBitsToByteArrayLE(raw_value, byteArray, 4792, 7);

    raw_value = convertPhysicalToRaw(@CAN_PrivMain::RFL_Object::RXX_Object_Obj8.Ay, 0.0625, -16.0);
    copyBitsToByteArrayLE(raw_value, byteArray, 4758, 9);

    raw_value = convertPhysicalToRaw(@CAN_PrivMain::RFL_Object::RXX_Object_Obj8.AyVnce, 0.01, 0.0);
    copyBitsToByteArrayLE(raw_value, byteArray, 4768, 12);

    raw_value = convertPhysicalToRaw(@CAN_PrivMain::RFL_Object::RXX_Object_Obj8.Vx, 0.0625, -128.0);
    copyBitsToByteArrayLE(raw_value, byteArray, 4780, 12);

    raw_value = convertPhysicalToRaw(@CAN_PrivMain::RFL_Object::RXX_Object_Obj8.AxVnce, 0.01, 0.0);
    copyBitsToByteArrayLE(raw_value, byteArray, 4704, 12);

    raw_value = convertPhysicalToRaw(@CAN_PrivMain::RFL_Object::RXX_Object_Obj8.OrientationYawVnce, 0.0003, 0.0);
    copyBitsToByteArrayLE(raw_value, byteArray, 4716, 12);

    raw_value = convertPhysicalToRaw(@CAN_PrivMain::RFL_Object::RXX_Object_Obj8.PyVnce, 0.1, 0.0);
    copyBitsToByteArrayLE(raw_value, byteArray, 4652, 12);

    raw_value = convertPhysicalToRaw(@CAN_PrivMain::RFL_Object::RXX_Object_Obj8.OrientationYaw, 0.0175, -4.48);
    copyBitsToByteArrayLE(raw_value, byteArray, 4694, 9);

    raw_value = convertPhysicalToRaw(@CAN_PrivMain::RFL_Object::RXX_Object_Obj8.Ax, 0.03125, -16.0);
    copyBitsToByteArrayLE(raw_value, byteArray, 4684, 10);

    raw_value = convertPhysicalToRaw(@CAN_PrivMain::RFL_Object::RXX_Object_Obj8.LengthVnce, 0.01, 0.0);
    copyBitsToByteArrayLE(raw_value, byteArray, 4672, 12);

    raw_value = convertPhysicalToRaw(@CAN_PrivMain::RFL_Object::RXX_Object_Obj8.Length, 0.125, 0.0);
    copyBitsToByteArrayLE(raw_value, byteArray, 4664, 7);

    raw_value = convertPhysicalToRaw(@CAN_PrivMain::RFL_Object::RXX_Object_Obj8.Py, 0.0625, -128.0);
    copyBitsToByteArrayLE(raw_value, byteArray, 4640, 12);

    raw_value = convertPhysicalToRaw(@CAN_PrivMain::RFL_Object::RXX_Object_Obj8.PxVnce, 0.1, 0.0);
    copyBitsToByteArrayLE(raw_value, byteArray, 4628, 12);

    raw_value = convertPhysicalToRaw(@CAN_PrivMain::RFL_Object::RXX_Object_Obj8.Px, 0.0625, -512.0);
    copyBitsToByteArrayLE(raw_value, byteArray, 4614, 14);

    raw_value = convertPhysicalToRaw(@CAN_PrivMain::RFL_Object::RXX_Object_Obj8.ProbClassConfidence, 2.0, 0.0);
    copyBitsToByteArrayLE(raw_value, byteArray, 4608, 6);

    raw_value = convertPhysicalToRaw(@CAN_PrivMain::RFL_Object::RXX_Object_Obj8.MovingStatus, 1.0, 0.0);
    copyBitsToByteArrayLE(raw_value, byteArray, 4812, 2);

    raw_value = convertPhysicalToRaw(@CAN_PrivMain::RFL_Object::RXX_Object_Obj8.VxVnce, 0.01, 0.0);
    copyBitsToByteArrayLE(raw_value, byteArray, 4800, 12);

    raw_value = convertPhysicalToRaw(@CAN_PrivMain::RFL_Object::RXX_Object_Obj8.Vy, 0.125, -64.0);
    copyBitsToByteArrayLE(raw_value, byteArray, 4814, 10);

    raw_value = convertPhysicalToRaw(@CAN_PrivMain::RFL_Object::RXX_Object_Obj8.AxAyCoVnce, 0.01, 0.0);
    copyBitsToByteArrayLE(raw_value, byteArray, 5068, 12);

    raw_value = convertPhysicalToRaw(@CAN_PrivMain::RFL_Object::RXX_Object_Obj8.PxAxCoVnce, 0.01, 0.0);
    copyBitsToByteArrayLE(raw_value, byteArray, 4928, 12);

    raw_value = convertPhysicalToRaw(@CAN_PrivMain::RFL_Object::RXX_Object_Obj8.Age, 1.0, 0.0);
    copyBitsToByteArrayLE(raw_value, byteArray, 5088, 32);

    raw_value = convertPhysicalToRaw(@CAN_PrivMain::RFL_Object::RXX_Object_Obj8.ExistProb, 2.0, 0.0);
    copyBitsToByteArrayLE(raw_value, byteArray, 4824, 6);

    raw_value = convertPhysicalToRaw(@CAN_PrivMain::RFL_Object::RXX_Object_Obj8.VyAyCoVnce, 0.01, 0.0);
    copyBitsToByteArrayLE(raw_value, byteArray, 5056, 12);

    raw_value = convertPhysicalToRaw(@CAN_PrivMain::RFL_Object::RXX_Object_Obj8.VyAxCoVnce, 0.01, 0.0);
    copyBitsToByteArrayLE(raw_value, byteArray, 5036, 12);

    raw_value = convertPhysicalToRaw(@CAN_PrivMain::RFL_Object::RXX_Object_Obj8.VxAyCoVnce, 0.01, 0.0);
    copyBitsToByteArrayLE(raw_value, byteArray, 5024, 12);

    raw_value = convertPhysicalToRaw(@CAN_PrivMain::RFL_Object::RXX_Object_Obj8.VxAxCoVnce, 0.01, 0.0);
    copyBitsToByteArrayLE(raw_value, byteArray, 5004, 12);

    raw_value = convertPhysicalToRaw(@CAN_PrivMain::RFL_Object::RXX_Object_Obj8.PyAyCoVnce, 0.01, 0.0);
    copyBitsToByteArrayLE(raw_value, byteArray, 4972, 12);

    raw_value = convertPhysicalToRaw(@CAN_PrivMain::RFL_Object::RXX_Object_Obj8.PyAxCoVnce, 0.01, 0.0);
    copyBitsToByteArrayLE(raw_value, byteArray, 4960, 12);

    raw_value = convertPhysicalToRaw(@CAN_PrivMain::RFL_Object::RXX_Object_Obj8.PxAyCoVnce, 0.01, 0.0);
    copyBitsToByteArrayLE(raw_value, byteArray, 4940, 12);

    raw_value = convertPhysicalToRaw(@CAN_PrivMain::RFL_Object::RXX_Object_Obj8.VxVyCoVnce, 0.01, 0.0);
    copyBitsToByteArrayLE(raw_value, byteArray, 4992, 12);

    raw_value = convertPhysicalToRaw(@CAN_PrivMain::RFL_Object::RXX_Object_Obj8.ReferencePoint, 1.0, 0.0);
    copyBitsToByteArrayLE(raw_value, byteArray, 4920, 4);

    raw_value = convertPhysicalToRaw(@CAN_PrivMain::RFL_Object::RXX_Object_Obj8.PxVxCoVnce, 0.01, 0.0);
    copyBitsToByteArrayLE(raw_value, byteArray, 4864, 12);

    raw_value = convertPhysicalToRaw(@CAN_PrivMain::RFL_Object::RXX_Object_Obj8.PyVyCoVnce, 0.01, 0.0);
    copyBitsToByteArrayLE(raw_value, byteArray, 4908, 12);

    raw_value = convertPhysicalToRaw(@CAN_PrivMain::RFL_Object::RXX_Object_Obj8.PxPyCoVnce, 0.01, 0.0);
    copyBitsToByteArrayLE(raw_value, byteArray, 4844, 12);

    raw_value = convertPhysicalToRaw(@CAN_PrivMain::RFL_Object::RXX_Object_Obj8.MeasurementStatus, 1.0, 0.0);
    copyBitsToByteArrayLE(raw_value, byteArray, 4856, 3);

    raw_value = convertPhysicalToRaw(@CAN_PrivMain::RFL_Object::RXX_Object_Obj8.ProbClassType, 1.0, 0.0);
    copyBitsToByteArrayLE(raw_value, byteArray, 4859, 4);

    raw_value = convertPhysicalToRaw(@CAN_PrivMain::RFL_Object::RXX_Object_Obj8.VyVnce, 0.01, 0.0);
    copyBitsToByteArrayLE(raw_value, byteArray, 4832, 12);

    raw_value = convertPhysicalToRaw(@CAN_PrivMain::RFL_Object::RXX_Object_Obj8.PxVyCoVnce, 0.01, 0.0);
    copyBitsToByteArrayLE(raw_value, byteArray, 4876, 12);

    raw_value = convertPhysicalToRaw(@CAN_PrivMain::RFL_Object::RXX_Object_Obj8.FilterInformation, 1.0, 0.0);
    copyBitsToByteArrayLE(raw_value, byteArray, 4888, 8);

    raw_value = convertPhysicalToRaw(@CAN_PrivMain::RFL_Object::RXX_Object_Obj8.PyVxCoVnce, 0.01, 0.0);
    copyBitsToByteArrayLE(raw_value, byteArray, 4896, 12);
}


void RXX_Object_Obj7_write(byte byteArray[])
{
    qword raw_value;

    raw_value = convertPhysicalToRaw(@CAN_PrivMain::RFL_Object::RXX_Object_Obj7.AxVnce, 0.01, 0.0);
    copyBitsToByteArrayLE(raw_value, byteArray, 4192, 12);

    raw_value = convertPhysicalToRaw(@CAN_PrivMain::RFL_Object::RXX_Object_Obj7.VxVnce, 0.01, 0.0);
    copyBitsToByteArrayLE(raw_value, byteArray, 4288, 12);

    raw_value = convertPhysicalToRaw(@CAN_PrivMain::RFL_Object::RXX_Object_Obj7.ObjId, 1.0, 0.0);
    copyBitsToByteArrayLE(raw_value, byteArray, 4280, 7);

    raw_value = convertPhysicalToRaw(@CAN_PrivMain::RFL_Object::RXX_Object_Obj7.Vx, 0.0625, -128.0);
    copyBitsToByteArrayLE(raw_value, byteArray, 4268, 12);

    raw_value = convertPhysicalToRaw(@CAN_PrivMain::RFL_Object::RXX_Object_Obj7.AyVnce, 0.01, 0.0);
    copyBitsToByteArrayLE(raw_value, byteArray, 4256, 12);

    raw_value = convertPhysicalToRaw(@CAN_PrivMain::RFL_Object::RXX_Object_Obj7.Ay, 0.0625, -16.0);
    copyBitsToByteArrayLE(raw_value, byteArray, 4246, 9);

    raw_value = convertPhysicalToRaw(@CAN_PrivMain::RFL_Object::RXX_Object_Obj7.RCS, 0.2, -102.4);
    copyBitsToByteArrayLE(raw_value, byteArray, 4236, 10);

    raw_value = convertPhysicalToRaw(@CAN_PrivMain::RFL_Object::RXX_Object_Obj7.WidthVnce, 0.01, 0.0);
    copyBitsToByteArrayLE(raw_value, byteArray, 4224, 12);

    raw_value = convertPhysicalToRaw(@CAN_PrivMain::RFL_Object::RXX_Object_Obj7.Width, 0.125, 0.0);
    copyBitsToByteArrayLE(raw_value, byteArray, 4216, 7);

    raw_value = convertPhysicalToRaw(@CAN_PrivMain::RFL_Object::RXX_Object_Obj7.OrientationYawVnce, 0.0003, 0.0);
    copyBitsToByteArrayLE(raw_value, byteArray, 4204, 12);

    raw_value = convertPhysicalToRaw(@CAN_PrivMain::RFL_Object::RXX_Object_Obj7.Vy, 0.125, -64.0);
    copyBitsToByteArrayLE(raw_value, byteArray, 4302, 10);

    raw_value = convertPhysicalToRaw(@CAN_PrivMain::RFL_Object::RXX_Object_Obj7.OrientationYaw, 0.0175, -4.48);
    copyBitsToByteArrayLE(raw_value, byteArray, 4182, 9);

    raw_value = convertPhysicalToRaw(@CAN_PrivMain::RFL_Object::RXX_Object_Obj7.Ax, 0.03125, -16.0);
    copyBitsToByteArrayLE(raw_value, byteArray, 4172, 10);

    raw_value = convertPhysicalToRaw(@CAN_PrivMain::RFL_Object::RXX_Object_Obj7.LengthVnce, 0.01, 0.0);
    copyBitsToByteArrayLE(raw_value, byteArray, 4160, 12);

    raw_value = convertPhysicalToRaw(@CAN_PrivMain::RFL_Object::RXX_Object_Obj7.Length, 0.125, 0.0);
    copyBitsToByteArrayLE(raw_value, byteArray, 4152, 7);

    raw_value = convertPhysicalToRaw(@CAN_PrivMain::RFL_Object::RXX_Object_Obj7.PyVnce, 0.1, 0.0);
    copyBitsToByteArrayLE(raw_value, byteArray, 4140, 12);

    raw_value = convertPhysicalToRaw(@CAN_PrivMain::RFL_Object::RXX_Object_Obj7.Py, 0.0625, -128.0);
    copyBitsToByteArrayLE(raw_value, byteArray, 4128, 12);

    raw_value = convertPhysicalToRaw(@CAN_PrivMain::RFL_Object::RXX_Object_Obj7.PxVnce, 0.1, 0.0);
    copyBitsToByteArrayLE(raw_value, byteArray, 4116, 12);

    raw_value = convertPhysicalToRaw(@CAN_PrivMain::RFL_Object::RXX_Object_Obj7.Px, 0.0625, -512.0);
    copyBitsToByteArrayLE(raw_value, byteArray, 4102, 14);

    raw_value = convertPhysicalToRaw(@CAN_PrivMain::RFL_Object::RXX_Object_Obj7.ProbClassConfidence, 2.0, 0.0);
    copyBitsToByteArrayLE(raw_value, byteArray, 4096, 6);

    raw_value = convertPhysicalToRaw(@CAN_PrivMain::RFL_Object::RXX_Object_Obj7.MovingStatus, 1.0, 0.0);
    copyBitsToByteArrayLE(raw_value, byteArray, 4300, 2);

    raw_value = convertPhysicalToRaw(@CAN_PrivMain::RFL_Object::RXX_Object_Obj7.Age, 1.0, 0.0);
    copyBitsToByteArrayLE(raw_value, byteArray, 4576, 32);

    raw_value = convertPhysicalToRaw(@CAN_PrivMain::RFL_Object::RXX_Object_Obj7.ExistProb, 2.0, 0.0);
    copyBitsToByteArrayLE(raw_value, byteArray, 4312, 6);

    raw_value = convertPhysicalToRaw(@CAN_PrivMain::RFL_Object::RXX_Object_Obj7.PxAxCoVnce, 0.01, 0.0);
    copyBitsToByteArrayLE(raw_value, byteArray, 4416, 12);

    raw_value = convertPhysicalToRaw(@CAN_PrivMain::RFL_Object::RXX_Object_Obj7.AxAyCoVnce, 0.01, 0.0);
    copyBitsToByteArrayLE(raw_value, byteArray, 4556, 12);

    raw_value = convertPhysicalToRaw(@CAN_PrivMain::RFL_Object::RXX_Object_Obj7.VyVnce, 0.01, 0.0);
    copyBitsToByteArrayLE(raw_value, byteArray, 4320, 12);

    raw_value = convertPhysicalToRaw(@CAN_PrivMain::RFL_Object::RXX_Object_Obj7.VyAyCoVnce, 0.01, 0.0);
    copyBitsToByteArrayLE(raw_value, byteArray, 4544, 12);

    raw_value = convertPhysicalToRaw(@CAN_PrivMain::RFL_Object::RXX_Object_Obj7.VyAxCoVnce, 0.01, 0.0);
    copyBitsToByteArrayLE(raw_value, byteArray, 4524, 12);

    raw_value = convertPhysicalToRaw(@CAN_PrivMain::RFL_Object::RXX_Object_Obj7.VxAyCoVnce, 0.01, 0.0);
    copyBitsToByteArrayLE(raw_value, byteArray, 4512, 12);

    raw_value = convertPhysicalToRaw(@CAN_PrivMain::RFL_Object::RXX_Object_Obj7.VxAxCoVnce, 0.01, 0.0);
    copyBitsToByteArrayLE(raw_value, byteArray, 4492, 12);

    raw_value = convertPhysicalToRaw(@CAN_PrivMain::RFL_Object::RXX_Object_Obj7.PyAyCoVnce, 0.01, 0.0);
    copyBitsToByteArrayLE(raw_value, byteArray, 4460, 12);

    raw_value = convertPhysicalToRaw(@CAN_PrivMain::RFL_Object::RXX_Object_Obj7.PyAxCoVnce, 0.01, 0.0);
    copyBitsToByteArrayLE(raw_value, byteArray, 4448, 12);

    raw_value = convertPhysicalToRaw(@CAN_PrivMain::RFL_Object::RXX_Object_Obj7.PxAyCoVnce, 0.01, 0.0);
    copyBitsToByteArrayLE(raw_value, byteArray, 4428, 12);

    raw_value = convertPhysicalToRaw(@CAN_PrivMain::RFL_Object::RXX_Object_Obj7.VxVyCoVnce, 0.01, 0.0);
    copyBitsToByteArrayLE(raw_value, byteArray, 4480, 12);

    raw_value = convertPhysicalToRaw(@CAN_PrivMain::RFL_Object::RXX_Object_Obj7.ReferencePoint, 1.0, 0.0);
    copyBitsToByteArrayLE(raw_value, byteArray, 4408, 4);

    raw_value = convertPhysicalToRaw(@CAN_PrivMain::RFL_Object::RXX_Object_Obj7.PxVxCoVnce, 0.01, 0.0);
    copyBitsToByteArrayLE(raw_value, byteArray, 4352, 12);

    raw_value = convertPhysicalToRaw(@CAN_PrivMain::RFL_Object::RXX_Object_Obj7.PxPyCoVnce, 0.01, 0.0);
    copyBitsToByteArrayLE(raw_value, byteArray, 4332, 12);

    raw_value = convertPhysicalToRaw(@CAN_PrivMain::RFL_Object::RXX_Object_Obj7.PyVyCoVnce, 0.01, 0.0);
    copyBitsToByteArrayLE(raw_value, byteArray, 4396, 12);

    raw_value = convertPhysicalToRaw(@CAN_PrivMain::RFL_Object::RXX_Object_Obj7.ProbClassType, 1.0, 0.0);
    copyBitsToByteArrayLE(raw_value, byteArray, 4347, 4);

    raw_value = convertPhysicalToRaw(@CAN_PrivMain::RFL_Object::RXX_Object_Obj7.MeasurementStatus, 1.0, 0.0);
    copyBitsToByteArrayLE(raw_value, byteArray, 4344, 3);

    raw_value = convertPhysicalToRaw(@CAN_PrivMain::RFL_Object::RXX_Object_Obj7.PxVyCoVnce, 0.01, 0.0);
    copyBitsToByteArrayLE(raw_value, byteArray, 4364, 12);

    raw_value = convertPhysicalToRaw(@CAN_PrivMain::RFL_Object::RXX_Object_Obj7.FilterInformation, 1.0, 0.0);
    copyBitsToByteArrayLE(raw_value, byteArray, 4376, 8);

    raw_value = convertPhysicalToRaw(@CAN_PrivMain::RFL_Object::RXX_Object_Obj7.PyVxCoVnce, 0.01, 0.0);
    copyBitsToByteArrayLE(raw_value, byteArray, 4384, 12);
}


void RXX_Object_Obj6_write(byte byteArray[])
{
    qword raw_value;

    raw_value = convertPhysicalToRaw(@CAN_PrivMain::RFL_Object::RXX_Object_Obj6.VxVnce, 0.01, 0.0);
    copyBitsToByteArrayLE(raw_value, byteArray, 3776, 12);

    raw_value = convertPhysicalToRaw(@CAN_PrivMain::RFL_Object::RXX_Object_Obj6.Width, 0.125, 0.0);
    copyBitsToByteArrayLE(raw_value, byteArray, 3704, 7);

    raw_value = convertPhysicalToRaw(@CAN_PrivMain::RFL_Object::RXX_Object_Obj6.Vy, 0.125, -64.0);
    copyBitsToByteArrayLE(raw_value, byteArray, 3790, 10);

    raw_value = convertPhysicalToRaw(@CAN_PrivMain::RFL_Object::RXX_Object_Obj6.ObjId, 1.0, 0.0);
    copyBitsToByteArrayLE(raw_value, byteArray, 3768, 7);

    raw_value = convertPhysicalToRaw(@CAN_PrivMain::RFL_Object::RXX_Object_Obj6.Vx, 0.0625, -128.0);
    copyBitsToByteArrayLE(raw_value, byteArray, 3756, 12);

    raw_value = convertPhysicalToRaw(@CAN_PrivMain::RFL_Object::RXX_Object_Obj6.AyVnce, 0.01, 0.0);
    copyBitsToByteArrayLE(raw_value, byteArray, 3744, 12);

    raw_value = convertPhysicalToRaw(@CAN_PrivMain::RFL_Object::RXX_Object_Obj6.Ay, 0.0625, -16.0);
    copyBitsToByteArrayLE(raw_value, byteArray, 3734, 9);

    raw_value = convertPhysicalToRaw(@CAN_PrivMain::RFL_Object::RXX_Object_Obj6.RCS, 0.2, -102.4);
    copyBitsToByteArrayLE(raw_value, byteArray, 3724, 10);

    raw_value = convertPhysicalToRaw(@CAN_PrivMain::RFL_Object::RXX_Object_Obj6.WidthVnce, 0.01, 0.0);
    copyBitsToByteArrayLE(raw_value, byteArray, 3712, 12);

    raw_value = convertPhysicalToRaw(@CAN_PrivMain::RFL_Object::RXX_Object_Obj6.Px, 0.0625, -512.0);
    copyBitsToByteArrayLE(raw_value, byteArray, 3590, 14);

    raw_value = convertPhysicalToRaw(@CAN_PrivMain::RFL_Object::RXX_Object_Obj6.OrientationYawVnce, 0.0003, 0.0);
    copyBitsToByteArrayLE(raw_value, byteArray, 3692, 12);

    raw_value = convertPhysicalToRaw(@CAN_PrivMain::RFL_Object::RXX_Object_Obj6.AxVnce, 0.01, 0.0);
    copyBitsToByteArrayLE(raw_value, byteArray, 3680, 12);

    raw_value = convertPhysicalToRaw(@CAN_PrivMain::RFL_Object::RXX_Object_Obj6.OrientationYaw, 0.0175, -4.48);
    copyBitsToByteArrayLE(raw_value, byteArray, 3670, 9);

    raw_value = convertPhysicalToRaw(@CAN_PrivMain::RFL_Object::RXX_Object_Obj6.Ax, 0.03125, -16.0);
    copyBitsToByteArrayLE(raw_value, byteArray, 3660, 10);

    raw_value = convertPhysicalToRaw(@CAN_PrivMain::RFL_Object::RXX_Object_Obj6.LengthVnce, 0.01, 0.0);
    copyBitsToByteArrayLE(raw_value, byteArray, 3648, 12);

    raw_value = convertPhysicalToRaw(@CAN_PrivMain::RFL_Object::RXX_Object_Obj6.Length, 0.125, 0.0);
    copyBitsToByteArrayLE(raw_value, byteArray, 3640, 7);

    raw_value = convertPhysicalToRaw(@CAN_PrivMain::RFL_Object::RXX_Object_Obj6.PyVnce, 0.1, 0.0);
    copyBitsToByteArrayLE(raw_value, byteArray, 3628, 12);

    raw_value = convertPhysicalToRaw(@CAN_PrivMain::RFL_Object::RXX_Object_Obj6.Py, 0.0625, -128.0);
    copyBitsToByteArrayLE(raw_value, byteArray, 3616, 12);

    raw_value = convertPhysicalToRaw(@CAN_PrivMain::RFL_Object::RXX_Object_Obj6.PxVnce, 0.1, 0.0);
    copyBitsToByteArrayLE(raw_value, byteArray, 3604, 12);

    raw_value = convertPhysicalToRaw(@CAN_PrivMain::RFL_Object::RXX_Object_Obj6.ProbClassConfidence, 2.0, 0.0);
    copyBitsToByteArrayLE(raw_value, byteArray, 3584, 6);

    raw_value = convertPhysicalToRaw(@CAN_PrivMain::RFL_Object::RXX_Object_Obj6.MovingStatus, 1.0, 0.0);
    copyBitsToByteArrayLE(raw_value, byteArray, 3788, 2);

    raw_value = convertPhysicalToRaw(@CAN_PrivMain::RFL_Object::RXX_Object_Obj6.PxPyCoVnce, 0.01, 0.0);
    copyBitsToByteArrayLE(raw_value, byteArray, 3820, 12);

    raw_value = convertPhysicalToRaw(@CAN_PrivMain::RFL_Object::RXX_Object_Obj6.ExistProb, 2.0, 0.0);
    copyBitsToByteArrayLE(raw_value, byteArray, 3800, 6);

    raw_value = convertPhysicalToRaw(@CAN_PrivMain::RFL_Object::RXX_Object_Obj6.PyAxCoVnce, 0.01, 0.0);
    copyBitsToByteArrayLE(raw_value, byteArray, 3936, 12);

    raw_value = convertPhysicalToRaw(@CAN_PrivMain::RFL_Object::RXX_Object_Obj6.VyVnce, 0.01, 0.0);
    copyBitsToByteArrayLE(raw_value, byteArray, 3808, 12);

    raw_value = convertPhysicalToRaw(@CAN_PrivMain::RFL_Object::RXX_Object_Obj6.Age, 1.0, 0.0);
    copyBitsToByteArrayLE(raw_value, byteArray, 4064, 32);

    raw_value = convertPhysicalToRaw(@CAN_PrivMain::RFL_Object::RXX_Object_Obj6.AxAyCoVnce, 0.01, 0.0);
    copyBitsToByteArrayLE(raw_value, byteArray, 4044, 12);

    raw_value = convertPhysicalToRaw(@CAN_PrivMain::RFL_Object::RXX_Object_Obj6.VyAyCoVnce, 0.01, 0.0);
    copyBitsToByteArrayLE(raw_value, byteArray, 4032, 12);

    raw_value = convertPhysicalToRaw(@CAN_PrivMain::RFL_Object::RXX_Object_Obj6.VyAxCoVnce, 0.01, 0.0);
    copyBitsToByteArrayLE(raw_value, byteArray, 4012, 12);

    raw_value = convertPhysicalToRaw(@CAN_PrivMain::RFL_Object::RXX_Object_Obj6.VxAyCoVnce, 0.01, 0.0);
    copyBitsToByteArrayLE(raw_value, byteArray, 4000, 12);

    raw_value = convertPhysicalToRaw(@CAN_PrivMain::RFL_Object::RXX_Object_Obj6.VxAxCoVnce, 0.01, 0.0);
    copyBitsToByteArrayLE(raw_value, byteArray, 3980, 12);

    raw_value = convertPhysicalToRaw(@CAN_PrivMain::RFL_Object::RXX_Object_Obj6.VxVyCoVnce, 0.01, 0.0);
    copyBitsToByteArrayLE(raw_value, byteArray, 3968, 12);

    raw_value = convertPhysicalToRaw(@CAN_PrivMain::RFL_Object::RXX_Object_Obj6.PyAyCoVnce, 0.01, 0.0);
    copyBitsToByteArrayLE(raw_value, byteArray, 3948, 12);

    raw_value = convertPhysicalToRaw(@CAN_PrivMain::RFL_Object::RXX_Object_Obj6.PyVxCoVnce, 0.01, 0.0);
    copyBitsToByteArrayLE(raw_value, byteArray, 3872, 12);

    raw_value = convertPhysicalToRaw(@CAN_PrivMain::RFL_Object::RXX_Object_Obj6.PxAyCoVnce, 0.01, 0.0);
    copyBitsToByteArrayLE(raw_value, byteArray, 3916, 12);

    raw_value = convertPhysicalToRaw(@CAN_PrivMain::RFL_Object::RXX_Object_Obj6.PxVyCoVnce, 0.01, 0.0);
    copyBitsToByteArrayLE(raw_value, byteArray, 3852, 12);

    raw_value = convertPhysicalToRaw(@CAN_PrivMain::RFL_Object::RXX_Object_Obj6.MeasurementStatus, 1.0, 0.0);
    copyBitsToByteArrayLE(raw_value, byteArray, 3832, 3);

    raw_value = convertPhysicalToRaw(@CAN_PrivMain::RFL_Object::RXX_Object_Obj6.ProbClassType, 1.0, 0.0);
    copyBitsToByteArrayLE(raw_value, byteArray, 3835, 4);

    raw_value = convertPhysicalToRaw(@CAN_PrivMain::RFL_Object::RXX_Object_Obj6.PxVxCoVnce, 0.01, 0.0);
    copyBitsToByteArrayLE(raw_value, byteArray, 3840, 12);

    raw_value = convertPhysicalToRaw(@CAN_PrivMain::RFL_Object::RXX_Object_Obj6.PxAxCoVnce, 0.01, 0.0);
    copyBitsToByteArrayLE(raw_value, byteArray, 3904, 12);

    raw_value = convertPhysicalToRaw(@CAN_PrivMain::RFL_Object::RXX_Object_Obj6.FilterInformation, 1.0, 0.0);
    copyBitsToByteArrayLE(raw_value, byteArray, 3864, 8);

    raw_value = convertPhysicalToRaw(@CAN_PrivMain::RFL_Object::RXX_Object_Obj6.PyVyCoVnce, 0.01, 0.0);
    copyBitsToByteArrayLE(raw_value, byteArray, 3884, 12);

    raw_value = convertPhysicalToRaw(@CAN_PrivMain::RFL_Object::RXX_Object_Obj6.ReferencePoint, 1.0, 0.0);
    copyBitsToByteArrayLE(raw_value, byteArray, 3896, 4);
}


void RXX_Object_Obj5_write(byte byteArray[])
{
    qword raw_value;

    raw_value = convertPhysicalToRaw(@CAN_PrivMain::RFL_Object::RXX_Object_Obj5.AxVnce, 0.01, 0.0);
    copyBitsToByteArrayLE(raw_value, byteArray, 3168, 12);

    raw_value = convertPhysicalToRaw(@CAN_PrivMain::RFL_Object::RXX_Object_Obj5.VxVnce, 0.01, 0.0);
    copyBitsToByteArrayLE(raw_value, byteArray, 3264, 12);

    raw_value = convertPhysicalToRaw(@CAN_PrivMain::RFL_Object::RXX_Object_Obj5.ObjId, 1.0, 0.0);
    copyBitsToByteArrayLE(raw_value, byteArray, 3256, 7);

    raw_value = convertPhysicalToRaw(@CAN_PrivMain::RFL_Object::RXX_Object_Obj5.Vx, 0.0625, -128.0);
    copyBitsToByteArrayLE(raw_value, byteArray, 3244, 12);

    raw_value = convertPhysicalToRaw(@CAN_PrivMain::RFL_Object::RXX_Object_Obj5.AyVnce, 0.01, 0.0);
    copyBitsToByteArrayLE(raw_value, byteArray, 3232, 12);

    raw_value = convertPhysicalToRaw(@CAN_PrivMain::RFL_Object::RXX_Object_Obj5.RCS, 0.2, -102.4);
    copyBitsToByteArrayLE(raw_value, byteArray, 3212, 10);

    raw_value = convertPhysicalToRaw(@CAN_PrivMain::RFL_Object::RXX_Object_Obj5.WidthVnce, 0.01, 0.0);
    copyBitsToByteArrayLE(raw_value, byteArray, 3200, 12);

    raw_value = convertPhysicalToRaw(@CAN_PrivMain::RFL_Object::RXX_Object_Obj5.Width, 0.125, 0.0);
    copyBitsToByteArrayLE(raw_value, byteArray, 3192, 7);

    raw_value = convertPhysicalToRaw(@CAN_PrivMain::RFL_Object::RXX_Object_Obj5.OrientationYawVnce, 0.0003, 0.0);
    copyBitsToByteArrayLE(raw_value, byteArray, 3180, 12);

    raw_value = convertPhysicalToRaw(@CAN_PrivMain::RFL_Object::RXX_Object_Obj5.PyVnce, 0.1, 0.0);
    copyBitsToByteArrayLE(raw_value, byteArray, 3116, 12);

    raw_value = convertPhysicalToRaw(@CAN_PrivMain::RFL_Object::RXX_Object_Obj5.OrientationYaw, 0.0175, -4.48);
    copyBitsToByteArrayLE(raw_value, byteArray, 3158, 9);

    raw_value = convertPhysicalToRaw(@CAN_PrivMain::RFL_Object::RXX_Object_Obj5.Ax, 0.03125, -16.0);
    copyBitsToByteArrayLE(raw_value, byteArray, 3148, 10);

    raw_value = convertPhysicalToRaw(@CAN_PrivMain::RFL_Object::RXX_Object_Obj5.LengthVnce, 0.01, 0.0);
    copyBitsToByteArrayLE(raw_value, byteArray, 3136, 12);

    raw_value = convertPhysicalToRaw(@CAN_PrivMain::RFL_Object::RXX_Object_Obj5.Length, 0.125, 0.0);
    copyBitsToByteArrayLE(raw_value, byteArray, 3128, 7);

    raw_value = convertPhysicalToRaw(@CAN_PrivMain::RFL_Object::RXX_Object_Obj5.Vy, 0.125, -64.0);
    copyBitsToByteArrayLE(raw_value, byteArray, 3278, 10);

    raw_value = convertPhysicalToRaw(@CAN_PrivMain::RFL_Object::RXX_Object_Obj5.Py, 0.0625, -128.0);
    copyBitsToByteArrayLE(raw_value, byteArray, 3104, 12);

    raw_value = convertPhysicalToRaw(@CAN_PrivMain::RFL_Object::RXX_Object_Obj5.PxVnce, 0.1, 0.0);
    copyBitsToByteArrayLE(raw_value, byteArray, 3092, 12);

    raw_value = convertPhysicalToRaw(@CAN_PrivMain::RFL_Object::RXX_Object_Obj5.Px, 0.0625, -512.0);
    copyBitsToByteArrayLE(raw_value, byteArray, 3078, 14);

    raw_value = convertPhysicalToRaw(@CAN_PrivMain::RFL_Object::RXX_Object_Obj5.ProbClassConfidence, 2.0, 0.0);
    copyBitsToByteArrayLE(raw_value, byteArray, 3072, 6);

    raw_value = convertPhysicalToRaw(@CAN_PrivMain::RFL_Object::RXX_Object_Obj5.MovingStatus, 1.0, 0.0);
    copyBitsToByteArrayLE(raw_value, byteArray, 3276, 2);

    raw_value = convertPhysicalToRaw(@CAN_PrivMain::RFL_Object::RXX_Object_Obj5.Ay, 0.0625, -16.0);
    copyBitsToByteArrayLE(raw_value, byteArray, 3222, 9);

    raw_value = convertPhysicalToRaw(@CAN_PrivMain::RFL_Object::RXX_Object_Obj5.ExistProb, 2.0, 0.0);
    copyBitsToByteArrayLE(raw_value, byteArray, 3288, 6);

    raw_value = convertPhysicalToRaw(@CAN_PrivMain::RFL_Object::RXX_Object_Obj5.PxAxCoVnce, 0.01, 0.0);
    copyBitsToByteArrayLE(raw_value, byteArray, 3392, 12);

    raw_value = convertPhysicalToRaw(@CAN_PrivMain::RFL_Object::RXX_Object_Obj5.Age, 1.0, 0.0);
    copyBitsToByteArrayLE(raw_value, byteArray, 3552, 32);

    raw_value = convertPhysicalToRaw(@CAN_PrivMain::RFL_Object::RXX_Object_Obj5.VyVnce, 0.01, 0.0);
    copyBitsToByteArrayLE(raw_value, byteArray, 3296, 12);

    raw_value = convertPhysicalToRaw(@CAN_PrivMain::RFL_Object::RXX_Object_Obj5.VyAyCoVnce, 0.01, 0.0);
    copyBitsToByteArrayLE(raw_value, byteArray, 3520, 12);

    raw_value = convertPhysicalToRaw(@CAN_PrivMain::RFL_Object::RXX_Object_Obj5.VyAxCoVnce, 0.01, 0.0);
    copyBitsToByteArrayLE(raw_value, byteArray, 3500, 12);

    raw_value = convertPhysicalToRaw(@CAN_PrivMain::RFL_Object::RXX_Object_Obj5.VxAyCoVnce, 0.01, 0.0);
    copyBitsToByteArrayLE(raw_value, byteArray, 3488, 12);

    raw_value = convertPhysicalToRaw(@CAN_PrivMain::RFL_Object::RXX_Object_Obj5.VxAxCoVnce, 0.01, 0.0);
    copyBitsToByteArrayLE(raw_value, byteArray, 3468, 12);

    raw_value = convertPhysicalToRaw(@CAN_PrivMain::RFL_Object::RXX_Object_Obj5.VxVyCoVnce, 0.01, 0.0);
    copyBitsToByteArrayLE(raw_value, byteArray, 3456, 12);

    raw_value = convertPhysicalToRaw(@CAN_PrivMain::RFL_Object::RXX_Object_Obj5.PyAyCoVnce, 0.01, 0.0);
    copyBitsToByteArrayLE(raw_value, byteArray, 3436, 12);

    raw_value = convertPhysicalToRaw(@CAN_PrivMain::RFL_Object::RXX_Object_Obj5.PyAxCoVnce, 0.01, 0.0);
    copyBitsToByteArrayLE(raw_value, byteArray, 3424, 12);

    raw_value = convertPhysicalToRaw(@CAN_PrivMain::RFL_Object::RXX_Object_Obj5.PxAyCoVnce, 0.01, 0.0);
    copyBitsToByteArrayLE(raw_value, byteArray, 3404, 12);

    raw_value = convertPhysicalToRaw(@CAN_PrivMain::RFL_Object::RXX_Object_Obj5.AxAyCoVnce, 0.01, 0.0);
    copyBitsToByteArrayLE(raw_value, byteArray, 3532, 12);

    raw_value = convertPhysicalToRaw(@CAN_PrivMain::RFL_Object::RXX_Object_Obj5.ReferencePoint, 1.0, 0.0);
    copyBitsToByteArrayLE(raw_value, byteArray, 3384, 4);

    raw_value = convertPhysicalToRaw(@CAN_PrivMain::RFL_Object::RXX_Object_Obj5.PxVxCoVnce, 0.01, 0.0);
    copyBitsToByteArrayLE(raw_value, byteArray, 3328, 12);

    raw_value = convertPhysicalToRaw(@CAN_PrivMain::RFL_Object::RXX_Object_Obj5.PyVyCoVnce, 0.01, 0.0);
    copyBitsToByteArrayLE(raw_value, byteArray, 3372, 12);

    raw_value = convertPhysicalToRaw(@CAN_PrivMain::RFL_Object::RXX_Object_Obj5.MeasurementStatus, 1.0, 0.0);
    copyBitsToByteArrayLE(raw_value, byteArray, 3320, 3);

    raw_value = convertPhysicalToRaw(@CAN_PrivMain::RFL_Object::RXX_Object_Obj5.ProbClassType, 1.0, 0.0);
    copyBitsToByteArrayLE(raw_value, byteArray, 3323, 4);

    raw_value = convertPhysicalToRaw(@CAN_PrivMain::RFL_Object::RXX_Object_Obj5.PxPyCoVnce, 0.01, 0.0);
    copyBitsToByteArrayLE(raw_value, byteArray, 3308, 12);

    raw_value = convertPhysicalToRaw(@CAN_PrivMain::RFL_Object::RXX_Object_Obj5.PxVyCoVnce, 0.01, 0.0);
    copyBitsToByteArrayLE(raw_value, byteArray, 3340, 12);

    raw_value = convertPhysicalToRaw(@CAN_PrivMain::RFL_Object::RXX_Object_Obj5.FilterInformation, 1.0, 0.0);
    copyBitsToByteArrayLE(raw_value, byteArray, 3352, 8);

    raw_value = convertPhysicalToRaw(@CAN_PrivMain::RFL_Object::RXX_Object_Obj5.PyVxCoVnce, 0.01, 0.0);
    copyBitsToByteArrayLE(raw_value, byteArray, 3360, 12);
}


void RXX_Object_Obj4_write(byte byteArray[])
{
    qword raw_value;

    raw_value = convertPhysicalToRaw(@CAN_PrivMain::RFL_Object::RXX_Object_Obj4.VxVnce, 0.01, 0.0);
    copyBitsToByteArrayLE(raw_value, byteArray, 2752, 12);

    raw_value = convertPhysicalToRaw(@CAN_PrivMain::RFL_Object::RXX_Object_Obj4.AxVnce, 0.01, 0.0);
    copyBitsToByteArrayLE(raw_value, byteArray, 2656, 12);

    raw_value = convertPhysicalToRaw(@CAN_PrivMain::RFL_Object::RXX_Object_Obj4.ObjId, 1.0, 0.0);
    copyBitsToByteArrayLE(raw_value, byteArray, 2744, 7);

    raw_value = convertPhysicalToRaw(@CAN_PrivMain::RFL_Object::RXX_Object_Obj4.Vx, 0.0625, -128.0);
    copyBitsToByteArrayLE(raw_value, byteArray, 2732, 12);

    raw_value = convertPhysicalToRaw(@CAN_PrivMain::RFL_Object::RXX_Object_Obj4.AyVnce, 0.01, 0.0);
    copyBitsToByteArrayLE(raw_value, byteArray, 2720, 12);

    raw_value = convertPhysicalToRaw(@CAN_PrivMain::RFL_Object::RXX_Object_Obj4.Ay, 0.0625, -16.0);
    copyBitsToByteArrayLE(raw_value, byteArray, 2710, 9);

    raw_value = convertPhysicalToRaw(@CAN_PrivMain::RFL_Object::RXX_Object_Obj4.RCS, 0.2, -102.4);
    copyBitsToByteArrayLE(raw_value, byteArray, 2700, 10);

    raw_value = convertPhysicalToRaw(@CAN_PrivMain::RFL_Object::RXX_Object_Obj4.WidthVnce, 0.01, 0.0);
    copyBitsToByteArrayLE(raw_value, byteArray, 2688, 12);

    raw_value = convertPhysicalToRaw(@CAN_PrivMain::RFL_Object::RXX_Object_Obj4.Width, 0.125, 0.0);
    copyBitsToByteArrayLE(raw_value, byteArray, 2680, 7);

    raw_value = convertPhysicalToRaw(@CAN_PrivMain::RFL_Object::RXX_Object_Obj4.OrientationYawVnce, 0.0003, 0.0);
    copyBitsToByteArrayLE(raw_value, byteArray, 2668, 12);

    raw_value = convertPhysicalToRaw(@CAN_PrivMain::RFL_Object::RXX_Object_Obj4.Length, 0.125, 0.0);
    copyBitsToByteArrayLE(raw_value, byteArray, 2616, 7);

    raw_value = convertPhysicalToRaw(@CAN_PrivMain::RFL_Object::RXX_Object_Obj4.OrientationYaw, 0.0175, -4.48);
    copyBitsToByteArrayLE(raw_value, byteArray, 2646, 9);

    raw_value = convertPhysicalToRaw(@CAN_PrivMain::RFL_Object::RXX_Object_Obj4.Ax, 0.03125, -16.0);
    copyBitsToByteArrayLE(raw_value, byteArray, 2636, 10);

    raw_value = convertPhysicalToRaw(@CAN_PrivMain::RFL_Object::RXX_Object_Obj4.LengthVnce, 0.01, 0.0);
    copyBitsToByteArrayLE(raw_value, byteArray, 2624, 12);

    raw_value = convertPhysicalToRaw(@CAN_PrivMain::RFL_Object::RXX_Object_Obj4.PyVnce, 0.1, 0.0);
    copyBitsToByteArrayLE(raw_value, byteArray, 2604, 12);

    raw_value = convertPhysicalToRaw(@CAN_PrivMain::RFL_Object::RXX_Object_Obj4.Py, 0.0625, -128.0);
    copyBitsToByteArrayLE(raw_value, byteArray, 2592, 12);

    raw_value = convertPhysicalToRaw(@CAN_PrivMain::RFL_Object::RXX_Object_Obj4.PxVnce, 0.1, 0.0);
    copyBitsToByteArrayLE(raw_value, byteArray, 2580, 12);

    raw_value = convertPhysicalToRaw(@CAN_PrivMain::RFL_Object::RXX_Object_Obj4.Px, 0.0625, -512.0);
    copyBitsToByteArrayLE(raw_value, byteArray, 2566, 14);

    raw_value = convertPhysicalToRaw(@CAN_PrivMain::RFL_Object::RXX_Object_Obj4.ProbClassConfidence, 2.0, 0.0);
    copyBitsToByteArrayLE(raw_value, byteArray, 2560, 6);

    raw_value = convertPhysicalToRaw(@CAN_PrivMain::RFL_Object::RXX_Object_Obj4.Vy, 0.125, -64.0);
    copyBitsToByteArrayLE(raw_value, byteArray, 2766, 10);

    raw_value = convertPhysicalToRaw(@CAN_PrivMain::RFL_Object::RXX_Object_Obj4.MovingStatus, 1.0, 0.0);
    copyBitsToByteArrayLE(raw_value, byteArray, 2764, 2);

    raw_value = convertPhysicalToRaw(@CAN_PrivMain::RFL_Object::RXX_Object_Obj4.PyAyCoVnce, 0.01, 0.0);
    copyBitsToByteArrayLE(raw_value, byteArray, 2924, 12);

    raw_value = convertPhysicalToRaw(@CAN_PrivMain::RFL_Object::RXX_Object_Obj4.ExistProb, 2.0, 0.0);
    copyBitsToByteArrayLE(raw_value, byteArray, 2776, 6);

    raw_value = convertPhysicalToRaw(@CAN_PrivMain::RFL_Object::RXX_Object_Obj4.PxAxCoVnce, 0.01, 0.0);
    copyBitsToByteArrayLE(raw_value, byteArray, 2880, 12);

    raw_value = convertPhysicalToRaw(@CAN_PrivMain::RFL_Object::RXX_Object_Obj4.AxAyCoVnce, 0.01, 0.0);
    copyBitsToByteArrayLE(raw_value, byteArray, 3020, 12);

    raw_value = convertPhysicalToRaw(@CAN_PrivMain::RFL_Object::RXX_Object_Obj4.VyVnce, 0.01, 0.0);
    copyBitsToByteArrayLE(raw_value, byteArray, 2784, 12);

    raw_value = convertPhysicalToRaw(@CAN_PrivMain::RFL_Object::RXX_Object_Obj4.Age, 1.0, 0.0);
    copyBitsToByteArrayLE(raw_value, byteArray, 3040, 32);

    raw_value = convertPhysicalToRaw(@CAN_PrivMain::RFL_Object::RXX_Object_Obj4.VyAyCoVnce, 0.01, 0.0);
    copyBitsToByteArrayLE(raw_value, byteArray, 3008, 12);

    raw_value = convertPhysicalToRaw(@CAN_PrivMain::RFL_Object::RXX_Object_Obj4.VyAxCoVnce, 0.01, 0.0);
    copyBitsToByteArrayLE(raw_value, byteArray, 2988, 12);

    raw_value = convertPhysicalToRaw(@CAN_PrivMain::RFL_Object::RXX_Object_Obj4.VxAyCoVnce, 0.01, 0.0);
    copyBitsToByteArrayLE(raw_value, byteArray, 2976, 12);

    raw_value = convertPhysicalToRaw(@CAN_PrivMain::RFL_Object::RXX_Object_Obj4.VxAxCoVnce, 0.01, 0.0);
    copyBitsToByteArrayLE(raw_value, byteArray, 2956, 12);

    raw_value = convertPhysicalToRaw(@CAN_PrivMain::RFL_Object::RXX_Object_Obj4.PyAxCoVnce, 0.01, 0.0);
    copyBitsToByteArrayLE(raw_value, byteArray, 2912, 12);

    raw_value = convertPhysicalToRaw(@CAN_PrivMain::RFL_Object::RXX_Object_Obj4.PxAyCoVnce, 0.01, 0.0);
    copyBitsToByteArrayLE(raw_value, byteArray, 2892, 12);

    raw_value = convertPhysicalToRaw(@CAN_PrivMain::RFL_Object::RXX_Object_Obj4.VxVyCoVnce, 0.01, 0.0);
    copyBitsToByteArrayLE(raw_value, byteArray, 2944, 12);

    raw_value = convertPhysicalToRaw(@CAN_PrivMain::RFL_Object::RXX_Object_Obj4.ReferencePoint, 1.0, 0.0);
    copyBitsToByteArrayLE(raw_value, byteArray, 2872, 4);

    raw_value = convertPhysicalToRaw(@CAN_PrivMain::RFL_Object::RXX_Object_Obj4.PxVyCoVnce, 0.01, 0.0);
    copyBitsToByteArrayLE(raw_value, byteArray, 2828, 12);

    raw_value = convertPhysicalToRaw(@CAN_PrivMain::RFL_Object::RXX_Object_Obj4.PxPyCoVnce, 0.01, 0.0);
    copyBitsToByteArrayLE(raw_value, byteArray, 2796, 12);

    raw_value = convertPhysicalToRaw(@CAN_PrivMain::RFL_Object::RXX_Object_Obj4.PyVyCoVnce, 0.01, 0.0);
    copyBitsToByteArrayLE(raw_value, byteArray, 2860, 12);

    raw_value = convertPhysicalToRaw(@CAN_PrivMain::RFL_Object::RXX_Object_Obj4.ProbClassType, 1.0, 0.0);
    copyBitsToByteArrayLE(raw_value, byteArray, 2811, 4);

    raw_value = convertPhysicalToRaw(@CAN_PrivMain::RFL_Object::RXX_Object_Obj4.PxVxCoVnce, 0.01, 0.0);
    copyBitsToByteArrayLE(raw_value, byteArray, 2816, 12);

    raw_value = convertPhysicalToRaw(@CAN_PrivMain::RFL_Object::RXX_Object_Obj4.MeasurementStatus, 1.0, 0.0);
    copyBitsToByteArrayLE(raw_value, byteArray, 2808, 3);

    raw_value = convertPhysicalToRaw(@CAN_PrivMain::RFL_Object::RXX_Object_Obj4.FilterInformation, 1.0, 0.0);
    copyBitsToByteArrayLE(raw_value, byteArray, 2840, 8);

    raw_value = convertPhysicalToRaw(@CAN_PrivMain::RFL_Object::RXX_Object_Obj4.PyVxCoVnce, 0.01, 0.0);
    copyBitsToByteArrayLE(raw_value, byteArray, 2848, 12);
}


void RXX_Object_Obj3_write(byte byteArray[])
{
    qword raw_value;

    raw_value = convertPhysicalToRaw(@CAN_PrivMain::RFL_Object::RXX_Object_Obj3.OrientationYawVnce, 0.0003, 0.0);
    copyBitsToByteArrayLE(raw_value, byteArray, 2156, 12);

    raw_value = convertPhysicalToRaw(@CAN_PrivMain::RFL_Object::RXX_Object_Obj3.ObjId, 1.0, 0.0);
    copyBitsToByteArrayLE(raw_value, byteArray, 2232, 7);

    raw_value = convertPhysicalToRaw(@CAN_PrivMain::RFL_Object::RXX_Object_Obj3.Vx, 0.0625, -128.0);
    copyBitsToByteArrayLE(raw_value, byteArray, 2220, 12);

    raw_value = convertPhysicalToRaw(@CAN_PrivMain::RFL_Object::RXX_Object_Obj3.AyVnce, 0.01, 0.0);
    copyBitsToByteArrayLE(raw_value, byteArray, 2208, 12);

    raw_value = convertPhysicalToRaw(@CAN_PrivMain::RFL_Object::RXX_Object_Obj3.Ay, 0.0625, -16.0);
    copyBitsToByteArrayLE(raw_value, byteArray, 2198, 9);

    raw_value = convertPhysicalToRaw(@CAN_PrivMain::RFL_Object::RXX_Object_Obj3.RCS, 0.2, -102.4);
    copyBitsToByteArrayLE(raw_value, byteArray, 2188, 10);

    raw_value = convertPhysicalToRaw(@CAN_PrivMain::RFL_Object::RXX_Object_Obj3.VxVnce, 0.01, 0.0);
    copyBitsToByteArrayLE(raw_value, byteArray, 2240, 12);

    raw_value = convertPhysicalToRaw(@CAN_PrivMain::RFL_Object::RXX_Object_Obj3.WidthVnce, 0.01, 0.0);
    copyBitsToByteArrayLE(raw_value, byteArray, 2176, 12);

    raw_value = convertPhysicalToRaw(@CAN_PrivMain::RFL_Object::RXX_Object_Obj3.Width, 0.125, 0.0);
    copyBitsToByteArrayLE(raw_value, byteArray, 2168, 7);

    raw_value = convertPhysicalToRaw(@CAN_PrivMain::RFL_Object::RXX_Object_Obj3.Px, 0.0625, -512.0);
    copyBitsToByteArrayLE(raw_value, byteArray, 2054, 14);

    raw_value = convertPhysicalToRaw(@CAN_PrivMain::RFL_Object::RXX_Object_Obj3.AxVnce, 0.01, 0.0);
    copyBitsToByteArrayLE(raw_value, byteArray, 2144, 12);

    raw_value = convertPhysicalToRaw(@CAN_PrivMain::RFL_Object::RXX_Object_Obj3.OrientationYaw, 0.0175, -4.48);
    copyBitsToByteArrayLE(raw_value, byteArray, 2134, 9);

    raw_value = convertPhysicalToRaw(@CAN_PrivMain::RFL_Object::RXX_Object_Obj3.Ax, 0.03125, -16.0);
    copyBitsToByteArrayLE(raw_value, byteArray, 2124, 10);

    raw_value = convertPhysicalToRaw(@CAN_PrivMain::RFL_Object::RXX_Object_Obj3.LengthVnce, 0.01, 0.0);
    copyBitsToByteArrayLE(raw_value, byteArray, 2112, 12);

    raw_value = convertPhysicalToRaw(@CAN_PrivMain::RFL_Object::RXX_Object_Obj3.Length, 0.125, 0.0);
    copyBitsToByteArrayLE(raw_value, byteArray, 2104, 7);

    raw_value = convertPhysicalToRaw(@CAN_PrivMain::RFL_Object::RXX_Object_Obj3.PyVnce, 0.1, 0.0);
    copyBitsToByteArrayLE(raw_value, byteArray, 2092, 12);

    raw_value = convertPhysicalToRaw(@CAN_PrivMain::RFL_Object::RXX_Object_Obj3.Py, 0.0625, -128.0);
    copyBitsToByteArrayLE(raw_value, byteArray, 2080, 12);

    raw_value = convertPhysicalToRaw(@CAN_PrivMain::RFL_Object::RXX_Object_Obj3.PxVnce, 0.1, 0.0);
    copyBitsToByteArrayLE(raw_value, byteArray, 2068, 12);

    raw_value = convertPhysicalToRaw(@CAN_PrivMain::RFL_Object::RXX_Object_Obj3.ProbClassConfidence, 2.0, 0.0);
    copyBitsToByteArrayLE(raw_value, byteArray, 2048, 6);

    raw_value = convertPhysicalToRaw(@CAN_PrivMain::RFL_Object::RXX_Object_Obj3.Vy, 0.125, -64.0);
    copyBitsToByteArrayLE(raw_value, byteArray, 2254, 10);

    raw_value = convertPhysicalToRaw(@CAN_PrivMain::RFL_Object::RXX_Object_Obj3.MovingStatus, 1.0, 0.0);
    copyBitsToByteArrayLE(raw_value, byteArray, 2252, 2);

    raw_value = convertPhysicalToRaw(@CAN_PrivMain::RFL_Object::RXX_Object_Obj3.PxPyCoVnce, 0.01, 0.0);
    copyBitsToByteArrayLE(raw_value, byteArray, 2284, 12);

    raw_value = convertPhysicalToRaw(@CAN_PrivMain::RFL_Object::RXX_Object_Obj3.ExistProb, 2.0, 0.0);
    copyBitsToByteArrayLE(raw_value, byteArray, 2264, 6);

    raw_value = convertPhysicalToRaw(@CAN_PrivMain::RFL_Object::RXX_Object_Obj3.PyAxCoVnce, 0.01, 0.0);
    copyBitsToByteArrayLE(raw_value, byteArray, 2400, 12);

    raw_value = convertPhysicalToRaw(@CAN_PrivMain::RFL_Object::RXX_Object_Obj3.VyVnce, 0.01, 0.0);
    copyBitsToByteArrayLE(raw_value, byteArray, 2272, 12);

    raw_value = convertPhysicalToRaw(@CAN_PrivMain::RFL_Object::RXX_Object_Obj3.Age, 1.0, 0.0);
    copyBitsToByteArrayLE(raw_value, byteArray, 2528, 32);

    raw_value = convertPhysicalToRaw(@CAN_PrivMain::RFL_Object::RXX_Object_Obj3.AxAyCoVnce, 0.01, 0.0);
    copyBitsToByteArrayLE(raw_value, byteArray, 2508, 12);

    raw_value = convertPhysicalToRaw(@CAN_PrivMain::RFL_Object::RXX_Object_Obj3.VyAyCoVnce, 0.01, 0.0);
    copyBitsToByteArrayLE(raw_value, byteArray, 2496, 12);

    raw_value = convertPhysicalToRaw(@CAN_PrivMain::RFL_Object::RXX_Object_Obj3.VyAxCoVnce, 0.01, 0.0);
    copyBitsToByteArrayLE(raw_value, byteArray, 2476, 12);

    raw_value = convertPhysicalToRaw(@CAN_PrivMain::RFL_Object::RXX_Object_Obj3.VxAyCoVnce, 0.01, 0.0);
    copyBitsToByteArrayLE(raw_value, byteArray, 2464, 12);

    raw_value = convertPhysicalToRaw(@CAN_PrivMain::RFL_Object::RXX_Object_Obj3.VxAxCoVnce, 0.01, 0.0);
    copyBitsToByteArrayLE(raw_value, byteArray, 2444, 12);

    raw_value = convertPhysicalToRaw(@CAN_PrivMain::RFL_Object::RXX_Object_Obj3.VxVyCoVnce, 0.01, 0.0);
    copyBitsToByteArrayLE(raw_value, byteArray, 2432, 12);

    raw_value = convertPhysicalToRaw(@CAN_PrivMain::RFL_Object::RXX_Object_Obj3.PyAyCoVnce, 0.01, 0.0);
    copyBitsToByteArrayLE(raw_value, byteArray, 2412, 12);

    raw_value = convertPhysicalToRaw(@CAN_PrivMain::RFL_Object::RXX_Object_Obj3.PyVxCoVnce, 0.01, 0.0);
    copyBitsToByteArrayLE(raw_value, byteArray, 2336, 12);

    raw_value = convertPhysicalToRaw(@CAN_PrivMain::RFL_Object::RXX_Object_Obj3.PxAyCoVnce, 0.01, 0.0);
    copyBitsToByteArrayLE(raw_value, byteArray, 2380, 12);

    raw_value = convertPhysicalToRaw(@CAN_PrivMain::RFL_Object::RXX_Object_Obj3.PxVyCoVnce, 0.01, 0.0);
    copyBitsToByteArrayLE(raw_value, byteArray, 2316, 12);

    raw_value = convertPhysicalToRaw(@CAN_PrivMain::RFL_Object::RXX_Object_Obj3.MeasurementStatus, 1.0, 0.0);
    copyBitsToByteArrayLE(raw_value, byteArray, 2296, 3);

    raw_value = convertPhysicalToRaw(@CAN_PrivMain::RFL_Object::RXX_Object_Obj3.ProbClassType, 1.0, 0.0);
    copyBitsToByteArrayLE(raw_value, byteArray, 2299, 4);

    raw_value = convertPhysicalToRaw(@CAN_PrivMain::RFL_Object::RXX_Object_Obj3.PxVxCoVnce, 0.01, 0.0);
    copyBitsToByteArrayLE(raw_value, byteArray, 2304, 12);

    raw_value = convertPhysicalToRaw(@CAN_PrivMain::RFL_Object::RXX_Object_Obj3.PxAxCoVnce, 0.01, 0.0);
    copyBitsToByteArrayLE(raw_value, byteArray, 2368, 12);

    raw_value = convertPhysicalToRaw(@CAN_PrivMain::RFL_Object::RXX_Object_Obj3.FilterInformation, 1.0, 0.0);
    copyBitsToByteArrayLE(raw_value, byteArray, 2328, 8);

    raw_value = convertPhysicalToRaw(@CAN_PrivMain::RFL_Object::RXX_Object_Obj3.PyVyCoVnce, 0.01, 0.0);
    copyBitsToByteArrayLE(raw_value, byteArray, 2348, 12);

    raw_value = convertPhysicalToRaw(@CAN_PrivMain::RFL_Object::RXX_Object_Obj3.ReferencePoint, 1.0, 0.0);
    copyBitsToByteArrayLE(raw_value, byteArray, 2360, 4);
}


void RXX_Object_Obj2_write(byte byteArray[])
{
    qword raw_value;

    raw_value = convertPhysicalToRaw(@CAN_PrivMain::RFL_Object::RXX_Object_Obj2.MovingStatus, 1.0, 0.0);
    copyBitsToByteArrayLE(raw_value, byteArray, 1740, 2);

    raw_value = convertPhysicalToRaw(@CAN_PrivMain::RFL_Object::RXX_Object_Obj2.Width, 0.125, 0.0);
    copyBitsToByteArrayLE(raw_value, byteArray, 1656, 7);

    raw_value = convertPhysicalToRaw(@CAN_PrivMain::RFL_Object::RXX_Object_Obj2.VxVnce, 0.01, 0.0);
    copyBitsToByteArrayLE(raw_value, byteArray, 1728, 12);

    raw_value = convertPhysicalToRaw(@CAN_PrivMain::RFL_Object::RXX_Object_Obj2.ObjId, 1.0, 0.0);
    copyBitsToByteArrayLE(raw_value, byteArray, 1720, 7);

    raw_value = convertPhysicalToRaw(@CAN_PrivMain::RFL_Object::RXX_Object_Obj2.Vx, 0.0625, -128.0);
    copyBitsToByteArrayLE(raw_value, byteArray, 1708, 12);

    raw_value = convertPhysicalToRaw(@CAN_PrivMain::RFL_Object::RXX_Object_Obj2.AyVnce, 0.01, 0.0);
    copyBitsToByteArrayLE(raw_value, byteArray, 1696, 12);

    raw_value = convertPhysicalToRaw(@CAN_PrivMain::RFL_Object::RXX_Object_Obj2.Ay, 0.0625, -16.0);
    copyBitsToByteArrayLE(raw_value, byteArray, 1686, 9);

    raw_value = convertPhysicalToRaw(@CAN_PrivMain::RFL_Object::RXX_Object_Obj2.RCS, 0.2, -102.4);
    copyBitsToByteArrayLE(raw_value, byteArray, 1676, 10);

    raw_value = convertPhysicalToRaw(@CAN_PrivMain::RFL_Object::RXX_Object_Obj2.WidthVnce, 0.01, 0.0);
    copyBitsToByteArrayLE(raw_value, byteArray, 1664, 12);

    raw_value = convertPhysicalToRaw(@CAN_PrivMain::RFL_Object::RXX_Object_Obj2.LengthVnce, 0.01, 0.0);
    copyBitsToByteArrayLE(raw_value, byteArray, 1600, 12);

    raw_value = convertPhysicalToRaw(@CAN_PrivMain::RFL_Object::RXX_Object_Obj2.OrientationYawVnce, 0.0003, 0.0);
    copyBitsToByteArrayLE(raw_value, byteArray, 1644, 12);

    raw_value = convertPhysicalToRaw(@CAN_PrivMain::RFL_Object::RXX_Object_Obj2.AxVnce, 0.01, 0.0);
    copyBitsToByteArrayLE(raw_value, byteArray, 1632, 12);

    raw_value = convertPhysicalToRaw(@CAN_PrivMain::RFL_Object::RXX_Object_Obj2.OrientationYaw, 0.0175, -4.48);
    copyBitsToByteArrayLE(raw_value, byteArray, 1622, 9);

    raw_value = convertPhysicalToRaw(@CAN_PrivMain::RFL_Object::RXX_Object_Obj2.ExistProb, 2.0, 0.0);
    copyBitsToByteArrayLE(raw_value, byteArray, 1752, 6);

    raw_value = convertPhysicalToRaw(@CAN_PrivMain::RFL_Object::RXX_Object_Obj2.Length, 0.125, 0.0);
    copyBitsToByteArrayLE(raw_value, byteArray, 1592, 7);

    raw_value = convertPhysicalToRaw(@CAN_PrivMain::RFL_Object::RXX_Object_Obj2.PyVnce, 0.1, 0.0);
    copyBitsToByteArrayLE(raw_value, byteArray, 1580, 12);

    raw_value = convertPhysicalToRaw(@CAN_PrivMain::RFL_Object::RXX_Object_Obj2.Py, 0.0625, -128.0);
    copyBitsToByteArrayLE(raw_value, byteArray, 1568, 12);

    raw_value = convertPhysicalToRaw(@CAN_PrivMain::RFL_Object::RXX_Object_Obj2.PxVnce, 0.1, 0.0);
    copyBitsToByteArrayLE(raw_value, byteArray, 1556, 12);

    raw_value = convertPhysicalToRaw(@CAN_PrivMain::RFL_Object::RXX_Object_Obj2.ProbClassConfidence, 2.0, 0.0);
    copyBitsToByteArrayLE(raw_value, byteArray, 1536, 6);

    raw_value = convertPhysicalToRaw(@CAN_PrivMain::RFL_Object::RXX_Object_Obj2.Vy, 0.125, -64.0);
    copyBitsToByteArrayLE(raw_value, byteArray, 1742, 10);

    raw_value = convertPhysicalToRaw(@CAN_PrivMain::RFL_Object::RXX_Object_Obj2.Px, 0.0625, -512.0);
    copyBitsToByteArrayLE(raw_value, byteArray, 1542, 14);

    raw_value = convertPhysicalToRaw(@CAN_PrivMain::RFL_Object::RXX_Object_Obj2.VyVnce, 0.01, 0.0);
    copyBitsToByteArrayLE(raw_value, byteArray, 1760, 12);

    raw_value = convertPhysicalToRaw(@CAN_PrivMain::RFL_Object::RXX_Object_Obj2.PyAxCoVnce, 0.01, 0.0);
    copyBitsToByteArrayLE(raw_value, byteArray, 1888, 12);

    raw_value = convertPhysicalToRaw(@CAN_PrivMain::RFL_Object::RXX_Object_Obj2.PxPyCoVnce, 0.01, 0.0);
    copyBitsToByteArrayLE(raw_value, byteArray, 1772, 12);

    raw_value = convertPhysicalToRaw(@CAN_PrivMain::RFL_Object::RXX_Object_Obj2.Age, 1.0, 0.0);
    copyBitsToByteArrayLE(raw_value, byteArray, 2016, 32);

    raw_value = convertPhysicalToRaw(@CAN_PrivMain::RFL_Object::RXX_Object_Obj2.AxAyCoVnce, 0.01, 0.0);
    copyBitsToByteArrayLE(raw_value, byteArray, 1996, 12);

    raw_value = convertPhysicalToRaw(@CAN_PrivMain::RFL_Object::RXX_Object_Obj2.VyAyCoVnce, 0.01, 0.0);
    copyBitsToByteArrayLE(raw_value, byteArray, 1984, 12);

    raw_value = convertPhysicalToRaw(@CAN_PrivMain::RFL_Object::RXX_Object_Obj2.VyAxCoVnce, 0.01, 0.0);
    copyBitsToByteArrayLE(raw_value, byteArray, 1964, 12);

    raw_value = convertPhysicalToRaw(@CAN_PrivMain::RFL_Object::RXX_Object_Obj2.VxAyCoVnce, 0.01, 0.0);
    copyBitsToByteArrayLE(raw_value, byteArray, 1952, 12);

    raw_value = convertPhysicalToRaw(@CAN_PrivMain::RFL_Object::RXX_Object_Obj2.VxAxCoVnce, 0.01, 0.0);
    copyBitsToByteArrayLE(raw_value, byteArray, 1932, 12);

    raw_value = convertPhysicalToRaw(@CAN_PrivMain::RFL_Object::RXX_Object_Obj2.VxVyCoVnce, 0.01, 0.0);
    copyBitsToByteArrayLE(raw_value, byteArray, 1920, 12);

    raw_value = convertPhysicalToRaw(@CAN_PrivMain::RFL_Object::RXX_Object_Obj2.PyAyCoVnce, 0.01, 0.0);
    copyBitsToByteArrayLE(raw_value, byteArray, 1900, 12);

    raw_value = convertPhysicalToRaw(@CAN_PrivMain::RFL_Object::RXX_Object_Obj2.Ax, 0.03125, -16.0);
    copyBitsToByteArrayLE(raw_value, byteArray, 1612, 10);

    raw_value = convertPhysicalToRaw(@CAN_PrivMain::RFL_Object::RXX_Object_Obj2.PxAyCoVnce, 0.01, 0.0);
    copyBitsToByteArrayLE(raw_value, byteArray, 1868, 12);

    raw_value = convertPhysicalToRaw(@CAN_PrivMain::RFL_Object::RXX_Object_Obj2.ReferencePoint, 1.0, 0.0);
    copyBitsToByteArrayLE(raw_value, byteArray, 1848, 4);

    raw_value = convertPhysicalToRaw(@CAN_PrivMain::RFL_Object::RXX_Object_Obj2.PyVyCoVnce, 0.01, 0.0);
    copyBitsToByteArrayLE(raw_value, byteArray, 1836, 12);

    raw_value = convertPhysicalToRaw(@CAN_PrivMain::RFL_Object::RXX_Object_Obj2.PyVxCoVnce, 0.01, 0.0);
    copyBitsToByteArrayLE(raw_value, byteArray, 1824, 12);

    raw_value = convertPhysicalToRaw(@CAN_PrivMain::RFL_Object::RXX_Object_Obj2.FilterInformation, 1.0, 0.0);
    copyBitsToByteArrayLE(raw_value, byteArray, 1816, 8);

    raw_value = convertPhysicalToRaw(@CAN_PrivMain::RFL_Object::RXX_Object_Obj2.PxVyCoVnce, 0.01, 0.0);
    copyBitsToByteArrayLE(raw_value, byteArray, 1804, 12);

    raw_value = convertPhysicalToRaw(@CAN_PrivMain::RFL_Object::RXX_Object_Obj2.PxVxCoVnce, 0.01, 0.0);
    copyBitsToByteArrayLE(raw_value, byteArray, 1792, 12);

    raw_value = convertPhysicalToRaw(@CAN_PrivMain::RFL_Object::RXX_Object_Obj2.ProbClassType, 1.0, 0.0);
    copyBitsToByteArrayLE(raw_value, byteArray, 1787, 4);

    raw_value = convertPhysicalToRaw(@CAN_PrivMain::RFL_Object::RXX_Object_Obj2.PxAxCoVnce, 0.01, 0.0);
    copyBitsToByteArrayLE(raw_value, byteArray, 1856, 12);

    raw_value = convertPhysicalToRaw(@CAN_PrivMain::RFL_Object::RXX_Object_Obj2.MeasurementStatus, 1.0, 0.0);
    copyBitsToByteArrayLE(raw_value, byteArray, 1784, 3);
}


void RXX_Object_Obj1_write(byte byteArray[])
{
    qword raw_value;

    raw_value = convertPhysicalToRaw(@CAN_PrivMain::RFL_Object::RXX_Object_Obj1.Ay, 0.0625, -16.0);
    copyBitsToByteArrayLE(raw_value, byteArray, 1174, 9);

    raw_value = convertPhysicalToRaw(@CAN_PrivMain::RFL_Object::RXX_Object_Obj1.WidthVnce, 0.01, 0.0);
    copyBitsToByteArrayLE(raw_value, byteArray, 1152, 12);

    raw_value = convertPhysicalToRaw(@CAN_PrivMain::RFL_Object::RXX_Object_Obj1.RCS, 0.2, -102.4);
    copyBitsToByteArrayLE(raw_value, byteArray, 1164, 10);

    raw_value = convertPhysicalToRaw(@CAN_PrivMain::RFL_Object::RXX_Object_Obj1.VxVnce, 0.01, 0.0);
    copyBitsToByteArrayLE(raw_value, byteArray, 1216, 12);

    raw_value = convertPhysicalToRaw(@CAN_PrivMain::RFL_Object::RXX_Object_Obj1.AyVnce, 0.01, 0.0);
    copyBitsToByteArrayLE(raw_value, byteArray, 1184, 12);

    raw_value = convertPhysicalToRaw(@CAN_PrivMain::RFL_Object::RXX_Object_Obj1.Vx, 0.0625, -128.0);
    copyBitsToByteArrayLE(raw_value, byteArray, 1196, 12);

    raw_value = convertPhysicalToRaw(@CAN_PrivMain::RFL_Object::RXX_Object_Obj1.ObjId, 1.0, 0.0);
    copyBitsToByteArrayLE(raw_value, byteArray, 1208, 7);

    raw_value = convertPhysicalToRaw(@CAN_PrivMain::RFL_Object::RXX_Object_Obj1.OrientationYawVnce, 0.0003, 0.0);
    copyBitsToByteArrayLE(raw_value, byteArray, 1132, 12);

    raw_value = convertPhysicalToRaw(@CAN_PrivMain::RFL_Object::RXX_Object_Obj1.Width, 0.125, 0.0);
    copyBitsToByteArrayLE(raw_value, byteArray, 1144, 7);

    raw_value = convertPhysicalToRaw(@CAN_PrivMain::RFL_Object::RXX_Object_Obj1.LengthVnce, 0.01, 0.0);
    copyBitsToByteArrayLE(raw_value, byteArray, 1088, 12);

    raw_value = convertPhysicalToRaw(@CAN_PrivMain::RFL_Object::RXX_Object_Obj1.AxVnce, 0.01, 0.0);
    copyBitsToByteArrayLE(raw_value, byteArray, 1120, 12);

    raw_value = convertPhysicalToRaw(@CAN_PrivMain::RFL_Object::RXX_Object_Obj1.OrientationYaw, 0.0175, -4.48);
    copyBitsToByteArrayLE(raw_value, byteArray, 1110, 9);

    raw_value = convertPhysicalToRaw(@CAN_PrivMain::RFL_Object::RXX_Object_Obj1.Ax, 0.03125, -16.0);
    copyBitsToByteArrayLE(raw_value, byteArray, 1100, 10);

    raw_value = convertPhysicalToRaw(@CAN_PrivMain::RFL_Object::RXX_Object_Obj1.Vy, 0.125, -64.0);
    copyBitsToByteArrayLE(raw_value, byteArray, 1230, 10);

    raw_value = convertPhysicalToRaw(@CAN_PrivMain::RFL_Object::RXX_Object_Obj1.Length, 0.125, 0.0);
    copyBitsToByteArrayLE(raw_value, byteArray, 1080, 7);

    raw_value = convertPhysicalToRaw(@CAN_PrivMain::RFL_Object::RXX_Object_Obj1.PyVnce, 0.1, 0.0);
    copyBitsToByteArrayLE(raw_value, byteArray, 1068, 12);

    raw_value = convertPhysicalToRaw(@CAN_PrivMain::RFL_Object::RXX_Object_Obj1.Py, 0.0625, -128.0);
    copyBitsToByteArrayLE(raw_value, byteArray, 1056, 12);

    raw_value = convertPhysicalToRaw(@CAN_PrivMain::RFL_Object::RXX_Object_Obj1.PxVnce, 0.1, 0.0);
    copyBitsToByteArrayLE(raw_value, byteArray, 1044, 12);

    raw_value = convertPhysicalToRaw(@CAN_PrivMain::RFL_Object::RXX_Object_Obj1.Px, 0.0625, -512.0);
    copyBitsToByteArrayLE(raw_value, byteArray, 1030, 14);

    raw_value = convertPhysicalToRaw(@CAN_PrivMain::RFL_Object::RXX_Object_Obj1.ProbClassConfidence, 2.0, 0.0);
    copyBitsToByteArrayLE(raw_value, byteArray, 1024, 6);

    raw_value = convertPhysicalToRaw(@CAN_PrivMain::RFL_Object::RXX_Object_Obj1.MovingStatus, 1.0, 0.0);
    copyBitsToByteArrayLE(raw_value, byteArray, 1228, 2);

    raw_value = convertPhysicalToRaw(@CAN_PrivMain::RFL_Object::RXX_Object_Obj1.PxPyCoVnce, 0.01, 0.0);
    copyBitsToByteArrayLE(raw_value, byteArray, 1260, 12);

    raw_value = convertPhysicalToRaw(@CAN_PrivMain::RFL_Object::RXX_Object_Obj1.ExistProb, 2.0, 0.0);
    copyBitsToByteArrayLE(raw_value, byteArray, 1240, 6);

    raw_value = convertPhysicalToRaw(@CAN_PrivMain::RFL_Object::RXX_Object_Obj1.PyAxCoVnce, 0.01, 0.0);
    copyBitsToByteArrayLE(raw_value, byteArray, 1376, 12);

    raw_value = convertPhysicalToRaw(@CAN_PrivMain::RFL_Object::RXX_Object_Obj1.Age, 1.0, 0.0);
    copyBitsToByteArrayLE(raw_value, byteArray, 1504, 32);

    raw_value = convertPhysicalToRaw(@CAN_PrivMain::RFL_Object::RXX_Object_Obj1.AxAyCoVnce, 0.01, 0.0);
    copyBitsToByteArrayLE(raw_value, byteArray, 1484, 12);

    raw_value = convertPhysicalToRaw(@CAN_PrivMain::RFL_Object::RXX_Object_Obj1.VyAyCoVnce, 0.01, 0.0);
    copyBitsToByteArrayLE(raw_value, byteArray, 1472, 12);

    raw_value = convertPhysicalToRaw(@CAN_PrivMain::RFL_Object::RXX_Object_Obj1.VyAxCoVnce, 0.01, 0.0);
    copyBitsToByteArrayLE(raw_value, byteArray, 1452, 12);

    raw_value = convertPhysicalToRaw(@CAN_PrivMain::RFL_Object::RXX_Object_Obj1.VxAyCoVnce, 0.01, 0.0);
    copyBitsToByteArrayLE(raw_value, byteArray, 1440, 12);

    raw_value = convertPhysicalToRaw(@CAN_PrivMain::RFL_Object::RXX_Object_Obj1.VxAxCoVnce, 0.01, 0.0);
    copyBitsToByteArrayLE(raw_value, byteArray, 1420, 12);

    raw_value = convertPhysicalToRaw(@CAN_PrivMain::RFL_Object::RXX_Object_Obj1.VxVyCoVnce, 0.01, 0.0);
    copyBitsToByteArrayLE(raw_value, byteArray, 1408, 12);

    raw_value = convertPhysicalToRaw(@CAN_PrivMain::RFL_Object::RXX_Object_Obj1.VyVnce, 0.01, 0.0);
    copyBitsToByteArrayLE(raw_value, byteArray, 1248, 12);

    raw_value = convertPhysicalToRaw(@CAN_PrivMain::RFL_Object::RXX_Object_Obj1.PyAyCoVnce, 0.01, 0.0);
    copyBitsToByteArrayLE(raw_value, byteArray, 1388, 12);

    raw_value = convertPhysicalToRaw(@CAN_PrivMain::RFL_Object::RXX_Object_Obj1.PxAyCoVnce, 0.01, 0.0);
    copyBitsToByteArrayLE(raw_value, byteArray, 1356, 12);

    raw_value = convertPhysicalToRaw(@CAN_PrivMain::RFL_Object::RXX_Object_Obj1.PxAxCoVnce, 0.01, 0.0);
    copyBitsToByteArrayLE(raw_value, byteArray, 1344, 12);

    raw_value = convertPhysicalToRaw(@CAN_PrivMain::RFL_Object::RXX_Object_Obj1.ReferencePoint, 1.0, 0.0);
    copyBitsToByteArrayLE(raw_value, byteArray, 1336, 4);

    raw_value = convertPhysicalToRaw(@CAN_PrivMain::RFL_Object::RXX_Object_Obj1.PyVyCoVnce, 0.01, 0.0);
    copyBitsToByteArrayLE(raw_value, byteArray, 1324, 12);

    raw_value = convertPhysicalToRaw(@CAN_PrivMain::RFL_Object::RXX_Object_Obj1.FilterInformation, 1.0, 0.0);
    copyBitsToByteArrayLE(raw_value, byteArray, 1304, 8);

    raw_value = convertPhysicalToRaw(@CAN_PrivMain::RFL_Object::RXX_Object_Obj1.PxVyCoVnce, 0.01, 0.0);
    copyBitsToByteArrayLE(raw_value, byteArray, 1292, 12);

    raw_value = convertPhysicalToRaw(@CAN_PrivMain::RFL_Object::RXX_Object_Obj1.PxVxCoVnce, 0.01, 0.0);
    copyBitsToByteArrayLE(raw_value, byteArray, 1280, 12);

    raw_value = convertPhysicalToRaw(@CAN_PrivMain::RFL_Object::RXX_Object_Obj1.ProbClassType, 1.0, 0.0);
    copyBitsToByteArrayLE(raw_value, byteArray, 1275, 4);

    raw_value = convertPhysicalToRaw(@CAN_PrivMain::RFL_Object::RXX_Object_Obj1.MeasurementStatus, 1.0, 0.0);
    copyBitsToByteArrayLE(raw_value, byteArray, 1272, 3);

    raw_value = convertPhysicalToRaw(@CAN_PrivMain::RFL_Object::RXX_Object_Obj1.PyVxCoVnce, 0.01, 0.0);
    copyBitsToByteArrayLE(raw_value, byteArray, 1312, 12);
}


void Write_OsekTP_CRadarFL_RFL_Object(byte byteArray[])
{
    qword raw_value;
    #if ADAS_HIL
      if(@target_radar_fl_sim::objdata.object_model==1)
      {
        dllStarGetByteArray(@hil_ctrl::Handle_RadarModel, byteArray, 2);
        dllResetStarModel(@hil_ctrl::Handle_RadarModel, 2);
      }
      else if(@target_radar_fl_sim::objdata.object_model==2)
      {
        dllClaraGetByteArray(@hil_ctrl::Handle_RadarModel, byteArray, 2);
        dllResetClaraModel(@hil_ctrl::Handle_RadarModel, 2);
      }
      else
      {
    #endif
    switch(@CAN_PrivMain_RFL_Object::Write_No_signals)
    {
    case 49:
    RXX_Object_Obj49_write(byteArray);
    case 48:
    RXX_Object_Obj48_write(byteArray);
    case 47:
    RXX_Object_Obj47_write(byteArray);
    case 46:
    RXX_Object_Obj46_write(byteArray);
    case 45:
    RXX_Object_Obj45_write(byteArray);
    case 44:
    RXX_Object_Obj44_write(byteArray);
    case 43:
    RXX_Object_Obj43_write(byteArray);
    case 42:
    RXX_Object_Obj42_write(byteArray);
    case 41:
    RXX_Object_Obj41_write(byteArray);
    case 40:
    RXX_Object_Obj40_write(byteArray);
    case 39:
    RXX_Object_Obj39_write(byteArray);
    case 38:
    RXX_Object_Obj38_write(byteArray);
    case 37:
    RXX_Object_Obj37_write(byteArray);
    case 36:
    RXX_Object_Obj36_write(byteArray);
    case 35:
    RXX_Object_Obj35_write(byteArray);
    case 34:
    RXX_Object_Obj34_write(byteArray);
    case 33:
    RXX_Object_Obj33_write(byteArray);
    case 32:
    RXX_Object_Obj32_write(byteArray);
    case 31:
    RXX_Object_Obj31_write(byteArray);
    case 30:
    RXX_Object_Obj30_write(byteArray);
    case 29:
    RXX_Object_Obj29_write(byteArray);
    case 28:
    RXX_Object_Obj28_write(byteArray);
    case 27:
    RXX_Object_Obj27_write(byteArray);
    case 26:
    RXX_Object_Obj26_write(byteArray);
    case 25:
    RXX_Object_Obj25_write(byteArray);
    case 24:
    RXX_Object_Obj24_write(byteArray);
    case 23:
    RXX_Object_Obj23_write(byteArray);
    case 22:
    RXX_Object_Obj22_write(byteArray);
    case 21:
    RXX_Object_Obj21_write(byteArray);
    case 20:
    RXX_Object_Obj20_write(byteArray);
    case 19:
    RXX_Object_Obj19_write(byteArray);
    case 18:
    RXX_Object_Obj18_write(byteArray);
    case 17:
    RXX_Object_Obj17_write(byteArray);
    case 16:
    RXX_Object_Obj16_write(byteArray);
    case 15:
    RXX_Object_Obj15_write(byteArray);
    case 14:
    RXX_Object_Obj14_write(byteArray);
    case 13:
    RXX_Object_Obj13_write(byteArray);
    case 12:
    RXX_Object_Obj12_write(byteArray);
    case 11:
    RXX_Object_Obj11_write(byteArray);
    case 10:
    RXX_Object_Obj10_write(byteArray);
    case 9:
    RXX_Object_Obj9_write(byteArray);
    case 8:
    RXX_Object_Obj8_write(byteArray);
    case 7:
    RXX_Object_Obj7_write(byteArray);
    case 6:
    RXX_Object_Obj6_write(byteArray);
    case 5:
    RXX_Object_Obj5_write(byteArray);
    case 4:
    RXX_Object_Obj4_write(byteArray);
    case 3:
    RXX_Object_Obj3_write(byteArray);
    case 2:
    RXX_Object_Obj2_write(byteArray);
    case 1:
    RXX_Object_Obj1_write(byteArray);
    break;
    }
    #if ADAS_HIL
    }
    #endif

    raw_value = convertPhysicalToRaw(@CAN_PrivMain::RFL_Object::RXX_Object_E2E_p44_length, 1.0, 0.0);
    copyBitsToByteArrayBE(raw_value, byteArray, 26112, 16);

    raw_value = convertPhysicalToRaw(@CAN_PrivMain::RFL_Object::RXX_Object_E2E_p44_counter, 1.0, 0.0);
    copyBitsToByteArrayBE(raw_value, byteArray, 26128, 16);

    raw_value = convertPhysicalToRaw(@CAN_PrivMain::RFL_Object::RXX_Object_E2E_p44_dataId, 1.0, 0.0);
    copyBitsToByteArrayBE(raw_value, byteArray, 26144, 32);

    raw_value = convertPhysicalToRaw(@CAN_PrivMain::RFL_Object::RXX_Object_ObjHdr_VersionIdMajor, 1.0, 0.0);
    copyBitsToByteArrayLE(raw_value, byteArray, 0, 8);

    raw_value = convertPhysicalToRaw(@CAN_PrivMain::RFL_Object::RXX_Object_ObjHdr_VersionIdMinor, 1.0, 0.0);
    copyBitsToByteArrayLE(raw_value, byteArray, 8, 8);

    raw_value = convertPhysicalToRaw(@CAN_PrivMain::RFL_Object::RXX_Object_SpiHdr_SensorOrientYaw, 0.00017, -5.57056);
    copyBitsToByteArrayLE(raw_value, byteArray, 416, 16);

    raw_value = convertPhysicalToRaw(@CAN_PrivMain::RFL_Object::RXX_Object_SpiHdr_FovRtrElRngGEnd01, 0.01, 0.0);
    copyBitsToByteArrayLE(raw_value, byteArray, 327, 7);

    raw_value = convertPhysicalToRaw(@CAN_PrivMain::RFL_Object::RXX_Object_SpiHdr_FovRtrElRngGEnd02, 0.01, 0.0);
    copyBitsToByteArrayLE(raw_value, byteArray, 334, 7);

    raw_value = convertPhysicalToRaw(@CAN_PrivMain::RFL_Object::RXX_Object_SpiHdr_FovRtrElRngGEnd03, 0.01, 0.0);
    copyBitsToByteArrayLE(raw_value, byteArray, 341, 7);

    raw_value = convertPhysicalToRaw(@CAN_PrivMain::RFL_Object::RXX_Object_SpiHdr_FovRtrElRngGEnd04, 0.01, 0.0);
    copyBitsToByteArrayLE(raw_value, byteArray, 352, 7);

    raw_value = convertPhysicalToRaw(@CAN_PrivMain::RFL_Object::RXX_Object_SpiHdr_FovRtrElRngGEnd05, 0.01, 0.0);
    copyBitsToByteArrayLE(raw_value, byteArray, 359, 7);

    raw_value = convertPhysicalToRaw(@CAN_PrivMain::RFL_Object::RXX_Object_SpiHdr_FovRtrElRngGEnd06, 0.01, 0.0);
    copyBitsToByteArrayLE(raw_value, byteArray, 366, 7);

    raw_value = convertPhysicalToRaw(@CAN_PrivMain::RFL_Object::RXX_Object_SpiHdr_FovRtrElRngGEnd07, 0.01, 0.0);
    copyBitsToByteArrayLE(raw_value, byteArray, 373, 7);

    raw_value = convertPhysicalToRaw(@CAN_PrivMain::RFL_Object::RXX_Object_SpiHdr_FovRtrElRngGEnd08, 0.01, 0.0);
    copyBitsToByteArrayLE(raw_value, byteArray, 384, 7);

    raw_value = convertPhysicalToRaw(@CAN_PrivMain::RFL_Object::RXX_Object_SpiHdr_FovRtrElRngGEnd09, 0.01, 0.0);
    copyBitsToByteArrayLE(raw_value, byteArray, 391, 7);

    raw_value = convertPhysicalToRaw(@CAN_PrivMain::RFL_Object::RXX_Object_SpiHdr_FovRtrElRngGEnd10, 0.01, 0.0);
    copyBitsToByteArrayLE(raw_value, byteArray, 398, 7);

    raw_value = convertPhysicalToRaw(@CAN_PrivMain::RFL_Object::RXX_Object_SpiHdr_VelMeasMin, 0.1, -150.0);
    copyBitsToByteArrayLE(raw_value, byteArray, 405, 11);

    raw_value = convertPhysicalToRaw(@CAN_PrivMain::RFL_Object::RXX_Object_SpiHdr_SensorOrientPitch, 0.00017, -0.34816);
    copyBitsToByteArrayLE(raw_value, byteArray, 432, 12);

    raw_value = convertPhysicalToRaw(@CAN_PrivMain::RFL_Object::RXX_Object_SpiHdr_FovRtrAzSegBrdr09, 0.0175, -2.24);
    copyBitsToByteArrayLE(raw_value, byteArray, 528, 8);

    raw_value = convertPhysicalToRaw(@CAN_PrivMain::RFL_Object::RXX_Object_SpiHdr_SensorExtDisturbed, 1.0, 0.0);
    copyBitsToByteArrayLE(raw_value, byteArray, 444, 3);

    raw_value = convertPhysicalToRaw(@CAN_PrivMain::RFL_Object::RXX_Object_SpiHdr_SensorOrientation, 1.0, 0.0);
    copyBitsToByteArrayLE(raw_value, byteArray, 447, 1);

    raw_value = convertPhysicalToRaw(@CAN_PrivMain::RFL_Object::RXX_Object_SpiHdr_RngGainRfInterfere, 1.0, 0.0);
    copyBitsToByteArrayLE(raw_value, byteArray, 448, 7);

    raw_value = convertPhysicalToRaw(@CAN_PrivMain::RFL_Object::RXX_Object_SpiHdr_FovRtrAzSegBrdr00, 0.0175, -2.24);
    copyBitsToByteArrayLE(raw_value, byteArray, 455, 8);

    raw_value = convertPhysicalToRaw(@CAN_PrivMain::RFL_Object::RXX_Object_SpiHdr_FovRtrAzSegBrdr01, 0.0175, -2.24);
    copyBitsToByteArrayLE(raw_value, byteArray, 463, 8);

    raw_value = convertPhysicalToRaw(@CAN_PrivMain::RFL_Object::RXX_Object_SpiHdr_FovRtrAzSegBrdr02, 0.0175, -2.24);
    copyBitsToByteArrayLE(raw_value, byteArray, 471, 8);

    raw_value = convertPhysicalToRaw(@CAN_PrivMain::RFL_Object::RXX_Object_SpiHdr_FovRtrAzSegBrdr03, 0.0175, -2.24);
    copyBitsToByteArrayLE(raw_value, byteArray, 480, 8);

    raw_value = convertPhysicalToRaw(@CAN_PrivMain::RFL_Object::RXX_Object_SpiHdr_FovRtrAzSegBrdr04, 0.0175, -2.24);
    copyBitsToByteArrayLE(raw_value, byteArray, 488, 8);

    raw_value = convertPhysicalToRaw(@CAN_PrivMain::RFL_Object::RXX_Object_SpiHdr_FovRtrAzSegBrdr05, 0.0175, -2.24);
    copyBitsToByteArrayLE(raw_value, byteArray, 496, 8);

    raw_value = convertPhysicalToRaw(@CAN_PrivMain::RFL_Object::RXX_Object_SpiHdr_FovRtrAzSegBrdr06, 0.0175, -2.24);
    copyBitsToByteArrayLE(raw_value, byteArray, 504, 8);

    raw_value = convertPhysicalToRaw(@CAN_PrivMain::RFL_Object::RXX_Object_SpiHdr_FovRtrAzSegBrdr07, 0.0175, -2.24);
    copyBitsToByteArrayLE(raw_value, byteArray, 512, 8);

    raw_value = convertPhysicalToRaw(@CAN_PrivMain::RFL_Object::RXX_Object_SpiHdr_FovRtrElRngGEnd00, 0.01, 0.0);
    copyBitsToByteArrayLE(raw_value, byteArray, 320, 7);

    raw_value = convertPhysicalToRaw(@CAN_PrivMain::RFL_Object::RXX_Object_SpiHdr_FovRtrElSegBrdr10, 0.0175, -1.12);
    copyBitsToByteArrayLE(raw_value, byteArray, 309, 7);

    raw_value = convertPhysicalToRaw(@CAN_PrivMain::RFL_Object::RXX_Object_SpiHdr_FovRtrElSegBrdr09, 0.0175, -1.12);
    copyBitsToByteArrayLE(raw_value, byteArray, 302, 7);

    raw_value = convertPhysicalToRaw(@CAN_PrivMain::RFL_Object::RXX_Object_SpiHdr_FovRtrElSegBrdr08, 0.0175, -1.12);
    copyBitsToByteArrayLE(raw_value, byteArray, 295, 7);

    @CAN_PrivMain::RFL_Object::RXX_Object_ObjHdr_TimeStamp = (timeNowInt64()-@CAN_Radar::TimeSync_CAN_Radar::SYNC_LastTimeReceivedNs)/100000+@sysvar::CAN_Radar::TimeSync_CAN_Radar::stbmTime_100us;  //Compute real time according to Autosar specification
    raw_value = convertPhysicalToRaw(@CAN_PrivMain::RFL_Object::RXX_Object_ObjHdr_TimeStamp, 1.0, 0.0);
    copyBitsToByteArrayLE(raw_value, byteArray, 32, 32);

    raw_value = convertPhysicalToRaw(@CAN_PrivMain::RFL_Object::RXX_Object_ObjHdr_TimeStampStatus, 1.0, 0.0);
    copyBitsToByteArrayLE(raw_value, byteArray, 64, 8);

    raw_value = convertPhysicalToRaw(@CAN_PrivMain::RFL_Object::RXX_Object_ObjHdr_NumValidObjects, 1.0, 0.0);
    copyBitsToByteArrayLE(raw_value, byteArray, 72, 10);

    raw_value = convertPhysicalToRaw(@CAN_PrivMain::RFL_Object::RXX_Object_ObjHdr_LocDownSel, 1.0, 0.0);
    copyBitsToByteArrayLE(raw_value, byteArray, 82, 1);

    raw_value = convertPhysicalToRaw(@CAN_PrivMain::RFL_Object::RXX_Object_SpiHdr_DmpId, 1.0, 0.0);
    copyBitsToByteArrayLE(raw_value, byteArray, 96, 6);

    raw_value = convertPhysicalToRaw(@CAN_PrivMain::RFL_Object::RXX_Object_SpiHdr_ModId, 1.0, 0.0);
    copyBitsToByteArrayLE(raw_value, byteArray, 102, 13);

    raw_value = convertPhysicalToRaw(@CAN_PrivMain::RFL_Object::RXX_Object_SpiHdr_DistSep, 0.01, 0.0);
    copyBitsToByteArrayLE(raw_value, byteArray, 115, 10);

    raw_value = convertPhysicalToRaw(@CAN_PrivMain::RFL_Object::RXX_Object_SpiHdr_DistStartProcDegraded, 0.01, 0.0);
    copyBitsToByteArrayLE(raw_value, byteArray, 128, 16);

    raw_value = convertPhysicalToRaw(@CAN_PrivMain::RFL_Object::RXX_Object_SpiHdr_DistPrec, 0.0001, 0.0);
    copyBitsToByteArrayLE(raw_value, byteArray, 144, 13);

    raw_value = convertPhysicalToRaw(@CAN_PrivMain::RFL_Object::RXX_Object_SpiHdr_VelPrec, 0.0001, 0.0);
    copyBitsToByteArrayLE(raw_value, byteArray, 160, 11);

    raw_value = convertPhysicalToRaw(@CAN_PrivMain::RFL_Object::RXX_Object_SpiHdr_DistMeasMinMod, 0.01, 0.0);
    copyBitsToByteArrayLE(raw_value, byteArray, 171, 10);

    raw_value = convertPhysicalToRaw(@CAN_PrivMain::RFL_Object::RXX_Object_SpiHdr_VelSep, 0.01, 0.0);
    copyBitsToByteArrayLE(raw_value, byteArray, 181, 10);

    raw_value = convertPhysicalToRaw(@CAN_PrivMain::RFL_Object::RXX_Object_SpiHdr_DistMeasMaxMod, 0.01, 0.0);
    copyBitsToByteArrayLE(raw_value, byteArray, 192, 16);

    raw_value = convertPhysicalToRaw(@CAN_PrivMain::RFL_Object::RXX_Object_SpiHdr_DistMaxProc, 0.01, 0.0);
    copyBitsToByteArrayLE(raw_value, byteArray, 208, 16);

    raw_value = convertPhysicalToRaw(@CAN_PrivMain::RFL_Object::RXX_Object_SpiHdr_VelMeasMax, 0.1, 0.0);
    copyBitsToByteArrayLE(raw_value, byteArray, 224, 11);

    raw_value = convertPhysicalToRaw(@CAN_PrivMain::RFL_Object::RXX_Object_SpiHdr_FovRtrElSegBrdr00, 0.0175, -1.12);
    copyBitsToByteArrayLE(raw_value, byteArray, 235, 7);

    raw_value = convertPhysicalToRaw(@CAN_PrivMain::RFL_Object::RXX_Object_SpiHdr_FovRtrElSegBrdr01, 0.0175, -1.12);
    copyBitsToByteArrayLE(raw_value, byteArray, 242, 7);

    raw_value = convertPhysicalToRaw(@CAN_PrivMain::RFL_Object::RXX_Object_SpiHdr_FovRtrElSegBrdr02, 0.0175, -1.12);
    copyBitsToByteArrayLE(raw_value, byteArray, 249, 7);

    raw_value = convertPhysicalToRaw(@CAN_PrivMain::RFL_Object::RXX_Object_SpiHdr_FovRtrElSegBrdr03, 0.0175, -1.12);
    copyBitsToByteArrayLE(raw_value, byteArray, 256, 7);

    raw_value = convertPhysicalToRaw(@CAN_PrivMain::RFL_Object::RXX_Object_SpiHdr_FovRtrElSegBrdr04, 0.0175, -1.12);
    copyBitsToByteArrayLE(raw_value, byteArray, 263, 7);

    raw_value = convertPhysicalToRaw(@CAN_PrivMain::RFL_Object::RXX_Object_SpiHdr_FovRtrElSegBrdr05, 0.0175, -1.12);
    copyBitsToByteArrayLE(raw_value, byteArray, 270, 7);

    raw_value = convertPhysicalToRaw(@CAN_PrivMain::RFL_Object::RXX_Object_SpiHdr_FovRtrElSegBrdr06, 0.0175, -1.12);
    copyBitsToByteArrayLE(raw_value, byteArray, 277, 7);

    raw_value = convertPhysicalToRaw(@CAN_PrivMain::RFL_Object::RXX_Object_SpiHdr_FovRtrElSegBrdr07, 0.0175, -1.12);
    copyBitsToByteArrayLE(raw_value, byteArray, 288, 7);

    raw_value = convertPhysicalToRaw(@CAN_PrivMain::RFL_Object::RXX_Object_SpiHdr_FovRtrAzSegBrdr08, 0.0175, -2.24);
    copyBitsToByteArrayLE(raw_value, byteArray, 520, 8);

    raw_value = convertPhysicalToRaw(@CAN_PrivMain::RFL_Object::RXX_Object_SpiHdr_FovRtrAzSegBrdr10, 0.0175, -2.24);
    copyBitsToByteArrayLE(raw_value, byteArray, 536, 8);

    raw_value = convertPhysicalToRaw(@CAN_PrivMain::RFL_Object::RXX_Object_ShiiHdr_SensorOmmOpMode, 1.0, 0.0);
    copyBitsToByteArrayLE(raw_value, byteArray, 1008, 8);

    raw_value = convertPhysicalToRaw(@CAN_PrivMain::RFL_Object::RXX_Object_SpiHdr_BldFov_Status, 1.0, 0.0);
    copyBitsToByteArrayLE(raw_value, byteArray, 928, 3);

    raw_value = convertPhysicalToRaw(@CAN_PrivMain::RFL_Object::RXX_Object_SpiHdr_FovRtrAzDetRng14, 1.0, 0.0);
    copyBitsToByteArrayLE(raw_value, byteArray, 810, 10);

    raw_value = convertPhysicalToRaw(@CAN_PrivMain::RFL_Object::RXX_Object_SpiHdr_FovRtrAzDetRng15, 1.0, 0.0);
    copyBitsToByteArrayLE(raw_value, byteArray, 820, 10);

    raw_value = convertPhysicalToRaw(@CAN_PrivMain::RFL_Object::RXX_Object_SpiHdr_FovRtrAzDetRng16, 1.0, 0.0);
    copyBitsToByteArrayLE(raw_value, byteArray, 832, 10);

    raw_value = convertPhysicalToRaw(@CAN_PrivMain::RFL_Object::RXX_Object_SpiHdr_FovRtrAzDetRng17, 1.0, 0.0);
    copyBitsToByteArrayLE(raw_value, byteArray, 842, 10);

    raw_value = convertPhysicalToRaw(@CAN_PrivMain::RFL_Object::RXX_Object_SpiHdr_FovRtrAzDetRng18, 1.0, 0.0);
    copyBitsToByteArrayLE(raw_value, byteArray, 852, 10);

    raw_value = convertPhysicalToRaw(@CAN_PrivMain::RFL_Object::RXX_Object_SpiHdr_FovRtrAzDetRng19, 1.0, 0.0);
    copyBitsToByteArrayLE(raw_value, byteArray, 864, 10);

    raw_value = convertPhysicalToRaw(@CAN_PrivMain::RFL_Object::RXX_Object_SpiHdr_FovRtrAzDetRng20, 1.0, 0.0);
    copyBitsToByteArrayLE(raw_value, byteArray, 874, 10);

    raw_value = convertPhysicalToRaw(@CAN_PrivMain::RFL_Object::RXX_Object_SpiHdr_FovRtrAzDetRng21, 1.0, 0.0);
    copyBitsToByteArrayLE(raw_value, byteArray, 884, 10);

    raw_value = convertPhysicalToRaw(@CAN_PrivMain::RFL_Object::RXX_Object_SpiHdr_FovRtrAzDetRng22, 1.0, 0.0);
    copyBitsToByteArrayLE(raw_value, byteArray, 896, 10);

    raw_value = convertPhysicalToRaw(@CAN_PrivMain::RFL_Object::RXX_Object_SpiHdr_FovRtrAzDetRng23, 1.0, 0.0);
    copyBitsToByteArrayLE(raw_value, byteArray, 906, 10);

    raw_value = convertPhysicalToRaw(@CAN_PrivMain::RFL_Object::RXX_Object_SpiHdr_FovRtrAzDetRng24, 1.0, 0.0);
    copyBitsToByteArrayLE(raw_value, byteArray, 916, 10);

    raw_value = convertPhysicalToRaw(@CAN_PrivMain::RFL_Object::RXX_Object_SpiHdr_BldFov_Confidence, 2.0, 0.0);
    copyBitsToByteArrayLE(raw_value, byteArray, 931, 6);

    raw_value = convertPhysicalToRaw(@CAN_PrivMain::RFL_Object::RXX_Object_SpiHdr_FovRtrAzSegBrdr11, 0.0175, -2.24);
    copyBitsToByteArrayLE(raw_value, byteArray, 544, 8);

    raw_value = convertPhysicalToRaw(@CAN_PrivMain::RFL_Object::RXX_Object_SpiHdr_SensorOriginPointX, 0.02, -5.12);
    copyBitsToByteArrayLE(raw_value, byteArray, 937, 9);

    raw_value = convertPhysicalToRaw(@CAN_PrivMain::RFL_Object::RXX_Object_SpiHdr_SensorOriginPointY, 0.01, -1.28);
    copyBitsToByteArrayLE(raw_value, byteArray, 946, 8);

    raw_value = convertPhysicalToRaw(@CAN_PrivMain::RFL_Object::RXX_Object_SpiHdr_SensorOriginPointZ, 0.05, 0.0);
    copyBitsToByteArrayLE(raw_value, byteArray, 954, 5);

    raw_value = convertPhysicalToRaw(@CAN_PrivMain::RFL_Object::RXX_Object_ShiiHdr_DataMeasured, 1.0, 0.0);
    copyBitsToByteArrayLE(raw_value, byteArray, 960, 2);

    raw_value = convertPhysicalToRaw(@CAN_PrivMain::RFL_Object::RXX_Object_ShiiHdr_SensorCalExtStat, 1.0, 0.0);
    copyBitsToByteArrayLE(raw_value, byteArray, 968, 1);

    raw_value = convertPhysicalToRaw(@CAN_PrivMain::RFL_Object::RXX_Object_ShiiHdr_SensorCalIntStat, 1.0, 0.0);
    copyBitsToByteArrayLE(raw_value, byteArray, 969, 1);

    raw_value = convertPhysicalToRaw(@CAN_PrivMain::RFL_Object::RXX_Object_ShiiHdr_SensorHeatingStatus, 1.0, 0.0);
    copyBitsToByteArrayLE(raw_value, byteArray, 970, 2);

    raw_value = convertPhysicalToRaw(@CAN_PrivMain::RFL_Object::RXX_Object_ShiiHdr_SensorCalOnlStat, 1.0, 0.0);
    copyBitsToByteArrayLE(raw_value, byteArray, 972, 4);

    raw_value = convertPhysicalToRaw(@CAN_PrivMain::RFL_Object::RXX_Object_ShiiHdr_MisAzOOPCause, 1.0, 0.0);
    copyBitsToByteArrayLE(raw_value, byteArray, 976, 8);

    raw_value = convertPhysicalToRaw(@CAN_PrivMain::RFL_Object::RXX_Object_ShiiHdr_MisElOOPCause, 1.0, 0.0);
    copyBitsToByteArrayLE(raw_value, byteArray, 984, 8);

    raw_value = convertPhysicalToRaw(@CAN_PrivMain::RFL_Object::RXX_Object_ShiiHdr_SensorFailureReas, 1.0, 0.0);
    copyBitsToByteArrayLE(raw_value, byteArray, 992, 16);

    raw_value = convertPhysicalToRaw(@CAN_PrivMain::RFL_Object::RXX_Object_SpiHdr_FovRtrAzDetRng13, 1.0, 0.0);
    copyBitsToByteArrayLE(raw_value, byteArray, 800, 10);

    raw_value = convertPhysicalToRaw(@CAN_PrivMain::RFL_Object::RXX_Object_SpiHdr_FovRtrAzDetRng12, 1.0, 0.0);
    copyBitsToByteArrayLE(raw_value, byteArray, 788, 10);

    raw_value = convertPhysicalToRaw(@CAN_PrivMain::RFL_Object::RXX_Object_SpiHdr_FovRtrAzDetRng11, 1.0, 0.0);
    copyBitsToByteArrayLE(raw_value, byteArray, 778, 10);

    raw_value = convertPhysicalToRaw(@CAN_PrivMain::RFL_Object::RXX_Object_SpiHdr_FovRtrAzDetRng10, 1.0, 0.0);
    copyBitsToByteArrayLE(raw_value, byteArray, 768, 10);

    raw_value = convertPhysicalToRaw(@CAN_PrivMain::RFL_Object::RXX_Object_SpiHdr_FovRtrAzSegBrdr12, 0.0175, -2.24);
    copyBitsToByteArrayLE(raw_value, byteArray, 552, 8);

    raw_value = convertPhysicalToRaw(@CAN_PrivMain::RFL_Object::RXX_Object_SpiHdr_FovRtrAzSegBrdr13, 0.0175, -2.24);
    copyBitsToByteArrayLE(raw_value, byteArray, 560, 8);

    raw_value = convertPhysicalToRaw(@CAN_PrivMain::RFL_Object::RXX_Object_SpiHdr_FovRtrAzSegBrdr14, 0.0175, -2.24);
    copyBitsToByteArrayLE(raw_value, byteArray, 568, 8);

    raw_value = convertPhysicalToRaw(@CAN_PrivMain::RFL_Object::RXX_Object_SpiHdr_FovRtrAzSegBrdr15, 0.0175, -2.24);
    copyBitsToByteArrayLE(raw_value, byteArray, 576, 8);

    raw_value = convertPhysicalToRaw(@CAN_PrivMain::RFL_Object::RXX_Object_SpiHdr_FovRtrAzSegBrdr16, 0.0175, -2.24);
    copyBitsToByteArrayLE(raw_value, byteArray, 584, 8);

    raw_value = convertPhysicalToRaw(@CAN_PrivMain::RFL_Object::RXX_Object_SpiHdr_FovRtrAzSegBrdr17, 0.0175, -2.24);
    copyBitsToByteArrayLE(raw_value, byteArray, 592, 8);

    raw_value = convertPhysicalToRaw(@CAN_PrivMain::RFL_Object::RXX_Object_SpiHdr_FovRtrAzSegBrdr18, 0.0175, -2.24);
    copyBitsToByteArrayLE(raw_value, byteArray, 600, 8);

    raw_value = convertPhysicalToRaw(@CAN_PrivMain::RFL_Object::RXX_Object_SpiHdr_FovRtrAzSegBrdr19, 0.0175, -2.24);
    copyBitsToByteArrayLE(raw_value, byteArray, 608, 8);

    raw_value = convertPhysicalToRaw(@CAN_PrivMain::RFL_Object::RXX_Object_SpiHdr_FovRtrAzSegBrdr20, 0.0175, -2.24);
    copyBitsToByteArrayLE(raw_value, byteArray, 616, 8);

    raw_value = convertPhysicalToRaw(@CAN_PrivMain::RFL_Object::RXX_Object_SpiHdr_FovRtrAzSegBrdr21, 0.0175, -2.24);
    copyBitsToByteArrayLE(raw_value, byteArray, 624, 8);

    raw_value = convertPhysicalToRaw(@CAN_PrivMain::RFL_Object::RXX_Object_SpiHdr_FovRtrAzSegBrdr22, 0.0175, -2.24);
    copyBitsToByteArrayLE(raw_value, byteArray, 632, 8);

    raw_value = convertPhysicalToRaw(@CAN_PrivMain::RFL_Object::RXX_Object_SpiHdr_FovRtrAzSegBrdr23, 0.0175, -2.24);
    copyBitsToByteArrayLE(raw_value, byteArray, 640, 8);

    raw_value = convertPhysicalToRaw(@CAN_PrivMain::RFL_Object::RXX_Object_SpiHdr_FovRtrAzSegBrdr24, 0.0175, -2.24);
    copyBitsToByteArrayLE(raw_value, byteArray, 648, 8);

    raw_value = convertPhysicalToRaw(@CAN_PrivMain::RFL_Object::RXX_Object_SpiHdr_FovRtrAzDetRng00, 1.0, 0.0);
    copyBitsToByteArrayLE(raw_value, byteArray, 656, 10);

    raw_value = convertPhysicalToRaw(@CAN_PrivMain::RFL_Object::RXX_Object_SpiHdr_FovRtrAzDetRng01, 1.0, 0.0);
    copyBitsToByteArrayLE(raw_value, byteArray, 672, 10);

    raw_value = convertPhysicalToRaw(@CAN_PrivMain::RFL_Object::RXX_Object_SpiHdr_FovRtrAzDetRng02, 1.0, 0.0);
    copyBitsToByteArrayLE(raw_value, byteArray, 682, 10);

    raw_value = convertPhysicalToRaw(@CAN_PrivMain::RFL_Object::RXX_Object_SpiHdr_FovRtrAzDetRng03, 1.0, 0.0);
    copyBitsToByteArrayLE(raw_value, byteArray, 692, 10);

    raw_value = convertPhysicalToRaw(@CAN_PrivMain::RFL_Object::RXX_Object_SpiHdr_FovRtrAzDetRng04, 1.0, 0.0);
    copyBitsToByteArrayLE(raw_value, byteArray, 704, 10);

    raw_value = convertPhysicalToRaw(@CAN_PrivMain::RFL_Object::RXX_Object_SpiHdr_FovRtrAzDetRng05, 1.0, 0.0);
    copyBitsToByteArrayLE(raw_value, byteArray, 714, 10);

    raw_value = convertPhysicalToRaw(@CAN_PrivMain::RFL_Object::RXX_Object_SpiHdr_FovRtrAzDetRng06, 1.0, 0.0);
    copyBitsToByteArrayLE(raw_value, byteArray, 724, 10);

    raw_value = convertPhysicalToRaw(@CAN_PrivMain::RFL_Object::RXX_Object_SpiHdr_FovRtrAzDetRng07, 1.0, 0.0);
    copyBitsToByteArrayLE(raw_value, byteArray, 736, 10);

    raw_value = convertPhysicalToRaw(@CAN_PrivMain::RFL_Object::RXX_Object_SpiHdr_FovRtrAzDetRng08, 1.0, 0.0);
    copyBitsToByteArrayLE(raw_value, byteArray, 746, 10);

    raw_value = convertPhysicalToRaw(@CAN_PrivMain::RFL_Object::RXX_Object_SpiHdr_FovRtrAzDetRng09, 1.0, 0.0);
    copyBitsToByteArrayLE(raw_value, byteArray, 756, 10);

    raw_value = convertPhysicalToRaw(@CAN_PrivMain::RFL_Object::RXX_Object_E2E_p44_crc, 1.0, 0.0);
    copyBitsToByteArrayBE(raw_value, byteArray, 26176, 32);
}


void Transmit_Pdu_CRadarFL_RFL_Object()
{
   long txCount ;
   pdu RFL_Object pdu_RFL_Object;
   byte txDataBuffer[kBufferSizeJumbo_CRadarFL_RFL_Object_NPdu_Data];
   byte txDataBuffer_null[kBufferSizeJumbo_CRadarFL_RFL_Object_NPdu_Data];
   txCount = kBufferSizeJumbo_CRadarFL_RFL_Object_NPdu_Data;
   Write_OsekTP_CRadarFL_RFL_Object(txDataBuffer);
   // OSEK TP supports up to 4 GiB with Jumbo frames, but limit that to a much lower value for this demo
   if (txCount > kBufferSizeJumbo_CRadarFL_RFL_Object_NPdu_Data)
   {
      txCount = kBufferSizeJumbo_CRadarFL_RFL_Object_NPdu_Data;
   }
   CanTpSendData(gHandle_CRadarFL_RFL_Object_NPdu_Data, txDataBuffer, txCount);
   memcpy(txDataBuffer, txDataBuffer_null, txCount);
}

on sysvar CAN_PrivMain::RFL_VehOutput::RFL_VehOutput_ON_OFF
{
  if (@this == 1)
  {
    ARILFaultInjectionEnablePDU(RFL_VehOutput);
  }
  else{
         ARILFaultInjectionDisablePDU(RFL_VehOutput);
      }
}

void cfg_Pdu_RFL_VehOutput(dword & aPDULength, byte data[])
{
   int64 i,k;//For looping
   byte xor,data_byte;
   dword crcTemp;
   byte DataLength;
   dword Msg_id;
   
   DataLength = Msg_RFL_VehOutput.DataLength;//Message Data Length
   Msg_id  = Msg_RFL_VehOutput.id;//Message ID
   
}

//  ARILSetPDUTimingCyclic (dbMsg dbMessage, long TrueOrFalse, long offset, long period, long disturbanceCount, long flags);
//  TrueOrFalse ; 0: denotes the False timing; 1: denotes the True timing; 3: denotes the True and the False timing.
//  offset :Defines the delay in [ms] from now when the first cyclic transmission will start.
//  period :Defines the period in [ms] for the cyclic transmission.
//  disturbanceCount :Reserved/unused; should be set to -1 (infinite).
//  flags :Reserved; should be set to 0.

on sysvar CAN_PrivMain::RFL_VehOutput::RFL_VehOutput_CycleTime
{
  ARILSetPDUTimingCyclic (RFL_VehOutput, 3, 0, @this, -1, 0);//TrueOrFalse=3,offset=0;disturbanceCount =-1;flags=0
  //ARILResetPDUTimingCyclic(RFL_VehOutput,3);//TrueOrFalse=3
}

void CRadarFL_sim_SetCycleTimeOffset()
{

//  ARILSetPDUTimingCyclic (dbMsg dbMessage, long TrueOrFalse, long offset, long period, long disturbanceCount, long flags);
//  TrueOrFalse ; 0: denotes the False timing; 1: denotes the True timing; 3: denotes the True and the False timing.
//  offset :Defines the delay in [ms] from now when the first cyclic transmission will start.
//  period :Defines the period in [ms] for the cyclic transmission.
//  disturbanceCount :Reserved/unused; should be set to -1 (infinite).
//  flags :Reserved; should be set to 0.
  ARILSetPDUTimingCyclic (RFL_VehOutput, 3, 0, 20, -1, 0);//TrueOrFalse=3;offset=0;cycletime=20;disturbanceCount =-1;flags=0
  //ARILResetPDUTimingCyclic(RFL_VehOutput,3);//TrueOrFalse=3

}

void OnSecurityLocalPDUPreTx(char pduName[], dword dataId, byte payload[], dword payloadLength, qword& authInfoHigh, qword& authInfo, dword authInfoBitLength, qword& freshness, dword freshnessBitLength, dword freshnessValueId)//This callback handler is called, after all data updates and the automatic Authenticator (CMAC) calculation has be done
{
}