/*@!Encoding:1252*/
// Autogenerated by -> Platform\Classe\Scripts\Rbs_Scripts\create_nodes.py
includes
{
  #pragma library ("C:\ProgramData\Vector\AddOn Packages\Vector AddOn\vModules\AsrPDUIL2.vmodule")
  #include "CAPL\DataHandling.cin" /*DataHandling for IL*/
  #include "CAPL\E2E.cin" /*OD Specific for CRC calculation */
  #include "OSEKTP\OSEKTP.cin"  //common definations for osektp
  #include "OSEKTP\OSEKTP_CAN_RadarFL_ADAS_RXX_FieldData_NPdu_FC.cin"  ///For handling  pdu RXX_FieldData_NPdu_FC with OSEKtp
  #include "OSEKTP\OSEKTP_CAN_RadarFL_ADAS_RXX_Object_NPdu_FC.cin"  ///For handling  pdu RXX_Object_NPdu_FC with OSEKtp
}

variables {
  int i;
  char sysvarElementName[256];
  char mSysVarNameSpace_CAN_RadarFL_RXX_Object[50] = "CAN_RadarFL::RXX_Object";
  char mSysVarNameSpace_CAN_RadarFL_RXX_FieldData[50] = "CAN_RadarFL::RXX_FieldData";
  message RXX_Config_Mgmt Msg_RXX_Config_Mgmt;
  message RXX_VehInput Msg_RXX_VehInput;
  message RXX_VehConfig Msg_RXX_VehConfig;

  dword crc_RXX_VehInput_RXX_VehInput_CRC;
  dword crc_RXX_VehConfig_RXX_VehConfig_CRC;

}

on preStart {
  long result;
  result=ARILControlInit ();//Initialization of AUTOSAR PDU IL,to prevent the IL autostart function.
  switch(result)
  {
    case  0    : write("ARILControlInit :: ADAS :: No error."); break;
    case -1    : write("ARILControlInit :: ADAS :: IL is in a state that ignores the given request: State graph of the IL (Link)."); break;
    case -2    : write("ARILControlInit :: ADAS :: Allowed value range of a signal exceeded. (The exceeded value is transmitted to the bus nevertheless).");  break;
    case -50   : write("ARILControlInit :: ADAS :: Node layer is not active. Presumably it is deactivated in the node’s configuration dialog."); break;
    case -51   : write("ARILControlInit :: ADAS :: The node is connected to another bus like the CAN Bus."); break;
    case -100  : write("ARILControlInit :: ADAS :: Signal/message not found in DB, or not mapped to the node."); break;
    case -101  : write("ARILControlInit :: ADAS :: Maximum possible value range exceeded. (There is no transmission to the bus)."); break;
    case -102  : write("ARILControlInit :: ADAS :: A network management-, diagnostic, or transport protocol signal was set. IL declines such types of signals, because it is not intended to connect these layers to the IL."); break;
    case -103  : write("ARILControlInit :: ADAS :: Invalid value supplied (for all types of requests)."); break;
    case -104  : write("ARILControlInit :: ADAS :: General error for invalid requests that are not described furthermore."); break;
   }

  ADAS_sim_Disable();
  ADAS_sim_SetCycleTimeOffset();
}

on start {

  ARILControlSimulationOn();//Starts the simulation of the IL. The IL is operational and started. The IL will send PDUs.
  ADAS_sim_DisableMsg();
  ADAS_sim_Disable();
  ARILControlStart ();//When the IL is started, then it is fully operating and sending.
  ADAS_sim_Reset();
  OnStart_init_CANTP_ADAS();
  OnStart_callTx_ADAS_RXX_FieldData_NPdu_FC();
  CallTx_ADAS_RXX_FieldData_NPdu_FC_hil_ctrl_adas_sim();
  OnStart_callTx_ADAS_RXX_Object_NPdu_FC();
}

OnStart_init_CANTP_ADAS()
{
  long dbHandle; 
  dbHandle = CanTpGetDBConnection();
  if (dbHandle > 0) 
  { 
    CanTpCloseConnection(dbHandle); 
  }
}

on stopMeasurement {

  ADAS_sim_DisableMsg();
  ADAS_sim_Disable();
  ARILControlStop();//Stops sending of PDUs.
  ARILControlSimulationOff();//Stops the simulation of the IL. The IL is not operational. All API function except function ARILControlSimulationOn will not work.

}

on sysvar_update hil_ctrl::adas_sim
{
  CallTx_ADAS_RXX_FieldData_NPdu_FC_hil_ctrl_adas_sim();
  ADAS_sim_Reset();
}

on sysvar_update hil_ctrl::variant
{
  ADAS_sim_Reset();
}

on sysvar_update Cus_bus::bus_CAN_RadarFL_ON_OFF
{
  ADAS_sim_Reset();
}

void ADAS_sim_Reset()
{

  ADAS_sim_DisableMsg();
  ADAS_sim_Disable();

  if ((@Cus_bus::bus_CAN_RadarFL_ON_OFF == 1) && (@hil_ctrl::adas_sim == 1))
  {
    switch(@hil_ctrl::variant)
    {
      case a_variant:ADAS_sim_start_a_variant();break;
      case b_variant:ADAS_sim_start_b_variant();break;
    }
    if (@hil_ctrl::hil_mode == @hil_ctrl::hil_mode::Restbus) 
    {
       ADAS_sim_EnableEventMsg();
    }
    else
    {
       ADAS_sim_DisableEventMsg();
    }
  }
}

void ADAS_sim_start_a_variant()
{
  @CAN_RadarFL::RXX_Config_Mgmt::RXX_Config_Mgmt_ON_OFF = 1;
  @CAN_RadarFL::RXX_VehInput::RXX_VehInput_ON_OFF = 1;
//  OnStart_callTx_ADAS_RXX_Object_NPdu_FC();
//  OnStart_callTx_ADAS_RXX_FieldData_NPdu_FC();
}

void ADAS_sim_start_b_variant()
{
  @CAN_RadarFL::RXX_Config_Mgmt::RXX_Config_Mgmt_ON_OFF = 1;
  @CAN_RadarFL::RXX_VehInput::RXX_VehInput_ON_OFF = 1;
//  OnStart_callTx_ADAS_RXX_Object_NPdu_FC();
//  OnStart_callTx_ADAS_RXX_FieldData_NPdu_FC();
}

void ADAS_sim_Disable()
{
  @CAN_RadarFL::RXX_Config_Mgmt::RXX_Config_Mgmt_ON_OFF = 0;
  @CAN_RadarFL::RXX_VehInput::RXX_VehInput_ON_OFF = 0;
  @CAN_RadarFL::RXX_VehConfig::RXX_VehConfig_ON_OFF = 0;
}

void ADAS_sim_DisableMsg()
{
   ARILFaultInjectionDisablePDU(RXX_Config_Mgmt);
   ARILFaultInjectionDisablePDU(RXX_VehInput);
   ARILFaultInjectionDisablePDU(RXX_VehConfig);
//   if (gHandle_ADAS_RXX_Object_NPdu_FC > 0)
//    {
//       CanTpCloseConnection(gHandle_ADAS_RXX_Object_NPdu_FC);
//    }
//   if (gHandle_ADAS_RXX_FieldData_NPdu_FC > 0)
//    {
//       CanTpCloseConnection(gHandle_ADAS_RXX_FieldData_NPdu_FC);
//    }
}
on sysvar hil_ctrl::hil_mode
{
  ADAS_sim_Reset();
}

void ADAS_sim_DisableEventMsg()
{
   ARILFaultInjectionDisablePDU(RXX_VehConfig);

}

void ADAS_sim_EnableEventMsg()
{
   ARILFaultInjectionEnablePDU(RXX_VehConfig);

}

dword applPDUILTxPending (dword busContext, dword shortID, dword longID, char name[], dword & aPDULength, byte data[])//This callback is being called before the IL sends a PDU to the bus
{
  if(strncmp(name, "RXX_Config_Mgmt", elcount(name)) == 0)
  {
    cfg_Pdu_RXX_Config_Mgmt(aPDULength, data);
    return 1; // don't prevent sending of the pdu
  }
  if(strncmp(name, "RXX_VehInput", elcount(name)) == 0)
  {
    cfg_Pdu_RXX_VehInput(aPDULength, data);
    return 1; // don't prevent sending of the pdu
  }
  if(strncmp(name, "RXX_VehConfig", elcount(name)) == 0)
  {
    cfg_Pdu_RXX_VehConfig(aPDULength, data);
    return 1; // don't prevent sending of the pdu
  }
  return 1; // don't prevent sending of the pdu
}

on sysvar CAN_RadarFL::RXX_Config_Mgmt::RXX_Config_Mgmt_ON_OFF
{
  if (@this == 1)
  {
    ARILFaultInjectionEnablePDU(RXX_Config_Mgmt);
  }
  else{
         ARILFaultInjectionDisablePDU(RXX_Config_Mgmt);
      }
}

void cfg_Pdu_RXX_Config_Mgmt(dword & aPDULength, byte data[])
{
   int64 i,k;//For looping
   byte xor,data_byte;
   dword crcTemp;
   byte DataLength;
   dword Msg_id;
   
   DataLength = Msg_RXX_Config_Mgmt.DataLength;//Message Data Length
   Msg_id  = Msg_RXX_Config_Mgmt.id;//Message ID
   
}


on sysvar CAN_RadarFL::RXX_VehConfig::RXX_VehConfig_ON_OFF
{
  if (@this == 1)
  {
     ARILSetPDUEvent(RXX_VehConfig);
     @CAN_RadarFL::RXX_VehConfig::RXX_VehConfig_ON_OFF = 0;
  }
}

void cfg_Pdu_RXX_VehConfig(dword & aPDULength, byte data[])
{
   int64 i,k;//For looping
   byte xor,data_byte;
   dword crcTemp;
   byte DataLength;
   dword Msg_id;
   long result;
   long type=0;//reserved (should be set to 0).
   long disturbanceMode  =0; //0 :: set to disturbanceValue //2 :: set to Random value //3 :: Offset Signal value is increased by disturbanceValue
   long disturbanceCount =0;//-1 ::Infinite Disturbance is continuously applied //0 ::Stop An active disturbance is stopped and the SequenceCounter/crc will be calculated again appropriately //n > 0 ::Count Do exactly n Repetition/disturbances
   long disturbanceValue =0;//According to the disturbance mode the SequenceCounter/crc will optionally be set to this value
   dword crc[1];
   
   DataLength = Msg_RXX_VehConfig.DataLength;//Message Data Length
   Msg_id  = Msg_RXX_VehConfig.id;//Message ID
   
{
   if (@CAN_RadarFL::RXX_VehConfig::RXX_VehConfig_CRC_FaultInject == 0)//CRC: No Error, calculate CRC
   {
      disturbanceCount  = 1;//Once Disturbance is applied
      disturbanceMode   = 0;//Sets the CRC fix to the value of parameter disturbanceValue.
      ARILCalculateCRC("RXX_VehConfig","SG_RXX_VehConfig",data,aPDULength,crc);//Profile 11A
      disturbanceValue=crc_RXX_VehConfig_RXX_VehConfig_CRC=crc[0]^0xFF;
      result=ARILFaultInjectionDisturbChecksum (RXX_VehConfig, "SG_RXX_VehConfig", type, disturbanceMode, disturbanceCount, disturbanceValue);
      //write("ARILFaultInjectionDisturbChecksum :: RXX_VehConfig :: SG_RXX_VehConfig :: RXX_VehConfig_CRC :: No Error");
   }
   else if (@CAN_RadarFL::RXX_VehConfig::RXX_VehConfig_CRC_FaultInject == 1)//CRC: Error , set CRC = 0
   {
      disturbanceCount  = 1;//Once Disturbance is continuously applied
      disturbanceMode   = 0;//Sets the CRC fix to the value of parameter disturbanceValue.
      disturbanceValue  = 0;//set CRC = 0
      result=ARILFaultInjectionDisturbChecksum (RXX_VehConfig, "SG_RXX_VehConfig", type, disturbanceMode, disturbanceCount, disturbanceValue);
      //write("ARILFaultInjectionDisturbChecksum :: RXX_VehConfig :: SG_RXX_VehConfig :: RXX_VehConfig_CRC :: AC = 0");
   }
   else if (@CAN_RadarFL::RXX_VehConfig::RXX_VehConfig_CRC_FaultInject == 2)//CRC: Error , Freeze last valid value
   {
      disturbanceCount  = 1;//Once Disturbance is  applied
      disturbanceMode   = 0;//Sets the CRC fix to the value of parameter disturbanceValue.
      disturbanceValue  = crc_RXX_VehConfig_RXX_VehConfig_CRC;
      result=ARILFaultInjectionDisturbChecksum (RXX_VehConfig, "SG_RXX_VehConfig", type, disturbanceMode, disturbanceCount, disturbanceValue);
      //write("ARILFaultInjectionDisturbChecksum :: RXX_VehConfig :: SG_RXX_VehConfig :: RXX_VehConfig_CRC :: Freeze");
    }
}
}


on sysvar CAN_RadarFL::RXX_VehInput::RXX_VehInput_ON_OFF
{
  if (@this == 1)
  {
    ARILFaultInjectionEnablePDU(RXX_VehInput);
  }
  else{
         ARILFaultInjectionDisablePDU(RXX_VehInput);
      }
}

void cfg_Pdu_RXX_VehInput(dword & aPDULength, byte data[])
{
   int64 i,k;//For looping
   byte xor,data_byte;
   dword crcTemp;
   byte DataLength;
   dword Msg_id;
   long result;
   long type=0;//reserved (should be set to 0).
   long disturbanceMode  =0; //0 :: set to disturbanceValue //2 :: set to Random value //3 :: Offset Signal value is increased by disturbanceValue
   long disturbanceCount =0;//-1 ::Infinite Disturbance is continuously applied //0 ::Stop An active disturbance is stopped and the SequenceCounter/crc will be calculated again appropriately //n > 0 ::Count Do exactly n Repetition/disturbances
   long disturbanceValue =0;//According to the disturbance mode the SequenceCounter/crc will optionally be set to this value
   dword crc[1];
   
   DataLength = Msg_RXX_VehInput.DataLength;//Message Data Length
   Msg_id  = Msg_RXX_VehInput.id;//Message ID
   
{
   if (@CAN_RadarFL::RXX_VehInput::RXX_VehInput_CRC_FaultInject == 0)//CRC: No Error, calculate CRC
   {
      disturbanceCount  = 1;//Once Disturbance is applied
      disturbanceMode   = 0;//Sets the CRC fix to the value of parameter disturbanceValue.
      ARILCalculateCRC("RXX_VehInput","SG_RXX_VehInput",data,aPDULength,crc);//Profile 11A
      disturbanceValue=crc_RXX_VehInput_RXX_VehInput_CRC=crc[0]^0xFF;
      result=ARILFaultInjectionDisturbChecksum (RXX_VehInput, "SG_RXX_VehInput", type, disturbanceMode, disturbanceCount, disturbanceValue);
      //write("ARILFaultInjectionDisturbChecksum :: RXX_VehInput :: SG_RXX_VehInput :: RXX_VehInput_CRC :: No Error");
   }
   else if (@CAN_RadarFL::RXX_VehInput::RXX_VehInput_CRC_FaultInject == 1)//CRC: Error , set CRC = 0
   {
      disturbanceCount  = 1;//Once Disturbance is continuously applied
      disturbanceMode   = 0;//Sets the CRC fix to the value of parameter disturbanceValue.
      disturbanceValue  = 0;//set CRC = 0
      result=ARILFaultInjectionDisturbChecksum (RXX_VehInput, "SG_RXX_VehInput", type, disturbanceMode, disturbanceCount, disturbanceValue);
      //write("ARILFaultInjectionDisturbChecksum :: RXX_VehInput :: SG_RXX_VehInput :: RXX_VehInput_CRC :: AC = 0");
   }
   else if (@CAN_RadarFL::RXX_VehInput::RXX_VehInput_CRC_FaultInject == 2)//CRC: Error , Freeze last valid value
   {
      disturbanceCount  = 1;//Once Disturbance is  applied
      disturbanceMode   = 0;//Sets the CRC fix to the value of parameter disturbanceValue.
      disturbanceValue  = crc_RXX_VehInput_RXX_VehInput_CRC;
      result=ARILFaultInjectionDisturbChecksum (RXX_VehInput, "SG_RXX_VehInput", type, disturbanceMode, disturbanceCount, disturbanceValue);
      //write("ARILFaultInjectionDisturbChecksum :: RXX_VehInput :: SG_RXX_VehInput :: RXX_VehInput_CRC :: Freeze");
    }
}
}

//  ARILSetPDUTimingCyclic (dbMsg dbMessage, long TrueOrFalse, long offset, long period, long disturbanceCount, long flags);
//  TrueOrFalse ; 0: denotes the False timing; 1: denotes the True timing; 3: denotes the True and the False timing.
//  offset :Defines the delay in [ms] from now when the first cyclic transmission will start.
//  period :Defines the period in [ms] for the cyclic transmission.
//  disturbanceCount :Reserved/unused; should be set to -1 (infinite).
//  flags :Reserved; should be set to 0.

on sysvar CAN_RadarFL::RXX_Config_Mgmt::RXX_Config_Mgmt_CycleTime
{
  ARILSetPDUTimingCyclic (RXX_Config_Mgmt, 3, 0, @this, -1, 0);//TrueOrFalse=3,offset=0;disturbanceCount =-1;flags=0
  //ARILResetPDUTimingCyclic(RXX_Config_Mgmt,3);//TrueOrFalse=3
}

on sysvar CAN_RadarFL::RXX_VehInput::RXX_VehInput_CycleTime
{
  ARILSetPDUTimingCyclic (RXX_VehInput, 3, 1, @this, -1, 0);//TrueOrFalse=3,offset=1;disturbanceCount =-1;flags=0
  //ARILResetPDUTimingCyclic(RXX_VehInput,3);//TrueOrFalse=3
}

void ADAS_sim_SetCycleTimeOffset()
{

//  ARILSetPDUTimingCyclic (dbMsg dbMessage, long TrueOrFalse, long offset, long period, long disturbanceCount, long flags);
//  TrueOrFalse ; 0: denotes the False timing; 1: denotes the True timing; 3: denotes the True and the False timing.
//  offset :Defines the delay in [ms] from now when the first cyclic transmission will start.
//  period :Defines the period in [ms] for the cyclic transmission.
//  disturbanceCount :Reserved/unused; should be set to -1 (infinite).
//  flags :Reserved; should be set to 0.
  ARILSetPDUTimingCyclic (RXX_Config_Mgmt, 3, 0, 20, -1, 0);//TrueOrFalse=3;offset=0;cycletime=20;disturbanceCount =-1;flags=0
  //ARILResetPDUTimingCyclic(RXX_Config_Mgmt,3);//TrueOrFalse=3
  ARILSetPDUTimingCyclic (RXX_VehInput, 3, 1, 20, -1, 0);//TrueOrFalse=3;offset=1;cycletime=20;disturbanceCount =-1;flags=0
  //ARILResetPDUTimingCyclic(RXX_VehInput,3);//TrueOrFalse=3

}

void OnSecurityLocalPDUPreTx(char pduName[], dword dataId, byte payload[], dword payloadLength, qword& authInfoHigh, qword& authInfo, dword authInfoBitLength, qword& freshness, dword freshnessBitLength, dword freshnessValueId)//This callback handler is called, after all data updates and the automatic Authenticator (CMAC) calculation has be done
{
}

CanTp_ReceptionInd(long connHandle, byte data[])//This function is called when data has been received on the connection with the given handle. The number of bytes received is available as length of the byte array.
{
  // Output of Source Address
  long rxCount;
  byte connId;
  
  rxCount = elcount(data);
  

  if (connHandle == gHandle_ADAS_RXX_FieldData_NPdu_FC)
  {
   connId = kId_ADAS_RXX_FieldData_NPdu_FC;
   if ((@hil_ctrl::adas_sim == 1) & (@hil_ctrl::radar_fl_obj_sim == 1))
   {
   }
   else if ((@hil_ctrl::adas_sim == 2) & (@hil_ctrl::radar_fl_obj_sim == 1))
   {
   }
   else if ((@hil_ctrl::adas_sim == 2) & (@hil_ctrl::radar_fl_obj_sim == 2))
   {
   SetDataReceived_ADAS_RXX_FieldData(data, rxCount);
   }
   else if ((@hil_ctrl::adas_sim == 1) & (@hil_ctrl::radar_fl_obj_sim == 2))
   {
   SetDataReceived_ADAS_RXX_FieldData(data, rxCount);
   }
  }


  if (connHandle == gHandle_ADAS_RXX_Object_NPdu_FC)
  {
   connId = kId_ADAS_RXX_Object_NPdu_FC;
   if ((@hil_ctrl::adas_sim == 1) & (@hil_ctrl::radar_fl_obj_sim == 1))
   {
   }
   else if ((@hil_ctrl::adas_sim == 2) & (@hil_ctrl::radar_fl_obj_sim == 1))
   {
   }
   else if ((@hil_ctrl::adas_sim == 2) & (@hil_ctrl::radar_fl_obj_sim == 2))
   {
   SetDataReceived_ADAS_RXX_Object(data, rxCount);
   }
   else if ((@hil_ctrl::adas_sim == 1) & (@hil_ctrl::radar_fl_obj_sim == 2))
   {
   SetDataReceived_ADAS_RXX_Object(data, rxCount);
   }
  }

   //writeDbgLevel(1,"%s, connection %d: Reception indication for %d bytes", "CAN_RadarFL", connId, rxCount);
}

void SetDataReceived_ADAS_RXX_FieldData(byte byteArray[], long count)//I-signal-i pdu : RXX_FieldData->Mapped to ->N-pdu : RXX_FieldData
{
    qword raw_value;

    @CAN_RadarFL::RXX_FieldData::rxBuffercount = count;
    sysSetVariableArraySize(sysvar::CAN_RadarFL::RXX_FieldData::RXX_FieldData, count);
    sysSetVariableData(sysvar::CAN_RadarFL::RXX_FieldData::RXX_FieldData, byteArray, count);
}


void SetDataReceived_ADAS_RXX_Object(byte byteArray[], long count)//I-signal-i pdu : RXX_Object->Mapped to ->N-pdu : RXX_Object
{
    qword raw_value;

    raw_value=copyBitsFromByteArrayBE( byteArray, 26128, 16);
    @CAN_RadarFL::RXX_Object::RXX_Object_E2E_p44_counter = convertRawToPhysical(raw_value, 1.0, 0.0);

    raw_value=copyBitsFromByteArrayBE( byteArray, 26176, 32);
    @CAN_RadarFL::RXX_Object::RXX_Object_E2E_p44_crc = convertRawToPhysical(raw_value, 1.0, 0.0);

    raw_value=copyBitsFromByteArrayBE( byteArray, 26144, 32);
    @CAN_RadarFL::RXX_Object::RXX_Object_E2E_p44_dataId = convertRawToPhysical(raw_value, 1.0, 0.0);

    raw_value=copyBitsFromByteArrayBE( byteArray, 26112, 16);
    @CAN_RadarFL::RXX_Object::RXX_Object_E2E_p44_length = convertRawToPhysical(raw_value, 1.0, 0.0);

    raw_value=copyBitsFromByteArrayLE( byteArray, 6112, 32);
    @CAN_RadarFL::RXX_Object::RXX_Object_Obj10_Age = convertRawToPhysical(raw_value, 1.0, 0.0);

    raw_value=copyBitsFromByteArrayLE( byteArray, 5708, 10);
    @CAN_RadarFL::RXX_Object::RXX_Object_Obj10_Ax = convertRawToPhysical(raw_value, 0.03125, -16.0);

    raw_value=copyBitsFromByteArrayLE( byteArray, 6092, 12);
    @CAN_RadarFL::RXX_Object::RXX_Object_Obj10_AxAyCoVnce = convertRawToPhysical(raw_value, 0.01, 0.0);

    raw_value=copyBitsFromByteArrayLE( byteArray, 5728, 12);
    @CAN_RadarFL::RXX_Object::RXX_Object_Obj10_AxVnce = convertRawToPhysical(raw_value, 0.01, 0.0);

    raw_value=copyBitsFromByteArrayLE( byteArray, 5782, 9);
    @CAN_RadarFL::RXX_Object::RXX_Object_Obj10_Ay = convertRawToPhysical(raw_value, 0.0625, -16.0);

    raw_value=copyBitsFromByteArrayLE( byteArray, 5792, 12);
    @CAN_RadarFL::RXX_Object::RXX_Object_Obj10_AyVnce = convertRawToPhysical(raw_value, 0.01, 0.0);

    raw_value=copyBitsFromByteArrayLE( byteArray, 5848, 6);
    @CAN_RadarFL::RXX_Object::RXX_Object_Obj10_ExistProb = convertRawToPhysical(raw_value, 2.0, 0.0);

    raw_value=copyBitsFromByteArrayLE( byteArray, 5912, 8);
    @CAN_RadarFL::RXX_Object::RXX_Object_Obj10_FilterInformation = convertRawToPhysical(raw_value, 1.0, 0.0);

    raw_value=copyBitsFromByteArrayLE( byteArray, 5688, 7);
    @CAN_RadarFL::RXX_Object::RXX_Object_Obj10_Length = convertRawToPhysical(raw_value, 0.125, 0.0);

    raw_value=copyBitsFromByteArrayLE( byteArray, 5696, 12);
    @CAN_RadarFL::RXX_Object::RXX_Object_Obj10_LengthVnce = convertRawToPhysical(raw_value, 0.01, 0.0);

    raw_value=copyBitsFromByteArrayLE( byteArray, 5880, 3);
    @CAN_RadarFL::RXX_Object::RXX_Object_Obj10_MeasurementStatus = convertRawToPhysical(raw_value, 1.0, 0.0);

    raw_value=copyBitsFromByteArrayLE( byteArray, 5836, 2);
    @CAN_RadarFL::RXX_Object::RXX_Object_Obj10_MovingStatus = convertRawToPhysical(raw_value, 1.0, 0.0);

    raw_value=copyBitsFromByteArrayLE( byteArray, 5816, 7);
    @CAN_RadarFL::RXX_Object::RXX_Object_Obj10_ObjId = convertRawToPhysical(raw_value, 1.0, 0.0);

    raw_value=copyBitsFromByteArrayLE( byteArray, 5718, 9);
    @CAN_RadarFL::RXX_Object::RXX_Object_Obj10_OrientationYaw = convertRawToPhysical(raw_value, 0.0175, -4.48);

    raw_value=copyBitsFromByteArrayLE( byteArray, 5740, 12);
    @CAN_RadarFL::RXX_Object::RXX_Object_Obj10_OrientationYawVnce = convertRawToPhysical(raw_value, 0.0003, 0.0);

    raw_value=copyBitsFromByteArrayLE( byteArray, 5632, 6);
    @CAN_RadarFL::RXX_Object::RXX_Object_Obj10_ProbClassConfidence = convertRawToPhysical(raw_value, 2.0, 0.0);

    raw_value=copyBitsFromByteArrayLE( byteArray, 5883, 4);
    @CAN_RadarFL::RXX_Object::RXX_Object_Obj10_ProbClassType = convertRawToPhysical(raw_value, 1.0, 0.0);

    raw_value=copyBitsFromByteArrayLE( byteArray, 5638, 14);
    @CAN_RadarFL::RXX_Object::RXX_Object_Obj10_Px = convertRawToPhysical(raw_value, 0.0625, -512.0);

    raw_value=copyBitsFromByteArrayLE( byteArray, 5952, 12);
    @CAN_RadarFL::RXX_Object::RXX_Object_Obj10_PxAxCoVnce = convertRawToPhysical(raw_value, 0.01, 0.0);

    raw_value=copyBitsFromByteArrayLE( byteArray, 5964, 12);
    @CAN_RadarFL::RXX_Object::RXX_Object_Obj10_PxAyCoVnce = convertRawToPhysical(raw_value, 0.01, 0.0);

    raw_value=copyBitsFromByteArrayLE( byteArray, 5868, 12);
    @CAN_RadarFL::RXX_Object::RXX_Object_Obj10_PxPyCoVnce = convertRawToPhysical(raw_value, 0.01, 0.0);

    raw_value=copyBitsFromByteArrayLE( byteArray, 5652, 12);
    @CAN_RadarFL::RXX_Object::RXX_Object_Obj10_PxVnce = convertRawToPhysical(raw_value, 0.1, 0.0);

    raw_value=copyBitsFromByteArrayLE( byteArray, 5888, 12);
    @CAN_RadarFL::RXX_Object::RXX_Object_Obj10_PxVxCoVnce = convertRawToPhysical(raw_value, 0.01, 0.0);

    raw_value=copyBitsFromByteArrayLE( byteArray, 5900, 12);
    @CAN_RadarFL::RXX_Object::RXX_Object_Obj10_PxVyCoVnce = convertRawToPhysical(raw_value, 0.01, 0.0);

    raw_value=copyBitsFromByteArrayLE( byteArray, 5664, 12);
    @CAN_RadarFL::RXX_Object::RXX_Object_Obj10_Py = convertRawToPhysical(raw_value, 0.0625, -128.0);

    raw_value=copyBitsFromByteArrayLE( byteArray, 5984, 12);
    @CAN_RadarFL::RXX_Object::RXX_Object_Obj10_PyAxCoVnce = convertRawToPhysical(raw_value, 0.01, 0.0);

    raw_value=copyBitsFromByteArrayLE( byteArray, 5996, 12);
    @CAN_RadarFL::RXX_Object::RXX_Object_Obj10_PyAyCoVnce = convertRawToPhysical(raw_value, 0.01, 0.0);

    raw_value=copyBitsFromByteArrayLE( byteArray, 5676, 12);
    @CAN_RadarFL::RXX_Object::RXX_Object_Obj10_PyVnce = convertRawToPhysical(raw_value, 0.1, 0.0);

    raw_value=copyBitsFromByteArrayLE( byteArray, 5920, 12);
    @CAN_RadarFL::RXX_Object::RXX_Object_Obj10_PyVxCoVnce = convertRawToPhysical(raw_value, 0.01, 0.0);

    raw_value=copyBitsFromByteArrayLE( byteArray, 5932, 12);
    @CAN_RadarFL::RXX_Object::RXX_Object_Obj10_PyVyCoVnce = convertRawToPhysical(raw_value, 0.01, 0.0);

    raw_value=copyBitsFromByteArrayLE( byteArray, 5772, 10);
    @CAN_RadarFL::RXX_Object::RXX_Object_Obj10_RCS = convertRawToPhysical(raw_value, 0.2, -102.4);

    raw_value=copyBitsFromByteArrayLE( byteArray, 5944, 4);
    @CAN_RadarFL::RXX_Object::RXX_Object_Obj10_ReferencePoint = convertRawToPhysical(raw_value, 1.0, 0.0);

    raw_value=copyBitsFromByteArrayLE( byteArray, 5804, 12);
    @CAN_RadarFL::RXX_Object::RXX_Object_Obj10_Vx = convertRawToPhysical(raw_value, 0.0625, -128.0);

    raw_value=copyBitsFromByteArrayLE( byteArray, 6028, 12);
    @CAN_RadarFL::RXX_Object::RXX_Object_Obj10_VxAxCoVnce = convertRawToPhysical(raw_value, 0.01, 0.0);

    raw_value=copyBitsFromByteArrayLE( byteArray, 6048, 12);
    @CAN_RadarFL::RXX_Object::RXX_Object_Obj10_VxAyCoVnce = convertRawToPhysical(raw_value, 0.01, 0.0);

    raw_value=copyBitsFromByteArrayLE( byteArray, 5824, 12);
    @CAN_RadarFL::RXX_Object::RXX_Object_Obj10_VxVnce = convertRawToPhysical(raw_value, 0.01, 0.0);

    raw_value=copyBitsFromByteArrayLE( byteArray, 6016, 12);
    @CAN_RadarFL::RXX_Object::RXX_Object_Obj10_VxVyCoVnce = convertRawToPhysical(raw_value, 0.01, 0.0);

    raw_value=copyBitsFromByteArrayLE( byteArray, 5838, 10);
    @CAN_RadarFL::RXX_Object::RXX_Object_Obj10_Vy = convertRawToPhysical(raw_value, 0.125, -64.0);

    raw_value=copyBitsFromByteArrayLE( byteArray, 6060, 12);
    @CAN_RadarFL::RXX_Object::RXX_Object_Obj10_VyAxCoVnce = convertRawToPhysical(raw_value, 0.01, 0.0);

    raw_value=copyBitsFromByteArrayLE( byteArray, 6080, 12);
    @CAN_RadarFL::RXX_Object::RXX_Object_Obj10_VyAyCoVnce = convertRawToPhysical(raw_value, 0.01, 0.0);

    raw_value=copyBitsFromByteArrayLE( byteArray, 5856, 12);
    @CAN_RadarFL::RXX_Object::RXX_Object_Obj10_VyVnce = convertRawToPhysical(raw_value, 0.01, 0.0);

    raw_value=copyBitsFromByteArrayLE( byteArray, 5752, 7);
    @CAN_RadarFL::RXX_Object::RXX_Object_Obj10_Width = convertRawToPhysical(raw_value, 0.125, 0.0);

    raw_value=copyBitsFromByteArrayLE( byteArray, 5760, 12);
    @CAN_RadarFL::RXX_Object::RXX_Object_Obj10_WidthVnce = convertRawToPhysical(raw_value, 0.01, 0.0);

    raw_value=copyBitsFromByteArrayLE( byteArray, 6624, 32);
    @CAN_RadarFL::RXX_Object::RXX_Object_Obj11_Age = convertRawToPhysical(raw_value, 1.0, 0.0);

    raw_value=copyBitsFromByteArrayLE( byteArray, 6220, 10);
    @CAN_RadarFL::RXX_Object::RXX_Object_Obj11_Ax = convertRawToPhysical(raw_value, 0.03125, -16.0);

    raw_value=copyBitsFromByteArrayLE( byteArray, 6604, 12);
    @CAN_RadarFL::RXX_Object::RXX_Object_Obj11_AxAyCoVnce = convertRawToPhysical(raw_value, 0.01, 0.0);

    raw_value=copyBitsFromByteArrayLE( byteArray, 6240, 12);
    @CAN_RadarFL::RXX_Object::RXX_Object_Obj11_AxVnce = convertRawToPhysical(raw_value, 0.01, 0.0);

    raw_value=copyBitsFromByteArrayLE( byteArray, 6294, 9);
    @CAN_RadarFL::RXX_Object::RXX_Object_Obj11_Ay = convertRawToPhysical(raw_value, 0.0625, -16.0);

    raw_value=copyBitsFromByteArrayLE( byteArray, 6304, 12);
    @CAN_RadarFL::RXX_Object::RXX_Object_Obj11_AyVnce = convertRawToPhysical(raw_value, 0.01, 0.0);

    raw_value=copyBitsFromByteArrayLE( byteArray, 6360, 6);
    @CAN_RadarFL::RXX_Object::RXX_Object_Obj11_ExistProb = convertRawToPhysical(raw_value, 2.0, 0.0);

    raw_value=copyBitsFromByteArrayLE( byteArray, 6424, 8);
    @CAN_RadarFL::RXX_Object::RXX_Object_Obj11_FilterInformation = convertRawToPhysical(raw_value, 1.0, 0.0);

    raw_value=copyBitsFromByteArrayLE( byteArray, 6200, 7);
    @CAN_RadarFL::RXX_Object::RXX_Object_Obj11_Length = convertRawToPhysical(raw_value, 0.125, 0.0);

    raw_value=copyBitsFromByteArrayLE( byteArray, 6208, 12);
    @CAN_RadarFL::RXX_Object::RXX_Object_Obj11_LengthVnce = convertRawToPhysical(raw_value, 0.01, 0.0);

    raw_value=copyBitsFromByteArrayLE( byteArray, 6392, 3);
    @CAN_RadarFL::RXX_Object::RXX_Object_Obj11_MeasurementStatus = convertRawToPhysical(raw_value, 1.0, 0.0);

    raw_value=copyBitsFromByteArrayLE( byteArray, 6348, 2);
    @CAN_RadarFL::RXX_Object::RXX_Object_Obj11_MovingStatus = convertRawToPhysical(raw_value, 1.0, 0.0);

    raw_value=copyBitsFromByteArrayLE( byteArray, 6328, 7);
    @CAN_RadarFL::RXX_Object::RXX_Object_Obj11_ObjId = convertRawToPhysical(raw_value, 1.0, 0.0);

    raw_value=copyBitsFromByteArrayLE( byteArray, 6230, 9);
    @CAN_RadarFL::RXX_Object::RXX_Object_Obj11_OrientationYaw = convertRawToPhysical(raw_value, 0.0175, -4.48);

    raw_value=copyBitsFromByteArrayLE( byteArray, 6252, 12);
    @CAN_RadarFL::RXX_Object::RXX_Object_Obj11_OrientationYawVnce = convertRawToPhysical(raw_value, 0.0003, 0.0);

    raw_value=copyBitsFromByteArrayLE( byteArray, 6144, 6);
    @CAN_RadarFL::RXX_Object::RXX_Object_Obj11_ProbClassConfidence = convertRawToPhysical(raw_value, 2.0, 0.0);

    raw_value=copyBitsFromByteArrayLE( byteArray, 6395, 4);
    @CAN_RadarFL::RXX_Object::RXX_Object_Obj11_ProbClassType = convertRawToPhysical(raw_value, 1.0, 0.0);

    raw_value=copyBitsFromByteArrayLE( byteArray, 6150, 14);
    @CAN_RadarFL::RXX_Object::RXX_Object_Obj11_Px = convertRawToPhysical(raw_value, 0.0625, -512.0);

    raw_value=copyBitsFromByteArrayLE( byteArray, 6464, 12);
    @CAN_RadarFL::RXX_Object::RXX_Object_Obj11_PxAxCoVnce = convertRawToPhysical(raw_value, 0.01, 0.0);

    raw_value=copyBitsFromByteArrayLE( byteArray, 6476, 12);
    @CAN_RadarFL::RXX_Object::RXX_Object_Obj11_PxAyCoVnce = convertRawToPhysical(raw_value, 0.01, 0.0);

    raw_value=copyBitsFromByteArrayLE( byteArray, 6380, 12);
    @CAN_RadarFL::RXX_Object::RXX_Object_Obj11_PxPyCoVnce = convertRawToPhysical(raw_value, 0.01, 0.0);

    raw_value=copyBitsFromByteArrayLE( byteArray, 6164, 12);
    @CAN_RadarFL::RXX_Object::RXX_Object_Obj11_PxVnce = convertRawToPhysical(raw_value, 0.1, 0.0);

    raw_value=copyBitsFromByteArrayLE( byteArray, 6400, 12);
    @CAN_RadarFL::RXX_Object::RXX_Object_Obj11_PxVxCoVnce = convertRawToPhysical(raw_value, 0.01, 0.0);

    raw_value=copyBitsFromByteArrayLE( byteArray, 6412, 12);
    @CAN_RadarFL::RXX_Object::RXX_Object_Obj11_PxVyCoVnce = convertRawToPhysical(raw_value, 0.01, 0.0);

    raw_value=copyBitsFromByteArrayLE( byteArray, 6176, 12);
    @CAN_RadarFL::RXX_Object::RXX_Object_Obj11_Py = convertRawToPhysical(raw_value, 0.0625, -128.0);

    raw_value=copyBitsFromByteArrayLE( byteArray, 6496, 12);
    @CAN_RadarFL::RXX_Object::RXX_Object_Obj11_PyAxCoVnce = convertRawToPhysical(raw_value, 0.01, 0.0);

    raw_value=copyBitsFromByteArrayLE( byteArray, 6508, 12);
    @CAN_RadarFL::RXX_Object::RXX_Object_Obj11_PyAyCoVnce = convertRawToPhysical(raw_value, 0.01, 0.0);

    raw_value=copyBitsFromByteArrayLE( byteArray, 6188, 12);
    @CAN_RadarFL::RXX_Object::RXX_Object_Obj11_PyVnce = convertRawToPhysical(raw_value, 0.1, 0.0);

    raw_value=copyBitsFromByteArrayLE( byteArray, 6432, 12);
    @CAN_RadarFL::RXX_Object::RXX_Object_Obj11_PyVxCoVnce = convertRawToPhysical(raw_value, 0.01, 0.0);

    raw_value=copyBitsFromByteArrayLE( byteArray, 6444, 12);
    @CAN_RadarFL::RXX_Object::RXX_Object_Obj11_PyVyCoVnce = convertRawToPhysical(raw_value, 0.01, 0.0);

    raw_value=copyBitsFromByteArrayLE( byteArray, 6284, 10);
    @CAN_RadarFL::RXX_Object::RXX_Object_Obj11_RCS = convertRawToPhysical(raw_value, 0.2, -102.4);

    raw_value=copyBitsFromByteArrayLE( byteArray, 6456, 4);
    @CAN_RadarFL::RXX_Object::RXX_Object_Obj11_ReferencePoint = convertRawToPhysical(raw_value, 1.0, 0.0);

    raw_value=copyBitsFromByteArrayLE( byteArray, 6316, 12);
    @CAN_RadarFL::RXX_Object::RXX_Object_Obj11_Vx = convertRawToPhysical(raw_value, 0.0625, -128.0);

    raw_value=copyBitsFromByteArrayLE( byteArray, 6540, 12);
    @CAN_RadarFL::RXX_Object::RXX_Object_Obj11_VxAxCoVnce = convertRawToPhysical(raw_value, 0.01, 0.0);

    raw_value=copyBitsFromByteArrayLE( byteArray, 6560, 12);
    @CAN_RadarFL::RXX_Object::RXX_Object_Obj11_VxAyCoVnce = convertRawToPhysical(raw_value, 0.01, 0.0);

    raw_value=copyBitsFromByteArrayLE( byteArray, 6336, 12);
    @CAN_RadarFL::RXX_Object::RXX_Object_Obj11_VxVnce = convertRawToPhysical(raw_value, 0.01, 0.0);

    raw_value=copyBitsFromByteArrayLE( byteArray, 6528, 12);
    @CAN_RadarFL::RXX_Object::RXX_Object_Obj11_VxVyCoVnce = convertRawToPhysical(raw_value, 0.01, 0.0);

    raw_value=copyBitsFromByteArrayLE( byteArray, 6350, 10);
    @CAN_RadarFL::RXX_Object::RXX_Object_Obj11_Vy = convertRawToPhysical(raw_value, 0.125, -64.0);

    raw_value=copyBitsFromByteArrayLE( byteArray, 6572, 12);
    @CAN_RadarFL::RXX_Object::RXX_Object_Obj11_VyAxCoVnce = convertRawToPhysical(raw_value, 0.01, 0.0);

    raw_value=copyBitsFromByteArrayLE( byteArray, 6592, 12);
    @CAN_RadarFL::RXX_Object::RXX_Object_Obj11_VyAyCoVnce = convertRawToPhysical(raw_value, 0.01, 0.0);

    raw_value=copyBitsFromByteArrayLE( byteArray, 6368, 12);
    @CAN_RadarFL::RXX_Object::RXX_Object_Obj11_VyVnce = convertRawToPhysical(raw_value, 0.01, 0.0);

    raw_value=copyBitsFromByteArrayLE( byteArray, 6264, 7);
    @CAN_RadarFL::RXX_Object::RXX_Object_Obj11_Width = convertRawToPhysical(raw_value, 0.125, 0.0);

    raw_value=copyBitsFromByteArrayLE( byteArray, 6272, 12);
    @CAN_RadarFL::RXX_Object::RXX_Object_Obj11_WidthVnce = convertRawToPhysical(raw_value, 0.01, 0.0);

    raw_value=copyBitsFromByteArrayLE( byteArray, 7136, 32);
    @CAN_RadarFL::RXX_Object::RXX_Object_Obj12_Age = convertRawToPhysical(raw_value, 1.0, 0.0);

    raw_value=copyBitsFromByteArrayLE( byteArray, 6732, 10);
    @CAN_RadarFL::RXX_Object::RXX_Object_Obj12_Ax = convertRawToPhysical(raw_value, 0.03125, -16.0);

    raw_value=copyBitsFromByteArrayLE( byteArray, 7116, 12);
    @CAN_RadarFL::RXX_Object::RXX_Object_Obj12_AxAyCoVnce = convertRawToPhysical(raw_value, 0.01, 0.0);

    raw_value=copyBitsFromByteArrayLE( byteArray, 6752, 12);
    @CAN_RadarFL::RXX_Object::RXX_Object_Obj12_AxVnce = convertRawToPhysical(raw_value, 0.01, 0.0);

    raw_value=copyBitsFromByteArrayLE( byteArray, 6806, 9);
    @CAN_RadarFL::RXX_Object::RXX_Object_Obj12_Ay = convertRawToPhysical(raw_value, 0.0625, -16.0);

    raw_value=copyBitsFromByteArrayLE( byteArray, 6816, 12);
    @CAN_RadarFL::RXX_Object::RXX_Object_Obj12_AyVnce = convertRawToPhysical(raw_value, 0.01, 0.0);

    raw_value=copyBitsFromByteArrayLE( byteArray, 6872, 6);
    @CAN_RadarFL::RXX_Object::RXX_Object_Obj12_ExistProb = convertRawToPhysical(raw_value, 2.0, 0.0);

    raw_value=copyBitsFromByteArrayLE( byteArray, 6936, 8);
    @CAN_RadarFL::RXX_Object::RXX_Object_Obj12_FilterInformation = convertRawToPhysical(raw_value, 1.0, 0.0);

    raw_value=copyBitsFromByteArrayLE( byteArray, 6712, 7);
    @CAN_RadarFL::RXX_Object::RXX_Object_Obj12_Length = convertRawToPhysical(raw_value, 0.125, 0.0);

    raw_value=copyBitsFromByteArrayLE( byteArray, 6720, 12);
    @CAN_RadarFL::RXX_Object::RXX_Object_Obj12_LengthVnce = convertRawToPhysical(raw_value, 0.01, 0.0);

    raw_value=copyBitsFromByteArrayLE( byteArray, 6904, 3);
    @CAN_RadarFL::RXX_Object::RXX_Object_Obj12_MeasurementStatus = convertRawToPhysical(raw_value, 1.0, 0.0);

    raw_value=copyBitsFromByteArrayLE( byteArray, 6860, 2);
    @CAN_RadarFL::RXX_Object::RXX_Object_Obj12_MovingStatus = convertRawToPhysical(raw_value, 1.0, 0.0);

    raw_value=copyBitsFromByteArrayLE( byteArray, 6840, 7);
    @CAN_RadarFL::RXX_Object::RXX_Object_Obj12_ObjId = convertRawToPhysical(raw_value, 1.0, 0.0);

    raw_value=copyBitsFromByteArrayLE( byteArray, 6742, 9);
    @CAN_RadarFL::RXX_Object::RXX_Object_Obj12_OrientationYaw = convertRawToPhysical(raw_value, 0.0175, -4.48);

    raw_value=copyBitsFromByteArrayLE( byteArray, 6764, 12);
    @CAN_RadarFL::RXX_Object::RXX_Object_Obj12_OrientationYawVnce = convertRawToPhysical(raw_value, 0.0003, 0.0);

    raw_value=copyBitsFromByteArrayLE( byteArray, 6656, 6);
    @CAN_RadarFL::RXX_Object::RXX_Object_Obj12_ProbClassConfidence = convertRawToPhysical(raw_value, 2.0, 0.0);

    raw_value=copyBitsFromByteArrayLE( byteArray, 6907, 4);
    @CAN_RadarFL::RXX_Object::RXX_Object_Obj12_ProbClassType = convertRawToPhysical(raw_value, 1.0, 0.0);

    raw_value=copyBitsFromByteArrayLE( byteArray, 6662, 14);
    @CAN_RadarFL::RXX_Object::RXX_Object_Obj12_Px = convertRawToPhysical(raw_value, 0.0625, -512.0);

    raw_value=copyBitsFromByteArrayLE( byteArray, 6976, 12);
    @CAN_RadarFL::RXX_Object::RXX_Object_Obj12_PxAxCoVnce = convertRawToPhysical(raw_value, 0.01, 0.0);

    raw_value=copyBitsFromByteArrayLE( byteArray, 6988, 12);
    @CAN_RadarFL::RXX_Object::RXX_Object_Obj12_PxAyCoVnce = convertRawToPhysical(raw_value, 0.01, 0.0);

    raw_value=copyBitsFromByteArrayLE( byteArray, 6892, 12);
    @CAN_RadarFL::RXX_Object::RXX_Object_Obj12_PxPyCoVnce = convertRawToPhysical(raw_value, 0.01, 0.0);

    raw_value=copyBitsFromByteArrayLE( byteArray, 6676, 12);
    @CAN_RadarFL::RXX_Object::RXX_Object_Obj12_PxVnce = convertRawToPhysical(raw_value, 0.1, 0.0);

    raw_value=copyBitsFromByteArrayLE( byteArray, 6912, 12);
    @CAN_RadarFL::RXX_Object::RXX_Object_Obj12_PxVxCoVnce = convertRawToPhysical(raw_value, 0.01, 0.0);

    raw_value=copyBitsFromByteArrayLE( byteArray, 6924, 12);
    @CAN_RadarFL::RXX_Object::RXX_Object_Obj12_PxVyCoVnce = convertRawToPhysical(raw_value, 0.01, 0.0);

    raw_value=copyBitsFromByteArrayLE( byteArray, 6688, 12);
    @CAN_RadarFL::RXX_Object::RXX_Object_Obj12_Py = convertRawToPhysical(raw_value, 0.0625, -128.0);

    raw_value=copyBitsFromByteArrayLE( byteArray, 7008, 12);
    @CAN_RadarFL::RXX_Object::RXX_Object_Obj12_PyAxCoVnce = convertRawToPhysical(raw_value, 0.01, 0.0);

    raw_value=copyBitsFromByteArrayLE( byteArray, 7020, 12);
    @CAN_RadarFL::RXX_Object::RXX_Object_Obj12_PyAyCoVnce = convertRawToPhysical(raw_value, 0.01, 0.0);

    raw_value=copyBitsFromByteArrayLE( byteArray, 6700, 12);
    @CAN_RadarFL::RXX_Object::RXX_Object_Obj12_PyVnce = convertRawToPhysical(raw_value, 0.1, 0.0);

    raw_value=copyBitsFromByteArrayLE( byteArray, 6944, 12);
    @CAN_RadarFL::RXX_Object::RXX_Object_Obj12_PyVxCoVnce = convertRawToPhysical(raw_value, 0.01, 0.0);

    raw_value=copyBitsFromByteArrayLE( byteArray, 6956, 12);
    @CAN_RadarFL::RXX_Object::RXX_Object_Obj12_PyVyCoVnce = convertRawToPhysical(raw_value, 0.01, 0.0);

    raw_value=copyBitsFromByteArrayLE( byteArray, 6796, 10);
    @CAN_RadarFL::RXX_Object::RXX_Object_Obj12_RCS = convertRawToPhysical(raw_value, 0.2, -102.4);

    raw_value=copyBitsFromByteArrayLE( byteArray, 6968, 4);
    @CAN_RadarFL::RXX_Object::RXX_Object_Obj12_ReferencePoint = convertRawToPhysical(raw_value, 1.0, 0.0);

    raw_value=copyBitsFromByteArrayLE( byteArray, 6828, 12);
    @CAN_RadarFL::RXX_Object::RXX_Object_Obj12_Vx = convertRawToPhysical(raw_value, 0.0625, -128.0);

    raw_value=copyBitsFromByteArrayLE( byteArray, 7052, 12);
    @CAN_RadarFL::RXX_Object::RXX_Object_Obj12_VxAxCoVnce = convertRawToPhysical(raw_value, 0.01, 0.0);

    raw_value=copyBitsFromByteArrayLE( byteArray, 7072, 12);
    @CAN_RadarFL::RXX_Object::RXX_Object_Obj12_VxAyCoVnce = convertRawToPhysical(raw_value, 0.01, 0.0);

    raw_value=copyBitsFromByteArrayLE( byteArray, 6848, 12);
    @CAN_RadarFL::RXX_Object::RXX_Object_Obj12_VxVnce = convertRawToPhysical(raw_value, 0.01, 0.0);

    raw_value=copyBitsFromByteArrayLE( byteArray, 7040, 12);
    @CAN_RadarFL::RXX_Object::RXX_Object_Obj12_VxVyCoVnce = convertRawToPhysical(raw_value, 0.01, 0.0);

    raw_value=copyBitsFromByteArrayLE( byteArray, 6862, 10);
    @CAN_RadarFL::RXX_Object::RXX_Object_Obj12_Vy = convertRawToPhysical(raw_value, 0.125, -64.0);

    raw_value=copyBitsFromByteArrayLE( byteArray, 7084, 12);
    @CAN_RadarFL::RXX_Object::RXX_Object_Obj12_VyAxCoVnce = convertRawToPhysical(raw_value, 0.01, 0.0);

    raw_value=copyBitsFromByteArrayLE( byteArray, 7104, 12);
    @CAN_RadarFL::RXX_Object::RXX_Object_Obj12_VyAyCoVnce = convertRawToPhysical(raw_value, 0.01, 0.0);

    raw_value=copyBitsFromByteArrayLE( byteArray, 6880, 12);
    @CAN_RadarFL::RXX_Object::RXX_Object_Obj12_VyVnce = convertRawToPhysical(raw_value, 0.01, 0.0);

    raw_value=copyBitsFromByteArrayLE( byteArray, 6776, 7);
    @CAN_RadarFL::RXX_Object::RXX_Object_Obj12_Width = convertRawToPhysical(raw_value, 0.125, 0.0);

    raw_value=copyBitsFromByteArrayLE( byteArray, 6784, 12);
    @CAN_RadarFL::RXX_Object::RXX_Object_Obj12_WidthVnce = convertRawToPhysical(raw_value, 0.01, 0.0);

    raw_value=copyBitsFromByteArrayLE( byteArray, 7648, 32);
    @CAN_RadarFL::RXX_Object::RXX_Object_Obj13_Age = convertRawToPhysical(raw_value, 1.0, 0.0);

    raw_value=copyBitsFromByteArrayLE( byteArray, 7244, 10);
    @CAN_RadarFL::RXX_Object::RXX_Object_Obj13_Ax = convertRawToPhysical(raw_value, 0.03125, -16.0);

    raw_value=copyBitsFromByteArrayLE( byteArray, 7628, 12);
    @CAN_RadarFL::RXX_Object::RXX_Object_Obj13_AxAyCoVnce = convertRawToPhysical(raw_value, 0.01, 0.0);

    raw_value=copyBitsFromByteArrayLE( byteArray, 7264, 12);
    @CAN_RadarFL::RXX_Object::RXX_Object_Obj13_AxVnce = convertRawToPhysical(raw_value, 0.01, 0.0);

    raw_value=copyBitsFromByteArrayLE( byteArray, 7318, 9);
    @CAN_RadarFL::RXX_Object::RXX_Object_Obj13_Ay = convertRawToPhysical(raw_value, 0.0625, -16.0);

    raw_value=copyBitsFromByteArrayLE( byteArray, 7328, 12);
    @CAN_RadarFL::RXX_Object::RXX_Object_Obj13_AyVnce = convertRawToPhysical(raw_value, 0.01, 0.0);

    raw_value=copyBitsFromByteArrayLE( byteArray, 7384, 6);
    @CAN_RadarFL::RXX_Object::RXX_Object_Obj13_ExistProb = convertRawToPhysical(raw_value, 2.0, 0.0);

    raw_value=copyBitsFromByteArrayLE( byteArray, 7448, 8);
    @CAN_RadarFL::RXX_Object::RXX_Object_Obj13_FilterInformation = convertRawToPhysical(raw_value, 1.0, 0.0);

    raw_value=copyBitsFromByteArrayLE( byteArray, 7224, 7);
    @CAN_RadarFL::RXX_Object::RXX_Object_Obj13_Length = convertRawToPhysical(raw_value, 0.125, 0.0);

    raw_value=copyBitsFromByteArrayLE( byteArray, 7232, 12);
    @CAN_RadarFL::RXX_Object::RXX_Object_Obj13_LengthVnce = convertRawToPhysical(raw_value, 0.01, 0.0);

    raw_value=copyBitsFromByteArrayLE( byteArray, 7416, 3);
    @CAN_RadarFL::RXX_Object::RXX_Object_Obj13_MeasurementStatus = convertRawToPhysical(raw_value, 1.0, 0.0);

    raw_value=copyBitsFromByteArrayLE( byteArray, 7372, 2);
    @CAN_RadarFL::RXX_Object::RXX_Object_Obj13_MovingStatus = convertRawToPhysical(raw_value, 1.0, 0.0);

    raw_value=copyBitsFromByteArrayLE( byteArray, 7352, 7);
    @CAN_RadarFL::RXX_Object::RXX_Object_Obj13_ObjId = convertRawToPhysical(raw_value, 1.0, 0.0);

    raw_value=copyBitsFromByteArrayLE( byteArray, 7254, 9);
    @CAN_RadarFL::RXX_Object::RXX_Object_Obj13_OrientationYaw = convertRawToPhysical(raw_value, 0.0175, -4.48);

    raw_value=copyBitsFromByteArrayLE( byteArray, 7276, 12);
    @CAN_RadarFL::RXX_Object::RXX_Object_Obj13_OrientationYawVnce = convertRawToPhysical(raw_value, 0.0003, 0.0);

    raw_value=copyBitsFromByteArrayLE( byteArray, 7168, 6);
    @CAN_RadarFL::RXX_Object::RXX_Object_Obj13_ProbClassConfidence = convertRawToPhysical(raw_value, 2.0, 0.0);

    raw_value=copyBitsFromByteArrayLE( byteArray, 7419, 4);
    @CAN_RadarFL::RXX_Object::RXX_Object_Obj13_ProbClassType = convertRawToPhysical(raw_value, 1.0, 0.0);

    raw_value=copyBitsFromByteArrayLE( byteArray, 7174, 14);
    @CAN_RadarFL::RXX_Object::RXX_Object_Obj13_Px = convertRawToPhysical(raw_value, 0.0625, -512.0);

    raw_value=copyBitsFromByteArrayLE( byteArray, 7488, 12);
    @CAN_RadarFL::RXX_Object::RXX_Object_Obj13_PxAxCoVnce = convertRawToPhysical(raw_value, 0.01, 0.0);

    raw_value=copyBitsFromByteArrayLE( byteArray, 7500, 12);
    @CAN_RadarFL::RXX_Object::RXX_Object_Obj13_PxAyCoVnce = convertRawToPhysical(raw_value, 0.01, 0.0);

    raw_value=copyBitsFromByteArrayLE( byteArray, 7404, 12);
    @CAN_RadarFL::RXX_Object::RXX_Object_Obj13_PxPyCoVnce = convertRawToPhysical(raw_value, 0.01, 0.0);

    raw_value=copyBitsFromByteArrayLE( byteArray, 7188, 12);
    @CAN_RadarFL::RXX_Object::RXX_Object_Obj13_PxVnce = convertRawToPhysical(raw_value, 0.1, 0.0);

    raw_value=copyBitsFromByteArrayLE( byteArray, 7424, 12);
    @CAN_RadarFL::RXX_Object::RXX_Object_Obj13_PxVxCoVnce = convertRawToPhysical(raw_value, 0.01, 0.0);

    raw_value=copyBitsFromByteArrayLE( byteArray, 7436, 12);
    @CAN_RadarFL::RXX_Object::RXX_Object_Obj13_PxVyCoVnce = convertRawToPhysical(raw_value, 0.01, 0.0);

    raw_value=copyBitsFromByteArrayLE( byteArray, 7200, 12);
    @CAN_RadarFL::RXX_Object::RXX_Object_Obj13_Py = convertRawToPhysical(raw_value, 0.0625, -128.0);

    raw_value=copyBitsFromByteArrayLE( byteArray, 7520, 12);
    @CAN_RadarFL::RXX_Object::RXX_Object_Obj13_PyAxCoVnce = convertRawToPhysical(raw_value, 0.01, 0.0);

    raw_value=copyBitsFromByteArrayLE( byteArray, 7532, 12);
    @CAN_RadarFL::RXX_Object::RXX_Object_Obj13_PyAyCoVnce = convertRawToPhysical(raw_value, 0.01, 0.0);

    raw_value=copyBitsFromByteArrayLE( byteArray, 7212, 12);
    @CAN_RadarFL::RXX_Object::RXX_Object_Obj13_PyVnce = convertRawToPhysical(raw_value, 0.1, 0.0);

    raw_value=copyBitsFromByteArrayLE( byteArray, 7456, 12);
    @CAN_RadarFL::RXX_Object::RXX_Object_Obj13_PyVxCoVnce = convertRawToPhysical(raw_value, 0.01, 0.0);

    raw_value=copyBitsFromByteArrayLE( byteArray, 7468, 12);
    @CAN_RadarFL::RXX_Object::RXX_Object_Obj13_PyVyCoVnce = convertRawToPhysical(raw_value, 0.01, 0.0);

    raw_value=copyBitsFromByteArrayLE( byteArray, 7308, 10);
    @CAN_RadarFL::RXX_Object::RXX_Object_Obj13_RCS = convertRawToPhysical(raw_value, 0.2, -102.4);

    raw_value=copyBitsFromByteArrayLE( byteArray, 7480, 4);
    @CAN_RadarFL::RXX_Object::RXX_Object_Obj13_ReferencePoint = convertRawToPhysical(raw_value, 1.0, 0.0);

    raw_value=copyBitsFromByteArrayLE( byteArray, 7340, 12);
    @CAN_RadarFL::RXX_Object::RXX_Object_Obj13_Vx = convertRawToPhysical(raw_value, 0.0625, -128.0);

    raw_value=copyBitsFromByteArrayLE( byteArray, 7564, 12);
    @CAN_RadarFL::RXX_Object::RXX_Object_Obj13_VxAxCoVnce = convertRawToPhysical(raw_value, 0.01, 0.0);

    raw_value=copyBitsFromByteArrayLE( byteArray, 7584, 12);
    @CAN_RadarFL::RXX_Object::RXX_Object_Obj13_VxAyCoVnce = convertRawToPhysical(raw_value, 0.01, 0.0);

    raw_value=copyBitsFromByteArrayLE( byteArray, 7360, 12);
    @CAN_RadarFL::RXX_Object::RXX_Object_Obj13_VxVnce = convertRawToPhysical(raw_value, 0.01, 0.0);

    raw_value=copyBitsFromByteArrayLE( byteArray, 7552, 12);
    @CAN_RadarFL::RXX_Object::RXX_Object_Obj13_VxVyCoVnce = convertRawToPhysical(raw_value, 0.01, 0.0);

    raw_value=copyBitsFromByteArrayLE( byteArray, 7374, 10);
    @CAN_RadarFL::RXX_Object::RXX_Object_Obj13_Vy = convertRawToPhysical(raw_value, 0.125, -64.0);

    raw_value=copyBitsFromByteArrayLE( byteArray, 7596, 12);
    @CAN_RadarFL::RXX_Object::RXX_Object_Obj13_VyAxCoVnce = convertRawToPhysical(raw_value, 0.01, 0.0);

    raw_value=copyBitsFromByteArrayLE( byteArray, 7616, 12);
    @CAN_RadarFL::RXX_Object::RXX_Object_Obj13_VyAyCoVnce = convertRawToPhysical(raw_value, 0.01, 0.0);

    raw_value=copyBitsFromByteArrayLE( byteArray, 7392, 12);
    @CAN_RadarFL::RXX_Object::RXX_Object_Obj13_VyVnce = convertRawToPhysical(raw_value, 0.01, 0.0);

    raw_value=copyBitsFromByteArrayLE( byteArray, 7288, 7);
    @CAN_RadarFL::RXX_Object::RXX_Object_Obj13_Width = convertRawToPhysical(raw_value, 0.125, 0.0);

    raw_value=copyBitsFromByteArrayLE( byteArray, 7296, 12);
    @CAN_RadarFL::RXX_Object::RXX_Object_Obj13_WidthVnce = convertRawToPhysical(raw_value, 0.01, 0.0);

    raw_value=copyBitsFromByteArrayLE( byteArray, 8160, 32);
    @CAN_RadarFL::RXX_Object::RXX_Object_Obj14_Age = convertRawToPhysical(raw_value, 1.0, 0.0);

    raw_value=copyBitsFromByteArrayLE( byteArray, 7756, 10);
    @CAN_RadarFL::RXX_Object::RXX_Object_Obj14_Ax = convertRawToPhysical(raw_value, 0.03125, -16.0);

    raw_value=copyBitsFromByteArrayLE( byteArray, 8140, 12);
    @CAN_RadarFL::RXX_Object::RXX_Object_Obj14_AxAyCoVnce = convertRawToPhysical(raw_value, 0.01, 0.0);

    raw_value=copyBitsFromByteArrayLE( byteArray, 7776, 12);
    @CAN_RadarFL::RXX_Object::RXX_Object_Obj14_AxVnce = convertRawToPhysical(raw_value, 0.01, 0.0);

    raw_value=copyBitsFromByteArrayLE( byteArray, 7830, 9);
    @CAN_RadarFL::RXX_Object::RXX_Object_Obj14_Ay = convertRawToPhysical(raw_value, 0.0625, -16.0);

    raw_value=copyBitsFromByteArrayLE( byteArray, 7840, 12);
    @CAN_RadarFL::RXX_Object::RXX_Object_Obj14_AyVnce = convertRawToPhysical(raw_value, 0.01, 0.0);

    raw_value=copyBitsFromByteArrayLE( byteArray, 7896, 6);
    @CAN_RadarFL::RXX_Object::RXX_Object_Obj14_ExistProb = convertRawToPhysical(raw_value, 2.0, 0.0);

    raw_value=copyBitsFromByteArrayLE( byteArray, 7960, 8);
    @CAN_RadarFL::RXX_Object::RXX_Object_Obj14_FilterInformation = convertRawToPhysical(raw_value, 1.0, 0.0);

    raw_value=copyBitsFromByteArrayLE( byteArray, 7736, 7);
    @CAN_RadarFL::RXX_Object::RXX_Object_Obj14_Length = convertRawToPhysical(raw_value, 0.125, 0.0);

    raw_value=copyBitsFromByteArrayLE( byteArray, 7744, 12);
    @CAN_RadarFL::RXX_Object::RXX_Object_Obj14_LengthVnce = convertRawToPhysical(raw_value, 0.01, 0.0);

    raw_value=copyBitsFromByteArrayLE( byteArray, 7928, 3);
    @CAN_RadarFL::RXX_Object::RXX_Object_Obj14_MeasurementStatus = convertRawToPhysical(raw_value, 1.0, 0.0);

    raw_value=copyBitsFromByteArrayLE( byteArray, 7884, 2);
    @CAN_RadarFL::RXX_Object::RXX_Object_Obj14_MovingStatus = convertRawToPhysical(raw_value, 1.0, 0.0);

    raw_value=copyBitsFromByteArrayLE( byteArray, 7864, 7);
    @CAN_RadarFL::RXX_Object::RXX_Object_Obj14_ObjId = convertRawToPhysical(raw_value, 1.0, 0.0);

    raw_value=copyBitsFromByteArrayLE( byteArray, 7766, 9);
    @CAN_RadarFL::RXX_Object::RXX_Object_Obj14_OrientationYaw = convertRawToPhysical(raw_value, 0.0175, -4.48);

    raw_value=copyBitsFromByteArrayLE( byteArray, 7788, 12);
    @CAN_RadarFL::RXX_Object::RXX_Object_Obj14_OrientationYawVnce = convertRawToPhysical(raw_value, 0.0003, 0.0);

    raw_value=copyBitsFromByteArrayLE( byteArray, 7680, 6);
    @CAN_RadarFL::RXX_Object::RXX_Object_Obj14_ProbClassConfidence = convertRawToPhysical(raw_value, 2.0, 0.0);

    raw_value=copyBitsFromByteArrayLE( byteArray, 7931, 4);
    @CAN_RadarFL::RXX_Object::RXX_Object_Obj14_ProbClassType = convertRawToPhysical(raw_value, 1.0, 0.0);

    raw_value=copyBitsFromByteArrayLE( byteArray, 7686, 14);
    @CAN_RadarFL::RXX_Object::RXX_Object_Obj14_Px = convertRawToPhysical(raw_value, 0.0625, -512.0);

    raw_value=copyBitsFromByteArrayLE( byteArray, 8000, 12);
    @CAN_RadarFL::RXX_Object::RXX_Object_Obj14_PxAxCoVnce = convertRawToPhysical(raw_value, 0.01, 0.0);

    raw_value=copyBitsFromByteArrayLE( byteArray, 8012, 12);
    @CAN_RadarFL::RXX_Object::RXX_Object_Obj14_PxAyCoVnce = convertRawToPhysical(raw_value, 0.01, 0.0);

    raw_value=copyBitsFromByteArrayLE( byteArray, 7916, 12);
    @CAN_RadarFL::RXX_Object::RXX_Object_Obj14_PxPyCoVnce = convertRawToPhysical(raw_value, 0.01, 0.0);

    raw_value=copyBitsFromByteArrayLE( byteArray, 7700, 12);
    @CAN_RadarFL::RXX_Object::RXX_Object_Obj14_PxVnce = convertRawToPhysical(raw_value, 0.1, 0.0);

    raw_value=copyBitsFromByteArrayLE( byteArray, 7936, 12);
    @CAN_RadarFL::RXX_Object::RXX_Object_Obj14_PxVxCoVnce = convertRawToPhysical(raw_value, 0.01, 0.0);

    raw_value=copyBitsFromByteArrayLE( byteArray, 7948, 12);
    @CAN_RadarFL::RXX_Object::RXX_Object_Obj14_PxVyCoVnce = convertRawToPhysical(raw_value, 0.01, 0.0);

    raw_value=copyBitsFromByteArrayLE( byteArray, 7712, 12);
    @CAN_RadarFL::RXX_Object::RXX_Object_Obj14_Py = convertRawToPhysical(raw_value, 0.0625, -128.0);

    raw_value=copyBitsFromByteArrayLE( byteArray, 8032, 12);
    @CAN_RadarFL::RXX_Object::RXX_Object_Obj14_PyAxCoVnce = convertRawToPhysical(raw_value, 0.01, 0.0);

    raw_value=copyBitsFromByteArrayLE( byteArray, 8044, 12);
    @CAN_RadarFL::RXX_Object::RXX_Object_Obj14_PyAyCoVnce = convertRawToPhysical(raw_value, 0.01, 0.0);

    raw_value=copyBitsFromByteArrayLE( byteArray, 7724, 12);
    @CAN_RadarFL::RXX_Object::RXX_Object_Obj14_PyVnce = convertRawToPhysical(raw_value, 0.1, 0.0);

    raw_value=copyBitsFromByteArrayLE( byteArray, 7968, 12);
    @CAN_RadarFL::RXX_Object::RXX_Object_Obj14_PyVxCoVnce = convertRawToPhysical(raw_value, 0.01, 0.0);

    raw_value=copyBitsFromByteArrayLE( byteArray, 7980, 12);
    @CAN_RadarFL::RXX_Object::RXX_Object_Obj14_PyVyCoVnce = convertRawToPhysical(raw_value, 0.01, 0.0);

    raw_value=copyBitsFromByteArrayLE( byteArray, 7820, 10);
    @CAN_RadarFL::RXX_Object::RXX_Object_Obj14_RCS = convertRawToPhysical(raw_value, 0.2, -102.4);

    raw_value=copyBitsFromByteArrayLE( byteArray, 7992, 4);
    @CAN_RadarFL::RXX_Object::RXX_Object_Obj14_ReferencePoint = convertRawToPhysical(raw_value, 1.0, 0.0);

    raw_value=copyBitsFromByteArrayLE( byteArray, 7852, 12);
    @CAN_RadarFL::RXX_Object::RXX_Object_Obj14_Vx = convertRawToPhysical(raw_value, 0.0625, -128.0);

    raw_value=copyBitsFromByteArrayLE( byteArray, 8076, 12);
    @CAN_RadarFL::RXX_Object::RXX_Object_Obj14_VxAxCoVnce = convertRawToPhysical(raw_value, 0.01, 0.0);

    raw_value=copyBitsFromByteArrayLE( byteArray, 8096, 12);
    @CAN_RadarFL::RXX_Object::RXX_Object_Obj14_VxAyCoVnce = convertRawToPhysical(raw_value, 0.01, 0.0);

    raw_value=copyBitsFromByteArrayLE( byteArray, 7872, 12);
    @CAN_RadarFL::RXX_Object::RXX_Object_Obj14_VxVnce = convertRawToPhysical(raw_value, 0.01, 0.0);

    raw_value=copyBitsFromByteArrayLE( byteArray, 8064, 12);
    @CAN_RadarFL::RXX_Object::RXX_Object_Obj14_VxVyCoVnce = convertRawToPhysical(raw_value, 0.01, 0.0);

    raw_value=copyBitsFromByteArrayLE( byteArray, 7886, 10);
    @CAN_RadarFL::RXX_Object::RXX_Object_Obj14_Vy = convertRawToPhysical(raw_value, 0.125, -64.0);

    raw_value=copyBitsFromByteArrayLE( byteArray, 8108, 12);
    @CAN_RadarFL::RXX_Object::RXX_Object_Obj14_VyAxCoVnce = convertRawToPhysical(raw_value, 0.01, 0.0);

    raw_value=copyBitsFromByteArrayLE( byteArray, 8128, 12);
    @CAN_RadarFL::RXX_Object::RXX_Object_Obj14_VyAyCoVnce = convertRawToPhysical(raw_value, 0.01, 0.0);

    raw_value=copyBitsFromByteArrayLE( byteArray, 7904, 12);
    @CAN_RadarFL::RXX_Object::RXX_Object_Obj14_VyVnce = convertRawToPhysical(raw_value, 0.01, 0.0);

    raw_value=copyBitsFromByteArrayLE( byteArray, 7800, 7);
    @CAN_RadarFL::RXX_Object::RXX_Object_Obj14_Width = convertRawToPhysical(raw_value, 0.125, 0.0);

    raw_value=copyBitsFromByteArrayLE( byteArray, 7808, 12);
    @CAN_RadarFL::RXX_Object::RXX_Object_Obj14_WidthVnce = convertRawToPhysical(raw_value, 0.01, 0.0);

    raw_value=copyBitsFromByteArrayLE( byteArray, 8672, 32);
    @CAN_RadarFL::RXX_Object::RXX_Object_Obj15_Age = convertRawToPhysical(raw_value, 1.0, 0.0);

    raw_value=copyBitsFromByteArrayLE( byteArray, 8268, 10);
    @CAN_RadarFL::RXX_Object::RXX_Object_Obj15_Ax = convertRawToPhysical(raw_value, 0.03125, -16.0);

    raw_value=copyBitsFromByteArrayLE( byteArray, 8652, 12);
    @CAN_RadarFL::RXX_Object::RXX_Object_Obj15_AxAyCoVnce = convertRawToPhysical(raw_value, 0.01, 0.0);

    raw_value=copyBitsFromByteArrayLE( byteArray, 8288, 12);
    @CAN_RadarFL::RXX_Object::RXX_Object_Obj15_AxVnce = convertRawToPhysical(raw_value, 0.01, 0.0);

    raw_value=copyBitsFromByteArrayLE( byteArray, 8342, 9);
    @CAN_RadarFL::RXX_Object::RXX_Object_Obj15_Ay = convertRawToPhysical(raw_value, 0.0625, -16.0);

    raw_value=copyBitsFromByteArrayLE( byteArray, 8352, 12);
    @CAN_RadarFL::RXX_Object::RXX_Object_Obj15_AyVnce = convertRawToPhysical(raw_value, 0.01, 0.0);

    raw_value=copyBitsFromByteArrayLE( byteArray, 8408, 6);
    @CAN_RadarFL::RXX_Object::RXX_Object_Obj15_ExistProb = convertRawToPhysical(raw_value, 2.0, 0.0);

    raw_value=copyBitsFromByteArrayLE( byteArray, 8472, 8);
    @CAN_RadarFL::RXX_Object::RXX_Object_Obj15_FilterInformation = convertRawToPhysical(raw_value, 1.0, 0.0);

    raw_value=copyBitsFromByteArrayLE( byteArray, 8248, 7);
    @CAN_RadarFL::RXX_Object::RXX_Object_Obj15_Length = convertRawToPhysical(raw_value, 0.125, 0.0);

    raw_value=copyBitsFromByteArrayLE( byteArray, 8256, 12);
    @CAN_RadarFL::RXX_Object::RXX_Object_Obj15_LengthVnce = convertRawToPhysical(raw_value, 0.01, 0.0);

    raw_value=copyBitsFromByteArrayLE( byteArray, 8440, 3);
    @CAN_RadarFL::RXX_Object::RXX_Object_Obj15_MeasurementStatus = convertRawToPhysical(raw_value, 1.0, 0.0);

    raw_value=copyBitsFromByteArrayLE( byteArray, 8396, 2);
    @CAN_RadarFL::RXX_Object::RXX_Object_Obj15_MovingStatus = convertRawToPhysical(raw_value, 1.0, 0.0);

    raw_value=copyBitsFromByteArrayLE( byteArray, 8376, 7);
    @CAN_RadarFL::RXX_Object::RXX_Object_Obj15_ObjId = convertRawToPhysical(raw_value, 1.0, 0.0);

    raw_value=copyBitsFromByteArrayLE( byteArray, 8278, 9);
    @CAN_RadarFL::RXX_Object::RXX_Object_Obj15_OrientationYaw = convertRawToPhysical(raw_value, 0.0175, -4.48);

    raw_value=copyBitsFromByteArrayLE( byteArray, 8300, 12);
    @CAN_RadarFL::RXX_Object::RXX_Object_Obj15_OrientationYawVnce = convertRawToPhysical(raw_value, 0.0003, 0.0);

    raw_value=copyBitsFromByteArrayLE( byteArray, 8192, 6);
    @CAN_RadarFL::RXX_Object::RXX_Object_Obj15_ProbClassConfidence = convertRawToPhysical(raw_value, 2.0, 0.0);

    raw_value=copyBitsFromByteArrayLE( byteArray, 8443, 4);
    @CAN_RadarFL::RXX_Object::RXX_Object_Obj15_ProbClassType = convertRawToPhysical(raw_value, 1.0, 0.0);

    raw_value=copyBitsFromByteArrayLE( byteArray, 8198, 14);
    @CAN_RadarFL::RXX_Object::RXX_Object_Obj15_Px = convertRawToPhysical(raw_value, 0.0625, -512.0);

    raw_value=copyBitsFromByteArrayLE( byteArray, 8512, 12);
    @CAN_RadarFL::RXX_Object::RXX_Object_Obj15_PxAxCoVnce = convertRawToPhysical(raw_value, 0.01, 0.0);

    raw_value=copyBitsFromByteArrayLE( byteArray, 8524, 12);
    @CAN_RadarFL::RXX_Object::RXX_Object_Obj15_PxAyCoVnce = convertRawToPhysical(raw_value, 0.01, 0.0);

    raw_value=copyBitsFromByteArrayLE( byteArray, 8428, 12);
    @CAN_RadarFL::RXX_Object::RXX_Object_Obj15_PxPyCoVnce = convertRawToPhysical(raw_value, 0.01, 0.0);

    raw_value=copyBitsFromByteArrayLE( byteArray, 8212, 12);
    @CAN_RadarFL::RXX_Object::RXX_Object_Obj15_PxVnce = convertRawToPhysical(raw_value, 0.1, 0.0);

    raw_value=copyBitsFromByteArrayLE( byteArray, 8448, 12);
    @CAN_RadarFL::RXX_Object::RXX_Object_Obj15_PxVxCoVnce = convertRawToPhysical(raw_value, 0.01, 0.0);

    raw_value=copyBitsFromByteArrayLE( byteArray, 8460, 12);
    @CAN_RadarFL::RXX_Object::RXX_Object_Obj15_PxVyCoVnce = convertRawToPhysical(raw_value, 0.01, 0.0);

    raw_value=copyBitsFromByteArrayLE( byteArray, 8224, 12);
    @CAN_RadarFL::RXX_Object::RXX_Object_Obj15_Py = convertRawToPhysical(raw_value, 0.0625, -128.0);

    raw_value=copyBitsFromByteArrayLE( byteArray, 8544, 12);
    @CAN_RadarFL::RXX_Object::RXX_Object_Obj15_PyAxCoVnce = convertRawToPhysical(raw_value, 0.01, 0.0);

    raw_value=copyBitsFromByteArrayLE( byteArray, 8556, 12);
    @CAN_RadarFL::RXX_Object::RXX_Object_Obj15_PyAyCoVnce = convertRawToPhysical(raw_value, 0.01, 0.0);

    raw_value=copyBitsFromByteArrayLE( byteArray, 8236, 12);
    @CAN_RadarFL::RXX_Object::RXX_Object_Obj15_PyVnce = convertRawToPhysical(raw_value, 0.1, 0.0);

    raw_value=copyBitsFromByteArrayLE( byteArray, 8480, 12);
    @CAN_RadarFL::RXX_Object::RXX_Object_Obj15_PyVxCoVnce = convertRawToPhysical(raw_value, 0.01, 0.0);

    raw_value=copyBitsFromByteArrayLE( byteArray, 8492, 12);
    @CAN_RadarFL::RXX_Object::RXX_Object_Obj15_PyVyCoVnce = convertRawToPhysical(raw_value, 0.01, 0.0);

    raw_value=copyBitsFromByteArrayLE( byteArray, 8332, 10);
    @CAN_RadarFL::RXX_Object::RXX_Object_Obj15_RCS = convertRawToPhysical(raw_value, 0.2, -102.4);

    raw_value=copyBitsFromByteArrayLE( byteArray, 8504, 4);
    @CAN_RadarFL::RXX_Object::RXX_Object_Obj15_ReferencePoint = convertRawToPhysical(raw_value, 1.0, 0.0);

    raw_value=copyBitsFromByteArrayLE( byteArray, 8364, 12);
    @CAN_RadarFL::RXX_Object::RXX_Object_Obj15_Vx = convertRawToPhysical(raw_value, 0.0625, -128.0);

    raw_value=copyBitsFromByteArrayLE( byteArray, 8588, 12);
    @CAN_RadarFL::RXX_Object::RXX_Object_Obj15_VxAxCoVnce = convertRawToPhysical(raw_value, 0.01, 0.0);

    raw_value=copyBitsFromByteArrayLE( byteArray, 8608, 12);
    @CAN_RadarFL::RXX_Object::RXX_Object_Obj15_VxAyCoVnce = convertRawToPhysical(raw_value, 0.01, 0.0);

    raw_value=copyBitsFromByteArrayLE( byteArray, 8384, 12);
    @CAN_RadarFL::RXX_Object::RXX_Object_Obj15_VxVnce = convertRawToPhysical(raw_value, 0.01, 0.0);

    raw_value=copyBitsFromByteArrayLE( byteArray, 8576, 12);
    @CAN_RadarFL::RXX_Object::RXX_Object_Obj15_VxVyCoVnce = convertRawToPhysical(raw_value, 0.01, 0.0);

    raw_value=copyBitsFromByteArrayLE( byteArray, 8398, 10);
    @CAN_RadarFL::RXX_Object::RXX_Object_Obj15_Vy = convertRawToPhysical(raw_value, 0.125, -64.0);

    raw_value=copyBitsFromByteArrayLE( byteArray, 8620, 12);
    @CAN_RadarFL::RXX_Object::RXX_Object_Obj15_VyAxCoVnce = convertRawToPhysical(raw_value, 0.01, 0.0);

    raw_value=copyBitsFromByteArrayLE( byteArray, 8640, 12);
    @CAN_RadarFL::RXX_Object::RXX_Object_Obj15_VyAyCoVnce = convertRawToPhysical(raw_value, 0.01, 0.0);

    raw_value=copyBitsFromByteArrayLE( byteArray, 8416, 12);
    @CAN_RadarFL::RXX_Object::RXX_Object_Obj15_VyVnce = convertRawToPhysical(raw_value, 0.01, 0.0);

    raw_value=copyBitsFromByteArrayLE( byteArray, 8312, 7);
    @CAN_RadarFL::RXX_Object::RXX_Object_Obj15_Width = convertRawToPhysical(raw_value, 0.125, 0.0);

    raw_value=copyBitsFromByteArrayLE( byteArray, 8320, 12);
    @CAN_RadarFL::RXX_Object::RXX_Object_Obj15_WidthVnce = convertRawToPhysical(raw_value, 0.01, 0.0);

    raw_value=copyBitsFromByteArrayLE( byteArray, 9184, 32);
    @CAN_RadarFL::RXX_Object::RXX_Object_Obj16_Age = convertRawToPhysical(raw_value, 1.0, 0.0);

    raw_value=copyBitsFromByteArrayLE( byteArray, 8780, 10);
    @CAN_RadarFL::RXX_Object::RXX_Object_Obj16_Ax = convertRawToPhysical(raw_value, 0.03125, -16.0);

    raw_value=copyBitsFromByteArrayLE( byteArray, 9164, 12);
    @CAN_RadarFL::RXX_Object::RXX_Object_Obj16_AxAyCoVnce = convertRawToPhysical(raw_value, 0.01, 0.0);

    raw_value=copyBitsFromByteArrayLE( byteArray, 8800, 12);
    @CAN_RadarFL::RXX_Object::RXX_Object_Obj16_AxVnce = convertRawToPhysical(raw_value, 0.01, 0.0);

    raw_value=copyBitsFromByteArrayLE( byteArray, 8854, 9);
    @CAN_RadarFL::RXX_Object::RXX_Object_Obj16_Ay = convertRawToPhysical(raw_value, 0.0625, -16.0);

    raw_value=copyBitsFromByteArrayLE( byteArray, 8864, 12);
    @CAN_RadarFL::RXX_Object::RXX_Object_Obj16_AyVnce = convertRawToPhysical(raw_value, 0.01, 0.0);

    raw_value=copyBitsFromByteArrayLE( byteArray, 8920, 6);
    @CAN_RadarFL::RXX_Object::RXX_Object_Obj16_ExistProb = convertRawToPhysical(raw_value, 2.0, 0.0);

    raw_value=copyBitsFromByteArrayLE( byteArray, 8984, 8);
    @CAN_RadarFL::RXX_Object::RXX_Object_Obj16_FilterInformation = convertRawToPhysical(raw_value, 1.0, 0.0);

    raw_value=copyBitsFromByteArrayLE( byteArray, 8760, 7);
    @CAN_RadarFL::RXX_Object::RXX_Object_Obj16_Length = convertRawToPhysical(raw_value, 0.125, 0.0);

    raw_value=copyBitsFromByteArrayLE( byteArray, 8768, 12);
    @CAN_RadarFL::RXX_Object::RXX_Object_Obj16_LengthVnce = convertRawToPhysical(raw_value, 0.01, 0.0);

    raw_value=copyBitsFromByteArrayLE( byteArray, 8952, 3);
    @CAN_RadarFL::RXX_Object::RXX_Object_Obj16_MeasurementStatus = convertRawToPhysical(raw_value, 1.0, 0.0);

    raw_value=copyBitsFromByteArrayLE( byteArray, 8908, 2);
    @CAN_RadarFL::RXX_Object::RXX_Object_Obj16_MovingStatus = convertRawToPhysical(raw_value, 1.0, 0.0);

    raw_value=copyBitsFromByteArrayLE( byteArray, 8888, 7);
    @CAN_RadarFL::RXX_Object::RXX_Object_Obj16_ObjId = convertRawToPhysical(raw_value, 1.0, 0.0);

    raw_value=copyBitsFromByteArrayLE( byteArray, 8790, 9);
    @CAN_RadarFL::RXX_Object::RXX_Object_Obj16_OrientationYaw = convertRawToPhysical(raw_value, 0.0175, -4.48);

    raw_value=copyBitsFromByteArrayLE( byteArray, 8812, 12);
    @CAN_RadarFL::RXX_Object::RXX_Object_Obj16_OrientationYawVnce = convertRawToPhysical(raw_value, 0.0003, 0.0);

    raw_value=copyBitsFromByteArrayLE( byteArray, 8704, 6);
    @CAN_RadarFL::RXX_Object::RXX_Object_Obj16_ProbClassConfidence = convertRawToPhysical(raw_value, 2.0, 0.0);

    raw_value=copyBitsFromByteArrayLE( byteArray, 8955, 4);
    @CAN_RadarFL::RXX_Object::RXX_Object_Obj16_ProbClassType = convertRawToPhysical(raw_value, 1.0, 0.0);

    raw_value=copyBitsFromByteArrayLE( byteArray, 8710, 14);
    @CAN_RadarFL::RXX_Object::RXX_Object_Obj16_Px = convertRawToPhysical(raw_value, 0.0625, -512.0);

    raw_value=copyBitsFromByteArrayLE( byteArray, 9024, 12);
    @CAN_RadarFL::RXX_Object::RXX_Object_Obj16_PxAxCoVnce = convertRawToPhysical(raw_value, 0.01, 0.0);

    raw_value=copyBitsFromByteArrayLE( byteArray, 9036, 12);
    @CAN_RadarFL::RXX_Object::RXX_Object_Obj16_PxAyCoVnce = convertRawToPhysical(raw_value, 0.01, 0.0);

    raw_value=copyBitsFromByteArrayLE( byteArray, 8940, 12);
    @CAN_RadarFL::RXX_Object::RXX_Object_Obj16_PxPyCoVnce = convertRawToPhysical(raw_value, 0.01, 0.0);

    raw_value=copyBitsFromByteArrayLE( byteArray, 8724, 12);
    @CAN_RadarFL::RXX_Object::RXX_Object_Obj16_PxVnce = convertRawToPhysical(raw_value, 0.1, 0.0);

    raw_value=copyBitsFromByteArrayLE( byteArray, 8960, 12);
    @CAN_RadarFL::RXX_Object::RXX_Object_Obj16_PxVxCoVnce = convertRawToPhysical(raw_value, 0.01, 0.0);

    raw_value=copyBitsFromByteArrayLE( byteArray, 8972, 12);
    @CAN_RadarFL::RXX_Object::RXX_Object_Obj16_PxVyCoVnce = convertRawToPhysical(raw_value, 0.01, 0.0);

    raw_value=copyBitsFromByteArrayLE( byteArray, 8736, 12);
    @CAN_RadarFL::RXX_Object::RXX_Object_Obj16_Py = convertRawToPhysical(raw_value, 0.0625, -128.0);

    raw_value=copyBitsFromByteArrayLE( byteArray, 9056, 12);
    @CAN_RadarFL::RXX_Object::RXX_Object_Obj16_PyAxCoVnce = convertRawToPhysical(raw_value, 0.01, 0.0);

    raw_value=copyBitsFromByteArrayLE( byteArray, 9068, 12);
    @CAN_RadarFL::RXX_Object::RXX_Object_Obj16_PyAyCoVnce = convertRawToPhysical(raw_value, 0.01, 0.0);

    raw_value=copyBitsFromByteArrayLE( byteArray, 8748, 12);
    @CAN_RadarFL::RXX_Object::RXX_Object_Obj16_PyVnce = convertRawToPhysical(raw_value, 0.1, 0.0);

    raw_value=copyBitsFromByteArrayLE( byteArray, 8992, 12);
    @CAN_RadarFL::RXX_Object::RXX_Object_Obj16_PyVxCoVnce = convertRawToPhysical(raw_value, 0.01, 0.0);

    raw_value=copyBitsFromByteArrayLE( byteArray, 9004, 12);
    @CAN_RadarFL::RXX_Object::RXX_Object_Obj16_PyVyCoVnce = convertRawToPhysical(raw_value, 0.01, 0.0);

    raw_value=copyBitsFromByteArrayLE( byteArray, 8844, 10);
    @CAN_RadarFL::RXX_Object::RXX_Object_Obj16_RCS = convertRawToPhysical(raw_value, 0.2, -102.4);

    raw_value=copyBitsFromByteArrayLE( byteArray, 9016, 4);
    @CAN_RadarFL::RXX_Object::RXX_Object_Obj16_ReferencePoint = convertRawToPhysical(raw_value, 1.0, 0.0);

    raw_value=copyBitsFromByteArrayLE( byteArray, 8876, 12);
    @CAN_RadarFL::RXX_Object::RXX_Object_Obj16_Vx = convertRawToPhysical(raw_value, 0.0625, -128.0);

    raw_value=copyBitsFromByteArrayLE( byteArray, 9100, 12);
    @CAN_RadarFL::RXX_Object::RXX_Object_Obj16_VxAxCoVnce = convertRawToPhysical(raw_value, 0.01, 0.0);

    raw_value=copyBitsFromByteArrayLE( byteArray, 9120, 12);
    @CAN_RadarFL::RXX_Object::RXX_Object_Obj16_VxAyCoVnce = convertRawToPhysical(raw_value, 0.01, 0.0);

    raw_value=copyBitsFromByteArrayLE( byteArray, 8896, 12);
    @CAN_RadarFL::RXX_Object::RXX_Object_Obj16_VxVnce = convertRawToPhysical(raw_value, 0.01, 0.0);

    raw_value=copyBitsFromByteArrayLE( byteArray, 9088, 12);
    @CAN_RadarFL::RXX_Object::RXX_Object_Obj16_VxVyCoVnce = convertRawToPhysical(raw_value, 0.01, 0.0);

    raw_value=copyBitsFromByteArrayLE( byteArray, 8910, 10);
    @CAN_RadarFL::RXX_Object::RXX_Object_Obj16_Vy = convertRawToPhysical(raw_value, 0.125, -64.0);

    raw_value=copyBitsFromByteArrayLE( byteArray, 9132, 12);
    @CAN_RadarFL::RXX_Object::RXX_Object_Obj16_VyAxCoVnce = convertRawToPhysical(raw_value, 0.01, 0.0);

    raw_value=copyBitsFromByteArrayLE( byteArray, 9152, 12);
    @CAN_RadarFL::RXX_Object::RXX_Object_Obj16_VyAyCoVnce = convertRawToPhysical(raw_value, 0.01, 0.0);

    raw_value=copyBitsFromByteArrayLE( byteArray, 8928, 12);
    @CAN_RadarFL::RXX_Object::RXX_Object_Obj16_VyVnce = convertRawToPhysical(raw_value, 0.01, 0.0);

    raw_value=copyBitsFromByteArrayLE( byteArray, 8824, 7);
    @CAN_RadarFL::RXX_Object::RXX_Object_Obj16_Width = convertRawToPhysical(raw_value, 0.125, 0.0);

    raw_value=copyBitsFromByteArrayLE( byteArray, 8832, 12);
    @CAN_RadarFL::RXX_Object::RXX_Object_Obj16_WidthVnce = convertRawToPhysical(raw_value, 0.01, 0.0);

    raw_value=copyBitsFromByteArrayLE( byteArray, 9696, 32);
    @CAN_RadarFL::RXX_Object::RXX_Object_Obj17_Age = convertRawToPhysical(raw_value, 1.0, 0.0);

    raw_value=copyBitsFromByteArrayLE( byteArray, 9292, 10);
    @CAN_RadarFL::RXX_Object::RXX_Object_Obj17_Ax = convertRawToPhysical(raw_value, 0.03125, -16.0);

    raw_value=copyBitsFromByteArrayLE( byteArray, 9676, 12);
    @CAN_RadarFL::RXX_Object::RXX_Object_Obj17_AxAyCoVnce = convertRawToPhysical(raw_value, 0.01, 0.0);

    raw_value=copyBitsFromByteArrayLE( byteArray, 9312, 12);
    @CAN_RadarFL::RXX_Object::RXX_Object_Obj17_AxVnce = convertRawToPhysical(raw_value, 0.01, 0.0);

    raw_value=copyBitsFromByteArrayLE( byteArray, 9366, 9);
    @CAN_RadarFL::RXX_Object::RXX_Object_Obj17_Ay = convertRawToPhysical(raw_value, 0.0625, -16.0);

    raw_value=copyBitsFromByteArrayLE( byteArray, 9376, 12);
    @CAN_RadarFL::RXX_Object::RXX_Object_Obj17_AyVnce = convertRawToPhysical(raw_value, 0.01, 0.0);

    raw_value=copyBitsFromByteArrayLE( byteArray, 9432, 6);
    @CAN_RadarFL::RXX_Object::RXX_Object_Obj17_ExistProb = convertRawToPhysical(raw_value, 2.0, 0.0);

    raw_value=copyBitsFromByteArrayLE( byteArray, 9496, 8);
    @CAN_RadarFL::RXX_Object::RXX_Object_Obj17_FilterInformation = convertRawToPhysical(raw_value, 1.0, 0.0);

    raw_value=copyBitsFromByteArrayLE( byteArray, 9272, 7);
    @CAN_RadarFL::RXX_Object::RXX_Object_Obj17_Length = convertRawToPhysical(raw_value, 0.125, 0.0);

    raw_value=copyBitsFromByteArrayLE( byteArray, 9280, 12);
    @CAN_RadarFL::RXX_Object::RXX_Object_Obj17_LengthVnce = convertRawToPhysical(raw_value, 0.01, 0.0);

    raw_value=copyBitsFromByteArrayLE( byteArray, 9464, 3);
    @CAN_RadarFL::RXX_Object::RXX_Object_Obj17_MeasurementStatus = convertRawToPhysical(raw_value, 1.0, 0.0);

    raw_value=copyBitsFromByteArrayLE( byteArray, 9420, 2);
    @CAN_RadarFL::RXX_Object::RXX_Object_Obj17_MovingStatus = convertRawToPhysical(raw_value, 1.0, 0.0);

    raw_value=copyBitsFromByteArrayLE( byteArray, 9400, 7);
    @CAN_RadarFL::RXX_Object::RXX_Object_Obj17_ObjId = convertRawToPhysical(raw_value, 1.0, 0.0);

    raw_value=copyBitsFromByteArrayLE( byteArray, 9302, 9);
    @CAN_RadarFL::RXX_Object::RXX_Object_Obj17_OrientationYaw = convertRawToPhysical(raw_value, 0.0175, -4.48);

    raw_value=copyBitsFromByteArrayLE( byteArray, 9324, 12);
    @CAN_RadarFL::RXX_Object::RXX_Object_Obj17_OrientationYawVnce = convertRawToPhysical(raw_value, 0.0003, 0.0);

    raw_value=copyBitsFromByteArrayLE( byteArray, 9216, 6);
    @CAN_RadarFL::RXX_Object::RXX_Object_Obj17_ProbClassConfidence = convertRawToPhysical(raw_value, 2.0, 0.0);

    raw_value=copyBitsFromByteArrayLE( byteArray, 9467, 4);
    @CAN_RadarFL::RXX_Object::RXX_Object_Obj17_ProbClassType = convertRawToPhysical(raw_value, 1.0, 0.0);

    raw_value=copyBitsFromByteArrayLE( byteArray, 9222, 14);
    @CAN_RadarFL::RXX_Object::RXX_Object_Obj17_Px = convertRawToPhysical(raw_value, 0.0625, -512.0);

    raw_value=copyBitsFromByteArrayLE( byteArray, 9536, 12);
    @CAN_RadarFL::RXX_Object::RXX_Object_Obj17_PxAxCoVnce = convertRawToPhysical(raw_value, 0.01, 0.0);

    raw_value=copyBitsFromByteArrayLE( byteArray, 9548, 12);
    @CAN_RadarFL::RXX_Object::RXX_Object_Obj17_PxAyCoVnce = convertRawToPhysical(raw_value, 0.01, 0.0);

    raw_value=copyBitsFromByteArrayLE( byteArray, 9452, 12);
    @CAN_RadarFL::RXX_Object::RXX_Object_Obj17_PxPyCoVnce = convertRawToPhysical(raw_value, 0.01, 0.0);

    raw_value=copyBitsFromByteArrayLE( byteArray, 9236, 12);
    @CAN_RadarFL::RXX_Object::RXX_Object_Obj17_PxVnce = convertRawToPhysical(raw_value, 0.1, 0.0);

    raw_value=copyBitsFromByteArrayLE( byteArray, 9472, 12);
    @CAN_RadarFL::RXX_Object::RXX_Object_Obj17_PxVxCoVnce = convertRawToPhysical(raw_value, 0.01, 0.0);

    raw_value=copyBitsFromByteArrayLE( byteArray, 9484, 12);
    @CAN_RadarFL::RXX_Object::RXX_Object_Obj17_PxVyCoVnce = convertRawToPhysical(raw_value, 0.01, 0.0);

    raw_value=copyBitsFromByteArrayLE( byteArray, 9248, 12);
    @CAN_RadarFL::RXX_Object::RXX_Object_Obj17_Py = convertRawToPhysical(raw_value, 0.0625, -128.0);

    raw_value=copyBitsFromByteArrayLE( byteArray, 9568, 12);
    @CAN_RadarFL::RXX_Object::RXX_Object_Obj17_PyAxCoVnce = convertRawToPhysical(raw_value, 0.01, 0.0);

    raw_value=copyBitsFromByteArrayLE( byteArray, 9580, 12);
    @CAN_RadarFL::RXX_Object::RXX_Object_Obj17_PyAyCoVnce = convertRawToPhysical(raw_value, 0.01, 0.0);

    raw_value=copyBitsFromByteArrayLE( byteArray, 9260, 12);
    @CAN_RadarFL::RXX_Object::RXX_Object_Obj17_PyVnce = convertRawToPhysical(raw_value, 0.1, 0.0);

    raw_value=copyBitsFromByteArrayLE( byteArray, 9504, 12);
    @CAN_RadarFL::RXX_Object::RXX_Object_Obj17_PyVxCoVnce = convertRawToPhysical(raw_value, 0.01, 0.0);

    raw_value=copyBitsFromByteArrayLE( byteArray, 9516, 12);
    @CAN_RadarFL::RXX_Object::RXX_Object_Obj17_PyVyCoVnce = convertRawToPhysical(raw_value, 0.01, 0.0);

    raw_value=copyBitsFromByteArrayLE( byteArray, 9356, 10);
    @CAN_RadarFL::RXX_Object::RXX_Object_Obj17_RCS = convertRawToPhysical(raw_value, 0.2, -102.4);

    raw_value=copyBitsFromByteArrayLE( byteArray, 9528, 4);
    @CAN_RadarFL::RXX_Object::RXX_Object_Obj17_ReferencePoint = convertRawToPhysical(raw_value, 1.0, 0.0);

    raw_value=copyBitsFromByteArrayLE( byteArray, 9388, 12);
    @CAN_RadarFL::RXX_Object::RXX_Object_Obj17_Vx = convertRawToPhysical(raw_value, 0.0625, -128.0);

    raw_value=copyBitsFromByteArrayLE( byteArray, 9612, 12);
    @CAN_RadarFL::RXX_Object::RXX_Object_Obj17_VxAxCoVnce = convertRawToPhysical(raw_value, 0.01, 0.0);

    raw_value=copyBitsFromByteArrayLE( byteArray, 9632, 12);
    @CAN_RadarFL::RXX_Object::RXX_Object_Obj17_VxAyCoVnce = convertRawToPhysical(raw_value, 0.01, 0.0);

    raw_value=copyBitsFromByteArrayLE( byteArray, 9408, 12);
    @CAN_RadarFL::RXX_Object::RXX_Object_Obj17_VxVnce = convertRawToPhysical(raw_value, 0.01, 0.0);

    raw_value=copyBitsFromByteArrayLE( byteArray, 9600, 12);
    @CAN_RadarFL::RXX_Object::RXX_Object_Obj17_VxVyCoVnce = convertRawToPhysical(raw_value, 0.01, 0.0);

    raw_value=copyBitsFromByteArrayLE( byteArray, 9422, 10);
    @CAN_RadarFL::RXX_Object::RXX_Object_Obj17_Vy = convertRawToPhysical(raw_value, 0.125, -64.0);

    raw_value=copyBitsFromByteArrayLE( byteArray, 9644, 12);
    @CAN_RadarFL::RXX_Object::RXX_Object_Obj17_VyAxCoVnce = convertRawToPhysical(raw_value, 0.01, 0.0);

    raw_value=copyBitsFromByteArrayLE( byteArray, 9664, 12);
    @CAN_RadarFL::RXX_Object::RXX_Object_Obj17_VyAyCoVnce = convertRawToPhysical(raw_value, 0.01, 0.0);

    raw_value=copyBitsFromByteArrayLE( byteArray, 9440, 12);
    @CAN_RadarFL::RXX_Object::RXX_Object_Obj17_VyVnce = convertRawToPhysical(raw_value, 0.01, 0.0);

    raw_value=copyBitsFromByteArrayLE( byteArray, 9336, 7);
    @CAN_RadarFL::RXX_Object::RXX_Object_Obj17_Width = convertRawToPhysical(raw_value, 0.125, 0.0);

    raw_value=copyBitsFromByteArrayLE( byteArray, 9344, 12);
    @CAN_RadarFL::RXX_Object::RXX_Object_Obj17_WidthVnce = convertRawToPhysical(raw_value, 0.01, 0.0);

    raw_value=copyBitsFromByteArrayLE( byteArray, 10208, 32);
    @CAN_RadarFL::RXX_Object::RXX_Object_Obj18_Age = convertRawToPhysical(raw_value, 1.0, 0.0);

    raw_value=copyBitsFromByteArrayLE( byteArray, 9804, 10);
    @CAN_RadarFL::RXX_Object::RXX_Object_Obj18_Ax = convertRawToPhysical(raw_value, 0.03125, -16.0);

    raw_value=copyBitsFromByteArrayLE( byteArray, 10188, 12);
    @CAN_RadarFL::RXX_Object::RXX_Object_Obj18_AxAyCoVnce = convertRawToPhysical(raw_value, 0.01, 0.0);

    raw_value=copyBitsFromByteArrayLE( byteArray, 9824, 12);
    @CAN_RadarFL::RXX_Object::RXX_Object_Obj18_AxVnce = convertRawToPhysical(raw_value, 0.01, 0.0);

    raw_value=copyBitsFromByteArrayLE( byteArray, 9878, 9);
    @CAN_RadarFL::RXX_Object::RXX_Object_Obj18_Ay = convertRawToPhysical(raw_value, 0.0625, -16.0);

    raw_value=copyBitsFromByteArrayLE( byteArray, 9888, 12);
    @CAN_RadarFL::RXX_Object::RXX_Object_Obj18_AyVnce = convertRawToPhysical(raw_value, 0.01, 0.0);

    raw_value=copyBitsFromByteArrayLE( byteArray, 9944, 6);
    @CAN_RadarFL::RXX_Object::RXX_Object_Obj18_ExistProb = convertRawToPhysical(raw_value, 2.0, 0.0);

    raw_value=copyBitsFromByteArrayLE( byteArray, 10008, 8);
    @CAN_RadarFL::RXX_Object::RXX_Object_Obj18_FilterInformation = convertRawToPhysical(raw_value, 1.0, 0.0);

    raw_value=copyBitsFromByteArrayLE( byteArray, 9784, 7);
    @CAN_RadarFL::RXX_Object::RXX_Object_Obj18_Length = convertRawToPhysical(raw_value, 0.125, 0.0);

    raw_value=copyBitsFromByteArrayLE( byteArray, 9792, 12);
    @CAN_RadarFL::RXX_Object::RXX_Object_Obj18_LengthVnce = convertRawToPhysical(raw_value, 0.01, 0.0);

    raw_value=copyBitsFromByteArrayLE( byteArray, 9976, 3);
    @CAN_RadarFL::RXX_Object::RXX_Object_Obj18_MeasurementStatus = convertRawToPhysical(raw_value, 1.0, 0.0);

    raw_value=copyBitsFromByteArrayLE( byteArray, 9932, 2);
    @CAN_RadarFL::RXX_Object::RXX_Object_Obj18_MovingStatus = convertRawToPhysical(raw_value, 1.0, 0.0);

    raw_value=copyBitsFromByteArrayLE( byteArray, 9912, 7);
    @CAN_RadarFL::RXX_Object::RXX_Object_Obj18_ObjId = convertRawToPhysical(raw_value, 1.0, 0.0);

    raw_value=copyBitsFromByteArrayLE( byteArray, 9814, 9);
    @CAN_RadarFL::RXX_Object::RXX_Object_Obj18_OrientationYaw = convertRawToPhysical(raw_value, 0.0175, -4.48);

    raw_value=copyBitsFromByteArrayLE( byteArray, 9836, 12);
    @CAN_RadarFL::RXX_Object::RXX_Object_Obj18_OrientationYawVnce = convertRawToPhysical(raw_value, 0.0003, 0.0);

    raw_value=copyBitsFromByteArrayLE( byteArray, 9728, 6);
    @CAN_RadarFL::RXX_Object::RXX_Object_Obj18_ProbClassConfidence = convertRawToPhysical(raw_value, 2.0, 0.0);

    raw_value=copyBitsFromByteArrayLE( byteArray, 9979, 4);
    @CAN_RadarFL::RXX_Object::RXX_Object_Obj18_ProbClassType = convertRawToPhysical(raw_value, 1.0, 0.0);

    raw_value=copyBitsFromByteArrayLE( byteArray, 9734, 14);
    @CAN_RadarFL::RXX_Object::RXX_Object_Obj18_Px = convertRawToPhysical(raw_value, 0.0625, -512.0);

    raw_value=copyBitsFromByteArrayLE( byteArray, 10048, 12);
    @CAN_RadarFL::RXX_Object::RXX_Object_Obj18_PxAxCoVnce = convertRawToPhysical(raw_value, 0.01, 0.0);

    raw_value=copyBitsFromByteArrayLE( byteArray, 10060, 12);
    @CAN_RadarFL::RXX_Object::RXX_Object_Obj18_PxAyCoVnce = convertRawToPhysical(raw_value, 0.01, 0.0);

    raw_value=copyBitsFromByteArrayLE( byteArray, 9964, 12);
    @CAN_RadarFL::RXX_Object::RXX_Object_Obj18_PxPyCoVnce = convertRawToPhysical(raw_value, 0.01, 0.0);

    raw_value=copyBitsFromByteArrayLE( byteArray, 9748, 12);
    @CAN_RadarFL::RXX_Object::RXX_Object_Obj18_PxVnce = convertRawToPhysical(raw_value, 0.1, 0.0);

    raw_value=copyBitsFromByteArrayLE( byteArray, 9984, 12);
    @CAN_RadarFL::RXX_Object::RXX_Object_Obj18_PxVxCoVnce = convertRawToPhysical(raw_value, 0.01, 0.0);

    raw_value=copyBitsFromByteArrayLE( byteArray, 9996, 12);
    @CAN_RadarFL::RXX_Object::RXX_Object_Obj18_PxVyCoVnce = convertRawToPhysical(raw_value, 0.01, 0.0);

    raw_value=copyBitsFromByteArrayLE( byteArray, 9760, 12);
    @CAN_RadarFL::RXX_Object::RXX_Object_Obj18_Py = convertRawToPhysical(raw_value, 0.0625, -128.0);

    raw_value=copyBitsFromByteArrayLE( byteArray, 10080, 12);
    @CAN_RadarFL::RXX_Object::RXX_Object_Obj18_PyAxCoVnce = convertRawToPhysical(raw_value, 0.01, 0.0);

    raw_value=copyBitsFromByteArrayLE( byteArray, 10092, 12);
    @CAN_RadarFL::RXX_Object::RXX_Object_Obj18_PyAyCoVnce = convertRawToPhysical(raw_value, 0.01, 0.0);

    raw_value=copyBitsFromByteArrayLE( byteArray, 9772, 12);
    @CAN_RadarFL::RXX_Object::RXX_Object_Obj18_PyVnce = convertRawToPhysical(raw_value, 0.1, 0.0);

    raw_value=copyBitsFromByteArrayLE( byteArray, 10016, 12);
    @CAN_RadarFL::RXX_Object::RXX_Object_Obj18_PyVxCoVnce = convertRawToPhysical(raw_value, 0.01, 0.0);

    raw_value=copyBitsFromByteArrayLE( byteArray, 10028, 12);
    @CAN_RadarFL::RXX_Object::RXX_Object_Obj18_PyVyCoVnce = convertRawToPhysical(raw_value, 0.01, 0.0);

    raw_value=copyBitsFromByteArrayLE( byteArray, 9868, 10);
    @CAN_RadarFL::RXX_Object::RXX_Object_Obj18_RCS = convertRawToPhysical(raw_value, 0.2, -102.4);

    raw_value=copyBitsFromByteArrayLE( byteArray, 10040, 4);
    @CAN_RadarFL::RXX_Object::RXX_Object_Obj18_ReferencePoint = convertRawToPhysical(raw_value, 1.0, 0.0);

    raw_value=copyBitsFromByteArrayLE( byteArray, 9900, 12);
    @CAN_RadarFL::RXX_Object::RXX_Object_Obj18_Vx = convertRawToPhysical(raw_value, 0.0625, -128.0);

    raw_value=copyBitsFromByteArrayLE( byteArray, 10124, 12);
    @CAN_RadarFL::RXX_Object::RXX_Object_Obj18_VxAxCoVnce = convertRawToPhysical(raw_value, 0.01, 0.0);

    raw_value=copyBitsFromByteArrayLE( byteArray, 10144, 12);
    @CAN_RadarFL::RXX_Object::RXX_Object_Obj18_VxAyCoVnce = convertRawToPhysical(raw_value, 0.01, 0.0);

    raw_value=copyBitsFromByteArrayLE( byteArray, 9920, 12);
    @CAN_RadarFL::RXX_Object::RXX_Object_Obj18_VxVnce = convertRawToPhysical(raw_value, 0.01, 0.0);

    raw_value=copyBitsFromByteArrayLE( byteArray, 10112, 12);
    @CAN_RadarFL::RXX_Object::RXX_Object_Obj18_VxVyCoVnce = convertRawToPhysical(raw_value, 0.01, 0.0);

    raw_value=copyBitsFromByteArrayLE( byteArray, 9934, 10);
    @CAN_RadarFL::RXX_Object::RXX_Object_Obj18_Vy = convertRawToPhysical(raw_value, 0.125, -64.0);

    raw_value=copyBitsFromByteArrayLE( byteArray, 10156, 12);
    @CAN_RadarFL::RXX_Object::RXX_Object_Obj18_VyAxCoVnce = convertRawToPhysical(raw_value, 0.01, 0.0);

    raw_value=copyBitsFromByteArrayLE( byteArray, 10176, 12);
    @CAN_RadarFL::RXX_Object::RXX_Object_Obj18_VyAyCoVnce = convertRawToPhysical(raw_value, 0.01, 0.0);

    raw_value=copyBitsFromByteArrayLE( byteArray, 9952, 12);
    @CAN_RadarFL::RXX_Object::RXX_Object_Obj18_VyVnce = convertRawToPhysical(raw_value, 0.01, 0.0);

    raw_value=copyBitsFromByteArrayLE( byteArray, 9848, 7);
    @CAN_RadarFL::RXX_Object::RXX_Object_Obj18_Width = convertRawToPhysical(raw_value, 0.125, 0.0);

    raw_value=copyBitsFromByteArrayLE( byteArray, 9856, 12);
    @CAN_RadarFL::RXX_Object::RXX_Object_Obj18_WidthVnce = convertRawToPhysical(raw_value, 0.01, 0.0);

    raw_value=copyBitsFromByteArrayLE( byteArray, 10720, 32);
    @CAN_RadarFL::RXX_Object::RXX_Object_Obj19_Age = convertRawToPhysical(raw_value, 1.0, 0.0);

    raw_value=copyBitsFromByteArrayLE( byteArray, 10316, 10);
    @CAN_RadarFL::RXX_Object::RXX_Object_Obj19_Ax = convertRawToPhysical(raw_value, 0.03125, -16.0);

    raw_value=copyBitsFromByteArrayLE( byteArray, 10700, 12);
    @CAN_RadarFL::RXX_Object::RXX_Object_Obj19_AxAyCoVnce = convertRawToPhysical(raw_value, 0.01, 0.0);

    raw_value=copyBitsFromByteArrayLE( byteArray, 10336, 12);
    @CAN_RadarFL::RXX_Object::RXX_Object_Obj19_AxVnce = convertRawToPhysical(raw_value, 0.01, 0.0);

    raw_value=copyBitsFromByteArrayLE( byteArray, 10390, 9);
    @CAN_RadarFL::RXX_Object::RXX_Object_Obj19_Ay = convertRawToPhysical(raw_value, 0.0625, -16.0);

    raw_value=copyBitsFromByteArrayLE( byteArray, 10400, 12);
    @CAN_RadarFL::RXX_Object::RXX_Object_Obj19_AyVnce = convertRawToPhysical(raw_value, 0.01, 0.0);

    raw_value=copyBitsFromByteArrayLE( byteArray, 10456, 6);
    @CAN_RadarFL::RXX_Object::RXX_Object_Obj19_ExistProb = convertRawToPhysical(raw_value, 2.0, 0.0);

    raw_value=copyBitsFromByteArrayLE( byteArray, 10520, 8);
    @CAN_RadarFL::RXX_Object::RXX_Object_Obj19_FilterInformation = convertRawToPhysical(raw_value, 1.0, 0.0);

    raw_value=copyBitsFromByteArrayLE( byteArray, 10296, 7);
    @CAN_RadarFL::RXX_Object::RXX_Object_Obj19_Length = convertRawToPhysical(raw_value, 0.125, 0.0);

    raw_value=copyBitsFromByteArrayLE( byteArray, 10304, 12);
    @CAN_RadarFL::RXX_Object::RXX_Object_Obj19_LengthVnce = convertRawToPhysical(raw_value, 0.01, 0.0);

    raw_value=copyBitsFromByteArrayLE( byteArray, 10488, 3);
    @CAN_RadarFL::RXX_Object::RXX_Object_Obj19_MeasurementStatus = convertRawToPhysical(raw_value, 1.0, 0.0);

    raw_value=copyBitsFromByteArrayLE( byteArray, 10444, 2);
    @CAN_RadarFL::RXX_Object::RXX_Object_Obj19_MovingStatus = convertRawToPhysical(raw_value, 1.0, 0.0);

    raw_value=copyBitsFromByteArrayLE( byteArray, 10424, 7);
    @CAN_RadarFL::RXX_Object::RXX_Object_Obj19_ObjId = convertRawToPhysical(raw_value, 1.0, 0.0);

    raw_value=copyBitsFromByteArrayLE( byteArray, 10326, 9);
    @CAN_RadarFL::RXX_Object::RXX_Object_Obj19_OrientationYaw = convertRawToPhysical(raw_value, 0.0175, -4.48);

    raw_value=copyBitsFromByteArrayLE( byteArray, 10348, 12);
    @CAN_RadarFL::RXX_Object::RXX_Object_Obj19_OrientationYawVnce = convertRawToPhysical(raw_value, 0.0003, 0.0);

    raw_value=copyBitsFromByteArrayLE( byteArray, 10240, 6);
    @CAN_RadarFL::RXX_Object::RXX_Object_Obj19_ProbClassConfidence = convertRawToPhysical(raw_value, 2.0, 0.0);

    raw_value=copyBitsFromByteArrayLE( byteArray, 10491, 4);
    @CAN_RadarFL::RXX_Object::RXX_Object_Obj19_ProbClassType = convertRawToPhysical(raw_value, 1.0, 0.0);

    raw_value=copyBitsFromByteArrayLE( byteArray, 10246, 14);
    @CAN_RadarFL::RXX_Object::RXX_Object_Obj19_Px = convertRawToPhysical(raw_value, 0.0625, -512.0);

    raw_value=copyBitsFromByteArrayLE( byteArray, 10560, 12);
    @CAN_RadarFL::RXX_Object::RXX_Object_Obj19_PxAxCoVnce = convertRawToPhysical(raw_value, 0.01, 0.0);

    raw_value=copyBitsFromByteArrayLE( byteArray, 10572, 12);
    @CAN_RadarFL::RXX_Object::RXX_Object_Obj19_PxAyCoVnce = convertRawToPhysical(raw_value, 0.01, 0.0);

    raw_value=copyBitsFromByteArrayLE( byteArray, 10476, 12);
    @CAN_RadarFL::RXX_Object::RXX_Object_Obj19_PxPyCoVnce = convertRawToPhysical(raw_value, 0.01, 0.0);

    raw_value=copyBitsFromByteArrayLE( byteArray, 10260, 12);
    @CAN_RadarFL::RXX_Object::RXX_Object_Obj19_PxVnce = convertRawToPhysical(raw_value, 0.1, 0.0);

    raw_value=copyBitsFromByteArrayLE( byteArray, 10496, 12);
    @CAN_RadarFL::RXX_Object::RXX_Object_Obj19_PxVxCoVnce = convertRawToPhysical(raw_value, 0.01, 0.0);

    raw_value=copyBitsFromByteArrayLE( byteArray, 10508, 12);
    @CAN_RadarFL::RXX_Object::RXX_Object_Obj19_PxVyCoVnce = convertRawToPhysical(raw_value, 0.01, 0.0);

    raw_value=copyBitsFromByteArrayLE( byteArray, 10272, 12);
    @CAN_RadarFL::RXX_Object::RXX_Object_Obj19_Py = convertRawToPhysical(raw_value, 0.0625, -128.0);

    raw_value=copyBitsFromByteArrayLE( byteArray, 10592, 12);
    @CAN_RadarFL::RXX_Object::RXX_Object_Obj19_PyAxCoVnce = convertRawToPhysical(raw_value, 0.01, 0.0);

    raw_value=copyBitsFromByteArrayLE( byteArray, 10604, 12);
    @CAN_RadarFL::RXX_Object::RXX_Object_Obj19_PyAyCoVnce = convertRawToPhysical(raw_value, 0.01, 0.0);

    raw_value=copyBitsFromByteArrayLE( byteArray, 10284, 12);
    @CAN_RadarFL::RXX_Object::RXX_Object_Obj19_PyVnce = convertRawToPhysical(raw_value, 0.1, 0.0);

    raw_value=copyBitsFromByteArrayLE( byteArray, 10528, 12);
    @CAN_RadarFL::RXX_Object::RXX_Object_Obj19_PyVxCoVnce = convertRawToPhysical(raw_value, 0.01, 0.0);

    raw_value=copyBitsFromByteArrayLE( byteArray, 10540, 12);
    @CAN_RadarFL::RXX_Object::RXX_Object_Obj19_PyVyCoVnce = convertRawToPhysical(raw_value, 0.01, 0.0);

    raw_value=copyBitsFromByteArrayLE( byteArray, 10380, 10);
    @CAN_RadarFL::RXX_Object::RXX_Object_Obj19_RCS = convertRawToPhysical(raw_value, 0.2, -102.4);

    raw_value=copyBitsFromByteArrayLE( byteArray, 10552, 4);
    @CAN_RadarFL::RXX_Object::RXX_Object_Obj19_ReferencePoint = convertRawToPhysical(raw_value, 1.0, 0.0);

    raw_value=copyBitsFromByteArrayLE( byteArray, 10412, 12);
    @CAN_RadarFL::RXX_Object::RXX_Object_Obj19_Vx = convertRawToPhysical(raw_value, 0.0625, -128.0);

    raw_value=copyBitsFromByteArrayLE( byteArray, 10636, 12);
    @CAN_RadarFL::RXX_Object::RXX_Object_Obj19_VxAxCoVnce = convertRawToPhysical(raw_value, 0.01, 0.0);

    raw_value=copyBitsFromByteArrayLE( byteArray, 10656, 12);
    @CAN_RadarFL::RXX_Object::RXX_Object_Obj19_VxAyCoVnce = convertRawToPhysical(raw_value, 0.01, 0.0);

    raw_value=copyBitsFromByteArrayLE( byteArray, 10432, 12);
    @CAN_RadarFL::RXX_Object::RXX_Object_Obj19_VxVnce = convertRawToPhysical(raw_value, 0.01, 0.0);

    raw_value=copyBitsFromByteArrayLE( byteArray, 10624, 12);
    @CAN_RadarFL::RXX_Object::RXX_Object_Obj19_VxVyCoVnce = convertRawToPhysical(raw_value, 0.01, 0.0);

    raw_value=copyBitsFromByteArrayLE( byteArray, 10446, 10);
    @CAN_RadarFL::RXX_Object::RXX_Object_Obj19_Vy = convertRawToPhysical(raw_value, 0.125, -64.0);

    raw_value=copyBitsFromByteArrayLE( byteArray, 10668, 12);
    @CAN_RadarFL::RXX_Object::RXX_Object_Obj19_VyAxCoVnce = convertRawToPhysical(raw_value, 0.01, 0.0);

    raw_value=copyBitsFromByteArrayLE( byteArray, 10688, 12);
    @CAN_RadarFL::RXX_Object::RXX_Object_Obj19_VyAyCoVnce = convertRawToPhysical(raw_value, 0.01, 0.0);

    raw_value=copyBitsFromByteArrayLE( byteArray, 10464, 12);
    @CAN_RadarFL::RXX_Object::RXX_Object_Obj19_VyVnce = convertRawToPhysical(raw_value, 0.01, 0.0);

    raw_value=copyBitsFromByteArrayLE( byteArray, 10360, 7);
    @CAN_RadarFL::RXX_Object::RXX_Object_Obj19_Width = convertRawToPhysical(raw_value, 0.125, 0.0);

    raw_value=copyBitsFromByteArrayLE( byteArray, 10368, 12);
    @CAN_RadarFL::RXX_Object::RXX_Object_Obj19_WidthVnce = convertRawToPhysical(raw_value, 0.01, 0.0);

    raw_value=copyBitsFromByteArrayLE( byteArray, 1504, 32);
    @CAN_RadarFL::RXX_Object::RXX_Object_Obj1_Age = convertRawToPhysical(raw_value, 1.0, 0.0);

    raw_value=copyBitsFromByteArrayLE( byteArray, 1100, 10);
    @CAN_RadarFL::RXX_Object::RXX_Object_Obj1_Ax = convertRawToPhysical(raw_value, 0.03125, -16.0);

    raw_value=copyBitsFromByteArrayLE( byteArray, 1484, 12);
    @CAN_RadarFL::RXX_Object::RXX_Object_Obj1_AxAyCoVnce = convertRawToPhysical(raw_value, 0.01, 0.0);

    raw_value=copyBitsFromByteArrayLE( byteArray, 1120, 12);
    @CAN_RadarFL::RXX_Object::RXX_Object_Obj1_AxVnce = convertRawToPhysical(raw_value, 0.01, 0.0);

    raw_value=copyBitsFromByteArrayLE( byteArray, 1174, 9);
    @CAN_RadarFL::RXX_Object::RXX_Object_Obj1_Ay = convertRawToPhysical(raw_value, 0.0625, -16.0);

    raw_value=copyBitsFromByteArrayLE( byteArray, 1184, 12);
    @CAN_RadarFL::RXX_Object::RXX_Object_Obj1_AyVnce = convertRawToPhysical(raw_value, 0.01, 0.0);

    raw_value=copyBitsFromByteArrayLE( byteArray, 1240, 6);
    @CAN_RadarFL::RXX_Object::RXX_Object_Obj1_ExistProb = convertRawToPhysical(raw_value, 2.0, 0.0);

    raw_value=copyBitsFromByteArrayLE( byteArray, 1304, 8);
    @CAN_RadarFL::RXX_Object::RXX_Object_Obj1_FilterInformation = convertRawToPhysical(raw_value, 1.0, 0.0);

    raw_value=copyBitsFromByteArrayLE( byteArray, 1080, 7);
    @CAN_RadarFL::RXX_Object::RXX_Object_Obj1_Length = convertRawToPhysical(raw_value, 0.125, 0.0);

    raw_value=copyBitsFromByteArrayLE( byteArray, 1088, 12);
    @CAN_RadarFL::RXX_Object::RXX_Object_Obj1_LengthVnce = convertRawToPhysical(raw_value, 0.01, 0.0);

    raw_value=copyBitsFromByteArrayLE( byteArray, 1272, 3);
    @CAN_RadarFL::RXX_Object::RXX_Object_Obj1_MeasurementStatus = convertRawToPhysical(raw_value, 1.0, 0.0);

    raw_value=copyBitsFromByteArrayLE( byteArray, 1228, 2);
    @CAN_RadarFL::RXX_Object::RXX_Object_Obj1_MovingStatus = convertRawToPhysical(raw_value, 1.0, 0.0);

    raw_value=copyBitsFromByteArrayLE( byteArray, 1208, 7);
    @CAN_RadarFL::RXX_Object::RXX_Object_Obj1_ObjId = convertRawToPhysical(raw_value, 1.0, 0.0);

    raw_value=copyBitsFromByteArrayLE( byteArray, 1110, 9);
    @CAN_RadarFL::RXX_Object::RXX_Object_Obj1_OrientationYaw = convertRawToPhysical(raw_value, 0.0175, -4.48);

    raw_value=copyBitsFromByteArrayLE( byteArray, 1132, 12);
    @CAN_RadarFL::RXX_Object::RXX_Object_Obj1_OrientationYawVnce = convertRawToPhysical(raw_value, 0.0003, 0.0);

    raw_value=copyBitsFromByteArrayLE( byteArray, 1024, 6);
    @CAN_RadarFL::RXX_Object::RXX_Object_Obj1_ProbClassConfidence = convertRawToPhysical(raw_value, 2.0, 0.0);

    raw_value=copyBitsFromByteArrayLE( byteArray, 1275, 4);
    @CAN_RadarFL::RXX_Object::RXX_Object_Obj1_ProbClassType = convertRawToPhysical(raw_value, 1.0, 0.0);

    raw_value=copyBitsFromByteArrayLE( byteArray, 1030, 14);
    @CAN_RadarFL::RXX_Object::RXX_Object_Obj1_Px = convertRawToPhysical(raw_value, 0.0625, -512.0);

    raw_value=copyBitsFromByteArrayLE( byteArray, 1344, 12);
    @CAN_RadarFL::RXX_Object::RXX_Object_Obj1_PxAxCoVnce = convertRawToPhysical(raw_value, 0.01, 0.0);

    raw_value=copyBitsFromByteArrayLE( byteArray, 1356, 12);
    @CAN_RadarFL::RXX_Object::RXX_Object_Obj1_PxAyCoVnce = convertRawToPhysical(raw_value, 0.01, 0.0);

    raw_value=copyBitsFromByteArrayLE( byteArray, 1260, 12);
    @CAN_RadarFL::RXX_Object::RXX_Object_Obj1_PxPyCoVnce = convertRawToPhysical(raw_value, 0.01, 0.0);

    raw_value=copyBitsFromByteArrayLE( byteArray, 1044, 12);
    @CAN_RadarFL::RXX_Object::RXX_Object_Obj1_PxVnce = convertRawToPhysical(raw_value, 0.1, 0.0);

    raw_value=copyBitsFromByteArrayLE( byteArray, 1280, 12);
    @CAN_RadarFL::RXX_Object::RXX_Object_Obj1_PxVxCoVnce = convertRawToPhysical(raw_value, 0.01, 0.0);

    raw_value=copyBitsFromByteArrayLE( byteArray, 1292, 12);
    @CAN_RadarFL::RXX_Object::RXX_Object_Obj1_PxVyCoVnce = convertRawToPhysical(raw_value, 0.01, 0.0);

    raw_value=copyBitsFromByteArrayLE( byteArray, 1056, 12);
    @CAN_RadarFL::RXX_Object::RXX_Object_Obj1_Py = convertRawToPhysical(raw_value, 0.0625, -128.0);

    raw_value=copyBitsFromByteArrayLE( byteArray, 1376, 12);
    @CAN_RadarFL::RXX_Object::RXX_Object_Obj1_PyAxCoVnce = convertRawToPhysical(raw_value, 0.01, 0.0);

    raw_value=copyBitsFromByteArrayLE( byteArray, 1388, 12);
    @CAN_RadarFL::RXX_Object::RXX_Object_Obj1_PyAyCoVnce = convertRawToPhysical(raw_value, 0.01, 0.0);

    raw_value=copyBitsFromByteArrayLE( byteArray, 1068, 12);
    @CAN_RadarFL::RXX_Object::RXX_Object_Obj1_PyVnce = convertRawToPhysical(raw_value, 0.1, 0.0);

    raw_value=copyBitsFromByteArrayLE( byteArray, 1312, 12);
    @CAN_RadarFL::RXX_Object::RXX_Object_Obj1_PyVxCoVnce = convertRawToPhysical(raw_value, 0.01, 0.0);

    raw_value=copyBitsFromByteArrayLE( byteArray, 1324, 12);
    @CAN_RadarFL::RXX_Object::RXX_Object_Obj1_PyVyCoVnce = convertRawToPhysical(raw_value, 0.01, 0.0);

    raw_value=copyBitsFromByteArrayLE( byteArray, 1164, 10);
    @CAN_RadarFL::RXX_Object::RXX_Object_Obj1_RCS = convertRawToPhysical(raw_value, 0.2, -102.4);

    raw_value=copyBitsFromByteArrayLE( byteArray, 1336, 4);
    @CAN_RadarFL::RXX_Object::RXX_Object_Obj1_ReferencePoint = convertRawToPhysical(raw_value, 1.0, 0.0);

    raw_value=copyBitsFromByteArrayLE( byteArray, 1196, 12);
    @CAN_RadarFL::RXX_Object::RXX_Object_Obj1_Vx = convertRawToPhysical(raw_value, 0.0625, -128.0);

    raw_value=copyBitsFromByteArrayLE( byteArray, 1420, 12);
    @CAN_RadarFL::RXX_Object::RXX_Object_Obj1_VxAxCoVnce = convertRawToPhysical(raw_value, 0.01, 0.0);

    raw_value=copyBitsFromByteArrayLE( byteArray, 1440, 12);
    @CAN_RadarFL::RXX_Object::RXX_Object_Obj1_VxAyCoVnce = convertRawToPhysical(raw_value, 0.01, 0.0);

    raw_value=copyBitsFromByteArrayLE( byteArray, 1216, 12);
    @CAN_RadarFL::RXX_Object::RXX_Object_Obj1_VxVnce = convertRawToPhysical(raw_value, 0.01, 0.0);

    raw_value=copyBitsFromByteArrayLE( byteArray, 1408, 12);
    @CAN_RadarFL::RXX_Object::RXX_Object_Obj1_VxVyCoVnce = convertRawToPhysical(raw_value, 0.01, 0.0);

    raw_value=copyBitsFromByteArrayLE( byteArray, 1230, 10);
    @CAN_RadarFL::RXX_Object::RXX_Object_Obj1_Vy = convertRawToPhysical(raw_value, 0.125, -64.0);

    raw_value=copyBitsFromByteArrayLE( byteArray, 1452, 12);
    @CAN_RadarFL::RXX_Object::RXX_Object_Obj1_VyAxCoVnce = convertRawToPhysical(raw_value, 0.01, 0.0);

    raw_value=copyBitsFromByteArrayLE( byteArray, 1472, 12);
    @CAN_RadarFL::RXX_Object::RXX_Object_Obj1_VyAyCoVnce = convertRawToPhysical(raw_value, 0.01, 0.0);

    raw_value=copyBitsFromByteArrayLE( byteArray, 1248, 12);
    @CAN_RadarFL::RXX_Object::RXX_Object_Obj1_VyVnce = convertRawToPhysical(raw_value, 0.01, 0.0);

    raw_value=copyBitsFromByteArrayLE( byteArray, 1144, 7);
    @CAN_RadarFL::RXX_Object::RXX_Object_Obj1_Width = convertRawToPhysical(raw_value, 0.125, 0.0);

    raw_value=copyBitsFromByteArrayLE( byteArray, 1152, 12);
    @CAN_RadarFL::RXX_Object::RXX_Object_Obj1_WidthVnce = convertRawToPhysical(raw_value, 0.01, 0.0);

    raw_value=copyBitsFromByteArrayLE( byteArray, 11232, 32);
    @CAN_RadarFL::RXX_Object::RXX_Object_Obj20_Age = convertRawToPhysical(raw_value, 1.0, 0.0);

    raw_value=copyBitsFromByteArrayLE( byteArray, 10828, 10);
    @CAN_RadarFL::RXX_Object::RXX_Object_Obj20_Ax = convertRawToPhysical(raw_value, 0.03125, -16.0);

    raw_value=copyBitsFromByteArrayLE( byteArray, 11212, 12);
    @CAN_RadarFL::RXX_Object::RXX_Object_Obj20_AxAyCoVnce = convertRawToPhysical(raw_value, 0.01, 0.0);

    raw_value=copyBitsFromByteArrayLE( byteArray, 10848, 12);
    @CAN_RadarFL::RXX_Object::RXX_Object_Obj20_AxVnce = convertRawToPhysical(raw_value, 0.01, 0.0);

    raw_value=copyBitsFromByteArrayLE( byteArray, 10902, 9);
    @CAN_RadarFL::RXX_Object::RXX_Object_Obj20_Ay = convertRawToPhysical(raw_value, 0.0625, -16.0);

    raw_value=copyBitsFromByteArrayLE( byteArray, 10912, 12);
    @CAN_RadarFL::RXX_Object::RXX_Object_Obj20_AyVnce = convertRawToPhysical(raw_value, 0.01, 0.0);

    raw_value=copyBitsFromByteArrayLE( byteArray, 10968, 6);
    @CAN_RadarFL::RXX_Object::RXX_Object_Obj20_ExistProb = convertRawToPhysical(raw_value, 2.0, 0.0);

    raw_value=copyBitsFromByteArrayLE( byteArray, 11032, 8);
    @CAN_RadarFL::RXX_Object::RXX_Object_Obj20_FilterInformation = convertRawToPhysical(raw_value, 1.0, 0.0);

    raw_value=copyBitsFromByteArrayLE( byteArray, 10808, 7);
    @CAN_RadarFL::RXX_Object::RXX_Object_Obj20_Length = convertRawToPhysical(raw_value, 0.125, 0.0);

    raw_value=copyBitsFromByteArrayLE( byteArray, 10816, 12);
    @CAN_RadarFL::RXX_Object::RXX_Object_Obj20_LengthVnce = convertRawToPhysical(raw_value, 0.01, 0.0);

    raw_value=copyBitsFromByteArrayLE( byteArray, 11000, 3);
    @CAN_RadarFL::RXX_Object::RXX_Object_Obj20_MeasurementStatus = convertRawToPhysical(raw_value, 1.0, 0.0);

    raw_value=copyBitsFromByteArrayLE( byteArray, 10956, 2);
    @CAN_RadarFL::RXX_Object::RXX_Object_Obj20_MovingStatus = convertRawToPhysical(raw_value, 1.0, 0.0);

    raw_value=copyBitsFromByteArrayLE( byteArray, 10936, 7);
    @CAN_RadarFL::RXX_Object::RXX_Object_Obj20_ObjId = convertRawToPhysical(raw_value, 1.0, 0.0);

    raw_value=copyBitsFromByteArrayLE( byteArray, 10838, 9);
    @CAN_RadarFL::RXX_Object::RXX_Object_Obj20_OrientationYaw = convertRawToPhysical(raw_value, 0.0175, -4.48);

    raw_value=copyBitsFromByteArrayLE( byteArray, 10860, 12);
    @CAN_RadarFL::RXX_Object::RXX_Object_Obj20_OrientationYawVnce = convertRawToPhysical(raw_value, 0.0003, 0.0);

    raw_value=copyBitsFromByteArrayLE( byteArray, 10752, 6);
    @CAN_RadarFL::RXX_Object::RXX_Object_Obj20_ProbClassConfidence = convertRawToPhysical(raw_value, 2.0, 0.0);

    raw_value=copyBitsFromByteArrayLE( byteArray, 11003, 4);
    @CAN_RadarFL::RXX_Object::RXX_Object_Obj20_ProbClassType = convertRawToPhysical(raw_value, 1.0, 0.0);

    raw_value=copyBitsFromByteArrayLE( byteArray, 10758, 14);
    @CAN_RadarFL::RXX_Object::RXX_Object_Obj20_Px = convertRawToPhysical(raw_value, 0.0625, -512.0);

    raw_value=copyBitsFromByteArrayLE( byteArray, 11072, 12);
    @CAN_RadarFL::RXX_Object::RXX_Object_Obj20_PxAxCoVnce = convertRawToPhysical(raw_value, 0.01, 0.0);

    raw_value=copyBitsFromByteArrayLE( byteArray, 11084, 12);
    @CAN_RadarFL::RXX_Object::RXX_Object_Obj20_PxAyCoVnce = convertRawToPhysical(raw_value, 0.01, 0.0);

    raw_value=copyBitsFromByteArrayLE( byteArray, 10988, 12);
    @CAN_RadarFL::RXX_Object::RXX_Object_Obj20_PxPyCoVnce = convertRawToPhysical(raw_value, 0.01, 0.0);

    raw_value=copyBitsFromByteArrayLE( byteArray, 10772, 12);
    @CAN_RadarFL::RXX_Object::RXX_Object_Obj20_PxVnce = convertRawToPhysical(raw_value, 0.1, 0.0);

    raw_value=copyBitsFromByteArrayLE( byteArray, 11008, 12);
    @CAN_RadarFL::RXX_Object::RXX_Object_Obj20_PxVxCoVnce = convertRawToPhysical(raw_value, 0.01, 0.0);

    raw_value=copyBitsFromByteArrayLE( byteArray, 11020, 12);
    @CAN_RadarFL::RXX_Object::RXX_Object_Obj20_PxVyCoVnce = convertRawToPhysical(raw_value, 0.01, 0.0);

    raw_value=copyBitsFromByteArrayLE( byteArray, 10784, 12);
    @CAN_RadarFL::RXX_Object::RXX_Object_Obj20_Py = convertRawToPhysical(raw_value, 0.0625, -128.0);

    raw_value=copyBitsFromByteArrayLE( byteArray, 11104, 12);
    @CAN_RadarFL::RXX_Object::RXX_Object_Obj20_PyAxCoVnce = convertRawToPhysical(raw_value, 0.01, 0.0);

    raw_value=copyBitsFromByteArrayLE( byteArray, 11116, 12);
    @CAN_RadarFL::RXX_Object::RXX_Object_Obj20_PyAyCoVnce = convertRawToPhysical(raw_value, 0.01, 0.0);

    raw_value=copyBitsFromByteArrayLE( byteArray, 10796, 12);
    @CAN_RadarFL::RXX_Object::RXX_Object_Obj20_PyVnce = convertRawToPhysical(raw_value, 0.1, 0.0);

    raw_value=copyBitsFromByteArrayLE( byteArray, 11040, 12);
    @CAN_RadarFL::RXX_Object::RXX_Object_Obj20_PyVxCoVnce = convertRawToPhysical(raw_value, 0.01, 0.0);

    raw_value=copyBitsFromByteArrayLE( byteArray, 11052, 12);
    @CAN_RadarFL::RXX_Object::RXX_Object_Obj20_PyVyCoVnce = convertRawToPhysical(raw_value, 0.01, 0.0);

    raw_value=copyBitsFromByteArrayLE( byteArray, 10892, 10);
    @CAN_RadarFL::RXX_Object::RXX_Object_Obj20_RCS = convertRawToPhysical(raw_value, 0.2, -102.4);

    raw_value=copyBitsFromByteArrayLE( byteArray, 11064, 4);
    @CAN_RadarFL::RXX_Object::RXX_Object_Obj20_ReferencePoint = convertRawToPhysical(raw_value, 1.0, 0.0);

    raw_value=copyBitsFromByteArrayLE( byteArray, 10924, 12);
    @CAN_RadarFL::RXX_Object::RXX_Object_Obj20_Vx = convertRawToPhysical(raw_value, 0.0625, -128.0);

    raw_value=copyBitsFromByteArrayLE( byteArray, 11148, 12);
    @CAN_RadarFL::RXX_Object::RXX_Object_Obj20_VxAxCoVnce = convertRawToPhysical(raw_value, 0.01, 0.0);

    raw_value=copyBitsFromByteArrayLE( byteArray, 11168, 12);
    @CAN_RadarFL::RXX_Object::RXX_Object_Obj20_VxAyCoVnce = convertRawToPhysical(raw_value, 0.01, 0.0);

    raw_value=copyBitsFromByteArrayLE( byteArray, 10944, 12);
    @CAN_RadarFL::RXX_Object::RXX_Object_Obj20_VxVnce = convertRawToPhysical(raw_value, 0.01, 0.0);

    raw_value=copyBitsFromByteArrayLE( byteArray, 11136, 12);
    @CAN_RadarFL::RXX_Object::RXX_Object_Obj20_VxVyCoVnce = convertRawToPhysical(raw_value, 0.01, 0.0);

    raw_value=copyBitsFromByteArrayLE( byteArray, 10958, 10);
    @CAN_RadarFL::RXX_Object::RXX_Object_Obj20_Vy = convertRawToPhysical(raw_value, 0.125, -64.0);

    raw_value=copyBitsFromByteArrayLE( byteArray, 11180, 12);
    @CAN_RadarFL::RXX_Object::RXX_Object_Obj20_VyAxCoVnce = convertRawToPhysical(raw_value, 0.01, 0.0);

    raw_value=copyBitsFromByteArrayLE( byteArray, 11200, 12);
    @CAN_RadarFL::RXX_Object::RXX_Object_Obj20_VyAyCoVnce = convertRawToPhysical(raw_value, 0.01, 0.0);

    raw_value=copyBitsFromByteArrayLE( byteArray, 10976, 12);
    @CAN_RadarFL::RXX_Object::RXX_Object_Obj20_VyVnce = convertRawToPhysical(raw_value, 0.01, 0.0);

    raw_value=copyBitsFromByteArrayLE( byteArray, 10872, 7);
    @CAN_RadarFL::RXX_Object::RXX_Object_Obj20_Width = convertRawToPhysical(raw_value, 0.125, 0.0);

    raw_value=copyBitsFromByteArrayLE( byteArray, 10880, 12);
    @CAN_RadarFL::RXX_Object::RXX_Object_Obj20_WidthVnce = convertRawToPhysical(raw_value, 0.01, 0.0);

    raw_value=copyBitsFromByteArrayLE( byteArray, 11744, 32);
    @CAN_RadarFL::RXX_Object::RXX_Object_Obj21_Age = convertRawToPhysical(raw_value, 1.0, 0.0);

    raw_value=copyBitsFromByteArrayLE( byteArray, 11340, 10);
    @CAN_RadarFL::RXX_Object::RXX_Object_Obj21_Ax = convertRawToPhysical(raw_value, 0.03125, -16.0);

    raw_value=copyBitsFromByteArrayLE( byteArray, 11724, 12);
    @CAN_RadarFL::RXX_Object::RXX_Object_Obj21_AxAyCoVnce = convertRawToPhysical(raw_value, 0.01, 0.0);

    raw_value=copyBitsFromByteArrayLE( byteArray, 11360, 12);
    @CAN_RadarFL::RXX_Object::RXX_Object_Obj21_AxVnce = convertRawToPhysical(raw_value, 0.01, 0.0);

    raw_value=copyBitsFromByteArrayLE( byteArray, 11414, 9);
    @CAN_RadarFL::RXX_Object::RXX_Object_Obj21_Ay = convertRawToPhysical(raw_value, 0.0625, -16.0);

    raw_value=copyBitsFromByteArrayLE( byteArray, 11424, 12);
    @CAN_RadarFL::RXX_Object::RXX_Object_Obj21_AyVnce = convertRawToPhysical(raw_value, 0.01, 0.0);

    raw_value=copyBitsFromByteArrayLE( byteArray, 11480, 6);
    @CAN_RadarFL::RXX_Object::RXX_Object_Obj21_ExistProb = convertRawToPhysical(raw_value, 2.0, 0.0);

    raw_value=copyBitsFromByteArrayLE( byteArray, 11544, 8);
    @CAN_RadarFL::RXX_Object::RXX_Object_Obj21_FilterInformation = convertRawToPhysical(raw_value, 1.0, 0.0);

    raw_value=copyBitsFromByteArrayLE( byteArray, 11320, 7);
    @CAN_RadarFL::RXX_Object::RXX_Object_Obj21_Length = convertRawToPhysical(raw_value, 0.125, 0.0);

    raw_value=copyBitsFromByteArrayLE( byteArray, 11328, 12);
    @CAN_RadarFL::RXX_Object::RXX_Object_Obj21_LengthVnce = convertRawToPhysical(raw_value, 0.01, 0.0);

    raw_value=copyBitsFromByteArrayLE( byteArray, 11512, 3);
    @CAN_RadarFL::RXX_Object::RXX_Object_Obj21_MeasurementStatus = convertRawToPhysical(raw_value, 1.0, 0.0);

    raw_value=copyBitsFromByteArrayLE( byteArray, 11468, 2);
    @CAN_RadarFL::RXX_Object::RXX_Object_Obj21_MovingStatus = convertRawToPhysical(raw_value, 1.0, 0.0);

    raw_value=copyBitsFromByteArrayLE( byteArray, 11448, 7);
    @CAN_RadarFL::RXX_Object::RXX_Object_Obj21_ObjId = convertRawToPhysical(raw_value, 1.0, 0.0);

    raw_value=copyBitsFromByteArrayLE( byteArray, 11350, 9);
    @CAN_RadarFL::RXX_Object::RXX_Object_Obj21_OrientationYaw = convertRawToPhysical(raw_value, 0.0175, -4.48);

    raw_value=copyBitsFromByteArrayLE( byteArray, 11372, 12);
    @CAN_RadarFL::RXX_Object::RXX_Object_Obj21_OrientationYawVnce = convertRawToPhysical(raw_value, 0.0003, 0.0);

    raw_value=copyBitsFromByteArrayLE( byteArray, 11264, 6);
    @CAN_RadarFL::RXX_Object::RXX_Object_Obj21_ProbClassConfidence = convertRawToPhysical(raw_value, 2.0, 0.0);

    raw_value=copyBitsFromByteArrayLE( byteArray, 11515, 4);
    @CAN_RadarFL::RXX_Object::RXX_Object_Obj21_ProbClassType = convertRawToPhysical(raw_value, 1.0, 0.0);

    raw_value=copyBitsFromByteArrayLE( byteArray, 11270, 14);
    @CAN_RadarFL::RXX_Object::RXX_Object_Obj21_Px = convertRawToPhysical(raw_value, 0.0625, -512.0);

    raw_value=copyBitsFromByteArrayLE( byteArray, 11584, 12);
    @CAN_RadarFL::RXX_Object::RXX_Object_Obj21_PxAxCoVnce = convertRawToPhysical(raw_value, 0.01, 0.0);

    raw_value=copyBitsFromByteArrayLE( byteArray, 11596, 12);
    @CAN_RadarFL::RXX_Object::RXX_Object_Obj21_PxAyCoVnce = convertRawToPhysical(raw_value, 0.01, 0.0);

    raw_value=copyBitsFromByteArrayLE( byteArray, 11500, 12);
    @CAN_RadarFL::RXX_Object::RXX_Object_Obj21_PxPyCoVnce = convertRawToPhysical(raw_value, 0.01, 0.0);

    raw_value=copyBitsFromByteArrayLE( byteArray, 11284, 12);
    @CAN_RadarFL::RXX_Object::RXX_Object_Obj21_PxVnce = convertRawToPhysical(raw_value, 0.1, 0.0);

    raw_value=copyBitsFromByteArrayLE( byteArray, 11520, 12);
    @CAN_RadarFL::RXX_Object::RXX_Object_Obj21_PxVxCoVnce = convertRawToPhysical(raw_value, 0.01, 0.0);

    raw_value=copyBitsFromByteArrayLE( byteArray, 11532, 12);
    @CAN_RadarFL::RXX_Object::RXX_Object_Obj21_PxVyCoVnce = convertRawToPhysical(raw_value, 0.01, 0.0);

    raw_value=copyBitsFromByteArrayLE( byteArray, 11296, 12);
    @CAN_RadarFL::RXX_Object::RXX_Object_Obj21_Py = convertRawToPhysical(raw_value, 0.0625, -128.0);

    raw_value=copyBitsFromByteArrayLE( byteArray, 11616, 12);
    @CAN_RadarFL::RXX_Object::RXX_Object_Obj21_PyAxCoVnce = convertRawToPhysical(raw_value, 0.01, 0.0);

    raw_value=copyBitsFromByteArrayLE( byteArray, 11628, 12);
    @CAN_RadarFL::RXX_Object::RXX_Object_Obj21_PyAyCoVnce = convertRawToPhysical(raw_value, 0.01, 0.0);

    raw_value=copyBitsFromByteArrayLE( byteArray, 11308, 12);
    @CAN_RadarFL::RXX_Object::RXX_Object_Obj21_PyVnce = convertRawToPhysical(raw_value, 0.1, 0.0);

    raw_value=copyBitsFromByteArrayLE( byteArray, 11552, 12);
    @CAN_RadarFL::RXX_Object::RXX_Object_Obj21_PyVxCoVnce = convertRawToPhysical(raw_value, 0.01, 0.0);

    raw_value=copyBitsFromByteArrayLE( byteArray, 11564, 12);
    @CAN_RadarFL::RXX_Object::RXX_Object_Obj21_PyVyCoVnce = convertRawToPhysical(raw_value, 0.01, 0.0);

    raw_value=copyBitsFromByteArrayLE( byteArray, 11404, 10);
    @CAN_RadarFL::RXX_Object::RXX_Object_Obj21_RCS = convertRawToPhysical(raw_value, 0.2, -102.4);

    raw_value=copyBitsFromByteArrayLE( byteArray, 11576, 4);
    @CAN_RadarFL::RXX_Object::RXX_Object_Obj21_ReferencePoint = convertRawToPhysical(raw_value, 1.0, 0.0);

    raw_value=copyBitsFromByteArrayLE( byteArray, 11436, 12);
    @CAN_RadarFL::RXX_Object::RXX_Object_Obj21_Vx = convertRawToPhysical(raw_value, 0.0625, -128.0);

    raw_value=copyBitsFromByteArrayLE( byteArray, 11660, 12);
    @CAN_RadarFL::RXX_Object::RXX_Object_Obj21_VxAxCoVnce = convertRawToPhysical(raw_value, 0.01, 0.0);

    raw_value=copyBitsFromByteArrayLE( byteArray, 11680, 12);
    @CAN_RadarFL::RXX_Object::RXX_Object_Obj21_VxAyCoVnce = convertRawToPhysical(raw_value, 0.01, 0.0);

    raw_value=copyBitsFromByteArrayLE( byteArray, 11456, 12);
    @CAN_RadarFL::RXX_Object::RXX_Object_Obj21_VxVnce = convertRawToPhysical(raw_value, 0.01, 0.0);

    raw_value=copyBitsFromByteArrayLE( byteArray, 11648, 12);
    @CAN_RadarFL::RXX_Object::RXX_Object_Obj21_VxVyCoVnce = convertRawToPhysical(raw_value, 0.01, 0.0);

    raw_value=copyBitsFromByteArrayLE( byteArray, 11470, 10);
    @CAN_RadarFL::RXX_Object::RXX_Object_Obj21_Vy = convertRawToPhysical(raw_value, 0.125, -64.0);

    raw_value=copyBitsFromByteArrayLE( byteArray, 11692, 12);
    @CAN_RadarFL::RXX_Object::RXX_Object_Obj21_VyAxCoVnce = convertRawToPhysical(raw_value, 0.01, 0.0);

    raw_value=copyBitsFromByteArrayLE( byteArray, 11712, 12);
    @CAN_RadarFL::RXX_Object::RXX_Object_Obj21_VyAyCoVnce = convertRawToPhysical(raw_value, 0.01, 0.0);

    raw_value=copyBitsFromByteArrayLE( byteArray, 11488, 12);
    @CAN_RadarFL::RXX_Object::RXX_Object_Obj21_VyVnce = convertRawToPhysical(raw_value, 0.01, 0.0);

    raw_value=copyBitsFromByteArrayLE( byteArray, 11384, 7);
    @CAN_RadarFL::RXX_Object::RXX_Object_Obj21_Width = convertRawToPhysical(raw_value, 0.125, 0.0);

    raw_value=copyBitsFromByteArrayLE( byteArray, 11392, 12);
    @CAN_RadarFL::RXX_Object::RXX_Object_Obj21_WidthVnce = convertRawToPhysical(raw_value, 0.01, 0.0);

    raw_value=copyBitsFromByteArrayLE( byteArray, 12256, 32);
    @CAN_RadarFL::RXX_Object::RXX_Object_Obj22_Age = convertRawToPhysical(raw_value, 1.0, 0.0);

    raw_value=copyBitsFromByteArrayLE( byteArray, 11852, 10);
    @CAN_RadarFL::RXX_Object::RXX_Object_Obj22_Ax = convertRawToPhysical(raw_value, 0.03125, -16.0);

    raw_value=copyBitsFromByteArrayLE( byteArray, 12236, 12);
    @CAN_RadarFL::RXX_Object::RXX_Object_Obj22_AxAyCoVnce = convertRawToPhysical(raw_value, 0.01, 0.0);

    raw_value=copyBitsFromByteArrayLE( byteArray, 11872, 12);
    @CAN_RadarFL::RXX_Object::RXX_Object_Obj22_AxVnce = convertRawToPhysical(raw_value, 0.01, 0.0);

    raw_value=copyBitsFromByteArrayLE( byteArray, 11926, 9);
    @CAN_RadarFL::RXX_Object::RXX_Object_Obj22_Ay = convertRawToPhysical(raw_value, 0.0625, -16.0);

    raw_value=copyBitsFromByteArrayLE( byteArray, 11936, 12);
    @CAN_RadarFL::RXX_Object::RXX_Object_Obj22_AyVnce = convertRawToPhysical(raw_value, 0.01, 0.0);

    raw_value=copyBitsFromByteArrayLE( byteArray, 11992, 6);
    @CAN_RadarFL::RXX_Object::RXX_Object_Obj22_ExistProb = convertRawToPhysical(raw_value, 2.0, 0.0);

    raw_value=copyBitsFromByteArrayLE( byteArray, 12056, 8);
    @CAN_RadarFL::RXX_Object::RXX_Object_Obj22_FilterInformation = convertRawToPhysical(raw_value, 1.0, 0.0);

    raw_value=copyBitsFromByteArrayLE( byteArray, 11832, 7);
    @CAN_RadarFL::RXX_Object::RXX_Object_Obj22_Length = convertRawToPhysical(raw_value, 0.125, 0.0);

    raw_value=copyBitsFromByteArrayLE( byteArray, 11840, 12);
    @CAN_RadarFL::RXX_Object::RXX_Object_Obj22_LengthVnce = convertRawToPhysical(raw_value, 0.01, 0.0);

    raw_value=copyBitsFromByteArrayLE( byteArray, 12024, 3);
    @CAN_RadarFL::RXX_Object::RXX_Object_Obj22_MeasurementStatus = convertRawToPhysical(raw_value, 1.0, 0.0);

    raw_value=copyBitsFromByteArrayLE( byteArray, 11980, 2);
    @CAN_RadarFL::RXX_Object::RXX_Object_Obj22_MovingStatus = convertRawToPhysical(raw_value, 1.0, 0.0);

    raw_value=copyBitsFromByteArrayLE( byteArray, 11960, 7);
    @CAN_RadarFL::RXX_Object::RXX_Object_Obj22_ObjId = convertRawToPhysical(raw_value, 1.0, 0.0);

    raw_value=copyBitsFromByteArrayLE( byteArray, 11862, 9);
    @CAN_RadarFL::RXX_Object::RXX_Object_Obj22_OrientationYaw = convertRawToPhysical(raw_value, 0.0175, -4.48);

    raw_value=copyBitsFromByteArrayLE( byteArray, 11884, 12);
    @CAN_RadarFL::RXX_Object::RXX_Object_Obj22_OrientationYawVnce = convertRawToPhysical(raw_value, 0.0003, 0.0);

    raw_value=copyBitsFromByteArrayLE( byteArray, 11776, 6);
    @CAN_RadarFL::RXX_Object::RXX_Object_Obj22_ProbClassConfidence = convertRawToPhysical(raw_value, 2.0, 0.0);

    raw_value=copyBitsFromByteArrayLE( byteArray, 12027, 4);
    @CAN_RadarFL::RXX_Object::RXX_Object_Obj22_ProbClassType = convertRawToPhysical(raw_value, 1.0, 0.0);

    raw_value=copyBitsFromByteArrayLE( byteArray, 11782, 14);
    @CAN_RadarFL::RXX_Object::RXX_Object_Obj22_Px = convertRawToPhysical(raw_value, 0.0625, -512.0);

    raw_value=copyBitsFromByteArrayLE( byteArray, 12096, 12);
    @CAN_RadarFL::RXX_Object::RXX_Object_Obj22_PxAxCoVnce = convertRawToPhysical(raw_value, 0.01, 0.0);

    raw_value=copyBitsFromByteArrayLE( byteArray, 12108, 12);
    @CAN_RadarFL::RXX_Object::RXX_Object_Obj22_PxAyCoVnce = convertRawToPhysical(raw_value, 0.01, 0.0);

    raw_value=copyBitsFromByteArrayLE( byteArray, 12012, 12);
    @CAN_RadarFL::RXX_Object::RXX_Object_Obj22_PxPyCoVnce = convertRawToPhysical(raw_value, 0.01, 0.0);

    raw_value=copyBitsFromByteArrayLE( byteArray, 11796, 12);
    @CAN_RadarFL::RXX_Object::RXX_Object_Obj22_PxVnce = convertRawToPhysical(raw_value, 0.1, 0.0);

    raw_value=copyBitsFromByteArrayLE( byteArray, 12032, 12);
    @CAN_RadarFL::RXX_Object::RXX_Object_Obj22_PxVxCoVnce = convertRawToPhysical(raw_value, 0.01, 0.0);

    raw_value=copyBitsFromByteArrayLE( byteArray, 12044, 12);
    @CAN_RadarFL::RXX_Object::RXX_Object_Obj22_PxVyCoVnce = convertRawToPhysical(raw_value, 0.01, 0.0);

    raw_value=copyBitsFromByteArrayLE( byteArray, 11808, 12);
    @CAN_RadarFL::RXX_Object::RXX_Object_Obj22_Py = convertRawToPhysical(raw_value, 0.0625, -128.0);

    raw_value=copyBitsFromByteArrayLE( byteArray, 12128, 12);
    @CAN_RadarFL::RXX_Object::RXX_Object_Obj22_PyAxCoVnce = convertRawToPhysical(raw_value, 0.01, 0.0);

    raw_value=copyBitsFromByteArrayLE( byteArray, 12140, 12);
    @CAN_RadarFL::RXX_Object::RXX_Object_Obj22_PyAyCoVnce = convertRawToPhysical(raw_value, 0.01, 0.0);

    raw_value=copyBitsFromByteArrayLE( byteArray, 11820, 12);
    @CAN_RadarFL::RXX_Object::RXX_Object_Obj22_PyVnce = convertRawToPhysical(raw_value, 0.1, 0.0);

    raw_value=copyBitsFromByteArrayLE( byteArray, 12064, 12);
    @CAN_RadarFL::RXX_Object::RXX_Object_Obj22_PyVxCoVnce = convertRawToPhysical(raw_value, 0.01, 0.0);

    raw_value=copyBitsFromByteArrayLE( byteArray, 12076, 12);
    @CAN_RadarFL::RXX_Object::RXX_Object_Obj22_PyVyCoVnce = convertRawToPhysical(raw_value, 0.01, 0.0);

    raw_value=copyBitsFromByteArrayLE( byteArray, 11916, 10);
    @CAN_RadarFL::RXX_Object::RXX_Object_Obj22_RCS = convertRawToPhysical(raw_value, 0.2, -102.4);

    raw_value=copyBitsFromByteArrayLE( byteArray, 12088, 4);
    @CAN_RadarFL::RXX_Object::RXX_Object_Obj22_ReferencePoint = convertRawToPhysical(raw_value, 1.0, 0.0);

    raw_value=copyBitsFromByteArrayLE( byteArray, 11948, 12);
    @CAN_RadarFL::RXX_Object::RXX_Object_Obj22_Vx = convertRawToPhysical(raw_value, 0.0625, -128.0);

    raw_value=copyBitsFromByteArrayLE( byteArray, 12172, 12);
    @CAN_RadarFL::RXX_Object::RXX_Object_Obj22_VxAxCoVnce = convertRawToPhysical(raw_value, 0.01, 0.0);

    raw_value=copyBitsFromByteArrayLE( byteArray, 12192, 12);
    @CAN_RadarFL::RXX_Object::RXX_Object_Obj22_VxAyCoVnce = convertRawToPhysical(raw_value, 0.01, 0.0);

    raw_value=copyBitsFromByteArrayLE( byteArray, 11968, 12);
    @CAN_RadarFL::RXX_Object::RXX_Object_Obj22_VxVnce = convertRawToPhysical(raw_value, 0.01, 0.0);

    raw_value=copyBitsFromByteArrayLE( byteArray, 12160, 12);
    @CAN_RadarFL::RXX_Object::RXX_Object_Obj22_VxVyCoVnce = convertRawToPhysical(raw_value, 0.01, 0.0);

    raw_value=copyBitsFromByteArrayLE( byteArray, 11982, 10);
    @CAN_RadarFL::RXX_Object::RXX_Object_Obj22_Vy = convertRawToPhysical(raw_value, 0.125, -64.0);

    raw_value=copyBitsFromByteArrayLE( byteArray, 12204, 12);
    @CAN_RadarFL::RXX_Object::RXX_Object_Obj22_VyAxCoVnce = convertRawToPhysical(raw_value, 0.01, 0.0);

    raw_value=copyBitsFromByteArrayLE( byteArray, 12224, 12);
    @CAN_RadarFL::RXX_Object::RXX_Object_Obj22_VyAyCoVnce = convertRawToPhysical(raw_value, 0.01, 0.0);

    raw_value=copyBitsFromByteArrayLE( byteArray, 12000, 12);
    @CAN_RadarFL::RXX_Object::RXX_Object_Obj22_VyVnce = convertRawToPhysical(raw_value, 0.01, 0.0);

    raw_value=copyBitsFromByteArrayLE( byteArray, 11896, 7);
    @CAN_RadarFL::RXX_Object::RXX_Object_Obj22_Width = convertRawToPhysical(raw_value, 0.125, 0.0);

    raw_value=copyBitsFromByteArrayLE( byteArray, 11904, 12);
    @CAN_RadarFL::RXX_Object::RXX_Object_Obj22_WidthVnce = convertRawToPhysical(raw_value, 0.01, 0.0);

    raw_value=copyBitsFromByteArrayLE( byteArray, 12768, 32);
    @CAN_RadarFL::RXX_Object::RXX_Object_Obj23_Age = convertRawToPhysical(raw_value, 1.0, 0.0);

    raw_value=copyBitsFromByteArrayLE( byteArray, 12364, 10);
    @CAN_RadarFL::RXX_Object::RXX_Object_Obj23_Ax = convertRawToPhysical(raw_value, 0.03125, -16.0);

    raw_value=copyBitsFromByteArrayLE( byteArray, 12748, 12);
    @CAN_RadarFL::RXX_Object::RXX_Object_Obj23_AxAyCoVnce = convertRawToPhysical(raw_value, 0.01, 0.0);

    raw_value=copyBitsFromByteArrayLE( byteArray, 12384, 12);
    @CAN_RadarFL::RXX_Object::RXX_Object_Obj23_AxVnce = convertRawToPhysical(raw_value, 0.01, 0.0);

    raw_value=copyBitsFromByteArrayLE( byteArray, 12438, 9);
    @CAN_RadarFL::RXX_Object::RXX_Object_Obj23_Ay = convertRawToPhysical(raw_value, 0.0625, -16.0);

    raw_value=copyBitsFromByteArrayLE( byteArray, 12448, 12);
    @CAN_RadarFL::RXX_Object::RXX_Object_Obj23_AyVnce = convertRawToPhysical(raw_value, 0.01, 0.0);

    raw_value=copyBitsFromByteArrayLE( byteArray, 12504, 6);
    @CAN_RadarFL::RXX_Object::RXX_Object_Obj23_ExistProb = convertRawToPhysical(raw_value, 2.0, 0.0);

    raw_value=copyBitsFromByteArrayLE( byteArray, 12568, 8);
    @CAN_RadarFL::RXX_Object::RXX_Object_Obj23_FilterInformation = convertRawToPhysical(raw_value, 1.0, 0.0);

    raw_value=copyBitsFromByteArrayLE( byteArray, 12344, 7);
    @CAN_RadarFL::RXX_Object::RXX_Object_Obj23_Length = convertRawToPhysical(raw_value, 0.125, 0.0);

    raw_value=copyBitsFromByteArrayLE( byteArray, 12352, 12);
    @CAN_RadarFL::RXX_Object::RXX_Object_Obj23_LengthVnce = convertRawToPhysical(raw_value, 0.01, 0.0);

    raw_value=copyBitsFromByteArrayLE( byteArray, 12536, 3);
    @CAN_RadarFL::RXX_Object::RXX_Object_Obj23_MeasurementStatus = convertRawToPhysical(raw_value, 1.0, 0.0);

    raw_value=copyBitsFromByteArrayLE( byteArray, 12492, 2);
    @CAN_RadarFL::RXX_Object::RXX_Object_Obj23_MovingStatus = convertRawToPhysical(raw_value, 1.0, 0.0);

    raw_value=copyBitsFromByteArrayLE( byteArray, 12472, 7);
    @CAN_RadarFL::RXX_Object::RXX_Object_Obj23_ObjId = convertRawToPhysical(raw_value, 1.0, 0.0);

    raw_value=copyBitsFromByteArrayLE( byteArray, 12374, 9);
    @CAN_RadarFL::RXX_Object::RXX_Object_Obj23_OrientationYaw = convertRawToPhysical(raw_value, 0.0175, -4.48);

    raw_value=copyBitsFromByteArrayLE( byteArray, 12396, 12);
    @CAN_RadarFL::RXX_Object::RXX_Object_Obj23_OrientationYawVnce = convertRawToPhysical(raw_value, 0.0003, 0.0);

    raw_value=copyBitsFromByteArrayLE( byteArray, 12288, 6);
    @CAN_RadarFL::RXX_Object::RXX_Object_Obj23_ProbClassConfidence = convertRawToPhysical(raw_value, 2.0, 0.0);

    raw_value=copyBitsFromByteArrayLE( byteArray, 12539, 4);
    @CAN_RadarFL::RXX_Object::RXX_Object_Obj23_ProbClassType = convertRawToPhysical(raw_value, 1.0, 0.0);

    raw_value=copyBitsFromByteArrayLE( byteArray, 12294, 14);
    @CAN_RadarFL::RXX_Object::RXX_Object_Obj23_Px = convertRawToPhysical(raw_value, 0.0625, -512.0);

    raw_value=copyBitsFromByteArrayLE( byteArray, 12608, 12);
    @CAN_RadarFL::RXX_Object::RXX_Object_Obj23_PxAxCoVnce = convertRawToPhysical(raw_value, 0.01, 0.0);

    raw_value=copyBitsFromByteArrayLE( byteArray, 12620, 12);
    @CAN_RadarFL::RXX_Object::RXX_Object_Obj23_PxAyCoVnce = convertRawToPhysical(raw_value, 0.01, 0.0);

    raw_value=copyBitsFromByteArrayLE( byteArray, 12524, 12);
    @CAN_RadarFL::RXX_Object::RXX_Object_Obj23_PxPyCoVnce = convertRawToPhysical(raw_value, 0.01, 0.0);

    raw_value=copyBitsFromByteArrayLE( byteArray, 12308, 12);
    @CAN_RadarFL::RXX_Object::RXX_Object_Obj23_PxVnce = convertRawToPhysical(raw_value, 0.1, 0.0);

    raw_value=copyBitsFromByteArrayLE( byteArray, 12544, 12);
    @CAN_RadarFL::RXX_Object::RXX_Object_Obj23_PxVxCoVnce = convertRawToPhysical(raw_value, 0.01, 0.0);

    raw_value=copyBitsFromByteArrayLE( byteArray, 12556, 12);
    @CAN_RadarFL::RXX_Object::RXX_Object_Obj23_PxVyCoVnce = convertRawToPhysical(raw_value, 0.01, 0.0);

    raw_value=copyBitsFromByteArrayLE( byteArray, 12320, 12);
    @CAN_RadarFL::RXX_Object::RXX_Object_Obj23_Py = convertRawToPhysical(raw_value, 0.0625, -128.0);

    raw_value=copyBitsFromByteArrayLE( byteArray, 12640, 12);
    @CAN_RadarFL::RXX_Object::RXX_Object_Obj23_PyAxCoVnce = convertRawToPhysical(raw_value, 0.01, 0.0);

    raw_value=copyBitsFromByteArrayLE( byteArray, 12652, 12);
    @CAN_RadarFL::RXX_Object::RXX_Object_Obj23_PyAyCoVnce = convertRawToPhysical(raw_value, 0.01, 0.0);

    raw_value=copyBitsFromByteArrayLE( byteArray, 12332, 12);
    @CAN_RadarFL::RXX_Object::RXX_Object_Obj23_PyVnce = convertRawToPhysical(raw_value, 0.1, 0.0);

    raw_value=copyBitsFromByteArrayLE( byteArray, 12576, 12);
    @CAN_RadarFL::RXX_Object::RXX_Object_Obj23_PyVxCoVnce = convertRawToPhysical(raw_value, 0.01, 0.0);

    raw_value=copyBitsFromByteArrayLE( byteArray, 12588, 12);
    @CAN_RadarFL::RXX_Object::RXX_Object_Obj23_PyVyCoVnce = convertRawToPhysical(raw_value, 0.01, 0.0);

    raw_value=copyBitsFromByteArrayLE( byteArray, 12428, 10);
    @CAN_RadarFL::RXX_Object::RXX_Object_Obj23_RCS = convertRawToPhysical(raw_value, 0.2, -102.4);

    raw_value=copyBitsFromByteArrayLE( byteArray, 12600, 4);
    @CAN_RadarFL::RXX_Object::RXX_Object_Obj23_ReferencePoint = convertRawToPhysical(raw_value, 1.0, 0.0);

    raw_value=copyBitsFromByteArrayLE( byteArray, 12460, 12);
    @CAN_RadarFL::RXX_Object::RXX_Object_Obj23_Vx = convertRawToPhysical(raw_value, 0.0625, -128.0);

    raw_value=copyBitsFromByteArrayLE( byteArray, 12684, 12);
    @CAN_RadarFL::RXX_Object::RXX_Object_Obj23_VxAxCoVnce = convertRawToPhysical(raw_value, 0.01, 0.0);

    raw_value=copyBitsFromByteArrayLE( byteArray, 12704, 12);
    @CAN_RadarFL::RXX_Object::RXX_Object_Obj23_VxAyCoVnce = convertRawToPhysical(raw_value, 0.01, 0.0);

    raw_value=copyBitsFromByteArrayLE( byteArray, 12480, 12);
    @CAN_RadarFL::RXX_Object::RXX_Object_Obj23_VxVnce = convertRawToPhysical(raw_value, 0.01, 0.0);

    raw_value=copyBitsFromByteArrayLE( byteArray, 12672, 12);
    @CAN_RadarFL::RXX_Object::RXX_Object_Obj23_VxVyCoVnce = convertRawToPhysical(raw_value, 0.01, 0.0);

    raw_value=copyBitsFromByteArrayLE( byteArray, 12494, 10);
    @CAN_RadarFL::RXX_Object::RXX_Object_Obj23_Vy = convertRawToPhysical(raw_value, 0.125, -64.0);

    raw_value=copyBitsFromByteArrayLE( byteArray, 12716, 12);
    @CAN_RadarFL::RXX_Object::RXX_Object_Obj23_VyAxCoVnce = convertRawToPhysical(raw_value, 0.01, 0.0);

    raw_value=copyBitsFromByteArrayLE( byteArray, 12736, 12);
    @CAN_RadarFL::RXX_Object::RXX_Object_Obj23_VyAyCoVnce = convertRawToPhysical(raw_value, 0.01, 0.0);

    raw_value=copyBitsFromByteArrayLE( byteArray, 12512, 12);
    @CAN_RadarFL::RXX_Object::RXX_Object_Obj23_VyVnce = convertRawToPhysical(raw_value, 0.01, 0.0);

    raw_value=copyBitsFromByteArrayLE( byteArray, 12408, 7);
    @CAN_RadarFL::RXX_Object::RXX_Object_Obj23_Width = convertRawToPhysical(raw_value, 0.125, 0.0);

    raw_value=copyBitsFromByteArrayLE( byteArray, 12416, 12);
    @CAN_RadarFL::RXX_Object::RXX_Object_Obj23_WidthVnce = convertRawToPhysical(raw_value, 0.01, 0.0);

    raw_value=copyBitsFromByteArrayLE( byteArray, 13280, 32);
    @CAN_RadarFL::RXX_Object::RXX_Object_Obj24_Age = convertRawToPhysical(raw_value, 1.0, 0.0);

    raw_value=copyBitsFromByteArrayLE( byteArray, 12876, 10);
    @CAN_RadarFL::RXX_Object::RXX_Object_Obj24_Ax = convertRawToPhysical(raw_value, 0.03125, -16.0);

    raw_value=copyBitsFromByteArrayLE( byteArray, 13260, 12);
    @CAN_RadarFL::RXX_Object::RXX_Object_Obj24_AxAyCoVnce = convertRawToPhysical(raw_value, 0.01, 0.0);

    raw_value=copyBitsFromByteArrayLE( byteArray, 12896, 12);
    @CAN_RadarFL::RXX_Object::RXX_Object_Obj24_AxVnce = convertRawToPhysical(raw_value, 0.01, 0.0);

    raw_value=copyBitsFromByteArrayLE( byteArray, 12950, 9);
    @CAN_RadarFL::RXX_Object::RXX_Object_Obj24_Ay = convertRawToPhysical(raw_value, 0.0625, -16.0);

    raw_value=copyBitsFromByteArrayLE( byteArray, 12960, 12);
    @CAN_RadarFL::RXX_Object::RXX_Object_Obj24_AyVnce = convertRawToPhysical(raw_value, 0.01, 0.0);

    raw_value=copyBitsFromByteArrayLE( byteArray, 13016, 6);
    @CAN_RadarFL::RXX_Object::RXX_Object_Obj24_ExistProb = convertRawToPhysical(raw_value, 2.0, 0.0);

    raw_value=copyBitsFromByteArrayLE( byteArray, 13080, 8);
    @CAN_RadarFL::RXX_Object::RXX_Object_Obj24_FilterInformation = convertRawToPhysical(raw_value, 1.0, 0.0);

    raw_value=copyBitsFromByteArrayLE( byteArray, 12856, 7);
    @CAN_RadarFL::RXX_Object::RXX_Object_Obj24_Length = convertRawToPhysical(raw_value, 0.125, 0.0);

    raw_value=copyBitsFromByteArrayLE( byteArray, 12864, 12);
    @CAN_RadarFL::RXX_Object::RXX_Object_Obj24_LengthVnce = convertRawToPhysical(raw_value, 0.01, 0.0);

    raw_value=copyBitsFromByteArrayLE( byteArray, 13048, 3);
    @CAN_RadarFL::RXX_Object::RXX_Object_Obj24_MeasurementStatus = convertRawToPhysical(raw_value, 1.0, 0.0);

    raw_value=copyBitsFromByteArrayLE( byteArray, 13004, 2);
    @CAN_RadarFL::RXX_Object::RXX_Object_Obj24_MovingStatus = convertRawToPhysical(raw_value, 1.0, 0.0);

    raw_value=copyBitsFromByteArrayLE( byteArray, 12984, 7);
    @CAN_RadarFL::RXX_Object::RXX_Object_Obj24_ObjId = convertRawToPhysical(raw_value, 1.0, 0.0);

    raw_value=copyBitsFromByteArrayLE( byteArray, 12886, 9);
    @CAN_RadarFL::RXX_Object::RXX_Object_Obj24_OrientationYaw = convertRawToPhysical(raw_value, 0.0175, -4.48);

    raw_value=copyBitsFromByteArrayLE( byteArray, 12908, 12);
    @CAN_RadarFL::RXX_Object::RXX_Object_Obj24_OrientationYawVnce = convertRawToPhysical(raw_value, 0.0003, 0.0);

    raw_value=copyBitsFromByteArrayLE( byteArray, 12800, 6);
    @CAN_RadarFL::RXX_Object::RXX_Object_Obj24_ProbClassConfidence = convertRawToPhysical(raw_value, 2.0, 0.0);

    raw_value=copyBitsFromByteArrayLE( byteArray, 13051, 4);
    @CAN_RadarFL::RXX_Object::RXX_Object_Obj24_ProbClassType = convertRawToPhysical(raw_value, 1.0, 0.0);

    raw_value=copyBitsFromByteArrayLE( byteArray, 12806, 14);
    @CAN_RadarFL::RXX_Object::RXX_Object_Obj24_Px = convertRawToPhysical(raw_value, 0.0625, -512.0);

    raw_value=copyBitsFromByteArrayLE( byteArray, 13120, 12);
    @CAN_RadarFL::RXX_Object::RXX_Object_Obj24_PxAxCoVnce = convertRawToPhysical(raw_value, 0.01, 0.0);

    raw_value=copyBitsFromByteArrayLE( byteArray, 13132, 12);
    @CAN_RadarFL::RXX_Object::RXX_Object_Obj24_PxAyCoVnce = convertRawToPhysical(raw_value, 0.01, 0.0);

    raw_value=copyBitsFromByteArrayLE( byteArray, 13036, 12);
    @CAN_RadarFL::RXX_Object::RXX_Object_Obj24_PxPyCoVnce = convertRawToPhysical(raw_value, 0.01, 0.0);

    raw_value=copyBitsFromByteArrayLE( byteArray, 12820, 12);
    @CAN_RadarFL::RXX_Object::RXX_Object_Obj24_PxVnce = convertRawToPhysical(raw_value, 0.1, 0.0);

    raw_value=copyBitsFromByteArrayLE( byteArray, 13056, 12);
    @CAN_RadarFL::RXX_Object::RXX_Object_Obj24_PxVxCoVnce = convertRawToPhysical(raw_value, 0.01, 0.0);

    raw_value=copyBitsFromByteArrayLE( byteArray, 13068, 12);
    @CAN_RadarFL::RXX_Object::RXX_Object_Obj24_PxVyCoVnce = convertRawToPhysical(raw_value, 0.01, 0.0);

    raw_value=copyBitsFromByteArrayLE( byteArray, 12832, 12);
    @CAN_RadarFL::RXX_Object::RXX_Object_Obj24_Py = convertRawToPhysical(raw_value, 0.0625, -128.0);

    raw_value=copyBitsFromByteArrayLE( byteArray, 13152, 12);
    @CAN_RadarFL::RXX_Object::RXX_Object_Obj24_PyAxCoVnce = convertRawToPhysical(raw_value, 0.01, 0.0);

    raw_value=copyBitsFromByteArrayLE( byteArray, 13164, 12);
    @CAN_RadarFL::RXX_Object::RXX_Object_Obj24_PyAyCoVnce = convertRawToPhysical(raw_value, 0.01, 0.0);

    raw_value=copyBitsFromByteArrayLE( byteArray, 12844, 12);
    @CAN_RadarFL::RXX_Object::RXX_Object_Obj24_PyVnce = convertRawToPhysical(raw_value, 0.1, 0.0);

    raw_value=copyBitsFromByteArrayLE( byteArray, 13088, 12);
    @CAN_RadarFL::RXX_Object::RXX_Object_Obj24_PyVxCoVnce = convertRawToPhysical(raw_value, 0.01, 0.0);

    raw_value=copyBitsFromByteArrayLE( byteArray, 13100, 12);
    @CAN_RadarFL::RXX_Object::RXX_Object_Obj24_PyVyCoVnce = convertRawToPhysical(raw_value, 0.01, 0.0);

    raw_value=copyBitsFromByteArrayLE( byteArray, 12940, 10);
    @CAN_RadarFL::RXX_Object::RXX_Object_Obj24_RCS = convertRawToPhysical(raw_value, 0.2, -102.4);

    raw_value=copyBitsFromByteArrayLE( byteArray, 13112, 4);
    @CAN_RadarFL::RXX_Object::RXX_Object_Obj24_ReferencePoint = convertRawToPhysical(raw_value, 1.0, 0.0);

    raw_value=copyBitsFromByteArrayLE( byteArray, 12972, 12);
    @CAN_RadarFL::RXX_Object::RXX_Object_Obj24_Vx = convertRawToPhysical(raw_value, 0.0625, -128.0);

    raw_value=copyBitsFromByteArrayLE( byteArray, 13196, 12);
    @CAN_RadarFL::RXX_Object::RXX_Object_Obj24_VxAxCoVnce = convertRawToPhysical(raw_value, 0.01, 0.0);

    raw_value=copyBitsFromByteArrayLE( byteArray, 13216, 12);
    @CAN_RadarFL::RXX_Object::RXX_Object_Obj24_VxAyCoVnce = convertRawToPhysical(raw_value, 0.01, 0.0);

    raw_value=copyBitsFromByteArrayLE( byteArray, 12992, 12);
    @CAN_RadarFL::RXX_Object::RXX_Object_Obj24_VxVnce = convertRawToPhysical(raw_value, 0.01, 0.0);

    raw_value=copyBitsFromByteArrayLE( byteArray, 13184, 12);
    @CAN_RadarFL::RXX_Object::RXX_Object_Obj24_VxVyCoVnce = convertRawToPhysical(raw_value, 0.01, 0.0);

    raw_value=copyBitsFromByteArrayLE( byteArray, 13006, 10);
    @CAN_RadarFL::RXX_Object::RXX_Object_Obj24_Vy = convertRawToPhysical(raw_value, 0.125, -64.0);

    raw_value=copyBitsFromByteArrayLE( byteArray, 13228, 12);
    @CAN_RadarFL::RXX_Object::RXX_Object_Obj24_VyAxCoVnce = convertRawToPhysical(raw_value, 0.01, 0.0);

    raw_value=copyBitsFromByteArrayLE( byteArray, 13248, 12);
    @CAN_RadarFL::RXX_Object::RXX_Object_Obj24_VyAyCoVnce = convertRawToPhysical(raw_value, 0.01, 0.0);

    raw_value=copyBitsFromByteArrayLE( byteArray, 13024, 12);
    @CAN_RadarFL::RXX_Object::RXX_Object_Obj24_VyVnce = convertRawToPhysical(raw_value, 0.01, 0.0);

    raw_value=copyBitsFromByteArrayLE( byteArray, 12920, 7);
    @CAN_RadarFL::RXX_Object::RXX_Object_Obj24_Width = convertRawToPhysical(raw_value, 0.125, 0.0);

    raw_value=copyBitsFromByteArrayLE( byteArray, 12928, 12);
    @CAN_RadarFL::RXX_Object::RXX_Object_Obj24_WidthVnce = convertRawToPhysical(raw_value, 0.01, 0.0);

    raw_value=copyBitsFromByteArrayLE( byteArray, 13792, 32);
    @CAN_RadarFL::RXX_Object::RXX_Object_Obj25_Age = convertRawToPhysical(raw_value, 1.0, 0.0);

    raw_value=copyBitsFromByteArrayLE( byteArray, 13388, 10);
    @CAN_RadarFL::RXX_Object::RXX_Object_Obj25_Ax = convertRawToPhysical(raw_value, 0.03125, -16.0);

    raw_value=copyBitsFromByteArrayLE( byteArray, 13772, 12);
    @CAN_RadarFL::RXX_Object::RXX_Object_Obj25_AxAyCoVnce = convertRawToPhysical(raw_value, 0.01, 0.0);

    raw_value=copyBitsFromByteArrayLE( byteArray, 13408, 12);
    @CAN_RadarFL::RXX_Object::RXX_Object_Obj25_AxVnce = convertRawToPhysical(raw_value, 0.01, 0.0);

    raw_value=copyBitsFromByteArrayLE( byteArray, 13462, 9);
    @CAN_RadarFL::RXX_Object::RXX_Object_Obj25_Ay = convertRawToPhysical(raw_value, 0.0625, -16.0);

    raw_value=copyBitsFromByteArrayLE( byteArray, 13472, 12);
    @CAN_RadarFL::RXX_Object::RXX_Object_Obj25_AyVnce = convertRawToPhysical(raw_value, 0.01, 0.0);

    raw_value=copyBitsFromByteArrayLE( byteArray, 13528, 6);
    @CAN_RadarFL::RXX_Object::RXX_Object_Obj25_ExistProb = convertRawToPhysical(raw_value, 2.0, 0.0);

    raw_value=copyBitsFromByteArrayLE( byteArray, 13592, 8);
    @CAN_RadarFL::RXX_Object::RXX_Object_Obj25_FilterInformation = convertRawToPhysical(raw_value, 1.0, 0.0);

    raw_value=copyBitsFromByteArrayLE( byteArray, 13368, 7);
    @CAN_RadarFL::RXX_Object::RXX_Object_Obj25_Length = convertRawToPhysical(raw_value, 0.125, 0.0);

    raw_value=copyBitsFromByteArrayLE( byteArray, 13376, 12);
    @CAN_RadarFL::RXX_Object::RXX_Object_Obj25_LengthVnce = convertRawToPhysical(raw_value, 0.01, 0.0);

    raw_value=copyBitsFromByteArrayLE( byteArray, 13560, 3);
    @CAN_RadarFL::RXX_Object::RXX_Object_Obj25_MeasurementStatus = convertRawToPhysical(raw_value, 1.0, 0.0);

    raw_value=copyBitsFromByteArrayLE( byteArray, 13516, 2);
    @CAN_RadarFL::RXX_Object::RXX_Object_Obj25_MovingStatus = convertRawToPhysical(raw_value, 1.0, 0.0);

    raw_value=copyBitsFromByteArrayLE( byteArray, 13496, 7);
    @CAN_RadarFL::RXX_Object::RXX_Object_Obj25_ObjId = convertRawToPhysical(raw_value, 1.0, 0.0);

    raw_value=copyBitsFromByteArrayLE( byteArray, 13398, 9);
    @CAN_RadarFL::RXX_Object::RXX_Object_Obj25_OrientationYaw = convertRawToPhysical(raw_value, 0.0175, -4.48);

    raw_value=copyBitsFromByteArrayLE( byteArray, 13420, 12);
    @CAN_RadarFL::RXX_Object::RXX_Object_Obj25_OrientationYawVnce = convertRawToPhysical(raw_value, 0.0003, 0.0);

    raw_value=copyBitsFromByteArrayLE( byteArray, 13312, 6);
    @CAN_RadarFL::RXX_Object::RXX_Object_Obj25_ProbClassConfidence = convertRawToPhysical(raw_value, 2.0, 0.0);

    raw_value=copyBitsFromByteArrayLE( byteArray, 13563, 4);
    @CAN_RadarFL::RXX_Object::RXX_Object_Obj25_ProbClassType = convertRawToPhysical(raw_value, 1.0, 0.0);

    raw_value=copyBitsFromByteArrayLE( byteArray, 13318, 14);
    @CAN_RadarFL::RXX_Object::RXX_Object_Obj25_Px = convertRawToPhysical(raw_value, 0.0625, -512.0);

    raw_value=copyBitsFromByteArrayLE( byteArray, 13632, 12);
    @CAN_RadarFL::RXX_Object::RXX_Object_Obj25_PxAxCoVnce = convertRawToPhysical(raw_value, 0.01, 0.0);

    raw_value=copyBitsFromByteArrayLE( byteArray, 13644, 12);
    @CAN_RadarFL::RXX_Object::RXX_Object_Obj25_PxAyCoVnce = convertRawToPhysical(raw_value, 0.01, 0.0);

    raw_value=copyBitsFromByteArrayLE( byteArray, 13548, 12);
    @CAN_RadarFL::RXX_Object::RXX_Object_Obj25_PxPyCoVnce = convertRawToPhysical(raw_value, 0.01, 0.0);

    raw_value=copyBitsFromByteArrayLE( byteArray, 13332, 12);
    @CAN_RadarFL::RXX_Object::RXX_Object_Obj25_PxVnce = convertRawToPhysical(raw_value, 0.1, 0.0);

    raw_value=copyBitsFromByteArrayLE( byteArray, 13568, 12);
    @CAN_RadarFL::RXX_Object::RXX_Object_Obj25_PxVxCoVnce = convertRawToPhysical(raw_value, 0.01, 0.0);

    raw_value=copyBitsFromByteArrayLE( byteArray, 13580, 12);
    @CAN_RadarFL::RXX_Object::RXX_Object_Obj25_PxVyCoVnce = convertRawToPhysical(raw_value, 0.01, 0.0);

    raw_value=copyBitsFromByteArrayLE( byteArray, 13344, 12);
    @CAN_RadarFL::RXX_Object::RXX_Object_Obj25_Py = convertRawToPhysical(raw_value, 0.0625, -128.0);

    raw_value=copyBitsFromByteArrayLE( byteArray, 13664, 12);
    @CAN_RadarFL::RXX_Object::RXX_Object_Obj25_PyAxCoVnce = convertRawToPhysical(raw_value, 0.01, 0.0);

    raw_value=copyBitsFromByteArrayLE( byteArray, 13676, 12);
    @CAN_RadarFL::RXX_Object::RXX_Object_Obj25_PyAyCoVnce = convertRawToPhysical(raw_value, 0.01, 0.0);

    raw_value=copyBitsFromByteArrayLE( byteArray, 13356, 12);
    @CAN_RadarFL::RXX_Object::RXX_Object_Obj25_PyVnce = convertRawToPhysical(raw_value, 0.1, 0.0);

    raw_value=copyBitsFromByteArrayLE( byteArray, 13600, 12);
    @CAN_RadarFL::RXX_Object::RXX_Object_Obj25_PyVxCoVnce = convertRawToPhysical(raw_value, 0.01, 0.0);

    raw_value=copyBitsFromByteArrayLE( byteArray, 13612, 12);
    @CAN_RadarFL::RXX_Object::RXX_Object_Obj25_PyVyCoVnce = convertRawToPhysical(raw_value, 0.01, 0.0);

    raw_value=copyBitsFromByteArrayLE( byteArray, 13452, 10);
    @CAN_RadarFL::RXX_Object::RXX_Object_Obj25_RCS = convertRawToPhysical(raw_value, 0.2, -102.4);

    raw_value=copyBitsFromByteArrayLE( byteArray, 13624, 4);
    @CAN_RadarFL::RXX_Object::RXX_Object_Obj25_ReferencePoint = convertRawToPhysical(raw_value, 1.0, 0.0);

    raw_value=copyBitsFromByteArrayLE( byteArray, 13484, 12);
    @CAN_RadarFL::RXX_Object::RXX_Object_Obj25_Vx = convertRawToPhysical(raw_value, 0.0625, -128.0);

    raw_value=copyBitsFromByteArrayLE( byteArray, 13708, 12);
    @CAN_RadarFL::RXX_Object::RXX_Object_Obj25_VxAxCoVnce = convertRawToPhysical(raw_value, 0.01, 0.0);

    raw_value=copyBitsFromByteArrayLE( byteArray, 13728, 12);
    @CAN_RadarFL::RXX_Object::RXX_Object_Obj25_VxAyCoVnce = convertRawToPhysical(raw_value, 0.01, 0.0);

    raw_value=copyBitsFromByteArrayLE( byteArray, 13504, 12);
    @CAN_RadarFL::RXX_Object::RXX_Object_Obj25_VxVnce = convertRawToPhysical(raw_value, 0.01, 0.0);

    raw_value=copyBitsFromByteArrayLE( byteArray, 13696, 12);
    @CAN_RadarFL::RXX_Object::RXX_Object_Obj25_VxVyCoVnce = convertRawToPhysical(raw_value, 0.01, 0.0);

    raw_value=copyBitsFromByteArrayLE( byteArray, 13518, 10);
    @CAN_RadarFL::RXX_Object::RXX_Object_Obj25_Vy = convertRawToPhysical(raw_value, 0.125, -64.0);

    raw_value=copyBitsFromByteArrayLE( byteArray, 13740, 12);
    @CAN_RadarFL::RXX_Object::RXX_Object_Obj25_VyAxCoVnce = convertRawToPhysical(raw_value, 0.01, 0.0);

    raw_value=copyBitsFromByteArrayLE( byteArray, 13760, 12);
    @CAN_RadarFL::RXX_Object::RXX_Object_Obj25_VyAyCoVnce = convertRawToPhysical(raw_value, 0.01, 0.0);

    raw_value=copyBitsFromByteArrayLE( byteArray, 13536, 12);
    @CAN_RadarFL::RXX_Object::RXX_Object_Obj25_VyVnce = convertRawToPhysical(raw_value, 0.01, 0.0);

    raw_value=copyBitsFromByteArrayLE( byteArray, 13432, 7);
    @CAN_RadarFL::RXX_Object::RXX_Object_Obj25_Width = convertRawToPhysical(raw_value, 0.125, 0.0);

    raw_value=copyBitsFromByteArrayLE( byteArray, 13440, 12);
    @CAN_RadarFL::RXX_Object::RXX_Object_Obj25_WidthVnce = convertRawToPhysical(raw_value, 0.01, 0.0);

    raw_value=copyBitsFromByteArrayLE( byteArray, 14304, 32);
    @CAN_RadarFL::RXX_Object::RXX_Object_Obj26_Age = convertRawToPhysical(raw_value, 1.0, 0.0);

    raw_value=copyBitsFromByteArrayLE( byteArray, 13900, 10);
    @CAN_RadarFL::RXX_Object::RXX_Object_Obj26_Ax = convertRawToPhysical(raw_value, 0.03125, -16.0);

    raw_value=copyBitsFromByteArrayLE( byteArray, 14284, 12);
    @CAN_RadarFL::RXX_Object::RXX_Object_Obj26_AxAyCoVnce = convertRawToPhysical(raw_value, 0.01, 0.0);

    raw_value=copyBitsFromByteArrayLE( byteArray, 13920, 12);
    @CAN_RadarFL::RXX_Object::RXX_Object_Obj26_AxVnce = convertRawToPhysical(raw_value, 0.01, 0.0);

    raw_value=copyBitsFromByteArrayLE( byteArray, 13974, 9);
    @CAN_RadarFL::RXX_Object::RXX_Object_Obj26_Ay = convertRawToPhysical(raw_value, 0.0625, -16.0);

    raw_value=copyBitsFromByteArrayLE( byteArray, 13984, 12);
    @CAN_RadarFL::RXX_Object::RXX_Object_Obj26_AyVnce = convertRawToPhysical(raw_value, 0.01, 0.0);

    raw_value=copyBitsFromByteArrayLE( byteArray, 14040, 6);
    @CAN_RadarFL::RXX_Object::RXX_Object_Obj26_ExistProb = convertRawToPhysical(raw_value, 2.0, 0.0);

    raw_value=copyBitsFromByteArrayLE( byteArray, 14104, 8);
    @CAN_RadarFL::RXX_Object::RXX_Object_Obj26_FilterInformation = convertRawToPhysical(raw_value, 1.0, 0.0);

    raw_value=copyBitsFromByteArrayLE( byteArray, 13880, 7);
    @CAN_RadarFL::RXX_Object::RXX_Object_Obj26_Length = convertRawToPhysical(raw_value, 0.125, 0.0);

    raw_value=copyBitsFromByteArrayLE( byteArray, 13888, 12);
    @CAN_RadarFL::RXX_Object::RXX_Object_Obj26_LengthVnce = convertRawToPhysical(raw_value, 0.01, 0.0);

    raw_value=copyBitsFromByteArrayLE( byteArray, 14072, 3);
    @CAN_RadarFL::RXX_Object::RXX_Object_Obj26_MeasurementStatus = convertRawToPhysical(raw_value, 1.0, 0.0);

    raw_value=copyBitsFromByteArrayLE( byteArray, 14028, 2);
    @CAN_RadarFL::RXX_Object::RXX_Object_Obj26_MovingStatus = convertRawToPhysical(raw_value, 1.0, 0.0);

    raw_value=copyBitsFromByteArrayLE( byteArray, 14008, 7);
    @CAN_RadarFL::RXX_Object::RXX_Object_Obj26_ObjId = convertRawToPhysical(raw_value, 1.0, 0.0);

    raw_value=copyBitsFromByteArrayLE( byteArray, 13910, 9);
    @CAN_RadarFL::RXX_Object::RXX_Object_Obj26_OrientationYaw = convertRawToPhysical(raw_value, 0.0175, -4.48);

    raw_value=copyBitsFromByteArrayLE( byteArray, 13932, 12);
    @CAN_RadarFL::RXX_Object::RXX_Object_Obj26_OrientationYawVnce = convertRawToPhysical(raw_value, 0.0003, 0.0);

    raw_value=copyBitsFromByteArrayLE( byteArray, 13824, 6);
    @CAN_RadarFL::RXX_Object::RXX_Object_Obj26_ProbClassConfidence = convertRawToPhysical(raw_value, 2.0, 0.0);

    raw_value=copyBitsFromByteArrayLE( byteArray, 14075, 4);
    @CAN_RadarFL::RXX_Object::RXX_Object_Obj26_ProbClassType = convertRawToPhysical(raw_value, 1.0, 0.0);

    raw_value=copyBitsFromByteArrayLE( byteArray, 13830, 14);
    @CAN_RadarFL::RXX_Object::RXX_Object_Obj26_Px = convertRawToPhysical(raw_value, 0.0625, -512.0);

    raw_value=copyBitsFromByteArrayLE( byteArray, 14144, 12);
    @CAN_RadarFL::RXX_Object::RXX_Object_Obj26_PxAxCoVnce = convertRawToPhysical(raw_value, 0.01, 0.0);

    raw_value=copyBitsFromByteArrayLE( byteArray, 14156, 12);
    @CAN_RadarFL::RXX_Object::RXX_Object_Obj26_PxAyCoVnce = convertRawToPhysical(raw_value, 0.01, 0.0);

    raw_value=copyBitsFromByteArrayLE( byteArray, 14060, 12);
    @CAN_RadarFL::RXX_Object::RXX_Object_Obj26_PxPyCoVnce = convertRawToPhysical(raw_value, 0.01, 0.0);

    raw_value=copyBitsFromByteArrayLE( byteArray, 13844, 12);
    @CAN_RadarFL::RXX_Object::RXX_Object_Obj26_PxVnce = convertRawToPhysical(raw_value, 0.1, 0.0);

    raw_value=copyBitsFromByteArrayLE( byteArray, 14080, 12);
    @CAN_RadarFL::RXX_Object::RXX_Object_Obj26_PxVxCoVnce = convertRawToPhysical(raw_value, 0.01, 0.0);

    raw_value=copyBitsFromByteArrayLE( byteArray, 14092, 12);
    @CAN_RadarFL::RXX_Object::RXX_Object_Obj26_PxVyCoVnce = convertRawToPhysical(raw_value, 0.01, 0.0);

    raw_value=copyBitsFromByteArrayLE( byteArray, 13856, 12);
    @CAN_RadarFL::RXX_Object::RXX_Object_Obj26_Py = convertRawToPhysical(raw_value, 0.0625, -128.0);

    raw_value=copyBitsFromByteArrayLE( byteArray, 14176, 12);
    @CAN_RadarFL::RXX_Object::RXX_Object_Obj26_PyAxCoVnce = convertRawToPhysical(raw_value, 0.01, 0.0);

    raw_value=copyBitsFromByteArrayLE( byteArray, 14188, 12);
    @CAN_RadarFL::RXX_Object::RXX_Object_Obj26_PyAyCoVnce = convertRawToPhysical(raw_value, 0.01, 0.0);

    raw_value=copyBitsFromByteArrayLE( byteArray, 13868, 12);
    @CAN_RadarFL::RXX_Object::RXX_Object_Obj26_PyVnce = convertRawToPhysical(raw_value, 0.1, 0.0);

    raw_value=copyBitsFromByteArrayLE( byteArray, 14112, 12);
    @CAN_RadarFL::RXX_Object::RXX_Object_Obj26_PyVxCoVnce = convertRawToPhysical(raw_value, 0.01, 0.0);

    raw_value=copyBitsFromByteArrayLE( byteArray, 14124, 12);
    @CAN_RadarFL::RXX_Object::RXX_Object_Obj26_PyVyCoVnce = convertRawToPhysical(raw_value, 0.01, 0.0);

    raw_value=copyBitsFromByteArrayLE( byteArray, 13964, 10);
    @CAN_RadarFL::RXX_Object::RXX_Object_Obj26_RCS = convertRawToPhysical(raw_value, 0.2, -102.4);

    raw_value=copyBitsFromByteArrayLE( byteArray, 14136, 4);
    @CAN_RadarFL::RXX_Object::RXX_Object_Obj26_ReferencePoint = convertRawToPhysical(raw_value, 1.0, 0.0);

    raw_value=copyBitsFromByteArrayLE( byteArray, 13996, 12);
    @CAN_RadarFL::RXX_Object::RXX_Object_Obj26_Vx = convertRawToPhysical(raw_value, 0.0625, -128.0);

    raw_value=copyBitsFromByteArrayLE( byteArray, 14220, 12);
    @CAN_RadarFL::RXX_Object::RXX_Object_Obj26_VxAxCoVnce = convertRawToPhysical(raw_value, 0.01, 0.0);

    raw_value=copyBitsFromByteArrayLE( byteArray, 14240, 12);
    @CAN_RadarFL::RXX_Object::RXX_Object_Obj26_VxAyCoVnce = convertRawToPhysical(raw_value, 0.01, 0.0);

    raw_value=copyBitsFromByteArrayLE( byteArray, 14016, 12);
    @CAN_RadarFL::RXX_Object::RXX_Object_Obj26_VxVnce = convertRawToPhysical(raw_value, 0.01, 0.0);

    raw_value=copyBitsFromByteArrayLE( byteArray, 14208, 12);
    @CAN_RadarFL::RXX_Object::RXX_Object_Obj26_VxVyCoVnce = convertRawToPhysical(raw_value, 0.01, 0.0);

    raw_value=copyBitsFromByteArrayLE( byteArray, 14030, 10);
    @CAN_RadarFL::RXX_Object::RXX_Object_Obj26_Vy = convertRawToPhysical(raw_value, 0.125, -64.0);

    raw_value=copyBitsFromByteArrayLE( byteArray, 14252, 12);
    @CAN_RadarFL::RXX_Object::RXX_Object_Obj26_VyAxCoVnce = convertRawToPhysical(raw_value, 0.01, 0.0);

    raw_value=copyBitsFromByteArrayLE( byteArray, 14272, 12);
    @CAN_RadarFL::RXX_Object::RXX_Object_Obj26_VyAyCoVnce = convertRawToPhysical(raw_value, 0.01, 0.0);

    raw_value=copyBitsFromByteArrayLE( byteArray, 14048, 12);
    @CAN_RadarFL::RXX_Object::RXX_Object_Obj26_VyVnce = convertRawToPhysical(raw_value, 0.01, 0.0);

    raw_value=copyBitsFromByteArrayLE( byteArray, 13944, 7);
    @CAN_RadarFL::RXX_Object::RXX_Object_Obj26_Width = convertRawToPhysical(raw_value, 0.125, 0.0);

    raw_value=copyBitsFromByteArrayLE( byteArray, 13952, 12);
    @CAN_RadarFL::RXX_Object::RXX_Object_Obj26_WidthVnce = convertRawToPhysical(raw_value, 0.01, 0.0);

    raw_value=copyBitsFromByteArrayLE( byteArray, 14816, 32);
    @CAN_RadarFL::RXX_Object::RXX_Object_Obj27_Age = convertRawToPhysical(raw_value, 1.0, 0.0);

    raw_value=copyBitsFromByteArrayLE( byteArray, 14412, 10);
    @CAN_RadarFL::RXX_Object::RXX_Object_Obj27_Ax = convertRawToPhysical(raw_value, 0.03125, -16.0);

    raw_value=copyBitsFromByteArrayLE( byteArray, 14796, 12);
    @CAN_RadarFL::RXX_Object::RXX_Object_Obj27_AxAyCoVnce = convertRawToPhysical(raw_value, 0.01, 0.0);

    raw_value=copyBitsFromByteArrayLE( byteArray, 14432, 12);
    @CAN_RadarFL::RXX_Object::RXX_Object_Obj27_AxVnce = convertRawToPhysical(raw_value, 0.01, 0.0);

    raw_value=copyBitsFromByteArrayLE( byteArray, 14486, 9);
    @CAN_RadarFL::RXX_Object::RXX_Object_Obj27_Ay = convertRawToPhysical(raw_value, 0.0625, -16.0);

    raw_value=copyBitsFromByteArrayLE( byteArray, 14496, 12);
    @CAN_RadarFL::RXX_Object::RXX_Object_Obj27_AyVnce = convertRawToPhysical(raw_value, 0.01, 0.0);

    raw_value=copyBitsFromByteArrayLE( byteArray, 14552, 6);
    @CAN_RadarFL::RXX_Object::RXX_Object_Obj27_ExistProb = convertRawToPhysical(raw_value, 2.0, 0.0);

    raw_value=copyBitsFromByteArrayLE( byteArray, 14616, 8);
    @CAN_RadarFL::RXX_Object::RXX_Object_Obj27_FilterInformation = convertRawToPhysical(raw_value, 1.0, 0.0);

    raw_value=copyBitsFromByteArrayLE( byteArray, 14392, 7);
    @CAN_RadarFL::RXX_Object::RXX_Object_Obj27_Length = convertRawToPhysical(raw_value, 0.125, 0.0);

    raw_value=copyBitsFromByteArrayLE( byteArray, 14400, 12);
    @CAN_RadarFL::RXX_Object::RXX_Object_Obj27_LengthVnce = convertRawToPhysical(raw_value, 0.01, 0.0);

    raw_value=copyBitsFromByteArrayLE( byteArray, 14584, 3);
    @CAN_RadarFL::RXX_Object::RXX_Object_Obj27_MeasurementStatus = convertRawToPhysical(raw_value, 1.0, 0.0);

    raw_value=copyBitsFromByteArrayLE( byteArray, 14540, 2);
    @CAN_RadarFL::RXX_Object::RXX_Object_Obj27_MovingStatus = convertRawToPhysical(raw_value, 1.0, 0.0);

    raw_value=copyBitsFromByteArrayLE( byteArray, 14520, 7);
    @CAN_RadarFL::RXX_Object::RXX_Object_Obj27_ObjId = convertRawToPhysical(raw_value, 1.0, 0.0);

    raw_value=copyBitsFromByteArrayLE( byteArray, 14422, 9);
    @CAN_RadarFL::RXX_Object::RXX_Object_Obj27_OrientationYaw = convertRawToPhysical(raw_value, 0.0175, -4.48);

    raw_value=copyBitsFromByteArrayLE( byteArray, 14444, 12);
    @CAN_RadarFL::RXX_Object::RXX_Object_Obj27_OrientationYawVnce = convertRawToPhysical(raw_value, 0.0003, 0.0);

    raw_value=copyBitsFromByteArrayLE( byteArray, 14336, 6);
    @CAN_RadarFL::RXX_Object::RXX_Object_Obj27_ProbClassConfidence = convertRawToPhysical(raw_value, 2.0, 0.0);

    raw_value=copyBitsFromByteArrayLE( byteArray, 14587, 4);
    @CAN_RadarFL::RXX_Object::RXX_Object_Obj27_ProbClassType = convertRawToPhysical(raw_value, 1.0, 0.0);

    raw_value=copyBitsFromByteArrayLE( byteArray, 14342, 14);
    @CAN_RadarFL::RXX_Object::RXX_Object_Obj27_Px = convertRawToPhysical(raw_value, 0.0625, -512.0);

    raw_value=copyBitsFromByteArrayLE( byteArray, 14656, 12);
    @CAN_RadarFL::RXX_Object::RXX_Object_Obj27_PxAxCoVnce = convertRawToPhysical(raw_value, 0.01, 0.0);

    raw_value=copyBitsFromByteArrayLE( byteArray, 14668, 12);
    @CAN_RadarFL::RXX_Object::RXX_Object_Obj27_PxAyCoVnce = convertRawToPhysical(raw_value, 0.01, 0.0);

    raw_value=copyBitsFromByteArrayLE( byteArray, 14572, 12);
    @CAN_RadarFL::RXX_Object::RXX_Object_Obj27_PxPyCoVnce = convertRawToPhysical(raw_value, 0.01, 0.0);

    raw_value=copyBitsFromByteArrayLE( byteArray, 14356, 12);
    @CAN_RadarFL::RXX_Object::RXX_Object_Obj27_PxVnce = convertRawToPhysical(raw_value, 0.1, 0.0);

    raw_value=copyBitsFromByteArrayLE( byteArray, 14592, 12);
    @CAN_RadarFL::RXX_Object::RXX_Object_Obj27_PxVxCoVnce = convertRawToPhysical(raw_value, 0.01, 0.0);

    raw_value=copyBitsFromByteArrayLE( byteArray, 14604, 12);
    @CAN_RadarFL::RXX_Object::RXX_Object_Obj27_PxVyCoVnce = convertRawToPhysical(raw_value, 0.01, 0.0);

    raw_value=copyBitsFromByteArrayLE( byteArray, 14368, 12);
    @CAN_RadarFL::RXX_Object::RXX_Object_Obj27_Py = convertRawToPhysical(raw_value, 0.0625, -128.0);

    raw_value=copyBitsFromByteArrayLE( byteArray, 14688, 12);
    @CAN_RadarFL::RXX_Object::RXX_Object_Obj27_PyAxCoVnce = convertRawToPhysical(raw_value, 0.01, 0.0);

    raw_value=copyBitsFromByteArrayLE( byteArray, 14700, 12);
    @CAN_RadarFL::RXX_Object::RXX_Object_Obj27_PyAyCoVnce = convertRawToPhysical(raw_value, 0.01, 0.0);

    raw_value=copyBitsFromByteArrayLE( byteArray, 14380, 12);
    @CAN_RadarFL::RXX_Object::RXX_Object_Obj27_PyVnce = convertRawToPhysical(raw_value, 0.1, 0.0);

    raw_value=copyBitsFromByteArrayLE( byteArray, 14624, 12);
    @CAN_RadarFL::RXX_Object::RXX_Object_Obj27_PyVxCoVnce = convertRawToPhysical(raw_value, 0.01, 0.0);

    raw_value=copyBitsFromByteArrayLE( byteArray, 14636, 12);
    @CAN_RadarFL::RXX_Object::RXX_Object_Obj27_PyVyCoVnce = convertRawToPhysical(raw_value, 0.01, 0.0);

    raw_value=copyBitsFromByteArrayLE( byteArray, 14476, 10);
    @CAN_RadarFL::RXX_Object::RXX_Object_Obj27_RCS = convertRawToPhysical(raw_value, 0.2, -102.4);

    raw_value=copyBitsFromByteArrayLE( byteArray, 14648, 4);
    @CAN_RadarFL::RXX_Object::RXX_Object_Obj27_ReferencePoint = convertRawToPhysical(raw_value, 1.0, 0.0);

    raw_value=copyBitsFromByteArrayLE( byteArray, 14508, 12);
    @CAN_RadarFL::RXX_Object::RXX_Object_Obj27_Vx = convertRawToPhysical(raw_value, 0.0625, -128.0);

    raw_value=copyBitsFromByteArrayLE( byteArray, 14732, 12);
    @CAN_RadarFL::RXX_Object::RXX_Object_Obj27_VxAxCoVnce = convertRawToPhysical(raw_value, 0.01, 0.0);

    raw_value=copyBitsFromByteArrayLE( byteArray, 14752, 12);
    @CAN_RadarFL::RXX_Object::RXX_Object_Obj27_VxAyCoVnce = convertRawToPhysical(raw_value, 0.01, 0.0);

    raw_value=copyBitsFromByteArrayLE( byteArray, 14528, 12);
    @CAN_RadarFL::RXX_Object::RXX_Object_Obj27_VxVnce = convertRawToPhysical(raw_value, 0.01, 0.0);

    raw_value=copyBitsFromByteArrayLE( byteArray, 14720, 12);
    @CAN_RadarFL::RXX_Object::RXX_Object_Obj27_VxVyCoVnce = convertRawToPhysical(raw_value, 0.01, 0.0);

    raw_value=copyBitsFromByteArrayLE( byteArray, 14542, 10);
    @CAN_RadarFL::RXX_Object::RXX_Object_Obj27_Vy = convertRawToPhysical(raw_value, 0.125, -64.0);

    raw_value=copyBitsFromByteArrayLE( byteArray, 14764, 12);
    @CAN_RadarFL::RXX_Object::RXX_Object_Obj27_VyAxCoVnce = convertRawToPhysical(raw_value, 0.01, 0.0);

    raw_value=copyBitsFromByteArrayLE( byteArray, 14784, 12);
    @CAN_RadarFL::RXX_Object::RXX_Object_Obj27_VyAyCoVnce = convertRawToPhysical(raw_value, 0.01, 0.0);

    raw_value=copyBitsFromByteArrayLE( byteArray, 14560, 12);
    @CAN_RadarFL::RXX_Object::RXX_Object_Obj27_VyVnce = convertRawToPhysical(raw_value, 0.01, 0.0);

    raw_value=copyBitsFromByteArrayLE( byteArray, 14456, 7);
    @CAN_RadarFL::RXX_Object::RXX_Object_Obj27_Width = convertRawToPhysical(raw_value, 0.125, 0.0);

    raw_value=copyBitsFromByteArrayLE( byteArray, 14464, 12);
    @CAN_RadarFL::RXX_Object::RXX_Object_Obj27_WidthVnce = convertRawToPhysical(raw_value, 0.01, 0.0);

    raw_value=copyBitsFromByteArrayLE( byteArray, 15328, 32);
    @CAN_RadarFL::RXX_Object::RXX_Object_Obj28_Age = convertRawToPhysical(raw_value, 1.0, 0.0);

    raw_value=copyBitsFromByteArrayLE( byteArray, 14924, 10);
    @CAN_RadarFL::RXX_Object::RXX_Object_Obj28_Ax = convertRawToPhysical(raw_value, 0.03125, -16.0);

    raw_value=copyBitsFromByteArrayLE( byteArray, 15308, 12);
    @CAN_RadarFL::RXX_Object::RXX_Object_Obj28_AxAyCoVnce = convertRawToPhysical(raw_value, 0.01, 0.0);

    raw_value=copyBitsFromByteArrayLE( byteArray, 14944, 12);
    @CAN_RadarFL::RXX_Object::RXX_Object_Obj28_AxVnce = convertRawToPhysical(raw_value, 0.01, 0.0);

    raw_value=copyBitsFromByteArrayLE( byteArray, 14998, 9);
    @CAN_RadarFL::RXX_Object::RXX_Object_Obj28_Ay = convertRawToPhysical(raw_value, 0.0625, -16.0);

    raw_value=copyBitsFromByteArrayLE( byteArray, 15008, 12);
    @CAN_RadarFL::RXX_Object::RXX_Object_Obj28_AyVnce = convertRawToPhysical(raw_value, 0.01, 0.0);

    raw_value=copyBitsFromByteArrayLE( byteArray, 15064, 6);
    @CAN_RadarFL::RXX_Object::RXX_Object_Obj28_ExistProb = convertRawToPhysical(raw_value, 2.0, 0.0);

    raw_value=copyBitsFromByteArrayLE( byteArray, 15128, 8);
    @CAN_RadarFL::RXX_Object::RXX_Object_Obj28_FilterInformation = convertRawToPhysical(raw_value, 1.0, 0.0);

    raw_value=copyBitsFromByteArrayLE( byteArray, 14904, 7);
    @CAN_RadarFL::RXX_Object::RXX_Object_Obj28_Length = convertRawToPhysical(raw_value, 0.125, 0.0);

    raw_value=copyBitsFromByteArrayLE( byteArray, 14912, 12);
    @CAN_RadarFL::RXX_Object::RXX_Object_Obj28_LengthVnce = convertRawToPhysical(raw_value, 0.01, 0.0);

    raw_value=copyBitsFromByteArrayLE( byteArray, 15096, 3);
    @CAN_RadarFL::RXX_Object::RXX_Object_Obj28_MeasurementStatus = convertRawToPhysical(raw_value, 1.0, 0.0);

    raw_value=copyBitsFromByteArrayLE( byteArray, 15052, 2);
    @CAN_RadarFL::RXX_Object::RXX_Object_Obj28_MovingStatus = convertRawToPhysical(raw_value, 1.0, 0.0);

    raw_value=copyBitsFromByteArrayLE( byteArray, 15032, 7);
    @CAN_RadarFL::RXX_Object::RXX_Object_Obj28_ObjId = convertRawToPhysical(raw_value, 1.0, 0.0);

    raw_value=copyBitsFromByteArrayLE( byteArray, 14934, 9);
    @CAN_RadarFL::RXX_Object::RXX_Object_Obj28_OrientationYaw = convertRawToPhysical(raw_value, 0.0175, -4.48);

    raw_value=copyBitsFromByteArrayLE( byteArray, 14956, 12);
    @CAN_RadarFL::RXX_Object::RXX_Object_Obj28_OrientationYawVnce = convertRawToPhysical(raw_value, 0.0003, 0.0);

    raw_value=copyBitsFromByteArrayLE( byteArray, 14848, 6);
    @CAN_RadarFL::RXX_Object::RXX_Object_Obj28_ProbClassConfidence = convertRawToPhysical(raw_value, 2.0, 0.0);

    raw_value=copyBitsFromByteArrayLE( byteArray, 15099, 4);
    @CAN_RadarFL::RXX_Object::RXX_Object_Obj28_ProbClassType = convertRawToPhysical(raw_value, 1.0, 0.0);

    raw_value=copyBitsFromByteArrayLE( byteArray, 14854, 14);
    @CAN_RadarFL::RXX_Object::RXX_Object_Obj28_Px = convertRawToPhysical(raw_value, 0.0625, -512.0);

    raw_value=copyBitsFromByteArrayLE( byteArray, 15168, 12);
    @CAN_RadarFL::RXX_Object::RXX_Object_Obj28_PxAxCoVnce = convertRawToPhysical(raw_value, 0.01, 0.0);

    raw_value=copyBitsFromByteArrayLE( byteArray, 15180, 12);
    @CAN_RadarFL::RXX_Object::RXX_Object_Obj28_PxAyCoVnce = convertRawToPhysical(raw_value, 0.01, 0.0);

    raw_value=copyBitsFromByteArrayLE( byteArray, 15084, 12);
    @CAN_RadarFL::RXX_Object::RXX_Object_Obj28_PxPyCoVnce = convertRawToPhysical(raw_value, 0.01, 0.0);

    raw_value=copyBitsFromByteArrayLE( byteArray, 14868, 12);
    @CAN_RadarFL::RXX_Object::RXX_Object_Obj28_PxVnce = convertRawToPhysical(raw_value, 0.1, 0.0);

    raw_value=copyBitsFromByteArrayLE( byteArray, 15104, 12);
    @CAN_RadarFL::RXX_Object::RXX_Object_Obj28_PxVxCoVnce = convertRawToPhysical(raw_value, 0.01, 0.0);

    raw_value=copyBitsFromByteArrayLE( byteArray, 15116, 12);
    @CAN_RadarFL::RXX_Object::RXX_Object_Obj28_PxVyCoVnce = convertRawToPhysical(raw_value, 0.01, 0.0);

    raw_value=copyBitsFromByteArrayLE( byteArray, 14880, 12);
    @CAN_RadarFL::RXX_Object::RXX_Object_Obj28_Py = convertRawToPhysical(raw_value, 0.0625, -128.0);

    raw_value=copyBitsFromByteArrayLE( byteArray, 15200, 12);
    @CAN_RadarFL::RXX_Object::RXX_Object_Obj28_PyAxCoVnce = convertRawToPhysical(raw_value, 0.01, 0.0);

    raw_value=copyBitsFromByteArrayLE( byteArray, 15212, 12);
    @CAN_RadarFL::RXX_Object::RXX_Object_Obj28_PyAyCoVnce = convertRawToPhysical(raw_value, 0.01, 0.0);

    raw_value=copyBitsFromByteArrayLE( byteArray, 14892, 12);
    @CAN_RadarFL::RXX_Object::RXX_Object_Obj28_PyVnce = convertRawToPhysical(raw_value, 0.1, 0.0);

    raw_value=copyBitsFromByteArrayLE( byteArray, 15136, 12);
    @CAN_RadarFL::RXX_Object::RXX_Object_Obj28_PyVxCoVnce = convertRawToPhysical(raw_value, 0.01, 0.0);

    raw_value=copyBitsFromByteArrayLE( byteArray, 15148, 12);
    @CAN_RadarFL::RXX_Object::RXX_Object_Obj28_PyVyCoVnce = convertRawToPhysical(raw_value, 0.01, 0.0);

    raw_value=copyBitsFromByteArrayLE( byteArray, 14988, 10);
    @CAN_RadarFL::RXX_Object::RXX_Object_Obj28_RCS = convertRawToPhysical(raw_value, 0.2, -102.4);

    raw_value=copyBitsFromByteArrayLE( byteArray, 15160, 4);
    @CAN_RadarFL::RXX_Object::RXX_Object_Obj28_ReferencePoint = convertRawToPhysical(raw_value, 1.0, 0.0);

    raw_value=copyBitsFromByteArrayLE( byteArray, 15020, 12);
    @CAN_RadarFL::RXX_Object::RXX_Object_Obj28_Vx = convertRawToPhysical(raw_value, 0.0625, -128.0);

    raw_value=copyBitsFromByteArrayLE( byteArray, 15244, 12);
    @CAN_RadarFL::RXX_Object::RXX_Object_Obj28_VxAxCoVnce = convertRawToPhysical(raw_value, 0.01, 0.0);

    raw_value=copyBitsFromByteArrayLE( byteArray, 15264, 12);
    @CAN_RadarFL::RXX_Object::RXX_Object_Obj28_VxAyCoVnce = convertRawToPhysical(raw_value, 0.01, 0.0);

    raw_value=copyBitsFromByteArrayLE( byteArray, 15040, 12);
    @CAN_RadarFL::RXX_Object::RXX_Object_Obj28_VxVnce = convertRawToPhysical(raw_value, 0.01, 0.0);

    raw_value=copyBitsFromByteArrayLE( byteArray, 15232, 12);
    @CAN_RadarFL::RXX_Object::RXX_Object_Obj28_VxVyCoVnce = convertRawToPhysical(raw_value, 0.01, 0.0);

    raw_value=copyBitsFromByteArrayLE( byteArray, 15054, 10);
    @CAN_RadarFL::RXX_Object::RXX_Object_Obj28_Vy = convertRawToPhysical(raw_value, 0.125, -64.0);

    raw_value=copyBitsFromByteArrayLE( byteArray, 15276, 12);
    @CAN_RadarFL::RXX_Object::RXX_Object_Obj28_VyAxCoVnce = convertRawToPhysical(raw_value, 0.01, 0.0);

    raw_value=copyBitsFromByteArrayLE( byteArray, 15296, 12);
    @CAN_RadarFL::RXX_Object::RXX_Object_Obj28_VyAyCoVnce = convertRawToPhysical(raw_value, 0.01, 0.0);

    raw_value=copyBitsFromByteArrayLE( byteArray, 15072, 12);
    @CAN_RadarFL::RXX_Object::RXX_Object_Obj28_VyVnce = convertRawToPhysical(raw_value, 0.01, 0.0);

    raw_value=copyBitsFromByteArrayLE( byteArray, 14968, 7);
    @CAN_RadarFL::RXX_Object::RXX_Object_Obj28_Width = convertRawToPhysical(raw_value, 0.125, 0.0);

    raw_value=copyBitsFromByteArrayLE( byteArray, 14976, 12);
    @CAN_RadarFL::RXX_Object::RXX_Object_Obj28_WidthVnce = convertRawToPhysical(raw_value, 0.01, 0.0);

    raw_value=copyBitsFromByteArrayLE( byteArray, 15840, 32);
    @CAN_RadarFL::RXX_Object::RXX_Object_Obj29_Age = convertRawToPhysical(raw_value, 1.0, 0.0);

    raw_value=copyBitsFromByteArrayLE( byteArray, 15436, 10);
    @CAN_RadarFL::RXX_Object::RXX_Object_Obj29_Ax = convertRawToPhysical(raw_value, 0.03125, -16.0);

    raw_value=copyBitsFromByteArrayLE( byteArray, 15820, 12);
    @CAN_RadarFL::RXX_Object::RXX_Object_Obj29_AxAyCoVnce = convertRawToPhysical(raw_value, 0.01, 0.0);

    raw_value=copyBitsFromByteArrayLE( byteArray, 15456, 12);
    @CAN_RadarFL::RXX_Object::RXX_Object_Obj29_AxVnce = convertRawToPhysical(raw_value, 0.01, 0.0);

    raw_value=copyBitsFromByteArrayLE( byteArray, 15510, 9);
    @CAN_RadarFL::RXX_Object::RXX_Object_Obj29_Ay = convertRawToPhysical(raw_value, 0.0625, -16.0);

    raw_value=copyBitsFromByteArrayLE( byteArray, 15520, 12);
    @CAN_RadarFL::RXX_Object::RXX_Object_Obj29_AyVnce = convertRawToPhysical(raw_value, 0.01, 0.0);

    raw_value=copyBitsFromByteArrayLE( byteArray, 15576, 6);
    @CAN_RadarFL::RXX_Object::RXX_Object_Obj29_ExistProb = convertRawToPhysical(raw_value, 2.0, 0.0);

    raw_value=copyBitsFromByteArrayLE( byteArray, 15640, 8);
    @CAN_RadarFL::RXX_Object::RXX_Object_Obj29_FilterInformation = convertRawToPhysical(raw_value, 1.0, 0.0);

    raw_value=copyBitsFromByteArrayLE( byteArray, 15416, 7);
    @CAN_RadarFL::RXX_Object::RXX_Object_Obj29_Length = convertRawToPhysical(raw_value, 0.125, 0.0);

    raw_value=copyBitsFromByteArrayLE( byteArray, 15424, 12);
    @CAN_RadarFL::RXX_Object::RXX_Object_Obj29_LengthVnce = convertRawToPhysical(raw_value, 0.01, 0.0);

    raw_value=copyBitsFromByteArrayLE( byteArray, 15608, 3);
    @CAN_RadarFL::RXX_Object::RXX_Object_Obj29_MeasurementStatus = convertRawToPhysical(raw_value, 1.0, 0.0);

    raw_value=copyBitsFromByteArrayLE( byteArray, 15564, 2);
    @CAN_RadarFL::RXX_Object::RXX_Object_Obj29_MovingStatus = convertRawToPhysical(raw_value, 1.0, 0.0);

    raw_value=copyBitsFromByteArrayLE( byteArray, 15544, 7);
    @CAN_RadarFL::RXX_Object::RXX_Object_Obj29_ObjId = convertRawToPhysical(raw_value, 1.0, 0.0);

    raw_value=copyBitsFromByteArrayLE( byteArray, 15446, 9);
    @CAN_RadarFL::RXX_Object::RXX_Object_Obj29_OrientationYaw = convertRawToPhysical(raw_value, 0.0175, -4.48);

    raw_value=copyBitsFromByteArrayLE( byteArray, 15468, 12);
    @CAN_RadarFL::RXX_Object::RXX_Object_Obj29_OrientationYawVnce = convertRawToPhysical(raw_value, 0.0003, 0.0);

    raw_value=copyBitsFromByteArrayLE( byteArray, 15360, 6);
    @CAN_RadarFL::RXX_Object::RXX_Object_Obj29_ProbClassConfidence = convertRawToPhysical(raw_value, 2.0, 0.0);

    raw_value=copyBitsFromByteArrayLE( byteArray, 15611, 4);
    @CAN_RadarFL::RXX_Object::RXX_Object_Obj29_ProbClassType = convertRawToPhysical(raw_value, 1.0, 0.0);

    raw_value=copyBitsFromByteArrayLE( byteArray, 15366, 14);
    @CAN_RadarFL::RXX_Object::RXX_Object_Obj29_Px = convertRawToPhysical(raw_value, 0.0625, -512.0);

    raw_value=copyBitsFromByteArrayLE( byteArray, 15680, 12);
    @CAN_RadarFL::RXX_Object::RXX_Object_Obj29_PxAxCoVnce = convertRawToPhysical(raw_value, 0.01, 0.0);

    raw_value=copyBitsFromByteArrayLE( byteArray, 15692, 12);
    @CAN_RadarFL::RXX_Object::RXX_Object_Obj29_PxAyCoVnce = convertRawToPhysical(raw_value, 0.01, 0.0);

    raw_value=copyBitsFromByteArrayLE( byteArray, 15596, 12);
    @CAN_RadarFL::RXX_Object::RXX_Object_Obj29_PxPyCoVnce = convertRawToPhysical(raw_value, 0.01, 0.0);

    raw_value=copyBitsFromByteArrayLE( byteArray, 15380, 12);
    @CAN_RadarFL::RXX_Object::RXX_Object_Obj29_PxVnce = convertRawToPhysical(raw_value, 0.1, 0.0);

    raw_value=copyBitsFromByteArrayLE( byteArray, 15616, 12);
    @CAN_RadarFL::RXX_Object::RXX_Object_Obj29_PxVxCoVnce = convertRawToPhysical(raw_value, 0.01, 0.0);

    raw_value=copyBitsFromByteArrayLE( byteArray, 15628, 12);
    @CAN_RadarFL::RXX_Object::RXX_Object_Obj29_PxVyCoVnce = convertRawToPhysical(raw_value, 0.01, 0.0);

    raw_value=copyBitsFromByteArrayLE( byteArray, 15392, 12);
    @CAN_RadarFL::RXX_Object::RXX_Object_Obj29_Py = convertRawToPhysical(raw_value, 0.0625, -128.0);

    raw_value=copyBitsFromByteArrayLE( byteArray, 15712, 12);
    @CAN_RadarFL::RXX_Object::RXX_Object_Obj29_PyAxCoVnce = convertRawToPhysical(raw_value, 0.01, 0.0);

    raw_value=copyBitsFromByteArrayLE( byteArray, 15724, 12);
    @CAN_RadarFL::RXX_Object::RXX_Object_Obj29_PyAyCoVnce = convertRawToPhysical(raw_value, 0.01, 0.0);

    raw_value=copyBitsFromByteArrayLE( byteArray, 15404, 12);
    @CAN_RadarFL::RXX_Object::RXX_Object_Obj29_PyVnce = convertRawToPhysical(raw_value, 0.1, 0.0);

    raw_value=copyBitsFromByteArrayLE( byteArray, 15648, 12);
    @CAN_RadarFL::RXX_Object::RXX_Object_Obj29_PyVxCoVnce = convertRawToPhysical(raw_value, 0.01, 0.0);

    raw_value=copyBitsFromByteArrayLE( byteArray, 15660, 12);
    @CAN_RadarFL::RXX_Object::RXX_Object_Obj29_PyVyCoVnce = convertRawToPhysical(raw_value, 0.01, 0.0);

    raw_value=copyBitsFromByteArrayLE( byteArray, 15500, 10);
    @CAN_RadarFL::RXX_Object::RXX_Object_Obj29_RCS = convertRawToPhysical(raw_value, 0.2, -102.4);

    raw_value=copyBitsFromByteArrayLE( byteArray, 15672, 4);
    @CAN_RadarFL::RXX_Object::RXX_Object_Obj29_ReferencePoint = convertRawToPhysical(raw_value, 1.0, 0.0);

    raw_value=copyBitsFromByteArrayLE( byteArray, 15532, 12);
    @CAN_RadarFL::RXX_Object::RXX_Object_Obj29_Vx = convertRawToPhysical(raw_value, 0.0625, -128.0);

    raw_value=copyBitsFromByteArrayLE( byteArray, 15756, 12);
    @CAN_RadarFL::RXX_Object::RXX_Object_Obj29_VxAxCoVnce = convertRawToPhysical(raw_value, 0.01, 0.0);

    raw_value=copyBitsFromByteArrayLE( byteArray, 15776, 12);
    @CAN_RadarFL::RXX_Object::RXX_Object_Obj29_VxAyCoVnce = convertRawToPhysical(raw_value, 0.01, 0.0);

    raw_value=copyBitsFromByteArrayLE( byteArray, 15552, 12);
    @CAN_RadarFL::RXX_Object::RXX_Object_Obj29_VxVnce = convertRawToPhysical(raw_value, 0.01, 0.0);

    raw_value=copyBitsFromByteArrayLE( byteArray, 15744, 12);
    @CAN_RadarFL::RXX_Object::RXX_Object_Obj29_VxVyCoVnce = convertRawToPhysical(raw_value, 0.01, 0.0);

    raw_value=copyBitsFromByteArrayLE( byteArray, 15566, 10);
    @CAN_RadarFL::RXX_Object::RXX_Object_Obj29_Vy = convertRawToPhysical(raw_value, 0.125, -64.0);

    raw_value=copyBitsFromByteArrayLE( byteArray, 15788, 12);
    @CAN_RadarFL::RXX_Object::RXX_Object_Obj29_VyAxCoVnce = convertRawToPhysical(raw_value, 0.01, 0.0);

    raw_value=copyBitsFromByteArrayLE( byteArray, 15808, 12);
    @CAN_RadarFL::RXX_Object::RXX_Object_Obj29_VyAyCoVnce = convertRawToPhysical(raw_value, 0.01, 0.0);

    raw_value=copyBitsFromByteArrayLE( byteArray, 15584, 12);
    @CAN_RadarFL::RXX_Object::RXX_Object_Obj29_VyVnce = convertRawToPhysical(raw_value, 0.01, 0.0);

    raw_value=copyBitsFromByteArrayLE( byteArray, 15480, 7);
    @CAN_RadarFL::RXX_Object::RXX_Object_Obj29_Width = convertRawToPhysical(raw_value, 0.125, 0.0);

    raw_value=copyBitsFromByteArrayLE( byteArray, 15488, 12);
    @CAN_RadarFL::RXX_Object::RXX_Object_Obj29_WidthVnce = convertRawToPhysical(raw_value, 0.01, 0.0);

    raw_value=copyBitsFromByteArrayLE( byteArray, 2016, 32);
    @CAN_RadarFL::RXX_Object::RXX_Object_Obj2_Age = convertRawToPhysical(raw_value, 1.0, 0.0);

    raw_value=copyBitsFromByteArrayLE( byteArray, 1612, 10);
    @CAN_RadarFL::RXX_Object::RXX_Object_Obj2_Ax = convertRawToPhysical(raw_value, 0.03125, -16.0);

    raw_value=copyBitsFromByteArrayLE( byteArray, 1996, 12);
    @CAN_RadarFL::RXX_Object::RXX_Object_Obj2_AxAyCoVnce = convertRawToPhysical(raw_value, 0.01, 0.0);

    raw_value=copyBitsFromByteArrayLE( byteArray, 1632, 12);
    @CAN_RadarFL::RXX_Object::RXX_Object_Obj2_AxVnce = convertRawToPhysical(raw_value, 0.01, 0.0);

    raw_value=copyBitsFromByteArrayLE( byteArray, 1686, 9);
    @CAN_RadarFL::RXX_Object::RXX_Object_Obj2_Ay = convertRawToPhysical(raw_value, 0.0625, -16.0);

    raw_value=copyBitsFromByteArrayLE( byteArray, 1696, 12);
    @CAN_RadarFL::RXX_Object::RXX_Object_Obj2_AyVnce = convertRawToPhysical(raw_value, 0.01, 0.0);

    raw_value=copyBitsFromByteArrayLE( byteArray, 1752, 6);
    @CAN_RadarFL::RXX_Object::RXX_Object_Obj2_ExistProb = convertRawToPhysical(raw_value, 2.0, 0.0);

    raw_value=copyBitsFromByteArrayLE( byteArray, 1816, 8);
    @CAN_RadarFL::RXX_Object::RXX_Object_Obj2_FilterInformation = convertRawToPhysical(raw_value, 1.0, 0.0);

    raw_value=copyBitsFromByteArrayLE( byteArray, 1592, 7);
    @CAN_RadarFL::RXX_Object::RXX_Object_Obj2_Length = convertRawToPhysical(raw_value, 0.125, 0.0);

    raw_value=copyBitsFromByteArrayLE( byteArray, 1600, 12);
    @CAN_RadarFL::RXX_Object::RXX_Object_Obj2_LengthVnce = convertRawToPhysical(raw_value, 0.01, 0.0);

    raw_value=copyBitsFromByteArrayLE( byteArray, 1784, 3);
    @CAN_RadarFL::RXX_Object::RXX_Object_Obj2_MeasurementStatus = convertRawToPhysical(raw_value, 1.0, 0.0);

    raw_value=copyBitsFromByteArrayLE( byteArray, 1740, 2);
    @CAN_RadarFL::RXX_Object::RXX_Object_Obj2_MovingStatus = convertRawToPhysical(raw_value, 1.0, 0.0);

    raw_value=copyBitsFromByteArrayLE( byteArray, 1720, 7);
    @CAN_RadarFL::RXX_Object::RXX_Object_Obj2_ObjId = convertRawToPhysical(raw_value, 1.0, 0.0);

    raw_value=copyBitsFromByteArrayLE( byteArray, 1622, 9);
    @CAN_RadarFL::RXX_Object::RXX_Object_Obj2_OrientationYaw = convertRawToPhysical(raw_value, 0.0175, -4.48);

    raw_value=copyBitsFromByteArrayLE( byteArray, 1644, 12);
    @CAN_RadarFL::RXX_Object::RXX_Object_Obj2_OrientationYawVnce = convertRawToPhysical(raw_value, 0.0003, 0.0);

    raw_value=copyBitsFromByteArrayLE( byteArray, 1536, 6);
    @CAN_RadarFL::RXX_Object::RXX_Object_Obj2_ProbClassConfidence = convertRawToPhysical(raw_value, 2.0, 0.0);

    raw_value=copyBitsFromByteArrayLE( byteArray, 1787, 4);
    @CAN_RadarFL::RXX_Object::RXX_Object_Obj2_ProbClassType = convertRawToPhysical(raw_value, 1.0, 0.0);

    raw_value=copyBitsFromByteArrayLE( byteArray, 1542, 14);
    @CAN_RadarFL::RXX_Object::RXX_Object_Obj2_Px = convertRawToPhysical(raw_value, 0.0625, -512.0);

    raw_value=copyBitsFromByteArrayLE( byteArray, 1856, 12);
    @CAN_RadarFL::RXX_Object::RXX_Object_Obj2_PxAxCoVnce = convertRawToPhysical(raw_value, 0.01, 0.0);

    raw_value=copyBitsFromByteArrayLE( byteArray, 1868, 12);
    @CAN_RadarFL::RXX_Object::RXX_Object_Obj2_PxAyCoVnce = convertRawToPhysical(raw_value, 0.01, 0.0);

    raw_value=copyBitsFromByteArrayLE( byteArray, 1772, 12);
    @CAN_RadarFL::RXX_Object::RXX_Object_Obj2_PxPyCoVnce = convertRawToPhysical(raw_value, 0.01, 0.0);

    raw_value=copyBitsFromByteArrayLE( byteArray, 1556, 12);
    @CAN_RadarFL::RXX_Object::RXX_Object_Obj2_PxVnce = convertRawToPhysical(raw_value, 0.1, 0.0);

    raw_value=copyBitsFromByteArrayLE( byteArray, 1792, 12);
    @CAN_RadarFL::RXX_Object::RXX_Object_Obj2_PxVxCoVnce = convertRawToPhysical(raw_value, 0.01, 0.0);

    raw_value=copyBitsFromByteArrayLE( byteArray, 1804, 12);
    @CAN_RadarFL::RXX_Object::RXX_Object_Obj2_PxVyCoVnce = convertRawToPhysical(raw_value, 0.01, 0.0);

    raw_value=copyBitsFromByteArrayLE( byteArray, 1568, 12);
    @CAN_RadarFL::RXX_Object::RXX_Object_Obj2_Py = convertRawToPhysical(raw_value, 0.0625, -128.0);

    raw_value=copyBitsFromByteArrayLE( byteArray, 1888, 12);
    @CAN_RadarFL::RXX_Object::RXX_Object_Obj2_PyAxCoVnce = convertRawToPhysical(raw_value, 0.01, 0.0);

    raw_value=copyBitsFromByteArrayLE( byteArray, 1900, 12);
    @CAN_RadarFL::RXX_Object::RXX_Object_Obj2_PyAyCoVnce = convertRawToPhysical(raw_value, 0.01, 0.0);

    raw_value=copyBitsFromByteArrayLE( byteArray, 1580, 12);
    @CAN_RadarFL::RXX_Object::RXX_Object_Obj2_PyVnce = convertRawToPhysical(raw_value, 0.1, 0.0);

    raw_value=copyBitsFromByteArrayLE( byteArray, 1824, 12);
    @CAN_RadarFL::RXX_Object::RXX_Object_Obj2_PyVxCoVnce = convertRawToPhysical(raw_value, 0.01, 0.0);

    raw_value=copyBitsFromByteArrayLE( byteArray, 1836, 12);
    @CAN_RadarFL::RXX_Object::RXX_Object_Obj2_PyVyCoVnce = convertRawToPhysical(raw_value, 0.01, 0.0);

    raw_value=copyBitsFromByteArrayLE( byteArray, 1676, 10);
    @CAN_RadarFL::RXX_Object::RXX_Object_Obj2_RCS = convertRawToPhysical(raw_value, 0.2, -102.4);

    raw_value=copyBitsFromByteArrayLE( byteArray, 1848, 4);
    @CAN_RadarFL::RXX_Object::RXX_Object_Obj2_ReferencePoint = convertRawToPhysical(raw_value, 1.0, 0.0);

    raw_value=copyBitsFromByteArrayLE( byteArray, 1708, 12);
    @CAN_RadarFL::RXX_Object::RXX_Object_Obj2_Vx = convertRawToPhysical(raw_value, 0.0625, -128.0);

    raw_value=copyBitsFromByteArrayLE( byteArray, 1932, 12);
    @CAN_RadarFL::RXX_Object::RXX_Object_Obj2_VxAxCoVnce = convertRawToPhysical(raw_value, 0.01, 0.0);

    raw_value=copyBitsFromByteArrayLE( byteArray, 1952, 12);
    @CAN_RadarFL::RXX_Object::RXX_Object_Obj2_VxAyCoVnce = convertRawToPhysical(raw_value, 0.01, 0.0);

    raw_value=copyBitsFromByteArrayLE( byteArray, 1728, 12);
    @CAN_RadarFL::RXX_Object::RXX_Object_Obj2_VxVnce = convertRawToPhysical(raw_value, 0.01, 0.0);

    raw_value=copyBitsFromByteArrayLE( byteArray, 1920, 12);
    @CAN_RadarFL::RXX_Object::RXX_Object_Obj2_VxVyCoVnce = convertRawToPhysical(raw_value, 0.01, 0.0);

    raw_value=copyBitsFromByteArrayLE( byteArray, 1742, 10);
    @CAN_RadarFL::RXX_Object::RXX_Object_Obj2_Vy = convertRawToPhysical(raw_value, 0.125, -64.0);

    raw_value=copyBitsFromByteArrayLE( byteArray, 1964, 12);
    @CAN_RadarFL::RXX_Object::RXX_Object_Obj2_VyAxCoVnce = convertRawToPhysical(raw_value, 0.01, 0.0);

    raw_value=copyBitsFromByteArrayLE( byteArray, 1984, 12);
    @CAN_RadarFL::RXX_Object::RXX_Object_Obj2_VyAyCoVnce = convertRawToPhysical(raw_value, 0.01, 0.0);

    raw_value=copyBitsFromByteArrayLE( byteArray, 1760, 12);
    @CAN_RadarFL::RXX_Object::RXX_Object_Obj2_VyVnce = convertRawToPhysical(raw_value, 0.01, 0.0);

    raw_value=copyBitsFromByteArrayLE( byteArray, 1656, 7);
    @CAN_RadarFL::RXX_Object::RXX_Object_Obj2_Width = convertRawToPhysical(raw_value, 0.125, 0.0);

    raw_value=copyBitsFromByteArrayLE( byteArray, 1664, 12);
    @CAN_RadarFL::RXX_Object::RXX_Object_Obj2_WidthVnce = convertRawToPhysical(raw_value, 0.01, 0.0);

    raw_value=copyBitsFromByteArrayLE( byteArray, 16352, 32);
    @CAN_RadarFL::RXX_Object::RXX_Object_Obj30_Age = convertRawToPhysical(raw_value, 1.0, 0.0);

    raw_value=copyBitsFromByteArrayLE( byteArray, 15948, 10);
    @CAN_RadarFL::RXX_Object::RXX_Object_Obj30_Ax = convertRawToPhysical(raw_value, 0.03125, -16.0);

    raw_value=copyBitsFromByteArrayLE( byteArray, 16332, 12);
    @CAN_RadarFL::RXX_Object::RXX_Object_Obj30_AxAyCoVnce = convertRawToPhysical(raw_value, 0.01, 0.0);

    raw_value=copyBitsFromByteArrayLE( byteArray, 15968, 12);
    @CAN_RadarFL::RXX_Object::RXX_Object_Obj30_AxVnce = convertRawToPhysical(raw_value, 0.01, 0.0);

    raw_value=copyBitsFromByteArrayLE( byteArray, 16022, 9);
    @CAN_RadarFL::RXX_Object::RXX_Object_Obj30_Ay = convertRawToPhysical(raw_value, 0.0625, -16.0);

    raw_value=copyBitsFromByteArrayLE( byteArray, 16032, 12);
    @CAN_RadarFL::RXX_Object::RXX_Object_Obj30_AyVnce = convertRawToPhysical(raw_value, 0.01, 0.0);

    raw_value=copyBitsFromByteArrayLE( byteArray, 16088, 6);
    @CAN_RadarFL::RXX_Object::RXX_Object_Obj30_ExistProb = convertRawToPhysical(raw_value, 2.0, 0.0);

    raw_value=copyBitsFromByteArrayLE( byteArray, 16152, 8);
    @CAN_RadarFL::RXX_Object::RXX_Object_Obj30_FilterInformation = convertRawToPhysical(raw_value, 1.0, 0.0);

    raw_value=copyBitsFromByteArrayLE( byteArray, 15928, 7);
    @CAN_RadarFL::RXX_Object::RXX_Object_Obj30_Length = convertRawToPhysical(raw_value, 0.125, 0.0);

    raw_value=copyBitsFromByteArrayLE( byteArray, 15936, 12);
    @CAN_RadarFL::RXX_Object::RXX_Object_Obj30_LengthVnce = convertRawToPhysical(raw_value, 0.01, 0.0);

    raw_value=copyBitsFromByteArrayLE( byteArray, 16120, 3);
    @CAN_RadarFL::RXX_Object::RXX_Object_Obj30_MeasurementStatus = convertRawToPhysical(raw_value, 1.0, 0.0);

    raw_value=copyBitsFromByteArrayLE( byteArray, 16076, 2);
    @CAN_RadarFL::RXX_Object::RXX_Object_Obj30_MovingStatus = convertRawToPhysical(raw_value, 1.0, 0.0);

    raw_value=copyBitsFromByteArrayLE( byteArray, 16056, 7);
    @CAN_RadarFL::RXX_Object::RXX_Object_Obj30_ObjId = convertRawToPhysical(raw_value, 1.0, 0.0);

    raw_value=copyBitsFromByteArrayLE( byteArray, 15958, 9);
    @CAN_RadarFL::RXX_Object::RXX_Object_Obj30_OrientationYaw = convertRawToPhysical(raw_value, 0.0175, -4.48);

    raw_value=copyBitsFromByteArrayLE( byteArray, 15980, 12);
    @CAN_RadarFL::RXX_Object::RXX_Object_Obj30_OrientationYawVnce = convertRawToPhysical(raw_value, 0.0003, 0.0);

    raw_value=copyBitsFromByteArrayLE( byteArray, 15872, 6);
    @CAN_RadarFL::RXX_Object::RXX_Object_Obj30_ProbClassConfidence = convertRawToPhysical(raw_value, 2.0, 0.0);

    raw_value=copyBitsFromByteArrayLE( byteArray, 16123, 4);
    @CAN_RadarFL::RXX_Object::RXX_Object_Obj30_ProbClassType = convertRawToPhysical(raw_value, 1.0, 0.0);

    raw_value=copyBitsFromByteArrayLE( byteArray, 15878, 14);
    @CAN_RadarFL::RXX_Object::RXX_Object_Obj30_Px = convertRawToPhysical(raw_value, 0.0625, -512.0);

    raw_value=copyBitsFromByteArrayLE( byteArray, 16192, 12);
    @CAN_RadarFL::RXX_Object::RXX_Object_Obj30_PxAxCoVnce = convertRawToPhysical(raw_value, 0.01, 0.0);

    raw_value=copyBitsFromByteArrayLE( byteArray, 16204, 12);
    @CAN_RadarFL::RXX_Object::RXX_Object_Obj30_PxAyCoVnce = convertRawToPhysical(raw_value, 0.01, 0.0);

    raw_value=copyBitsFromByteArrayLE( byteArray, 16108, 12);
    @CAN_RadarFL::RXX_Object::RXX_Object_Obj30_PxPyCoVnce = convertRawToPhysical(raw_value, 0.01, 0.0);

    raw_value=copyBitsFromByteArrayLE( byteArray, 15892, 12);
    @CAN_RadarFL::RXX_Object::RXX_Object_Obj30_PxVnce = convertRawToPhysical(raw_value, 0.1, 0.0);

    raw_value=copyBitsFromByteArrayLE( byteArray, 16128, 12);
    @CAN_RadarFL::RXX_Object::RXX_Object_Obj30_PxVxCoVnce = convertRawToPhysical(raw_value, 0.01, 0.0);

    raw_value=copyBitsFromByteArrayLE( byteArray, 16140, 12);
    @CAN_RadarFL::RXX_Object::RXX_Object_Obj30_PxVyCoVnce = convertRawToPhysical(raw_value, 0.01, 0.0);

    raw_value=copyBitsFromByteArrayLE( byteArray, 15904, 12);
    @CAN_RadarFL::RXX_Object::RXX_Object_Obj30_Py = convertRawToPhysical(raw_value, 0.0625, -128.0);

    raw_value=copyBitsFromByteArrayLE( byteArray, 16224, 12);
    @CAN_RadarFL::RXX_Object::RXX_Object_Obj30_PyAxCoVnce = convertRawToPhysical(raw_value, 0.01, 0.0);

    raw_value=copyBitsFromByteArrayLE( byteArray, 16236, 12);
    @CAN_RadarFL::RXX_Object::RXX_Object_Obj30_PyAyCoVnce = convertRawToPhysical(raw_value, 0.01, 0.0);

    raw_value=copyBitsFromByteArrayLE( byteArray, 15916, 12);
    @CAN_RadarFL::RXX_Object::RXX_Object_Obj30_PyVnce = convertRawToPhysical(raw_value, 0.1, 0.0);

    raw_value=copyBitsFromByteArrayLE( byteArray, 16160, 12);
    @CAN_RadarFL::RXX_Object::RXX_Object_Obj30_PyVxCoVnce = convertRawToPhysical(raw_value, 0.01, 0.0);

    raw_value=copyBitsFromByteArrayLE( byteArray, 16172, 12);
    @CAN_RadarFL::RXX_Object::RXX_Object_Obj30_PyVyCoVnce = convertRawToPhysical(raw_value, 0.01, 0.0);

    raw_value=copyBitsFromByteArrayLE( byteArray, 16012, 10);
    @CAN_RadarFL::RXX_Object::RXX_Object_Obj30_RCS = convertRawToPhysical(raw_value, 0.2, -102.4);

    raw_value=copyBitsFromByteArrayLE( byteArray, 16184, 4);
    @CAN_RadarFL::RXX_Object::RXX_Object_Obj30_ReferencePoint = convertRawToPhysical(raw_value, 1.0, 0.0);

    raw_value=copyBitsFromByteArrayLE( byteArray, 16044, 12);
    @CAN_RadarFL::RXX_Object::RXX_Object_Obj30_Vx = convertRawToPhysical(raw_value, 0.0625, -128.0);

    raw_value=copyBitsFromByteArrayLE( byteArray, 16268, 12);
    @CAN_RadarFL::RXX_Object::RXX_Object_Obj30_VxAxCoVnce = convertRawToPhysical(raw_value, 0.01, 0.0);

    raw_value=copyBitsFromByteArrayLE( byteArray, 16288, 12);
    @CAN_RadarFL::RXX_Object::RXX_Object_Obj30_VxAyCoVnce = convertRawToPhysical(raw_value, 0.01, 0.0);

    raw_value=copyBitsFromByteArrayLE( byteArray, 16064, 12);
    @CAN_RadarFL::RXX_Object::RXX_Object_Obj30_VxVnce = convertRawToPhysical(raw_value, 0.01, 0.0);

    raw_value=copyBitsFromByteArrayLE( byteArray, 16256, 12);
    @CAN_RadarFL::RXX_Object::RXX_Object_Obj30_VxVyCoVnce = convertRawToPhysical(raw_value, 0.01, 0.0);

    raw_value=copyBitsFromByteArrayLE( byteArray, 16078, 10);
    @CAN_RadarFL::RXX_Object::RXX_Object_Obj30_Vy = convertRawToPhysical(raw_value, 0.125, -64.0);

    raw_value=copyBitsFromByteArrayLE( byteArray, 16300, 12);
    @CAN_RadarFL::RXX_Object::RXX_Object_Obj30_VyAxCoVnce = convertRawToPhysical(raw_value, 0.01, 0.0);

    raw_value=copyBitsFromByteArrayLE( byteArray, 16320, 12);
    @CAN_RadarFL::RXX_Object::RXX_Object_Obj30_VyAyCoVnce = convertRawToPhysical(raw_value, 0.01, 0.0);

    raw_value=copyBitsFromByteArrayLE( byteArray, 16096, 12);
    @CAN_RadarFL::RXX_Object::RXX_Object_Obj30_VyVnce = convertRawToPhysical(raw_value, 0.01, 0.0);

    raw_value=copyBitsFromByteArrayLE( byteArray, 15992, 7);
    @CAN_RadarFL::RXX_Object::RXX_Object_Obj30_Width = convertRawToPhysical(raw_value, 0.125, 0.0);

    raw_value=copyBitsFromByteArrayLE( byteArray, 16000, 12);
    @CAN_RadarFL::RXX_Object::RXX_Object_Obj30_WidthVnce = convertRawToPhysical(raw_value, 0.01, 0.0);

    raw_value=copyBitsFromByteArrayLE( byteArray, 16864, 32);
    @CAN_RadarFL::RXX_Object::RXX_Object_Obj31_Age = convertRawToPhysical(raw_value, 1.0, 0.0);

    raw_value=copyBitsFromByteArrayLE( byteArray, 16460, 10);
    @CAN_RadarFL::RXX_Object::RXX_Object_Obj31_Ax = convertRawToPhysical(raw_value, 0.03125, -16.0);

    raw_value=copyBitsFromByteArrayLE( byteArray, 16844, 12);
    @CAN_RadarFL::RXX_Object::RXX_Object_Obj31_AxAyCoVnce = convertRawToPhysical(raw_value, 0.01, 0.0);

    raw_value=copyBitsFromByteArrayLE( byteArray, 16480, 12);
    @CAN_RadarFL::RXX_Object::RXX_Object_Obj31_AxVnce = convertRawToPhysical(raw_value, 0.01, 0.0);

    raw_value=copyBitsFromByteArrayLE( byteArray, 16534, 9);
    @CAN_RadarFL::RXX_Object::RXX_Object_Obj31_Ay = convertRawToPhysical(raw_value, 0.0625, -16.0);

    raw_value=copyBitsFromByteArrayLE( byteArray, 16544, 12);
    @CAN_RadarFL::RXX_Object::RXX_Object_Obj31_AyVnce = convertRawToPhysical(raw_value, 0.01, 0.0);

    raw_value=copyBitsFromByteArrayLE( byteArray, 16600, 6);
    @CAN_RadarFL::RXX_Object::RXX_Object_Obj31_ExistProb = convertRawToPhysical(raw_value, 2.0, 0.0);

    raw_value=copyBitsFromByteArrayLE( byteArray, 16664, 8);
    @CAN_RadarFL::RXX_Object::RXX_Object_Obj31_FilterInformation = convertRawToPhysical(raw_value, 1.0, 0.0);

    raw_value=copyBitsFromByteArrayLE( byteArray, 16440, 7);
    @CAN_RadarFL::RXX_Object::RXX_Object_Obj31_Length = convertRawToPhysical(raw_value, 0.125, 0.0);

    raw_value=copyBitsFromByteArrayLE( byteArray, 16448, 12);
    @CAN_RadarFL::RXX_Object::RXX_Object_Obj31_LengthVnce = convertRawToPhysical(raw_value, 0.01, 0.0);

    raw_value=copyBitsFromByteArrayLE( byteArray, 16632, 3);
    @CAN_RadarFL::RXX_Object::RXX_Object_Obj31_MeasurementStatus = convertRawToPhysical(raw_value, 1.0, 0.0);

    raw_value=copyBitsFromByteArrayLE( byteArray, 16588, 2);
    @CAN_RadarFL::RXX_Object::RXX_Object_Obj31_MovingStatus = convertRawToPhysical(raw_value, 1.0, 0.0);

    raw_value=copyBitsFromByteArrayLE( byteArray, 16568, 7);
    @CAN_RadarFL::RXX_Object::RXX_Object_Obj31_ObjId = convertRawToPhysical(raw_value, 1.0, 0.0);

    raw_value=copyBitsFromByteArrayLE( byteArray, 16470, 9);
    @CAN_RadarFL::RXX_Object::RXX_Object_Obj31_OrientationYaw = convertRawToPhysical(raw_value, 0.0175, -4.48);

    raw_value=copyBitsFromByteArrayLE( byteArray, 16492, 12);
    @CAN_RadarFL::RXX_Object::RXX_Object_Obj31_OrientationYawVnce = convertRawToPhysical(raw_value, 0.0003, 0.0);

    raw_value=copyBitsFromByteArrayLE( byteArray, 16384, 6);
    @CAN_RadarFL::RXX_Object::RXX_Object_Obj31_ProbClassConfidence = convertRawToPhysical(raw_value, 2.0, 0.0);

    raw_value=copyBitsFromByteArrayLE( byteArray, 16635, 4);
    @CAN_RadarFL::RXX_Object::RXX_Object_Obj31_ProbClassType = convertRawToPhysical(raw_value, 1.0, 0.0);

    raw_value=copyBitsFromByteArrayLE( byteArray, 16390, 14);
    @CAN_RadarFL::RXX_Object::RXX_Object_Obj31_Px = convertRawToPhysical(raw_value, 0.0625, -512.0);

    raw_value=copyBitsFromByteArrayLE( byteArray, 16704, 12);
    @CAN_RadarFL::RXX_Object::RXX_Object_Obj31_PxAxCoVnce = convertRawToPhysical(raw_value, 0.01, 0.0);

    raw_value=copyBitsFromByteArrayLE( byteArray, 16716, 12);
    @CAN_RadarFL::RXX_Object::RXX_Object_Obj31_PxAyCoVnce = convertRawToPhysical(raw_value, 0.01, 0.0);

    raw_value=copyBitsFromByteArrayLE( byteArray, 16620, 12);
    @CAN_RadarFL::RXX_Object::RXX_Object_Obj31_PxPyCoVnce = convertRawToPhysical(raw_value, 0.01, 0.0);

    raw_value=copyBitsFromByteArrayLE( byteArray, 16404, 12);
    @CAN_RadarFL::RXX_Object::RXX_Object_Obj31_PxVnce = convertRawToPhysical(raw_value, 0.1, 0.0);

    raw_value=copyBitsFromByteArrayLE( byteArray, 16640, 12);
    @CAN_RadarFL::RXX_Object::RXX_Object_Obj31_PxVxCoVnce = convertRawToPhysical(raw_value, 0.01, 0.0);

    raw_value=copyBitsFromByteArrayLE( byteArray, 16652, 12);
    @CAN_RadarFL::RXX_Object::RXX_Object_Obj31_PxVyCoVnce = convertRawToPhysical(raw_value, 0.01, 0.0);

    raw_value=copyBitsFromByteArrayLE( byteArray, 16416, 12);
    @CAN_RadarFL::RXX_Object::RXX_Object_Obj31_Py = convertRawToPhysical(raw_value, 0.0625, -128.0);

    raw_value=copyBitsFromByteArrayLE( byteArray, 16736, 12);
    @CAN_RadarFL::RXX_Object::RXX_Object_Obj31_PyAxCoVnce = convertRawToPhysical(raw_value, 0.01, 0.0);

    raw_value=copyBitsFromByteArrayLE( byteArray, 16748, 12);
    @CAN_RadarFL::RXX_Object::RXX_Object_Obj31_PyAyCoVnce = convertRawToPhysical(raw_value, 0.01, 0.0);

    raw_value=copyBitsFromByteArrayLE( byteArray, 16428, 12);
    @CAN_RadarFL::RXX_Object::RXX_Object_Obj31_PyVnce = convertRawToPhysical(raw_value, 0.1, 0.0);

    raw_value=copyBitsFromByteArrayLE( byteArray, 16672, 12);
    @CAN_RadarFL::RXX_Object::RXX_Object_Obj31_PyVxCoVnce = convertRawToPhysical(raw_value, 0.01, 0.0);

    raw_value=copyBitsFromByteArrayLE( byteArray, 16684, 12);
    @CAN_RadarFL::RXX_Object::RXX_Object_Obj31_PyVyCoVnce = convertRawToPhysical(raw_value, 0.01, 0.0);

    raw_value=copyBitsFromByteArrayLE( byteArray, 16524, 10);
    @CAN_RadarFL::RXX_Object::RXX_Object_Obj31_RCS = convertRawToPhysical(raw_value, 0.2, -102.4);

    raw_value=copyBitsFromByteArrayLE( byteArray, 16696, 4);
    @CAN_RadarFL::RXX_Object::RXX_Object_Obj31_ReferencePoint = convertRawToPhysical(raw_value, 1.0, 0.0);

    raw_value=copyBitsFromByteArrayLE( byteArray, 16556, 12);
    @CAN_RadarFL::RXX_Object::RXX_Object_Obj31_Vx = convertRawToPhysical(raw_value, 0.0625, -128.0);

    raw_value=copyBitsFromByteArrayLE( byteArray, 16780, 12);
    @CAN_RadarFL::RXX_Object::RXX_Object_Obj31_VxAxCoVnce = convertRawToPhysical(raw_value, 0.01, 0.0);

    raw_value=copyBitsFromByteArrayLE( byteArray, 16800, 12);
    @CAN_RadarFL::RXX_Object::RXX_Object_Obj31_VxAyCoVnce = convertRawToPhysical(raw_value, 0.01, 0.0);

    raw_value=copyBitsFromByteArrayLE( byteArray, 16576, 12);
    @CAN_RadarFL::RXX_Object::RXX_Object_Obj31_VxVnce = convertRawToPhysical(raw_value, 0.01, 0.0);

    raw_value=copyBitsFromByteArrayLE( byteArray, 16768, 12);
    @CAN_RadarFL::RXX_Object::RXX_Object_Obj31_VxVyCoVnce = convertRawToPhysical(raw_value, 0.01, 0.0);

    raw_value=copyBitsFromByteArrayLE( byteArray, 16590, 10);
    @CAN_RadarFL::RXX_Object::RXX_Object_Obj31_Vy = convertRawToPhysical(raw_value, 0.125, -64.0);

    raw_value=copyBitsFromByteArrayLE( byteArray, 16812, 12);
    @CAN_RadarFL::RXX_Object::RXX_Object_Obj31_VyAxCoVnce = convertRawToPhysical(raw_value, 0.01, 0.0);

    raw_value=copyBitsFromByteArrayLE( byteArray, 16832, 12);
    @CAN_RadarFL::RXX_Object::RXX_Object_Obj31_VyAyCoVnce = convertRawToPhysical(raw_value, 0.01, 0.0);

    raw_value=copyBitsFromByteArrayLE( byteArray, 16608, 12);
    @CAN_RadarFL::RXX_Object::RXX_Object_Obj31_VyVnce = convertRawToPhysical(raw_value, 0.01, 0.0);

    raw_value=copyBitsFromByteArrayLE( byteArray, 16504, 7);
    @CAN_RadarFL::RXX_Object::RXX_Object_Obj31_Width = convertRawToPhysical(raw_value, 0.125, 0.0);

    raw_value=copyBitsFromByteArrayLE( byteArray, 16512, 12);
    @CAN_RadarFL::RXX_Object::RXX_Object_Obj31_WidthVnce = convertRawToPhysical(raw_value, 0.01, 0.0);

    raw_value=copyBitsFromByteArrayLE( byteArray, 17376, 32);
    @CAN_RadarFL::RXX_Object::RXX_Object_Obj32_Age = convertRawToPhysical(raw_value, 1.0, 0.0);

    raw_value=copyBitsFromByteArrayLE( byteArray, 16972, 10);
    @CAN_RadarFL::RXX_Object::RXX_Object_Obj32_Ax = convertRawToPhysical(raw_value, 0.03125, -16.0);

    raw_value=copyBitsFromByteArrayLE( byteArray, 17356, 12);
    @CAN_RadarFL::RXX_Object::RXX_Object_Obj32_AxAyCoVnce = convertRawToPhysical(raw_value, 0.01, 0.0);

    raw_value=copyBitsFromByteArrayLE( byteArray, 16992, 12);
    @CAN_RadarFL::RXX_Object::RXX_Object_Obj32_AxVnce = convertRawToPhysical(raw_value, 0.01, 0.0);

    raw_value=copyBitsFromByteArrayLE( byteArray, 17046, 9);
    @CAN_RadarFL::RXX_Object::RXX_Object_Obj32_Ay = convertRawToPhysical(raw_value, 0.0625, -16.0);

    raw_value=copyBitsFromByteArrayLE( byteArray, 17056, 12);
    @CAN_RadarFL::RXX_Object::RXX_Object_Obj32_AyVnce = convertRawToPhysical(raw_value, 0.01, 0.0);

    raw_value=copyBitsFromByteArrayLE( byteArray, 17112, 6);
    @CAN_RadarFL::RXX_Object::RXX_Object_Obj32_ExistProb = convertRawToPhysical(raw_value, 2.0, 0.0);

    raw_value=copyBitsFromByteArrayLE( byteArray, 17176, 8);
    @CAN_RadarFL::RXX_Object::RXX_Object_Obj32_FilterInformation = convertRawToPhysical(raw_value, 1.0, 0.0);

    raw_value=copyBitsFromByteArrayLE( byteArray, 16952, 7);
    @CAN_RadarFL::RXX_Object::RXX_Object_Obj32_Length = convertRawToPhysical(raw_value, 0.125, 0.0);

    raw_value=copyBitsFromByteArrayLE( byteArray, 16960, 12);
    @CAN_RadarFL::RXX_Object::RXX_Object_Obj32_LengthVnce = convertRawToPhysical(raw_value, 0.01, 0.0);

    raw_value=copyBitsFromByteArrayLE( byteArray, 17144, 3);
    @CAN_RadarFL::RXX_Object::RXX_Object_Obj32_MeasurementStatus = convertRawToPhysical(raw_value, 1.0, 0.0);

    raw_value=copyBitsFromByteArrayLE( byteArray, 17100, 2);
    @CAN_RadarFL::RXX_Object::RXX_Object_Obj32_MovingStatus = convertRawToPhysical(raw_value, 1.0, 0.0);

    raw_value=copyBitsFromByteArrayLE( byteArray, 17080, 7);
    @CAN_RadarFL::RXX_Object::RXX_Object_Obj32_ObjId = convertRawToPhysical(raw_value, 1.0, 0.0);

    raw_value=copyBitsFromByteArrayLE( byteArray, 16982, 9);
    @CAN_RadarFL::RXX_Object::RXX_Object_Obj32_OrientationYaw = convertRawToPhysical(raw_value, 0.0175, -4.48);

    raw_value=copyBitsFromByteArrayLE( byteArray, 17004, 12);
    @CAN_RadarFL::RXX_Object::RXX_Object_Obj32_OrientationYawVnce = convertRawToPhysical(raw_value, 0.0003, 0.0);

    raw_value=copyBitsFromByteArrayLE( byteArray, 16896, 6);
    @CAN_RadarFL::RXX_Object::RXX_Object_Obj32_ProbClassConfidence = convertRawToPhysical(raw_value, 2.0, 0.0);

    raw_value=copyBitsFromByteArrayLE( byteArray, 17147, 4);
    @CAN_RadarFL::RXX_Object::RXX_Object_Obj32_ProbClassType = convertRawToPhysical(raw_value, 1.0, 0.0);

    raw_value=copyBitsFromByteArrayLE( byteArray, 16902, 14);
    @CAN_RadarFL::RXX_Object::RXX_Object_Obj32_Px = convertRawToPhysical(raw_value, 0.0625, -512.0);

    raw_value=copyBitsFromByteArrayLE( byteArray, 17216, 12);
    @CAN_RadarFL::RXX_Object::RXX_Object_Obj32_PxAxCoVnce = convertRawToPhysical(raw_value, 0.01, 0.0);

    raw_value=copyBitsFromByteArrayLE( byteArray, 17228, 12);
    @CAN_RadarFL::RXX_Object::RXX_Object_Obj32_PxAyCoVnce = convertRawToPhysical(raw_value, 0.01, 0.0);

    raw_value=copyBitsFromByteArrayLE( byteArray, 17132, 12);
    @CAN_RadarFL::RXX_Object::RXX_Object_Obj32_PxPyCoVnce = convertRawToPhysical(raw_value, 0.01, 0.0);

    raw_value=copyBitsFromByteArrayLE( byteArray, 16916, 12);
    @CAN_RadarFL::RXX_Object::RXX_Object_Obj32_PxVnce = convertRawToPhysical(raw_value, 0.1, 0.0);

    raw_value=copyBitsFromByteArrayLE( byteArray, 17152, 12);
    @CAN_RadarFL::RXX_Object::RXX_Object_Obj32_PxVxCoVnce = convertRawToPhysical(raw_value, 0.01, 0.0);

    raw_value=copyBitsFromByteArrayLE( byteArray, 17164, 12);
    @CAN_RadarFL::RXX_Object::RXX_Object_Obj32_PxVyCoVnce = convertRawToPhysical(raw_value, 0.01, 0.0);

    raw_value=copyBitsFromByteArrayLE( byteArray, 16928, 12);
    @CAN_RadarFL::RXX_Object::RXX_Object_Obj32_Py = convertRawToPhysical(raw_value, 0.0625, -128.0);

    raw_value=copyBitsFromByteArrayLE( byteArray, 17248, 12);
    @CAN_RadarFL::RXX_Object::RXX_Object_Obj32_PyAxCoVnce = convertRawToPhysical(raw_value, 0.01, 0.0);

    raw_value=copyBitsFromByteArrayLE( byteArray, 17260, 12);
    @CAN_RadarFL::RXX_Object::RXX_Object_Obj32_PyAyCoVnce = convertRawToPhysical(raw_value, 0.01, 0.0);

    raw_value=copyBitsFromByteArrayLE( byteArray, 16940, 12);
    @CAN_RadarFL::RXX_Object::RXX_Object_Obj32_PyVnce = convertRawToPhysical(raw_value, 0.1, 0.0);

    raw_value=copyBitsFromByteArrayLE( byteArray, 17184, 12);
    @CAN_RadarFL::RXX_Object::RXX_Object_Obj32_PyVxCoVnce = convertRawToPhysical(raw_value, 0.01, 0.0);

    raw_value=copyBitsFromByteArrayLE( byteArray, 17196, 12);
    @CAN_RadarFL::RXX_Object::RXX_Object_Obj32_PyVyCoVnce = convertRawToPhysical(raw_value, 0.01, 0.0);

    raw_value=copyBitsFromByteArrayLE( byteArray, 17036, 10);
    @CAN_RadarFL::RXX_Object::RXX_Object_Obj32_RCS = convertRawToPhysical(raw_value, 0.2, -102.4);

    raw_value=copyBitsFromByteArrayLE( byteArray, 17208, 4);
    @CAN_RadarFL::RXX_Object::RXX_Object_Obj32_ReferencePoint = convertRawToPhysical(raw_value, 1.0, 0.0);

    raw_value=copyBitsFromByteArrayLE( byteArray, 17068, 12);
    @CAN_RadarFL::RXX_Object::RXX_Object_Obj32_Vx = convertRawToPhysical(raw_value, 0.0625, -128.0);

    raw_value=copyBitsFromByteArrayLE( byteArray, 17292, 12);
    @CAN_RadarFL::RXX_Object::RXX_Object_Obj32_VxAxCoVnce = convertRawToPhysical(raw_value, 0.01, 0.0);

    raw_value=copyBitsFromByteArrayLE( byteArray, 17312, 12);
    @CAN_RadarFL::RXX_Object::RXX_Object_Obj32_VxAyCoVnce = convertRawToPhysical(raw_value, 0.01, 0.0);

    raw_value=copyBitsFromByteArrayLE( byteArray, 17088, 12);
    @CAN_RadarFL::RXX_Object::RXX_Object_Obj32_VxVnce = convertRawToPhysical(raw_value, 0.01, 0.0);

    raw_value=copyBitsFromByteArrayLE( byteArray, 17280, 12);
    @CAN_RadarFL::RXX_Object::RXX_Object_Obj32_VxVyCoVnce = convertRawToPhysical(raw_value, 0.01, 0.0);

    raw_value=copyBitsFromByteArrayLE( byteArray, 17102, 10);
    @CAN_RadarFL::RXX_Object::RXX_Object_Obj32_Vy = convertRawToPhysical(raw_value, 0.125, -64.0);

    raw_value=copyBitsFromByteArrayLE( byteArray, 17324, 12);
    @CAN_RadarFL::RXX_Object::RXX_Object_Obj32_VyAxCoVnce = convertRawToPhysical(raw_value, 0.01, 0.0);

    raw_value=copyBitsFromByteArrayLE( byteArray, 17344, 12);
    @CAN_RadarFL::RXX_Object::RXX_Object_Obj32_VyAyCoVnce = convertRawToPhysical(raw_value, 0.01, 0.0);

    raw_value=copyBitsFromByteArrayLE( byteArray, 17120, 12);
    @CAN_RadarFL::RXX_Object::RXX_Object_Obj32_VyVnce = convertRawToPhysical(raw_value, 0.01, 0.0);

    raw_value=copyBitsFromByteArrayLE( byteArray, 17016, 7);
    @CAN_RadarFL::RXX_Object::RXX_Object_Obj32_Width = convertRawToPhysical(raw_value, 0.125, 0.0);

    raw_value=copyBitsFromByteArrayLE( byteArray, 17024, 12);
    @CAN_RadarFL::RXX_Object::RXX_Object_Obj32_WidthVnce = convertRawToPhysical(raw_value, 0.01, 0.0);

    raw_value=copyBitsFromByteArrayLE( byteArray, 17888, 32);
    @CAN_RadarFL::RXX_Object::RXX_Object_Obj33_Age = convertRawToPhysical(raw_value, 1.0, 0.0);

    raw_value=copyBitsFromByteArrayLE( byteArray, 17484, 10);
    @CAN_RadarFL::RXX_Object::RXX_Object_Obj33_Ax = convertRawToPhysical(raw_value, 0.03125, -16.0);

    raw_value=copyBitsFromByteArrayLE( byteArray, 17868, 12);
    @CAN_RadarFL::RXX_Object::RXX_Object_Obj33_AxAyCoVnce = convertRawToPhysical(raw_value, 0.01, 0.0);

    raw_value=copyBitsFromByteArrayLE( byteArray, 17504, 12);
    @CAN_RadarFL::RXX_Object::RXX_Object_Obj33_AxVnce = convertRawToPhysical(raw_value, 0.01, 0.0);

    raw_value=copyBitsFromByteArrayLE( byteArray, 17558, 9);
    @CAN_RadarFL::RXX_Object::RXX_Object_Obj33_Ay = convertRawToPhysical(raw_value, 0.0625, -16.0);

    raw_value=copyBitsFromByteArrayLE( byteArray, 17568, 12);
    @CAN_RadarFL::RXX_Object::RXX_Object_Obj33_AyVnce = convertRawToPhysical(raw_value, 0.01, 0.0);

    raw_value=copyBitsFromByteArrayLE( byteArray, 17624, 6);
    @CAN_RadarFL::RXX_Object::RXX_Object_Obj33_ExistProb = convertRawToPhysical(raw_value, 2.0, 0.0);

    raw_value=copyBitsFromByteArrayLE( byteArray, 17688, 8);
    @CAN_RadarFL::RXX_Object::RXX_Object_Obj33_FilterInformation = convertRawToPhysical(raw_value, 1.0, 0.0);

    raw_value=copyBitsFromByteArrayLE( byteArray, 17464, 7);
    @CAN_RadarFL::RXX_Object::RXX_Object_Obj33_Length = convertRawToPhysical(raw_value, 0.125, 0.0);

    raw_value=copyBitsFromByteArrayLE( byteArray, 17472, 12);
    @CAN_RadarFL::RXX_Object::RXX_Object_Obj33_LengthVnce = convertRawToPhysical(raw_value, 0.01, 0.0);

    raw_value=copyBitsFromByteArrayLE( byteArray, 17656, 3);
    @CAN_RadarFL::RXX_Object::RXX_Object_Obj33_MeasurementStatus = convertRawToPhysical(raw_value, 1.0, 0.0);

    raw_value=copyBitsFromByteArrayLE( byteArray, 17612, 2);
    @CAN_RadarFL::RXX_Object::RXX_Object_Obj33_MovingStatus = convertRawToPhysical(raw_value, 1.0, 0.0);

    raw_value=copyBitsFromByteArrayLE( byteArray, 17592, 7);
    @CAN_RadarFL::RXX_Object::RXX_Object_Obj33_ObjId = convertRawToPhysical(raw_value, 1.0, 0.0);

    raw_value=copyBitsFromByteArrayLE( byteArray, 17494, 9);
    @CAN_RadarFL::RXX_Object::RXX_Object_Obj33_OrientationYaw = convertRawToPhysical(raw_value, 0.0175, -4.48);

    raw_value=copyBitsFromByteArrayLE( byteArray, 17516, 12);
    @CAN_RadarFL::RXX_Object::RXX_Object_Obj33_OrientationYawVnce = convertRawToPhysical(raw_value, 0.0003, 0.0);

    raw_value=copyBitsFromByteArrayLE( byteArray, 17408, 6);
    @CAN_RadarFL::RXX_Object::RXX_Object_Obj33_ProbClassConfidence = convertRawToPhysical(raw_value, 2.0, 0.0);

    raw_value=copyBitsFromByteArrayLE( byteArray, 17659, 4);
    @CAN_RadarFL::RXX_Object::RXX_Object_Obj33_ProbClassType = convertRawToPhysical(raw_value, 1.0, 0.0);

    raw_value=copyBitsFromByteArrayLE( byteArray, 17414, 14);
    @CAN_RadarFL::RXX_Object::RXX_Object_Obj33_Px = convertRawToPhysical(raw_value, 0.0625, -512.0);

    raw_value=copyBitsFromByteArrayLE( byteArray, 17728, 12);
    @CAN_RadarFL::RXX_Object::RXX_Object_Obj33_PxAxCoVnce = convertRawToPhysical(raw_value, 0.01, 0.0);

    raw_value=copyBitsFromByteArrayLE( byteArray, 17740, 12);
    @CAN_RadarFL::RXX_Object::RXX_Object_Obj33_PxAyCoVnce = convertRawToPhysical(raw_value, 0.01, 0.0);

    raw_value=copyBitsFromByteArrayLE( byteArray, 17644, 12);
    @CAN_RadarFL::RXX_Object::RXX_Object_Obj33_PxPyCoVnce = convertRawToPhysical(raw_value, 0.01, 0.0);

    raw_value=copyBitsFromByteArrayLE( byteArray, 17428, 12);
    @CAN_RadarFL::RXX_Object::RXX_Object_Obj33_PxVnce = convertRawToPhysical(raw_value, 0.1, 0.0);

    raw_value=copyBitsFromByteArrayLE( byteArray, 17664, 12);
    @CAN_RadarFL::RXX_Object::RXX_Object_Obj33_PxVxCoVnce = convertRawToPhysical(raw_value, 0.01, 0.0);

    raw_value=copyBitsFromByteArrayLE( byteArray, 17676, 12);
    @CAN_RadarFL::RXX_Object::RXX_Object_Obj33_PxVyCoVnce = convertRawToPhysical(raw_value, 0.01, 0.0);

    raw_value=copyBitsFromByteArrayLE( byteArray, 17440, 12);
    @CAN_RadarFL::RXX_Object::RXX_Object_Obj33_Py = convertRawToPhysical(raw_value, 0.0625, -128.0);

    raw_value=copyBitsFromByteArrayLE( byteArray, 17760, 12);
    @CAN_RadarFL::RXX_Object::RXX_Object_Obj33_PyAxCoVnce = convertRawToPhysical(raw_value, 0.01, 0.0);

    raw_value=copyBitsFromByteArrayLE( byteArray, 17772, 12);
    @CAN_RadarFL::RXX_Object::RXX_Object_Obj33_PyAyCoVnce = convertRawToPhysical(raw_value, 0.01, 0.0);

    raw_value=copyBitsFromByteArrayLE( byteArray, 17452, 12);
    @CAN_RadarFL::RXX_Object::RXX_Object_Obj33_PyVnce = convertRawToPhysical(raw_value, 0.1, 0.0);

    raw_value=copyBitsFromByteArrayLE( byteArray, 17696, 12);
    @CAN_RadarFL::RXX_Object::RXX_Object_Obj33_PyVxCoVnce = convertRawToPhysical(raw_value, 0.01, 0.0);

    raw_value=copyBitsFromByteArrayLE( byteArray, 17708, 12);
    @CAN_RadarFL::RXX_Object::RXX_Object_Obj33_PyVyCoVnce = convertRawToPhysical(raw_value, 0.01, 0.0);

    raw_value=copyBitsFromByteArrayLE( byteArray, 17548, 10);
    @CAN_RadarFL::RXX_Object::RXX_Object_Obj33_RCS = convertRawToPhysical(raw_value, 0.2, -102.4);

    raw_value=copyBitsFromByteArrayLE( byteArray, 17720, 4);
    @CAN_RadarFL::RXX_Object::RXX_Object_Obj33_ReferencePoint = convertRawToPhysical(raw_value, 1.0, 0.0);

    raw_value=copyBitsFromByteArrayLE( byteArray, 17580, 12);
    @CAN_RadarFL::RXX_Object::RXX_Object_Obj33_Vx = convertRawToPhysical(raw_value, 0.0625, -128.0);

    raw_value=copyBitsFromByteArrayLE( byteArray, 17804, 12);
    @CAN_RadarFL::RXX_Object::RXX_Object_Obj33_VxAxCoVnce = convertRawToPhysical(raw_value, 0.01, 0.0);

    raw_value=copyBitsFromByteArrayLE( byteArray, 17824, 12);
    @CAN_RadarFL::RXX_Object::RXX_Object_Obj33_VxAyCoVnce = convertRawToPhysical(raw_value, 0.01, 0.0);

    raw_value=copyBitsFromByteArrayLE( byteArray, 17600, 12);
    @CAN_RadarFL::RXX_Object::RXX_Object_Obj33_VxVnce = convertRawToPhysical(raw_value, 0.01, 0.0);

    raw_value=copyBitsFromByteArrayLE( byteArray, 17792, 12);
    @CAN_RadarFL::RXX_Object::RXX_Object_Obj33_VxVyCoVnce = convertRawToPhysical(raw_value, 0.01, 0.0);

    raw_value=copyBitsFromByteArrayLE( byteArray, 17614, 10);
    @CAN_RadarFL::RXX_Object::RXX_Object_Obj33_Vy = convertRawToPhysical(raw_value, 0.125, -64.0);

    raw_value=copyBitsFromByteArrayLE( byteArray, 17836, 12);
    @CAN_RadarFL::RXX_Object::RXX_Object_Obj33_VyAxCoVnce = convertRawToPhysical(raw_value, 0.01, 0.0);

    raw_value=copyBitsFromByteArrayLE( byteArray, 17856, 12);
    @CAN_RadarFL::RXX_Object::RXX_Object_Obj33_VyAyCoVnce = convertRawToPhysical(raw_value, 0.01, 0.0);

    raw_value=copyBitsFromByteArrayLE( byteArray, 17632, 12);
    @CAN_RadarFL::RXX_Object::RXX_Object_Obj33_VyVnce = convertRawToPhysical(raw_value, 0.01, 0.0);

    raw_value=copyBitsFromByteArrayLE( byteArray, 17528, 7);
    @CAN_RadarFL::RXX_Object::RXX_Object_Obj33_Width = convertRawToPhysical(raw_value, 0.125, 0.0);

    raw_value=copyBitsFromByteArrayLE( byteArray, 17536, 12);
    @CAN_RadarFL::RXX_Object::RXX_Object_Obj33_WidthVnce = convertRawToPhysical(raw_value, 0.01, 0.0);

    raw_value=copyBitsFromByteArrayLE( byteArray, 18400, 32);
    @CAN_RadarFL::RXX_Object::RXX_Object_Obj34_Age = convertRawToPhysical(raw_value, 1.0, 0.0);

    raw_value=copyBitsFromByteArrayLE( byteArray, 17996, 10);
    @CAN_RadarFL::RXX_Object::RXX_Object_Obj34_Ax = convertRawToPhysical(raw_value, 0.03125, -16.0);

    raw_value=copyBitsFromByteArrayLE( byteArray, 18380, 12);
    @CAN_RadarFL::RXX_Object::RXX_Object_Obj34_AxAyCoVnce = convertRawToPhysical(raw_value, 0.01, 0.0);

    raw_value=copyBitsFromByteArrayLE( byteArray, 18016, 12);
    @CAN_RadarFL::RXX_Object::RXX_Object_Obj34_AxVnce = convertRawToPhysical(raw_value, 0.01, 0.0);

    raw_value=copyBitsFromByteArrayLE( byteArray, 18070, 9);
    @CAN_RadarFL::RXX_Object::RXX_Object_Obj34_Ay = convertRawToPhysical(raw_value, 0.0625, -16.0);

    raw_value=copyBitsFromByteArrayLE( byteArray, 18080, 12);
    @CAN_RadarFL::RXX_Object::RXX_Object_Obj34_AyVnce = convertRawToPhysical(raw_value, 0.01, 0.0);

    raw_value=copyBitsFromByteArrayLE( byteArray, 18136, 6);
    @CAN_RadarFL::RXX_Object::RXX_Object_Obj34_ExistProb = convertRawToPhysical(raw_value, 2.0, 0.0);

    raw_value=copyBitsFromByteArrayLE( byteArray, 18200, 8);
    @CAN_RadarFL::RXX_Object::RXX_Object_Obj34_FilterInformation = convertRawToPhysical(raw_value, 1.0, 0.0);

    raw_value=copyBitsFromByteArrayLE( byteArray, 17976, 7);
    @CAN_RadarFL::RXX_Object::RXX_Object_Obj34_Length = convertRawToPhysical(raw_value, 0.125, 0.0);

    raw_value=copyBitsFromByteArrayLE( byteArray, 17984, 12);
    @CAN_RadarFL::RXX_Object::RXX_Object_Obj34_LengthVnce = convertRawToPhysical(raw_value, 0.01, 0.0);

    raw_value=copyBitsFromByteArrayLE( byteArray, 18168, 3);
    @CAN_RadarFL::RXX_Object::RXX_Object_Obj34_MeasurementStatus = convertRawToPhysical(raw_value, 1.0, 0.0);

    raw_value=copyBitsFromByteArrayLE( byteArray, 18124, 2);
    @CAN_RadarFL::RXX_Object::RXX_Object_Obj34_MovingStatus = convertRawToPhysical(raw_value, 1.0, 0.0);

    raw_value=copyBitsFromByteArrayLE( byteArray, 18104, 7);
    @CAN_RadarFL::RXX_Object::RXX_Object_Obj34_ObjId = convertRawToPhysical(raw_value, 1.0, 0.0);

    raw_value=copyBitsFromByteArrayLE( byteArray, 18006, 9);
    @CAN_RadarFL::RXX_Object::RXX_Object_Obj34_OrientationYaw = convertRawToPhysical(raw_value, 0.0175, -4.48);

    raw_value=copyBitsFromByteArrayLE( byteArray, 18028, 12);
    @CAN_RadarFL::RXX_Object::RXX_Object_Obj34_OrientationYawVnce = convertRawToPhysical(raw_value, 0.0003, 0.0);

    raw_value=copyBitsFromByteArrayLE( byteArray, 17920, 6);
    @CAN_RadarFL::RXX_Object::RXX_Object_Obj34_ProbClassConfidence = convertRawToPhysical(raw_value, 2.0, 0.0);

    raw_value=copyBitsFromByteArrayLE( byteArray, 18171, 4);
    @CAN_RadarFL::RXX_Object::RXX_Object_Obj34_ProbClassType = convertRawToPhysical(raw_value, 1.0, 0.0);

    raw_value=copyBitsFromByteArrayLE( byteArray, 17926, 14);
    @CAN_RadarFL::RXX_Object::RXX_Object_Obj34_Px = convertRawToPhysical(raw_value, 0.0625, -512.0);

    raw_value=copyBitsFromByteArrayLE( byteArray, 18240, 12);
    @CAN_RadarFL::RXX_Object::RXX_Object_Obj34_PxAxCoVnce = convertRawToPhysical(raw_value, 0.01, 0.0);

    raw_value=copyBitsFromByteArrayLE( byteArray, 18252, 12);
    @CAN_RadarFL::RXX_Object::RXX_Object_Obj34_PxAyCoVnce = convertRawToPhysical(raw_value, 0.01, 0.0);

    raw_value=copyBitsFromByteArrayLE( byteArray, 18156, 12);
    @CAN_RadarFL::RXX_Object::RXX_Object_Obj34_PxPyCoVnce = convertRawToPhysical(raw_value, 0.01, 0.0);

    raw_value=copyBitsFromByteArrayLE( byteArray, 17940, 12);
    @CAN_RadarFL::RXX_Object::RXX_Object_Obj34_PxVnce = convertRawToPhysical(raw_value, 0.1, 0.0);

    raw_value=copyBitsFromByteArrayLE( byteArray, 18176, 12);
    @CAN_RadarFL::RXX_Object::RXX_Object_Obj34_PxVxCoVnce = convertRawToPhysical(raw_value, 0.01, 0.0);

    raw_value=copyBitsFromByteArrayLE( byteArray, 18188, 12);
    @CAN_RadarFL::RXX_Object::RXX_Object_Obj34_PxVyCoVnce = convertRawToPhysical(raw_value, 0.01, 0.0);

    raw_value=copyBitsFromByteArrayLE( byteArray, 17952, 12);
    @CAN_RadarFL::RXX_Object::RXX_Object_Obj34_Py = convertRawToPhysical(raw_value, 0.0625, -128.0);

    raw_value=copyBitsFromByteArrayLE( byteArray, 18272, 12);
    @CAN_RadarFL::RXX_Object::RXX_Object_Obj34_PyAxCoVnce = convertRawToPhysical(raw_value, 0.01, 0.0);

    raw_value=copyBitsFromByteArrayLE( byteArray, 18284, 12);
    @CAN_RadarFL::RXX_Object::RXX_Object_Obj34_PyAyCoVnce = convertRawToPhysical(raw_value, 0.01, 0.0);

    raw_value=copyBitsFromByteArrayLE( byteArray, 17964, 12);
    @CAN_RadarFL::RXX_Object::RXX_Object_Obj34_PyVnce = convertRawToPhysical(raw_value, 0.1, 0.0);

    raw_value=copyBitsFromByteArrayLE( byteArray, 18208, 12);
    @CAN_RadarFL::RXX_Object::RXX_Object_Obj34_PyVxCoVnce = convertRawToPhysical(raw_value, 0.01, 0.0);

    raw_value=copyBitsFromByteArrayLE( byteArray, 18220, 12);
    @CAN_RadarFL::RXX_Object::RXX_Object_Obj34_PyVyCoVnce = convertRawToPhysical(raw_value, 0.01, 0.0);

    raw_value=copyBitsFromByteArrayLE( byteArray, 18060, 10);
    @CAN_RadarFL::RXX_Object::RXX_Object_Obj34_RCS = convertRawToPhysical(raw_value, 0.2, -102.4);

    raw_value=copyBitsFromByteArrayLE( byteArray, 18232, 4);
    @CAN_RadarFL::RXX_Object::RXX_Object_Obj34_ReferencePoint = convertRawToPhysical(raw_value, 1.0, 0.0);

    raw_value=copyBitsFromByteArrayLE( byteArray, 18092, 12);
    @CAN_RadarFL::RXX_Object::RXX_Object_Obj34_Vx = convertRawToPhysical(raw_value, 0.0625, -128.0);

    raw_value=copyBitsFromByteArrayLE( byteArray, 18316, 12);
    @CAN_RadarFL::RXX_Object::RXX_Object_Obj34_VxAxCoVnce = convertRawToPhysical(raw_value, 0.01, 0.0);

    raw_value=copyBitsFromByteArrayLE( byteArray, 18336, 12);
    @CAN_RadarFL::RXX_Object::RXX_Object_Obj34_VxAyCoVnce = convertRawToPhysical(raw_value, 0.01, 0.0);

    raw_value=copyBitsFromByteArrayLE( byteArray, 18112, 12);
    @CAN_RadarFL::RXX_Object::RXX_Object_Obj34_VxVnce = convertRawToPhysical(raw_value, 0.01, 0.0);

    raw_value=copyBitsFromByteArrayLE( byteArray, 18304, 12);
    @CAN_RadarFL::RXX_Object::RXX_Object_Obj34_VxVyCoVnce = convertRawToPhysical(raw_value, 0.01, 0.0);

    raw_value=copyBitsFromByteArrayLE( byteArray, 18126, 10);
    @CAN_RadarFL::RXX_Object::RXX_Object_Obj34_Vy = convertRawToPhysical(raw_value, 0.125, -64.0);

    raw_value=copyBitsFromByteArrayLE( byteArray, 18348, 12);
    @CAN_RadarFL::RXX_Object::RXX_Object_Obj34_VyAxCoVnce = convertRawToPhysical(raw_value, 0.01, 0.0);

    raw_value=copyBitsFromByteArrayLE( byteArray, 18368, 12);
    @CAN_RadarFL::RXX_Object::RXX_Object_Obj34_VyAyCoVnce = convertRawToPhysical(raw_value, 0.01, 0.0);

    raw_value=copyBitsFromByteArrayLE( byteArray, 18144, 12);
    @CAN_RadarFL::RXX_Object::RXX_Object_Obj34_VyVnce = convertRawToPhysical(raw_value, 0.01, 0.0);

    raw_value=copyBitsFromByteArrayLE( byteArray, 18040, 7);
    @CAN_RadarFL::RXX_Object::RXX_Object_Obj34_Width = convertRawToPhysical(raw_value, 0.125, 0.0);

    raw_value=copyBitsFromByteArrayLE( byteArray, 18048, 12);
    @CAN_RadarFL::RXX_Object::RXX_Object_Obj34_WidthVnce = convertRawToPhysical(raw_value, 0.01, 0.0);

    raw_value=copyBitsFromByteArrayLE( byteArray, 18912, 32);
    @CAN_RadarFL::RXX_Object::RXX_Object_Obj35_Age = convertRawToPhysical(raw_value, 1.0, 0.0);

    raw_value=copyBitsFromByteArrayLE( byteArray, 18508, 10);
    @CAN_RadarFL::RXX_Object::RXX_Object_Obj35_Ax = convertRawToPhysical(raw_value, 0.03125, -16.0);

    raw_value=copyBitsFromByteArrayLE( byteArray, 18892, 12);
    @CAN_RadarFL::RXX_Object::RXX_Object_Obj35_AxAyCoVnce = convertRawToPhysical(raw_value, 0.01, 0.0);

    raw_value=copyBitsFromByteArrayLE( byteArray, 18528, 12);
    @CAN_RadarFL::RXX_Object::RXX_Object_Obj35_AxVnce = convertRawToPhysical(raw_value, 0.01, 0.0);

    raw_value=copyBitsFromByteArrayLE( byteArray, 18582, 9);
    @CAN_RadarFL::RXX_Object::RXX_Object_Obj35_Ay = convertRawToPhysical(raw_value, 0.0625, -16.0);

    raw_value=copyBitsFromByteArrayLE( byteArray, 18592, 12);
    @CAN_RadarFL::RXX_Object::RXX_Object_Obj35_AyVnce = convertRawToPhysical(raw_value, 0.01, 0.0);

    raw_value=copyBitsFromByteArrayLE( byteArray, 18648, 6);
    @CAN_RadarFL::RXX_Object::RXX_Object_Obj35_ExistProb = convertRawToPhysical(raw_value, 2.0, 0.0);

    raw_value=copyBitsFromByteArrayLE( byteArray, 18712, 8);
    @CAN_RadarFL::RXX_Object::RXX_Object_Obj35_FilterInformation = convertRawToPhysical(raw_value, 1.0, 0.0);

    raw_value=copyBitsFromByteArrayLE( byteArray, 18488, 7);
    @CAN_RadarFL::RXX_Object::RXX_Object_Obj35_Length = convertRawToPhysical(raw_value, 0.125, 0.0);

    raw_value=copyBitsFromByteArrayLE( byteArray, 18496, 12);
    @CAN_RadarFL::RXX_Object::RXX_Object_Obj35_LengthVnce = convertRawToPhysical(raw_value, 0.01, 0.0);

    raw_value=copyBitsFromByteArrayLE( byteArray, 18680, 3);
    @CAN_RadarFL::RXX_Object::RXX_Object_Obj35_MeasurementStatus = convertRawToPhysical(raw_value, 1.0, 0.0);

    raw_value=copyBitsFromByteArrayLE( byteArray, 18636, 2);
    @CAN_RadarFL::RXX_Object::RXX_Object_Obj35_MovingStatus = convertRawToPhysical(raw_value, 1.0, 0.0);

    raw_value=copyBitsFromByteArrayLE( byteArray, 18616, 7);
    @CAN_RadarFL::RXX_Object::RXX_Object_Obj35_ObjId = convertRawToPhysical(raw_value, 1.0, 0.0);

    raw_value=copyBitsFromByteArrayLE( byteArray, 18518, 9);
    @CAN_RadarFL::RXX_Object::RXX_Object_Obj35_OrientationYaw = convertRawToPhysical(raw_value, 0.0175, -4.48);

    raw_value=copyBitsFromByteArrayLE( byteArray, 18540, 12);
    @CAN_RadarFL::RXX_Object::RXX_Object_Obj35_OrientationYawVnce = convertRawToPhysical(raw_value, 0.0003, 0.0);

    raw_value=copyBitsFromByteArrayLE( byteArray, 18432, 6);
    @CAN_RadarFL::RXX_Object::RXX_Object_Obj35_ProbClassConfidence = convertRawToPhysical(raw_value, 2.0, 0.0);

    raw_value=copyBitsFromByteArrayLE( byteArray, 18683, 4);
    @CAN_RadarFL::RXX_Object::RXX_Object_Obj35_ProbClassType = convertRawToPhysical(raw_value, 1.0, 0.0);

    raw_value=copyBitsFromByteArrayLE( byteArray, 18438, 14);
    @CAN_RadarFL::RXX_Object::RXX_Object_Obj35_Px = convertRawToPhysical(raw_value, 0.0625, -512.0);

    raw_value=copyBitsFromByteArrayLE( byteArray, 18752, 12);
    @CAN_RadarFL::RXX_Object::RXX_Object_Obj35_PxAxCoVnce = convertRawToPhysical(raw_value, 0.01, 0.0);

    raw_value=copyBitsFromByteArrayLE( byteArray, 18764, 12);
    @CAN_RadarFL::RXX_Object::RXX_Object_Obj35_PxAyCoVnce = convertRawToPhysical(raw_value, 0.01, 0.0);

    raw_value=copyBitsFromByteArrayLE( byteArray, 18668, 12);
    @CAN_RadarFL::RXX_Object::RXX_Object_Obj35_PxPyCoVnce = convertRawToPhysical(raw_value, 0.01, 0.0);

    raw_value=copyBitsFromByteArrayLE( byteArray, 18452, 12);
    @CAN_RadarFL::RXX_Object::RXX_Object_Obj35_PxVnce = convertRawToPhysical(raw_value, 0.1, 0.0);

    raw_value=copyBitsFromByteArrayLE( byteArray, 18688, 12);
    @CAN_RadarFL::RXX_Object::RXX_Object_Obj35_PxVxCoVnce = convertRawToPhysical(raw_value, 0.01, 0.0);

    raw_value=copyBitsFromByteArrayLE( byteArray, 18700, 12);
    @CAN_RadarFL::RXX_Object::RXX_Object_Obj35_PxVyCoVnce = convertRawToPhysical(raw_value, 0.01, 0.0);

    raw_value=copyBitsFromByteArrayLE( byteArray, 18464, 12);
    @CAN_RadarFL::RXX_Object::RXX_Object_Obj35_Py = convertRawToPhysical(raw_value, 0.0625, -128.0);

    raw_value=copyBitsFromByteArrayLE( byteArray, 18784, 12);
    @CAN_RadarFL::RXX_Object::RXX_Object_Obj35_PyAxCoVnce = convertRawToPhysical(raw_value, 0.01, 0.0);

    raw_value=copyBitsFromByteArrayLE( byteArray, 18796, 12);
    @CAN_RadarFL::RXX_Object::RXX_Object_Obj35_PyAyCoVnce = convertRawToPhysical(raw_value, 0.01, 0.0);

    raw_value=copyBitsFromByteArrayLE( byteArray, 18476, 12);
    @CAN_RadarFL::RXX_Object::RXX_Object_Obj35_PyVnce = convertRawToPhysical(raw_value, 0.1, 0.0);

    raw_value=copyBitsFromByteArrayLE( byteArray, 18720, 12);
    @CAN_RadarFL::RXX_Object::RXX_Object_Obj35_PyVxCoVnce = convertRawToPhysical(raw_value, 0.01, 0.0);

    raw_value=copyBitsFromByteArrayLE( byteArray, 18732, 12);
    @CAN_RadarFL::RXX_Object::RXX_Object_Obj35_PyVyCoVnce = convertRawToPhysical(raw_value, 0.01, 0.0);

    raw_value=copyBitsFromByteArrayLE( byteArray, 18572, 10);
    @CAN_RadarFL::RXX_Object::RXX_Object_Obj35_RCS = convertRawToPhysical(raw_value, 0.2, -102.4);

    raw_value=copyBitsFromByteArrayLE( byteArray, 18744, 4);
    @CAN_RadarFL::RXX_Object::RXX_Object_Obj35_ReferencePoint = convertRawToPhysical(raw_value, 1.0, 0.0);

    raw_value=copyBitsFromByteArrayLE( byteArray, 18604, 12);
    @CAN_RadarFL::RXX_Object::RXX_Object_Obj35_Vx = convertRawToPhysical(raw_value, 0.0625, -128.0);

    raw_value=copyBitsFromByteArrayLE( byteArray, 18828, 12);
    @CAN_RadarFL::RXX_Object::RXX_Object_Obj35_VxAxCoVnce = convertRawToPhysical(raw_value, 0.01, 0.0);

    raw_value=copyBitsFromByteArrayLE( byteArray, 18848, 12);
    @CAN_RadarFL::RXX_Object::RXX_Object_Obj35_VxAyCoVnce = convertRawToPhysical(raw_value, 0.01, 0.0);

    raw_value=copyBitsFromByteArrayLE( byteArray, 18624, 12);
    @CAN_RadarFL::RXX_Object::RXX_Object_Obj35_VxVnce = convertRawToPhysical(raw_value, 0.01, 0.0);

    raw_value=copyBitsFromByteArrayLE( byteArray, 18816, 12);
    @CAN_RadarFL::RXX_Object::RXX_Object_Obj35_VxVyCoVnce = convertRawToPhysical(raw_value, 0.01, 0.0);

    raw_value=copyBitsFromByteArrayLE( byteArray, 18638, 10);
    @CAN_RadarFL::RXX_Object::RXX_Object_Obj35_Vy = convertRawToPhysical(raw_value, 0.125, -64.0);

    raw_value=copyBitsFromByteArrayLE( byteArray, 18860, 12);
    @CAN_RadarFL::RXX_Object::RXX_Object_Obj35_VyAxCoVnce = convertRawToPhysical(raw_value, 0.01, 0.0);

    raw_value=copyBitsFromByteArrayLE( byteArray, 18880, 12);
    @CAN_RadarFL::RXX_Object::RXX_Object_Obj35_VyAyCoVnce = convertRawToPhysical(raw_value, 0.01, 0.0);

    raw_value=copyBitsFromByteArrayLE( byteArray, 18656, 12);
    @CAN_RadarFL::RXX_Object::RXX_Object_Obj35_VyVnce = convertRawToPhysical(raw_value, 0.01, 0.0);

    raw_value=copyBitsFromByteArrayLE( byteArray, 18552, 7);
    @CAN_RadarFL::RXX_Object::RXX_Object_Obj35_Width = convertRawToPhysical(raw_value, 0.125, 0.0);

    raw_value=copyBitsFromByteArrayLE( byteArray, 18560, 12);
    @CAN_RadarFL::RXX_Object::RXX_Object_Obj35_WidthVnce = convertRawToPhysical(raw_value, 0.01, 0.0);

    raw_value=copyBitsFromByteArrayLE( byteArray, 19424, 32);
    @CAN_RadarFL::RXX_Object::RXX_Object_Obj36_Age = convertRawToPhysical(raw_value, 1.0, 0.0);

    raw_value=copyBitsFromByteArrayLE( byteArray, 19020, 10);
    @CAN_RadarFL::RXX_Object::RXX_Object_Obj36_Ax = convertRawToPhysical(raw_value, 0.03125, -16.0);

    raw_value=copyBitsFromByteArrayLE( byteArray, 19404, 12);
    @CAN_RadarFL::RXX_Object::RXX_Object_Obj36_AxAyCoVnce = convertRawToPhysical(raw_value, 0.01, 0.0);

    raw_value=copyBitsFromByteArrayLE( byteArray, 19040, 12);
    @CAN_RadarFL::RXX_Object::RXX_Object_Obj36_AxVnce = convertRawToPhysical(raw_value, 0.01, 0.0);

    raw_value=copyBitsFromByteArrayLE( byteArray, 19094, 9);
    @CAN_RadarFL::RXX_Object::RXX_Object_Obj36_Ay = convertRawToPhysical(raw_value, 0.0625, -16.0);

    raw_value=copyBitsFromByteArrayLE( byteArray, 19104, 12);
    @CAN_RadarFL::RXX_Object::RXX_Object_Obj36_AyVnce = convertRawToPhysical(raw_value, 0.01, 0.0);

    raw_value=copyBitsFromByteArrayLE( byteArray, 19160, 6);
    @CAN_RadarFL::RXX_Object::RXX_Object_Obj36_ExistProb = convertRawToPhysical(raw_value, 2.0, 0.0);

    raw_value=copyBitsFromByteArrayLE( byteArray, 19224, 8);
    @CAN_RadarFL::RXX_Object::RXX_Object_Obj36_FilterInformation = convertRawToPhysical(raw_value, 1.0, 0.0);

    raw_value=copyBitsFromByteArrayLE( byteArray, 19000, 7);
    @CAN_RadarFL::RXX_Object::RXX_Object_Obj36_Length = convertRawToPhysical(raw_value, 0.125, 0.0);

    raw_value=copyBitsFromByteArrayLE( byteArray, 19008, 12);
    @CAN_RadarFL::RXX_Object::RXX_Object_Obj36_LengthVnce = convertRawToPhysical(raw_value, 0.01, 0.0);

    raw_value=copyBitsFromByteArrayLE( byteArray, 19192, 3);
    @CAN_RadarFL::RXX_Object::RXX_Object_Obj36_MeasurementStatus = convertRawToPhysical(raw_value, 1.0, 0.0);

    raw_value=copyBitsFromByteArrayLE( byteArray, 19148, 2);
    @CAN_RadarFL::RXX_Object::RXX_Object_Obj36_MovingStatus = convertRawToPhysical(raw_value, 1.0, 0.0);

    raw_value=copyBitsFromByteArrayLE( byteArray, 19128, 7);
    @CAN_RadarFL::RXX_Object::RXX_Object_Obj36_ObjId = convertRawToPhysical(raw_value, 1.0, 0.0);

    raw_value=copyBitsFromByteArrayLE( byteArray, 19030, 9);
    @CAN_RadarFL::RXX_Object::RXX_Object_Obj36_OrientationYaw = convertRawToPhysical(raw_value, 0.0175, -4.48);

    raw_value=copyBitsFromByteArrayLE( byteArray, 19052, 12);
    @CAN_RadarFL::RXX_Object::RXX_Object_Obj36_OrientationYawVnce = convertRawToPhysical(raw_value, 0.0003, 0.0);

    raw_value=copyBitsFromByteArrayLE( byteArray, 18944, 6);
    @CAN_RadarFL::RXX_Object::RXX_Object_Obj36_ProbClassConfidence = convertRawToPhysical(raw_value, 2.0, 0.0);

    raw_value=copyBitsFromByteArrayLE( byteArray, 19195, 4);
    @CAN_RadarFL::RXX_Object::RXX_Object_Obj36_ProbClassType = convertRawToPhysical(raw_value, 1.0, 0.0);

    raw_value=copyBitsFromByteArrayLE( byteArray, 18950, 14);
    @CAN_RadarFL::RXX_Object::RXX_Object_Obj36_Px = convertRawToPhysical(raw_value, 0.0625, -512.0);

    raw_value=copyBitsFromByteArrayLE( byteArray, 19264, 12);
    @CAN_RadarFL::RXX_Object::RXX_Object_Obj36_PxAxCoVnce = convertRawToPhysical(raw_value, 0.01, 0.0);

    raw_value=copyBitsFromByteArrayLE( byteArray, 19276, 12);
    @CAN_RadarFL::RXX_Object::RXX_Object_Obj36_PxAyCoVnce = convertRawToPhysical(raw_value, 0.01, 0.0);

    raw_value=copyBitsFromByteArrayLE( byteArray, 19180, 12);
    @CAN_RadarFL::RXX_Object::RXX_Object_Obj36_PxPyCoVnce = convertRawToPhysical(raw_value, 0.01, 0.0);

    raw_value=copyBitsFromByteArrayLE( byteArray, 18964, 12);
    @CAN_RadarFL::RXX_Object::RXX_Object_Obj36_PxVnce = convertRawToPhysical(raw_value, 0.1, 0.0);

    raw_value=copyBitsFromByteArrayLE( byteArray, 19200, 12);
    @CAN_RadarFL::RXX_Object::RXX_Object_Obj36_PxVxCoVnce = convertRawToPhysical(raw_value, 0.01, 0.0);

    raw_value=copyBitsFromByteArrayLE( byteArray, 19212, 12);
    @CAN_RadarFL::RXX_Object::RXX_Object_Obj36_PxVyCoVnce = convertRawToPhysical(raw_value, 0.01, 0.0);

    raw_value=copyBitsFromByteArrayLE( byteArray, 18976, 12);
    @CAN_RadarFL::RXX_Object::RXX_Object_Obj36_Py = convertRawToPhysical(raw_value, 0.0625, -128.0);

    raw_value=copyBitsFromByteArrayLE( byteArray, 19296, 12);
    @CAN_RadarFL::RXX_Object::RXX_Object_Obj36_PyAxCoVnce = convertRawToPhysical(raw_value, 0.01, 0.0);

    raw_value=copyBitsFromByteArrayLE( byteArray, 19308, 12);
    @CAN_RadarFL::RXX_Object::RXX_Object_Obj36_PyAyCoVnce = convertRawToPhysical(raw_value, 0.01, 0.0);

    raw_value=copyBitsFromByteArrayLE( byteArray, 18988, 12);
    @CAN_RadarFL::RXX_Object::RXX_Object_Obj36_PyVnce = convertRawToPhysical(raw_value, 0.1, 0.0);

    raw_value=copyBitsFromByteArrayLE( byteArray, 19232, 12);
    @CAN_RadarFL::RXX_Object::RXX_Object_Obj36_PyVxCoVnce = convertRawToPhysical(raw_value, 0.01, 0.0);

    raw_value=copyBitsFromByteArrayLE( byteArray, 19244, 12);
    @CAN_RadarFL::RXX_Object::RXX_Object_Obj36_PyVyCoVnce = convertRawToPhysical(raw_value, 0.01, 0.0);

    raw_value=copyBitsFromByteArrayLE( byteArray, 19084, 10);
    @CAN_RadarFL::RXX_Object::RXX_Object_Obj36_RCS = convertRawToPhysical(raw_value, 0.2, -102.4);

    raw_value=copyBitsFromByteArrayLE( byteArray, 19256, 4);
    @CAN_RadarFL::RXX_Object::RXX_Object_Obj36_ReferencePoint = convertRawToPhysical(raw_value, 1.0, 0.0);

    raw_value=copyBitsFromByteArrayLE( byteArray, 19116, 12);
    @CAN_RadarFL::RXX_Object::RXX_Object_Obj36_Vx = convertRawToPhysical(raw_value, 0.0625, -128.0);

    raw_value=copyBitsFromByteArrayLE( byteArray, 19340, 12);
    @CAN_RadarFL::RXX_Object::RXX_Object_Obj36_VxAxCoVnce = convertRawToPhysical(raw_value, 0.01, 0.0);

    raw_value=copyBitsFromByteArrayLE( byteArray, 19360, 12);
    @CAN_RadarFL::RXX_Object::RXX_Object_Obj36_VxAyCoVnce = convertRawToPhysical(raw_value, 0.01, 0.0);

    raw_value=copyBitsFromByteArrayLE( byteArray, 19136, 12);
    @CAN_RadarFL::RXX_Object::RXX_Object_Obj36_VxVnce = convertRawToPhysical(raw_value, 0.01, 0.0);

    raw_value=copyBitsFromByteArrayLE( byteArray, 19328, 12);
    @CAN_RadarFL::RXX_Object::RXX_Object_Obj36_VxVyCoVnce = convertRawToPhysical(raw_value, 0.01, 0.0);

    raw_value=copyBitsFromByteArrayLE( byteArray, 19150, 10);
    @CAN_RadarFL::RXX_Object::RXX_Object_Obj36_Vy = convertRawToPhysical(raw_value, 0.125, -64.0);

    raw_value=copyBitsFromByteArrayLE( byteArray, 19372, 12);
    @CAN_RadarFL::RXX_Object::RXX_Object_Obj36_VyAxCoVnce = convertRawToPhysical(raw_value, 0.01, 0.0);

    raw_value=copyBitsFromByteArrayLE( byteArray, 19392, 12);
    @CAN_RadarFL::RXX_Object::RXX_Object_Obj36_VyAyCoVnce = convertRawToPhysical(raw_value, 0.01, 0.0);

    raw_value=copyBitsFromByteArrayLE( byteArray, 19168, 12);
    @CAN_RadarFL::RXX_Object::RXX_Object_Obj36_VyVnce = convertRawToPhysical(raw_value, 0.01, 0.0);

    raw_value=copyBitsFromByteArrayLE( byteArray, 19064, 7);
    @CAN_RadarFL::RXX_Object::RXX_Object_Obj36_Width = convertRawToPhysical(raw_value, 0.125, 0.0);

    raw_value=copyBitsFromByteArrayLE( byteArray, 19072, 12);
    @CAN_RadarFL::RXX_Object::RXX_Object_Obj36_WidthVnce = convertRawToPhysical(raw_value, 0.01, 0.0);

    raw_value=copyBitsFromByteArrayLE( byteArray, 19936, 32);
    @CAN_RadarFL::RXX_Object::RXX_Object_Obj37_Age = convertRawToPhysical(raw_value, 1.0, 0.0);

    raw_value=copyBitsFromByteArrayLE( byteArray, 19532, 10);
    @CAN_RadarFL::RXX_Object::RXX_Object_Obj37_Ax = convertRawToPhysical(raw_value, 0.03125, -16.0);

    raw_value=copyBitsFromByteArrayLE( byteArray, 19916, 12);
    @CAN_RadarFL::RXX_Object::RXX_Object_Obj37_AxAyCoVnce = convertRawToPhysical(raw_value, 0.01, 0.0);

    raw_value=copyBitsFromByteArrayLE( byteArray, 19552, 12);
    @CAN_RadarFL::RXX_Object::RXX_Object_Obj37_AxVnce = convertRawToPhysical(raw_value, 0.01, 0.0);

    raw_value=copyBitsFromByteArrayLE( byteArray, 19606, 9);
    @CAN_RadarFL::RXX_Object::RXX_Object_Obj37_Ay = convertRawToPhysical(raw_value, 0.0625, -16.0);

    raw_value=copyBitsFromByteArrayLE( byteArray, 19616, 12);
    @CAN_RadarFL::RXX_Object::RXX_Object_Obj37_AyVnce = convertRawToPhysical(raw_value, 0.01, 0.0);

    raw_value=copyBitsFromByteArrayLE( byteArray, 19672, 6);
    @CAN_RadarFL::RXX_Object::RXX_Object_Obj37_ExistProb = convertRawToPhysical(raw_value, 2.0, 0.0);

    raw_value=copyBitsFromByteArrayLE( byteArray, 19736, 8);
    @CAN_RadarFL::RXX_Object::RXX_Object_Obj37_FilterInformation = convertRawToPhysical(raw_value, 1.0, 0.0);

    raw_value=copyBitsFromByteArrayLE( byteArray, 19512, 7);
    @CAN_RadarFL::RXX_Object::RXX_Object_Obj37_Length = convertRawToPhysical(raw_value, 0.125, 0.0);

    raw_value=copyBitsFromByteArrayLE( byteArray, 19520, 12);
    @CAN_RadarFL::RXX_Object::RXX_Object_Obj37_LengthVnce = convertRawToPhysical(raw_value, 0.01, 0.0);

    raw_value=copyBitsFromByteArrayLE( byteArray, 19704, 3);
    @CAN_RadarFL::RXX_Object::RXX_Object_Obj37_MeasurementStatus = convertRawToPhysical(raw_value, 1.0, 0.0);

    raw_value=copyBitsFromByteArrayLE( byteArray, 19660, 2);
    @CAN_RadarFL::RXX_Object::RXX_Object_Obj37_MovingStatus = convertRawToPhysical(raw_value, 1.0, 0.0);

    raw_value=copyBitsFromByteArrayLE( byteArray, 19640, 7);
    @CAN_RadarFL::RXX_Object::RXX_Object_Obj37_ObjId = convertRawToPhysical(raw_value, 1.0, 0.0);

    raw_value=copyBitsFromByteArrayLE( byteArray, 19542, 9);
    @CAN_RadarFL::RXX_Object::RXX_Object_Obj37_OrientationYaw = convertRawToPhysical(raw_value, 0.0175, -4.48);

    raw_value=copyBitsFromByteArrayLE( byteArray, 19564, 12);
    @CAN_RadarFL::RXX_Object::RXX_Object_Obj37_OrientationYawVnce = convertRawToPhysical(raw_value, 0.0003, 0.0);

    raw_value=copyBitsFromByteArrayLE( byteArray, 19456, 6);
    @CAN_RadarFL::RXX_Object::RXX_Object_Obj37_ProbClassConfidence = convertRawToPhysical(raw_value, 2.0, 0.0);

    raw_value=copyBitsFromByteArrayLE( byteArray, 19707, 4);
    @CAN_RadarFL::RXX_Object::RXX_Object_Obj37_ProbClassType = convertRawToPhysical(raw_value, 1.0, 0.0);

    raw_value=copyBitsFromByteArrayLE( byteArray, 19462, 14);
    @CAN_RadarFL::RXX_Object::RXX_Object_Obj37_Px = convertRawToPhysical(raw_value, 0.0625, -512.0);

    raw_value=copyBitsFromByteArrayLE( byteArray, 19776, 12);
    @CAN_RadarFL::RXX_Object::RXX_Object_Obj37_PxAxCoVnce = convertRawToPhysical(raw_value, 0.01, 0.0);

    raw_value=copyBitsFromByteArrayLE( byteArray, 19788, 12);
    @CAN_RadarFL::RXX_Object::RXX_Object_Obj37_PxAyCoVnce = convertRawToPhysical(raw_value, 0.01, 0.0);

    raw_value=copyBitsFromByteArrayLE( byteArray, 19692, 12);
    @CAN_RadarFL::RXX_Object::RXX_Object_Obj37_PxPyCoVnce = convertRawToPhysical(raw_value, 0.01, 0.0);

    raw_value=copyBitsFromByteArrayLE( byteArray, 19476, 12);
    @CAN_RadarFL::RXX_Object::RXX_Object_Obj37_PxVnce = convertRawToPhysical(raw_value, 0.1, 0.0);

    raw_value=copyBitsFromByteArrayLE( byteArray, 19712, 12);
    @CAN_RadarFL::RXX_Object::RXX_Object_Obj37_PxVxCoVnce = convertRawToPhysical(raw_value, 0.01, 0.0);

    raw_value=copyBitsFromByteArrayLE( byteArray, 19724, 12);
    @CAN_RadarFL::RXX_Object::RXX_Object_Obj37_PxVyCoVnce = convertRawToPhysical(raw_value, 0.01, 0.0);

    raw_value=copyBitsFromByteArrayLE( byteArray, 19488, 12);
    @CAN_RadarFL::RXX_Object::RXX_Object_Obj37_Py = convertRawToPhysical(raw_value, 0.0625, -128.0);

    raw_value=copyBitsFromByteArrayLE( byteArray, 19808, 12);
    @CAN_RadarFL::RXX_Object::RXX_Object_Obj37_PyAxCoVnce = convertRawToPhysical(raw_value, 0.01, 0.0);

    raw_value=copyBitsFromByteArrayLE( byteArray, 19820, 12);
    @CAN_RadarFL::RXX_Object::RXX_Object_Obj37_PyAyCoVnce = convertRawToPhysical(raw_value, 0.01, 0.0);

    raw_value=copyBitsFromByteArrayLE( byteArray, 19500, 12);
    @CAN_RadarFL::RXX_Object::RXX_Object_Obj37_PyVnce = convertRawToPhysical(raw_value, 0.1, 0.0);

    raw_value=copyBitsFromByteArrayLE( byteArray, 19744, 12);
    @CAN_RadarFL::RXX_Object::RXX_Object_Obj37_PyVxCoVnce = convertRawToPhysical(raw_value, 0.01, 0.0);

    raw_value=copyBitsFromByteArrayLE( byteArray, 19756, 12);
    @CAN_RadarFL::RXX_Object::RXX_Object_Obj37_PyVyCoVnce = convertRawToPhysical(raw_value, 0.01, 0.0);

    raw_value=copyBitsFromByteArrayLE( byteArray, 19596, 10);
    @CAN_RadarFL::RXX_Object::RXX_Object_Obj37_RCS = convertRawToPhysical(raw_value, 0.2, -102.4);

    raw_value=copyBitsFromByteArrayLE( byteArray, 19768, 4);
    @CAN_RadarFL::RXX_Object::RXX_Object_Obj37_ReferencePoint = convertRawToPhysical(raw_value, 1.0, 0.0);

    raw_value=copyBitsFromByteArrayLE( byteArray, 19628, 12);
    @CAN_RadarFL::RXX_Object::RXX_Object_Obj37_Vx = convertRawToPhysical(raw_value, 0.0625, -128.0);

    raw_value=copyBitsFromByteArrayLE( byteArray, 19852, 12);
    @CAN_RadarFL::RXX_Object::RXX_Object_Obj37_VxAxCoVnce = convertRawToPhysical(raw_value, 0.01, 0.0);

    raw_value=copyBitsFromByteArrayLE( byteArray, 19872, 12);
    @CAN_RadarFL::RXX_Object::RXX_Object_Obj37_VxAyCoVnce = convertRawToPhysical(raw_value, 0.01, 0.0);

    raw_value=copyBitsFromByteArrayLE( byteArray, 19648, 12);
    @CAN_RadarFL::RXX_Object::RXX_Object_Obj37_VxVnce = convertRawToPhysical(raw_value, 0.01, 0.0);

    raw_value=copyBitsFromByteArrayLE( byteArray, 19840, 12);
    @CAN_RadarFL::RXX_Object::RXX_Object_Obj37_VxVyCoVnce = convertRawToPhysical(raw_value, 0.01, 0.0);

    raw_value=copyBitsFromByteArrayLE( byteArray, 19662, 10);
    @CAN_RadarFL::RXX_Object::RXX_Object_Obj37_Vy = convertRawToPhysical(raw_value, 0.125, -64.0);

    raw_value=copyBitsFromByteArrayLE( byteArray, 19884, 12);
    @CAN_RadarFL::RXX_Object::RXX_Object_Obj37_VyAxCoVnce = convertRawToPhysical(raw_value, 0.01, 0.0);

    raw_value=copyBitsFromByteArrayLE( byteArray, 19904, 12);
    @CAN_RadarFL::RXX_Object::RXX_Object_Obj37_VyAyCoVnce = convertRawToPhysical(raw_value, 0.01, 0.0);

    raw_value=copyBitsFromByteArrayLE( byteArray, 19680, 12);
    @CAN_RadarFL::RXX_Object::RXX_Object_Obj37_VyVnce = convertRawToPhysical(raw_value, 0.01, 0.0);

    raw_value=copyBitsFromByteArrayLE( byteArray, 19576, 7);
    @CAN_RadarFL::RXX_Object::RXX_Object_Obj37_Width = convertRawToPhysical(raw_value, 0.125, 0.0);

    raw_value=copyBitsFromByteArrayLE( byteArray, 19584, 12);
    @CAN_RadarFL::RXX_Object::RXX_Object_Obj37_WidthVnce = convertRawToPhysical(raw_value, 0.01, 0.0);

    raw_value=copyBitsFromByteArrayLE( byteArray, 20448, 32);
    @CAN_RadarFL::RXX_Object::RXX_Object_Obj38_Age = convertRawToPhysical(raw_value, 1.0, 0.0);

    raw_value=copyBitsFromByteArrayLE( byteArray, 20044, 10);
    @CAN_RadarFL::RXX_Object::RXX_Object_Obj38_Ax = convertRawToPhysical(raw_value, 0.03125, -16.0);

    raw_value=copyBitsFromByteArrayLE( byteArray, 20428, 12);
    @CAN_RadarFL::RXX_Object::RXX_Object_Obj38_AxAyCoVnce = convertRawToPhysical(raw_value, 0.01, 0.0);

    raw_value=copyBitsFromByteArrayLE( byteArray, 20064, 12);
    @CAN_RadarFL::RXX_Object::RXX_Object_Obj38_AxVnce = convertRawToPhysical(raw_value, 0.01, 0.0);

    raw_value=copyBitsFromByteArrayLE( byteArray, 20118, 9);
    @CAN_RadarFL::RXX_Object::RXX_Object_Obj38_Ay = convertRawToPhysical(raw_value, 0.0625, -16.0);

    raw_value=copyBitsFromByteArrayLE( byteArray, 20128, 12);
    @CAN_RadarFL::RXX_Object::RXX_Object_Obj38_AyVnce = convertRawToPhysical(raw_value, 0.01, 0.0);

    raw_value=copyBitsFromByteArrayLE( byteArray, 20184, 6);
    @CAN_RadarFL::RXX_Object::RXX_Object_Obj38_ExistProb = convertRawToPhysical(raw_value, 2.0, 0.0);

    raw_value=copyBitsFromByteArrayLE( byteArray, 20248, 8);
    @CAN_RadarFL::RXX_Object::RXX_Object_Obj38_FilterInformation = convertRawToPhysical(raw_value, 1.0, 0.0);

    raw_value=copyBitsFromByteArrayLE( byteArray, 20024, 7);
    @CAN_RadarFL::RXX_Object::RXX_Object_Obj38_Length = convertRawToPhysical(raw_value, 0.125, 0.0);

    raw_value=copyBitsFromByteArrayLE( byteArray, 20032, 12);
    @CAN_RadarFL::RXX_Object::RXX_Object_Obj38_LengthVnce = convertRawToPhysical(raw_value, 0.01, 0.0);

    raw_value=copyBitsFromByteArrayLE( byteArray, 20216, 3);
    @CAN_RadarFL::RXX_Object::RXX_Object_Obj38_MeasurementStatus = convertRawToPhysical(raw_value, 1.0, 0.0);

    raw_value=copyBitsFromByteArrayLE( byteArray, 20172, 2);
    @CAN_RadarFL::RXX_Object::RXX_Object_Obj38_MovingStatus = convertRawToPhysical(raw_value, 1.0, 0.0);

    raw_value=copyBitsFromByteArrayLE( byteArray, 20152, 7);
    @CAN_RadarFL::RXX_Object::RXX_Object_Obj38_ObjId = convertRawToPhysical(raw_value, 1.0, 0.0);

    raw_value=copyBitsFromByteArrayLE( byteArray, 20054, 9);
    @CAN_RadarFL::RXX_Object::RXX_Object_Obj38_OrientationYaw = convertRawToPhysical(raw_value, 0.0175, -4.48);

    raw_value=copyBitsFromByteArrayLE( byteArray, 20076, 12);
    @CAN_RadarFL::RXX_Object::RXX_Object_Obj38_OrientationYawVnce = convertRawToPhysical(raw_value, 0.0003, 0.0);

    raw_value=copyBitsFromByteArrayLE( byteArray, 19968, 6);
    @CAN_RadarFL::RXX_Object::RXX_Object_Obj38_ProbClassConfidence = convertRawToPhysical(raw_value, 2.0, 0.0);

    raw_value=copyBitsFromByteArrayLE( byteArray, 20219, 4);
    @CAN_RadarFL::RXX_Object::RXX_Object_Obj38_ProbClassType = convertRawToPhysical(raw_value, 1.0, 0.0);

    raw_value=copyBitsFromByteArrayLE( byteArray, 19974, 14);
    @CAN_RadarFL::RXX_Object::RXX_Object_Obj38_Px = convertRawToPhysical(raw_value, 0.0625, -512.0);

    raw_value=copyBitsFromByteArrayLE( byteArray, 20288, 12);
    @CAN_RadarFL::RXX_Object::RXX_Object_Obj38_PxAxCoVnce = convertRawToPhysical(raw_value, 0.01, 0.0);

    raw_value=copyBitsFromByteArrayLE( byteArray, 20300, 12);
    @CAN_RadarFL::RXX_Object::RXX_Object_Obj38_PxAyCoVnce = convertRawToPhysical(raw_value, 0.01, 0.0);

    raw_value=copyBitsFromByteArrayLE( byteArray, 20204, 12);
    @CAN_RadarFL::RXX_Object::RXX_Object_Obj38_PxPyCoVnce = convertRawToPhysical(raw_value, 0.01, 0.0);

    raw_value=copyBitsFromByteArrayLE( byteArray, 19988, 12);
    @CAN_RadarFL::RXX_Object::RXX_Object_Obj38_PxVnce = convertRawToPhysical(raw_value, 0.1, 0.0);

    raw_value=copyBitsFromByteArrayLE( byteArray, 20224, 12);
    @CAN_RadarFL::RXX_Object::RXX_Object_Obj38_PxVxCoVnce = convertRawToPhysical(raw_value, 0.01, 0.0);

    raw_value=copyBitsFromByteArrayLE( byteArray, 20236, 12);
    @CAN_RadarFL::RXX_Object::RXX_Object_Obj38_PxVyCoVnce = convertRawToPhysical(raw_value, 0.01, 0.0);

    raw_value=copyBitsFromByteArrayLE( byteArray, 20000, 12);
    @CAN_RadarFL::RXX_Object::RXX_Object_Obj38_Py = convertRawToPhysical(raw_value, 0.0625, -128.0);

    raw_value=copyBitsFromByteArrayLE( byteArray, 20320, 12);
    @CAN_RadarFL::RXX_Object::RXX_Object_Obj38_PyAxCoVnce = convertRawToPhysical(raw_value, 0.01, 0.0);

    raw_value=copyBitsFromByteArrayLE( byteArray, 20332, 12);
    @CAN_RadarFL::RXX_Object::RXX_Object_Obj38_PyAyCoVnce = convertRawToPhysical(raw_value, 0.01, 0.0);

    raw_value=copyBitsFromByteArrayLE( byteArray, 20012, 12);
    @CAN_RadarFL::RXX_Object::RXX_Object_Obj38_PyVnce = convertRawToPhysical(raw_value, 0.1, 0.0);

    raw_value=copyBitsFromByteArrayLE( byteArray, 20256, 12);
    @CAN_RadarFL::RXX_Object::RXX_Object_Obj38_PyVxCoVnce = convertRawToPhysical(raw_value, 0.01, 0.0);

    raw_value=copyBitsFromByteArrayLE( byteArray, 20268, 12);
    @CAN_RadarFL::RXX_Object::RXX_Object_Obj38_PyVyCoVnce = convertRawToPhysical(raw_value, 0.01, 0.0);

    raw_value=copyBitsFromByteArrayLE( byteArray, 20108, 10);
    @CAN_RadarFL::RXX_Object::RXX_Object_Obj38_RCS = convertRawToPhysical(raw_value, 0.2, -102.4);

    raw_value=copyBitsFromByteArrayLE( byteArray, 20280, 4);
    @CAN_RadarFL::RXX_Object::RXX_Object_Obj38_ReferencePoint = convertRawToPhysical(raw_value, 1.0, 0.0);

    raw_value=copyBitsFromByteArrayLE( byteArray, 20140, 12);
    @CAN_RadarFL::RXX_Object::RXX_Object_Obj38_Vx = convertRawToPhysical(raw_value, 0.0625, -128.0);

    raw_value=copyBitsFromByteArrayLE( byteArray, 20364, 12);
    @CAN_RadarFL::RXX_Object::RXX_Object_Obj38_VxAxCoVnce = convertRawToPhysical(raw_value, 0.01, 0.0);

    raw_value=copyBitsFromByteArrayLE( byteArray, 20384, 12);
    @CAN_RadarFL::RXX_Object::RXX_Object_Obj38_VxAyCoVnce = convertRawToPhysical(raw_value, 0.01, 0.0);

    raw_value=copyBitsFromByteArrayLE( byteArray, 20160, 12);
    @CAN_RadarFL::RXX_Object::RXX_Object_Obj38_VxVnce = convertRawToPhysical(raw_value, 0.01, 0.0);

    raw_value=copyBitsFromByteArrayLE( byteArray, 20352, 12);
    @CAN_RadarFL::RXX_Object::RXX_Object_Obj38_VxVyCoVnce = convertRawToPhysical(raw_value, 0.01, 0.0);

    raw_value=copyBitsFromByteArrayLE( byteArray, 20174, 10);
    @CAN_RadarFL::RXX_Object::RXX_Object_Obj38_Vy = convertRawToPhysical(raw_value, 0.125, -64.0);

    raw_value=copyBitsFromByteArrayLE( byteArray, 20396, 12);
    @CAN_RadarFL::RXX_Object::RXX_Object_Obj38_VyAxCoVnce = convertRawToPhysical(raw_value, 0.01, 0.0);

    raw_value=copyBitsFromByteArrayLE( byteArray, 20416, 12);
    @CAN_RadarFL::RXX_Object::RXX_Object_Obj38_VyAyCoVnce = convertRawToPhysical(raw_value, 0.01, 0.0);

    raw_value=copyBitsFromByteArrayLE( byteArray, 20192, 12);
    @CAN_RadarFL::RXX_Object::RXX_Object_Obj38_VyVnce = convertRawToPhysical(raw_value, 0.01, 0.0);

    raw_value=copyBitsFromByteArrayLE( byteArray, 20088, 7);
    @CAN_RadarFL::RXX_Object::RXX_Object_Obj38_Width = convertRawToPhysical(raw_value, 0.125, 0.0);

    raw_value=copyBitsFromByteArrayLE( byteArray, 20096, 12);
    @CAN_RadarFL::RXX_Object::RXX_Object_Obj38_WidthVnce = convertRawToPhysical(raw_value, 0.01, 0.0);

    raw_value=copyBitsFromByteArrayLE( byteArray, 20960, 32);
    @CAN_RadarFL::RXX_Object::RXX_Object_Obj39_Age = convertRawToPhysical(raw_value, 1.0, 0.0);

    raw_value=copyBitsFromByteArrayLE( byteArray, 20556, 10);
    @CAN_RadarFL::RXX_Object::RXX_Object_Obj39_Ax = convertRawToPhysical(raw_value, 0.03125, -16.0);

    raw_value=copyBitsFromByteArrayLE( byteArray, 20940, 12);
    @CAN_RadarFL::RXX_Object::RXX_Object_Obj39_AxAyCoVnce = convertRawToPhysical(raw_value, 0.01, 0.0);

    raw_value=copyBitsFromByteArrayLE( byteArray, 20576, 12);
    @CAN_RadarFL::RXX_Object::RXX_Object_Obj39_AxVnce = convertRawToPhysical(raw_value, 0.01, 0.0);

    raw_value=copyBitsFromByteArrayLE( byteArray, 20630, 9);
    @CAN_RadarFL::RXX_Object::RXX_Object_Obj39_Ay = convertRawToPhysical(raw_value, 0.0625, -16.0);

    raw_value=copyBitsFromByteArrayLE( byteArray, 20640, 12);
    @CAN_RadarFL::RXX_Object::RXX_Object_Obj39_AyVnce = convertRawToPhysical(raw_value, 0.01, 0.0);

    raw_value=copyBitsFromByteArrayLE( byteArray, 20696, 6);
    @CAN_RadarFL::RXX_Object::RXX_Object_Obj39_ExistProb = convertRawToPhysical(raw_value, 2.0, 0.0);

    raw_value=copyBitsFromByteArrayLE( byteArray, 20760, 8);
    @CAN_RadarFL::RXX_Object::RXX_Object_Obj39_FilterInformation = convertRawToPhysical(raw_value, 1.0, 0.0);

    raw_value=copyBitsFromByteArrayLE( byteArray, 20536, 7);
    @CAN_RadarFL::RXX_Object::RXX_Object_Obj39_Length = convertRawToPhysical(raw_value, 0.125, 0.0);

    raw_value=copyBitsFromByteArrayLE( byteArray, 20544, 12);
    @CAN_RadarFL::RXX_Object::RXX_Object_Obj39_LengthVnce = convertRawToPhysical(raw_value, 0.01, 0.0);

    raw_value=copyBitsFromByteArrayLE( byteArray, 20728, 3);
    @CAN_RadarFL::RXX_Object::RXX_Object_Obj39_MeasurementStatus = convertRawToPhysical(raw_value, 1.0, 0.0);

    raw_value=copyBitsFromByteArrayLE( byteArray, 20684, 2);
    @CAN_RadarFL::RXX_Object::RXX_Object_Obj39_MovingStatus = convertRawToPhysical(raw_value, 1.0, 0.0);

    raw_value=copyBitsFromByteArrayLE( byteArray, 20664, 7);
    @CAN_RadarFL::RXX_Object::RXX_Object_Obj39_ObjId = convertRawToPhysical(raw_value, 1.0, 0.0);

    raw_value=copyBitsFromByteArrayLE( byteArray, 20566, 9);
    @CAN_RadarFL::RXX_Object::RXX_Object_Obj39_OrientationYaw = convertRawToPhysical(raw_value, 0.0175, -4.48);

    raw_value=copyBitsFromByteArrayLE( byteArray, 20588, 12);
    @CAN_RadarFL::RXX_Object::RXX_Object_Obj39_OrientationYawVnce = convertRawToPhysical(raw_value, 0.0003, 0.0);

    raw_value=copyBitsFromByteArrayLE( byteArray, 20480, 6);
    @CAN_RadarFL::RXX_Object::RXX_Object_Obj39_ProbClassConfidence = convertRawToPhysical(raw_value, 2.0, 0.0);

    raw_value=copyBitsFromByteArrayLE( byteArray, 20731, 4);
    @CAN_RadarFL::RXX_Object::RXX_Object_Obj39_ProbClassType = convertRawToPhysical(raw_value, 1.0, 0.0);

    raw_value=copyBitsFromByteArrayLE( byteArray, 20486, 14);
    @CAN_RadarFL::RXX_Object::RXX_Object_Obj39_Px = convertRawToPhysical(raw_value, 0.0625, -512.0);

    raw_value=copyBitsFromByteArrayLE( byteArray, 20800, 12);
    @CAN_RadarFL::RXX_Object::RXX_Object_Obj39_PxAxCoVnce = convertRawToPhysical(raw_value, 0.01, 0.0);

    raw_value=copyBitsFromByteArrayLE( byteArray, 20812, 12);
    @CAN_RadarFL::RXX_Object::RXX_Object_Obj39_PxAyCoVnce = convertRawToPhysical(raw_value, 0.01, 0.0);

    raw_value=copyBitsFromByteArrayLE( byteArray, 20716, 12);
    @CAN_RadarFL::RXX_Object::RXX_Object_Obj39_PxPyCoVnce = convertRawToPhysical(raw_value, 0.01, 0.0);

    raw_value=copyBitsFromByteArrayLE( byteArray, 20500, 12);
    @CAN_RadarFL::RXX_Object::RXX_Object_Obj39_PxVnce = convertRawToPhysical(raw_value, 0.1, 0.0);

    raw_value=copyBitsFromByteArrayLE( byteArray, 20736, 12);
    @CAN_RadarFL::RXX_Object::RXX_Object_Obj39_PxVxCoVnce = convertRawToPhysical(raw_value, 0.01, 0.0);

    raw_value=copyBitsFromByteArrayLE( byteArray, 20748, 12);
    @CAN_RadarFL::RXX_Object::RXX_Object_Obj39_PxVyCoVnce = convertRawToPhysical(raw_value, 0.01, 0.0);

    raw_value=copyBitsFromByteArrayLE( byteArray, 20512, 12);
    @CAN_RadarFL::RXX_Object::RXX_Object_Obj39_Py = convertRawToPhysical(raw_value, 0.0625, -128.0);

    raw_value=copyBitsFromByteArrayLE( byteArray, 20832, 12);
    @CAN_RadarFL::RXX_Object::RXX_Object_Obj39_PyAxCoVnce = convertRawToPhysical(raw_value, 0.01, 0.0);

    raw_value=copyBitsFromByteArrayLE( byteArray, 20844, 12);
    @CAN_RadarFL::RXX_Object::RXX_Object_Obj39_PyAyCoVnce = convertRawToPhysical(raw_value, 0.01, 0.0);

    raw_value=copyBitsFromByteArrayLE( byteArray, 20524, 12);
    @CAN_RadarFL::RXX_Object::RXX_Object_Obj39_PyVnce = convertRawToPhysical(raw_value, 0.1, 0.0);

    raw_value=copyBitsFromByteArrayLE( byteArray, 20768, 12);
    @CAN_RadarFL::RXX_Object::RXX_Object_Obj39_PyVxCoVnce = convertRawToPhysical(raw_value, 0.01, 0.0);

    raw_value=copyBitsFromByteArrayLE( byteArray, 20780, 12);
    @CAN_RadarFL::RXX_Object::RXX_Object_Obj39_PyVyCoVnce = convertRawToPhysical(raw_value, 0.01, 0.0);

    raw_value=copyBitsFromByteArrayLE( byteArray, 20620, 10);
    @CAN_RadarFL::RXX_Object::RXX_Object_Obj39_RCS = convertRawToPhysical(raw_value, 0.2, -102.4);

    raw_value=copyBitsFromByteArrayLE( byteArray, 20792, 4);
    @CAN_RadarFL::RXX_Object::RXX_Object_Obj39_ReferencePoint = convertRawToPhysical(raw_value, 1.0, 0.0);

    raw_value=copyBitsFromByteArrayLE( byteArray, 20652, 12);
    @CAN_RadarFL::RXX_Object::RXX_Object_Obj39_Vx = convertRawToPhysical(raw_value, 0.0625, -128.0);

    raw_value=copyBitsFromByteArrayLE( byteArray, 20876, 12);
    @CAN_RadarFL::RXX_Object::RXX_Object_Obj39_VxAxCoVnce = convertRawToPhysical(raw_value, 0.01, 0.0);

    raw_value=copyBitsFromByteArrayLE( byteArray, 20896, 12);
    @CAN_RadarFL::RXX_Object::RXX_Object_Obj39_VxAyCoVnce = convertRawToPhysical(raw_value, 0.01, 0.0);

    raw_value=copyBitsFromByteArrayLE( byteArray, 20672, 12);
    @CAN_RadarFL::RXX_Object::RXX_Object_Obj39_VxVnce = convertRawToPhysical(raw_value, 0.01, 0.0);

    raw_value=copyBitsFromByteArrayLE( byteArray, 20864, 12);
    @CAN_RadarFL::RXX_Object::RXX_Object_Obj39_VxVyCoVnce = convertRawToPhysical(raw_value, 0.01, 0.0);

    raw_value=copyBitsFromByteArrayLE( byteArray, 20686, 10);
    @CAN_RadarFL::RXX_Object::RXX_Object_Obj39_Vy = convertRawToPhysical(raw_value, 0.125, -64.0);

    raw_value=copyBitsFromByteArrayLE( byteArray, 20908, 12);
    @CAN_RadarFL::RXX_Object::RXX_Object_Obj39_VyAxCoVnce = convertRawToPhysical(raw_value, 0.01, 0.0);

    raw_value=copyBitsFromByteArrayLE( byteArray, 20928, 12);
    @CAN_RadarFL::RXX_Object::RXX_Object_Obj39_VyAyCoVnce = convertRawToPhysical(raw_value, 0.01, 0.0);

    raw_value=copyBitsFromByteArrayLE( byteArray, 20704, 12);
    @CAN_RadarFL::RXX_Object::RXX_Object_Obj39_VyVnce = convertRawToPhysical(raw_value, 0.01, 0.0);

    raw_value=copyBitsFromByteArrayLE( byteArray, 20600, 7);
    @CAN_RadarFL::RXX_Object::RXX_Object_Obj39_Width = convertRawToPhysical(raw_value, 0.125, 0.0);

    raw_value=copyBitsFromByteArrayLE( byteArray, 20608, 12);
    @CAN_RadarFL::RXX_Object::RXX_Object_Obj39_WidthVnce = convertRawToPhysical(raw_value, 0.01, 0.0);

    raw_value=copyBitsFromByteArrayLE( byteArray, 2528, 32);
    @CAN_RadarFL::RXX_Object::RXX_Object_Obj3_Age = convertRawToPhysical(raw_value, 1.0, 0.0);

    raw_value=copyBitsFromByteArrayLE( byteArray, 2124, 10);
    @CAN_RadarFL::RXX_Object::RXX_Object_Obj3_Ax = convertRawToPhysical(raw_value, 0.03125, -16.0);

    raw_value=copyBitsFromByteArrayLE( byteArray, 2508, 12);
    @CAN_RadarFL::RXX_Object::RXX_Object_Obj3_AxAyCoVnce = convertRawToPhysical(raw_value, 0.01, 0.0);

    raw_value=copyBitsFromByteArrayLE( byteArray, 2144, 12);
    @CAN_RadarFL::RXX_Object::RXX_Object_Obj3_AxVnce = convertRawToPhysical(raw_value, 0.01, 0.0);

    raw_value=copyBitsFromByteArrayLE( byteArray, 2198, 9);
    @CAN_RadarFL::RXX_Object::RXX_Object_Obj3_Ay = convertRawToPhysical(raw_value, 0.0625, -16.0);

    raw_value=copyBitsFromByteArrayLE( byteArray, 2208, 12);
    @CAN_RadarFL::RXX_Object::RXX_Object_Obj3_AyVnce = convertRawToPhysical(raw_value, 0.01, 0.0);

    raw_value=copyBitsFromByteArrayLE( byteArray, 2264, 6);
    @CAN_RadarFL::RXX_Object::RXX_Object_Obj3_ExistProb = convertRawToPhysical(raw_value, 2.0, 0.0);

    raw_value=copyBitsFromByteArrayLE( byteArray, 2328, 8);
    @CAN_RadarFL::RXX_Object::RXX_Object_Obj3_FilterInformation = convertRawToPhysical(raw_value, 1.0, 0.0);

    raw_value=copyBitsFromByteArrayLE( byteArray, 2104, 7);
    @CAN_RadarFL::RXX_Object::RXX_Object_Obj3_Length = convertRawToPhysical(raw_value, 0.125, 0.0);

    raw_value=copyBitsFromByteArrayLE( byteArray, 2112, 12);
    @CAN_RadarFL::RXX_Object::RXX_Object_Obj3_LengthVnce = convertRawToPhysical(raw_value, 0.01, 0.0);

    raw_value=copyBitsFromByteArrayLE( byteArray, 2296, 3);
    @CAN_RadarFL::RXX_Object::RXX_Object_Obj3_MeasurementStatus = convertRawToPhysical(raw_value, 1.0, 0.0);

    raw_value=copyBitsFromByteArrayLE( byteArray, 2252, 2);
    @CAN_RadarFL::RXX_Object::RXX_Object_Obj3_MovingStatus = convertRawToPhysical(raw_value, 1.0, 0.0);

    raw_value=copyBitsFromByteArrayLE( byteArray, 2232, 7);
    @CAN_RadarFL::RXX_Object::RXX_Object_Obj3_ObjId = convertRawToPhysical(raw_value, 1.0, 0.0);

    raw_value=copyBitsFromByteArrayLE( byteArray, 2134, 9);
    @CAN_RadarFL::RXX_Object::RXX_Object_Obj3_OrientationYaw = convertRawToPhysical(raw_value, 0.0175, -4.48);

    raw_value=copyBitsFromByteArrayLE( byteArray, 2156, 12);
    @CAN_RadarFL::RXX_Object::RXX_Object_Obj3_OrientationYawVnce = convertRawToPhysical(raw_value, 0.0003, 0.0);

    raw_value=copyBitsFromByteArrayLE( byteArray, 2048, 6);
    @CAN_RadarFL::RXX_Object::RXX_Object_Obj3_ProbClassConfidence = convertRawToPhysical(raw_value, 2.0, 0.0);

    raw_value=copyBitsFromByteArrayLE( byteArray, 2299, 4);
    @CAN_RadarFL::RXX_Object::RXX_Object_Obj3_ProbClassType = convertRawToPhysical(raw_value, 1.0, 0.0);

    raw_value=copyBitsFromByteArrayLE( byteArray, 2054, 14);
    @CAN_RadarFL::RXX_Object::RXX_Object_Obj3_Px = convertRawToPhysical(raw_value, 0.0625, -512.0);

    raw_value=copyBitsFromByteArrayLE( byteArray, 2368, 12);
    @CAN_RadarFL::RXX_Object::RXX_Object_Obj3_PxAxCoVnce = convertRawToPhysical(raw_value, 0.01, 0.0);

    raw_value=copyBitsFromByteArrayLE( byteArray, 2380, 12);
    @CAN_RadarFL::RXX_Object::RXX_Object_Obj3_PxAyCoVnce = convertRawToPhysical(raw_value, 0.01, 0.0);

    raw_value=copyBitsFromByteArrayLE( byteArray, 2284, 12);
    @CAN_RadarFL::RXX_Object::RXX_Object_Obj3_PxPyCoVnce = convertRawToPhysical(raw_value, 0.01, 0.0);

    raw_value=copyBitsFromByteArrayLE( byteArray, 2068, 12);
    @CAN_RadarFL::RXX_Object::RXX_Object_Obj3_PxVnce = convertRawToPhysical(raw_value, 0.1, 0.0);

    raw_value=copyBitsFromByteArrayLE( byteArray, 2304, 12);
    @CAN_RadarFL::RXX_Object::RXX_Object_Obj3_PxVxCoVnce = convertRawToPhysical(raw_value, 0.01, 0.0);

    raw_value=copyBitsFromByteArrayLE( byteArray, 2316, 12);
    @CAN_RadarFL::RXX_Object::RXX_Object_Obj3_PxVyCoVnce = convertRawToPhysical(raw_value, 0.01, 0.0);

    raw_value=copyBitsFromByteArrayLE( byteArray, 2080, 12);
    @CAN_RadarFL::RXX_Object::RXX_Object_Obj3_Py = convertRawToPhysical(raw_value, 0.0625, -128.0);

    raw_value=copyBitsFromByteArrayLE( byteArray, 2400, 12);
    @CAN_RadarFL::RXX_Object::RXX_Object_Obj3_PyAxCoVnce = convertRawToPhysical(raw_value, 0.01, 0.0);

    raw_value=copyBitsFromByteArrayLE( byteArray, 2412, 12);
    @CAN_RadarFL::RXX_Object::RXX_Object_Obj3_PyAyCoVnce = convertRawToPhysical(raw_value, 0.01, 0.0);

    raw_value=copyBitsFromByteArrayLE( byteArray, 2092, 12);
    @CAN_RadarFL::RXX_Object::RXX_Object_Obj3_PyVnce = convertRawToPhysical(raw_value, 0.1, 0.0);

    raw_value=copyBitsFromByteArrayLE( byteArray, 2336, 12);
    @CAN_RadarFL::RXX_Object::RXX_Object_Obj3_PyVxCoVnce = convertRawToPhysical(raw_value, 0.01, 0.0);

    raw_value=copyBitsFromByteArrayLE( byteArray, 2348, 12);
    @CAN_RadarFL::RXX_Object::RXX_Object_Obj3_PyVyCoVnce = convertRawToPhysical(raw_value, 0.01, 0.0);

    raw_value=copyBitsFromByteArrayLE( byteArray, 2188, 10);
    @CAN_RadarFL::RXX_Object::RXX_Object_Obj3_RCS = convertRawToPhysical(raw_value, 0.2, -102.4);

    raw_value=copyBitsFromByteArrayLE( byteArray, 2360, 4);
    @CAN_RadarFL::RXX_Object::RXX_Object_Obj3_ReferencePoint = convertRawToPhysical(raw_value, 1.0, 0.0);

    raw_value=copyBitsFromByteArrayLE( byteArray, 2220, 12);
    @CAN_RadarFL::RXX_Object::RXX_Object_Obj3_Vx = convertRawToPhysical(raw_value, 0.0625, -128.0);

    raw_value=copyBitsFromByteArrayLE( byteArray, 2444, 12);
    @CAN_RadarFL::RXX_Object::RXX_Object_Obj3_VxAxCoVnce = convertRawToPhysical(raw_value, 0.01, 0.0);

    raw_value=copyBitsFromByteArrayLE( byteArray, 2464, 12);
    @CAN_RadarFL::RXX_Object::RXX_Object_Obj3_VxAyCoVnce = convertRawToPhysical(raw_value, 0.01, 0.0);

    raw_value=copyBitsFromByteArrayLE( byteArray, 2240, 12);
    @CAN_RadarFL::RXX_Object::RXX_Object_Obj3_VxVnce = convertRawToPhysical(raw_value, 0.01, 0.0);

    raw_value=copyBitsFromByteArrayLE( byteArray, 2432, 12);
    @CAN_RadarFL::RXX_Object::RXX_Object_Obj3_VxVyCoVnce = convertRawToPhysical(raw_value, 0.01, 0.0);

    raw_value=copyBitsFromByteArrayLE( byteArray, 2254, 10);
    @CAN_RadarFL::RXX_Object::RXX_Object_Obj3_Vy = convertRawToPhysical(raw_value, 0.125, -64.0);

    raw_value=copyBitsFromByteArrayLE( byteArray, 2476, 12);
    @CAN_RadarFL::RXX_Object::RXX_Object_Obj3_VyAxCoVnce = convertRawToPhysical(raw_value, 0.01, 0.0);

    raw_value=copyBitsFromByteArrayLE( byteArray, 2496, 12);
    @CAN_RadarFL::RXX_Object::RXX_Object_Obj3_VyAyCoVnce = convertRawToPhysical(raw_value, 0.01, 0.0);

    raw_value=copyBitsFromByteArrayLE( byteArray, 2272, 12);
    @CAN_RadarFL::RXX_Object::RXX_Object_Obj3_VyVnce = convertRawToPhysical(raw_value, 0.01, 0.0);

    raw_value=copyBitsFromByteArrayLE( byteArray, 2168, 7);
    @CAN_RadarFL::RXX_Object::RXX_Object_Obj3_Width = convertRawToPhysical(raw_value, 0.125, 0.0);

    raw_value=copyBitsFromByteArrayLE( byteArray, 2176, 12);
    @CAN_RadarFL::RXX_Object::RXX_Object_Obj3_WidthVnce = convertRawToPhysical(raw_value, 0.01, 0.0);

    raw_value=copyBitsFromByteArrayLE( byteArray, 21472, 32);
    @CAN_RadarFL::RXX_Object::RXX_Object_Obj40_Age = convertRawToPhysical(raw_value, 1.0, 0.0);

    raw_value=copyBitsFromByteArrayLE( byteArray, 21068, 10);
    @CAN_RadarFL::RXX_Object::RXX_Object_Obj40_Ax = convertRawToPhysical(raw_value, 0.03125, -16.0);

    raw_value=copyBitsFromByteArrayLE( byteArray, 21452, 12);
    @CAN_RadarFL::RXX_Object::RXX_Object_Obj40_AxAyCoVnce = convertRawToPhysical(raw_value, 0.01, 0.0);

    raw_value=copyBitsFromByteArrayLE( byteArray, 21088, 12);
    @CAN_RadarFL::RXX_Object::RXX_Object_Obj40_AxVnce = convertRawToPhysical(raw_value, 0.01, 0.0);

    raw_value=copyBitsFromByteArrayLE( byteArray, 21142, 9);
    @CAN_RadarFL::RXX_Object::RXX_Object_Obj40_Ay = convertRawToPhysical(raw_value, 0.0625, -16.0);

    raw_value=copyBitsFromByteArrayLE( byteArray, 21152, 12);
    @CAN_RadarFL::RXX_Object::RXX_Object_Obj40_AyVnce = convertRawToPhysical(raw_value, 0.01, 0.0);

    raw_value=copyBitsFromByteArrayLE( byteArray, 21208, 6);
    @CAN_RadarFL::RXX_Object::RXX_Object_Obj40_ExistProb = convertRawToPhysical(raw_value, 2.0, 0.0);

    raw_value=copyBitsFromByteArrayLE( byteArray, 21272, 8);
    @CAN_RadarFL::RXX_Object::RXX_Object_Obj40_FilterInformation = convertRawToPhysical(raw_value, 1.0, 0.0);

    raw_value=copyBitsFromByteArrayLE( byteArray, 21048, 7);
    @CAN_RadarFL::RXX_Object::RXX_Object_Obj40_Length = convertRawToPhysical(raw_value, 0.125, 0.0);

    raw_value=copyBitsFromByteArrayLE( byteArray, 21056, 12);
    @CAN_RadarFL::RXX_Object::RXX_Object_Obj40_LengthVnce = convertRawToPhysical(raw_value, 0.01, 0.0);

    raw_value=copyBitsFromByteArrayLE( byteArray, 21240, 3);
    @CAN_RadarFL::RXX_Object::RXX_Object_Obj40_MeasurementStatus = convertRawToPhysical(raw_value, 1.0, 0.0);

    raw_value=copyBitsFromByteArrayLE( byteArray, 21196, 2);
    @CAN_RadarFL::RXX_Object::RXX_Object_Obj40_MovingStatus = convertRawToPhysical(raw_value, 1.0, 0.0);

    raw_value=copyBitsFromByteArrayLE( byteArray, 21176, 7);
    @CAN_RadarFL::RXX_Object::RXX_Object_Obj40_ObjId = convertRawToPhysical(raw_value, 1.0, 0.0);

    raw_value=copyBitsFromByteArrayLE( byteArray, 21078, 9);
    @CAN_RadarFL::RXX_Object::RXX_Object_Obj40_OrientationYaw = convertRawToPhysical(raw_value, 0.0175, -4.48);

    raw_value=copyBitsFromByteArrayLE( byteArray, 21100, 12);
    @CAN_RadarFL::RXX_Object::RXX_Object_Obj40_OrientationYawVnce = convertRawToPhysical(raw_value, 0.0003, 0.0);

    raw_value=copyBitsFromByteArrayLE( byteArray, 20992, 6);
    @CAN_RadarFL::RXX_Object::RXX_Object_Obj40_ProbClassConfidence = convertRawToPhysical(raw_value, 2.0, 0.0);

    raw_value=copyBitsFromByteArrayLE( byteArray, 21243, 4);
    @CAN_RadarFL::RXX_Object::RXX_Object_Obj40_ProbClassType = convertRawToPhysical(raw_value, 1.0, 0.0);

    raw_value=copyBitsFromByteArrayLE( byteArray, 20998, 14);
    @CAN_RadarFL::RXX_Object::RXX_Object_Obj40_Px = convertRawToPhysical(raw_value, 0.0625, -512.0);

    raw_value=copyBitsFromByteArrayLE( byteArray, 21312, 12);
    @CAN_RadarFL::RXX_Object::RXX_Object_Obj40_PxAxCoVnce = convertRawToPhysical(raw_value, 0.01, 0.0);

    raw_value=copyBitsFromByteArrayLE( byteArray, 21324, 12);
    @CAN_RadarFL::RXX_Object::RXX_Object_Obj40_PxAyCoVnce = convertRawToPhysical(raw_value, 0.01, 0.0);

    raw_value=copyBitsFromByteArrayLE( byteArray, 21228, 12);
    @CAN_RadarFL::RXX_Object::RXX_Object_Obj40_PxPyCoVnce = convertRawToPhysical(raw_value, 0.01, 0.0);

    raw_value=copyBitsFromByteArrayLE( byteArray, 21012, 12);
    @CAN_RadarFL::RXX_Object::RXX_Object_Obj40_PxVnce = convertRawToPhysical(raw_value, 0.1, 0.0);

    raw_value=copyBitsFromByteArrayLE( byteArray, 21248, 12);
    @CAN_RadarFL::RXX_Object::RXX_Object_Obj40_PxVxCoVnce = convertRawToPhysical(raw_value, 0.01, 0.0);

    raw_value=copyBitsFromByteArrayLE( byteArray, 21260, 12);
    @CAN_RadarFL::RXX_Object::RXX_Object_Obj40_PxVyCoVnce = convertRawToPhysical(raw_value, 0.01, 0.0);

    raw_value=copyBitsFromByteArrayLE( byteArray, 21024, 12);
    @CAN_RadarFL::RXX_Object::RXX_Object_Obj40_Py = convertRawToPhysical(raw_value, 0.0625, -128.0);

    raw_value=copyBitsFromByteArrayLE( byteArray, 21344, 12);
    @CAN_RadarFL::RXX_Object::RXX_Object_Obj40_PyAxCoVnce = convertRawToPhysical(raw_value, 0.01, 0.0);

    raw_value=copyBitsFromByteArrayLE( byteArray, 21356, 12);
    @CAN_RadarFL::RXX_Object::RXX_Object_Obj40_PyAyCoVnce = convertRawToPhysical(raw_value, 0.01, 0.0);

    raw_value=copyBitsFromByteArrayLE( byteArray, 21036, 12);
    @CAN_RadarFL::RXX_Object::RXX_Object_Obj40_PyVnce = convertRawToPhysical(raw_value, 0.1, 0.0);

    raw_value=copyBitsFromByteArrayLE( byteArray, 21280, 12);
    @CAN_RadarFL::RXX_Object::RXX_Object_Obj40_PyVxCoVnce = convertRawToPhysical(raw_value, 0.01, 0.0);

    raw_value=copyBitsFromByteArrayLE( byteArray, 21292, 12);
    @CAN_RadarFL::RXX_Object::RXX_Object_Obj40_PyVyCoVnce = convertRawToPhysical(raw_value, 0.01, 0.0);

    raw_value=copyBitsFromByteArrayLE( byteArray, 21132, 10);
    @CAN_RadarFL::RXX_Object::RXX_Object_Obj40_RCS = convertRawToPhysical(raw_value, 0.2, -102.4);

    raw_value=copyBitsFromByteArrayLE( byteArray, 21304, 4);
    @CAN_RadarFL::RXX_Object::RXX_Object_Obj40_ReferencePoint = convertRawToPhysical(raw_value, 1.0, 0.0);

    raw_value=copyBitsFromByteArrayLE( byteArray, 21164, 12);
    @CAN_RadarFL::RXX_Object::RXX_Object_Obj40_Vx = convertRawToPhysical(raw_value, 0.0625, -128.0);

    raw_value=copyBitsFromByteArrayLE( byteArray, 21388, 12);
    @CAN_RadarFL::RXX_Object::RXX_Object_Obj40_VxAxCoVnce = convertRawToPhysical(raw_value, 0.01, 0.0);

    raw_value=copyBitsFromByteArrayLE( byteArray, 21408, 12);
    @CAN_RadarFL::RXX_Object::RXX_Object_Obj40_VxAyCoVnce = convertRawToPhysical(raw_value, 0.01, 0.0);

    raw_value=copyBitsFromByteArrayLE( byteArray, 21184, 12);
    @CAN_RadarFL::RXX_Object::RXX_Object_Obj40_VxVnce = convertRawToPhysical(raw_value, 0.01, 0.0);

    raw_value=copyBitsFromByteArrayLE( byteArray, 21376, 12);
    @CAN_RadarFL::RXX_Object::RXX_Object_Obj40_VxVyCoVnce = convertRawToPhysical(raw_value, 0.01, 0.0);

    raw_value=copyBitsFromByteArrayLE( byteArray, 21198, 10);
    @CAN_RadarFL::RXX_Object::RXX_Object_Obj40_Vy = convertRawToPhysical(raw_value, 0.125, -64.0);

    raw_value=copyBitsFromByteArrayLE( byteArray, 21420, 12);
    @CAN_RadarFL::RXX_Object::RXX_Object_Obj40_VyAxCoVnce = convertRawToPhysical(raw_value, 0.01, 0.0);

    raw_value=copyBitsFromByteArrayLE( byteArray, 21440, 12);
    @CAN_RadarFL::RXX_Object::RXX_Object_Obj40_VyAyCoVnce = convertRawToPhysical(raw_value, 0.01, 0.0);

    raw_value=copyBitsFromByteArrayLE( byteArray, 21216, 12);
    @CAN_RadarFL::RXX_Object::RXX_Object_Obj40_VyVnce = convertRawToPhysical(raw_value, 0.01, 0.0);

    raw_value=copyBitsFromByteArrayLE( byteArray, 21112, 7);
    @CAN_RadarFL::RXX_Object::RXX_Object_Obj40_Width = convertRawToPhysical(raw_value, 0.125, 0.0);

    raw_value=copyBitsFromByteArrayLE( byteArray, 21120, 12);
    @CAN_RadarFL::RXX_Object::RXX_Object_Obj40_WidthVnce = convertRawToPhysical(raw_value, 0.01, 0.0);

    raw_value=copyBitsFromByteArrayLE( byteArray, 21984, 32);
    @CAN_RadarFL::RXX_Object::RXX_Object_Obj41_Age = convertRawToPhysical(raw_value, 1.0, 0.0);

    raw_value=copyBitsFromByteArrayLE( byteArray, 21580, 10);
    @CAN_RadarFL::RXX_Object::RXX_Object_Obj41_Ax = convertRawToPhysical(raw_value, 0.03125, -16.0);

    raw_value=copyBitsFromByteArrayLE( byteArray, 21964, 12);
    @CAN_RadarFL::RXX_Object::RXX_Object_Obj41_AxAyCoVnce = convertRawToPhysical(raw_value, 0.01, 0.0);

    raw_value=copyBitsFromByteArrayLE( byteArray, 21600, 12);
    @CAN_RadarFL::RXX_Object::RXX_Object_Obj41_AxVnce = convertRawToPhysical(raw_value, 0.01, 0.0);

    raw_value=copyBitsFromByteArrayLE( byteArray, 21654, 9);
    @CAN_RadarFL::RXX_Object::RXX_Object_Obj41_Ay = convertRawToPhysical(raw_value, 0.0625, -16.0);

    raw_value=copyBitsFromByteArrayLE( byteArray, 21664, 12);
    @CAN_RadarFL::RXX_Object::RXX_Object_Obj41_AyVnce = convertRawToPhysical(raw_value, 0.01, 0.0);

    raw_value=copyBitsFromByteArrayLE( byteArray, 21720, 6);
    @CAN_RadarFL::RXX_Object::RXX_Object_Obj41_ExistProb = convertRawToPhysical(raw_value, 2.0, 0.0);

    raw_value=copyBitsFromByteArrayLE( byteArray, 21784, 8);
    @CAN_RadarFL::RXX_Object::RXX_Object_Obj41_FilterInformation = convertRawToPhysical(raw_value, 1.0, 0.0);

    raw_value=copyBitsFromByteArrayLE( byteArray, 21560, 7);
    @CAN_RadarFL::RXX_Object::RXX_Object_Obj41_Length = convertRawToPhysical(raw_value, 0.125, 0.0);

    raw_value=copyBitsFromByteArrayLE( byteArray, 21568, 12);
    @CAN_RadarFL::RXX_Object::RXX_Object_Obj41_LengthVnce = convertRawToPhysical(raw_value, 0.01, 0.0);

    raw_value=copyBitsFromByteArrayLE( byteArray, 21752, 3);
    @CAN_RadarFL::RXX_Object::RXX_Object_Obj41_MeasurementStatus = convertRawToPhysical(raw_value, 1.0, 0.0);

    raw_value=copyBitsFromByteArrayLE( byteArray, 21708, 2);
    @CAN_RadarFL::RXX_Object::RXX_Object_Obj41_MovingStatus = convertRawToPhysical(raw_value, 1.0, 0.0);

    raw_value=copyBitsFromByteArrayLE( byteArray, 21688, 7);
    @CAN_RadarFL::RXX_Object::RXX_Object_Obj41_ObjId = convertRawToPhysical(raw_value, 1.0, 0.0);

    raw_value=copyBitsFromByteArrayLE( byteArray, 21590, 9);
    @CAN_RadarFL::RXX_Object::RXX_Object_Obj41_OrientationYaw = convertRawToPhysical(raw_value, 0.0175, -4.48);

    raw_value=copyBitsFromByteArrayLE( byteArray, 21612, 12);
    @CAN_RadarFL::RXX_Object::RXX_Object_Obj41_OrientationYawVnce = convertRawToPhysical(raw_value, 0.0003, 0.0);

    raw_value=copyBitsFromByteArrayLE( byteArray, 21504, 6);
    @CAN_RadarFL::RXX_Object::RXX_Object_Obj41_ProbClassConfidence = convertRawToPhysical(raw_value, 2.0, 0.0);

    raw_value=copyBitsFromByteArrayLE( byteArray, 21755, 4);
    @CAN_RadarFL::RXX_Object::RXX_Object_Obj41_ProbClassType = convertRawToPhysical(raw_value, 1.0, 0.0);

    raw_value=copyBitsFromByteArrayLE( byteArray, 21510, 14);
    @CAN_RadarFL::RXX_Object::RXX_Object_Obj41_Px = convertRawToPhysical(raw_value, 0.0625, -512.0);

    raw_value=copyBitsFromByteArrayLE( byteArray, 21824, 12);
    @CAN_RadarFL::RXX_Object::RXX_Object_Obj41_PxAxCoVnce = convertRawToPhysical(raw_value, 0.01, 0.0);

    raw_value=copyBitsFromByteArrayLE( byteArray, 21836, 12);
    @CAN_RadarFL::RXX_Object::RXX_Object_Obj41_PxAyCoVnce = convertRawToPhysical(raw_value, 0.01, 0.0);

    raw_value=copyBitsFromByteArrayLE( byteArray, 21740, 12);
    @CAN_RadarFL::RXX_Object::RXX_Object_Obj41_PxPyCoVnce = convertRawToPhysical(raw_value, 0.01, 0.0);

    raw_value=copyBitsFromByteArrayLE( byteArray, 21524, 12);
    @CAN_RadarFL::RXX_Object::RXX_Object_Obj41_PxVnce = convertRawToPhysical(raw_value, 0.1, 0.0);

    raw_value=copyBitsFromByteArrayLE( byteArray, 21760, 12);
    @CAN_RadarFL::RXX_Object::RXX_Object_Obj41_PxVxCoVnce = convertRawToPhysical(raw_value, 0.01, 0.0);

    raw_value=copyBitsFromByteArrayLE( byteArray, 21772, 12);
    @CAN_RadarFL::RXX_Object::RXX_Object_Obj41_PxVyCoVnce = convertRawToPhysical(raw_value, 0.01, 0.0);

    raw_value=copyBitsFromByteArrayLE( byteArray, 21536, 12);
    @CAN_RadarFL::RXX_Object::RXX_Object_Obj41_Py = convertRawToPhysical(raw_value, 0.0625, -128.0);

    raw_value=copyBitsFromByteArrayLE( byteArray, 21856, 12);
    @CAN_RadarFL::RXX_Object::RXX_Object_Obj41_PyAxCoVnce = convertRawToPhysical(raw_value, 0.01, 0.0);

    raw_value=copyBitsFromByteArrayLE( byteArray, 21868, 12);
    @CAN_RadarFL::RXX_Object::RXX_Object_Obj41_PyAyCoVnce = convertRawToPhysical(raw_value, 0.01, 0.0);

    raw_value=copyBitsFromByteArrayLE( byteArray, 21548, 12);
    @CAN_RadarFL::RXX_Object::RXX_Object_Obj41_PyVnce = convertRawToPhysical(raw_value, 0.1, 0.0);

    raw_value=copyBitsFromByteArrayLE( byteArray, 21792, 12);
    @CAN_RadarFL::RXX_Object::RXX_Object_Obj41_PyVxCoVnce = convertRawToPhysical(raw_value, 0.01, 0.0);

    raw_value=copyBitsFromByteArrayLE( byteArray, 21804, 12);
    @CAN_RadarFL::RXX_Object::RXX_Object_Obj41_PyVyCoVnce = convertRawToPhysical(raw_value, 0.01, 0.0);

    raw_value=copyBitsFromByteArrayLE( byteArray, 21644, 10);
    @CAN_RadarFL::RXX_Object::RXX_Object_Obj41_RCS = convertRawToPhysical(raw_value, 0.2, -102.4);

    raw_value=copyBitsFromByteArrayLE( byteArray, 21816, 4);
    @CAN_RadarFL::RXX_Object::RXX_Object_Obj41_ReferencePoint = convertRawToPhysical(raw_value, 1.0, 0.0);

    raw_value=copyBitsFromByteArrayLE( byteArray, 21676, 12);
    @CAN_RadarFL::RXX_Object::RXX_Object_Obj41_Vx = convertRawToPhysical(raw_value, 0.0625, -128.0);

    raw_value=copyBitsFromByteArrayLE( byteArray, 21900, 12);
    @CAN_RadarFL::RXX_Object::RXX_Object_Obj41_VxAxCoVnce = convertRawToPhysical(raw_value, 0.01, 0.0);

    raw_value=copyBitsFromByteArrayLE( byteArray, 21920, 12);
    @CAN_RadarFL::RXX_Object::RXX_Object_Obj41_VxAyCoVnce = convertRawToPhysical(raw_value, 0.01, 0.0);

    raw_value=copyBitsFromByteArrayLE( byteArray, 21696, 12);
    @CAN_RadarFL::RXX_Object::RXX_Object_Obj41_VxVnce = convertRawToPhysical(raw_value, 0.01, 0.0);

    raw_value=copyBitsFromByteArrayLE( byteArray, 21888, 12);
    @CAN_RadarFL::RXX_Object::RXX_Object_Obj41_VxVyCoVnce = convertRawToPhysical(raw_value, 0.01, 0.0);

    raw_value=copyBitsFromByteArrayLE( byteArray, 21710, 10);
    @CAN_RadarFL::RXX_Object::RXX_Object_Obj41_Vy = convertRawToPhysical(raw_value, 0.125, -64.0);

    raw_value=copyBitsFromByteArrayLE( byteArray, 21932, 12);
    @CAN_RadarFL::RXX_Object::RXX_Object_Obj41_VyAxCoVnce = convertRawToPhysical(raw_value, 0.01, 0.0);

    raw_value=copyBitsFromByteArrayLE( byteArray, 21952, 12);
    @CAN_RadarFL::RXX_Object::RXX_Object_Obj41_VyAyCoVnce = convertRawToPhysical(raw_value, 0.01, 0.0);

    raw_value=copyBitsFromByteArrayLE( byteArray, 21728, 12);
    @CAN_RadarFL::RXX_Object::RXX_Object_Obj41_VyVnce = convertRawToPhysical(raw_value, 0.01, 0.0);

    raw_value=copyBitsFromByteArrayLE( byteArray, 21624, 7);
    @CAN_RadarFL::RXX_Object::RXX_Object_Obj41_Width = convertRawToPhysical(raw_value, 0.125, 0.0);

    raw_value=copyBitsFromByteArrayLE( byteArray, 21632, 12);
    @CAN_RadarFL::RXX_Object::RXX_Object_Obj41_WidthVnce = convertRawToPhysical(raw_value, 0.01, 0.0);

    raw_value=copyBitsFromByteArrayLE( byteArray, 22496, 32);
    @CAN_RadarFL::RXX_Object::RXX_Object_Obj42_Age = convertRawToPhysical(raw_value, 1.0, 0.0);

    raw_value=copyBitsFromByteArrayLE( byteArray, 22092, 10);
    @CAN_RadarFL::RXX_Object::RXX_Object_Obj42_Ax = convertRawToPhysical(raw_value, 0.03125, -16.0);

    raw_value=copyBitsFromByteArrayLE( byteArray, 22476, 12);
    @CAN_RadarFL::RXX_Object::RXX_Object_Obj42_AxAyCoVnce = convertRawToPhysical(raw_value, 0.01, 0.0);

    raw_value=copyBitsFromByteArrayLE( byteArray, 22112, 12);
    @CAN_RadarFL::RXX_Object::RXX_Object_Obj42_AxVnce = convertRawToPhysical(raw_value, 0.01, 0.0);

    raw_value=copyBitsFromByteArrayLE( byteArray, 22166, 9);
    @CAN_RadarFL::RXX_Object::RXX_Object_Obj42_Ay = convertRawToPhysical(raw_value, 0.0625, -16.0);

    raw_value=copyBitsFromByteArrayLE( byteArray, 22176, 12);
    @CAN_RadarFL::RXX_Object::RXX_Object_Obj42_AyVnce = convertRawToPhysical(raw_value, 0.01, 0.0);

    raw_value=copyBitsFromByteArrayLE( byteArray, 22232, 6);
    @CAN_RadarFL::RXX_Object::RXX_Object_Obj42_ExistProb = convertRawToPhysical(raw_value, 2.0, 0.0);

    raw_value=copyBitsFromByteArrayLE( byteArray, 22296, 8);
    @CAN_RadarFL::RXX_Object::RXX_Object_Obj42_FilterInformation = convertRawToPhysical(raw_value, 1.0, 0.0);

    raw_value=copyBitsFromByteArrayLE( byteArray, 22072, 7);
    @CAN_RadarFL::RXX_Object::RXX_Object_Obj42_Length = convertRawToPhysical(raw_value, 0.125, 0.0);

    raw_value=copyBitsFromByteArrayLE( byteArray, 22080, 12);
    @CAN_RadarFL::RXX_Object::RXX_Object_Obj42_LengthVnce = convertRawToPhysical(raw_value, 0.01, 0.0);

    raw_value=copyBitsFromByteArrayLE( byteArray, 22264, 3);
    @CAN_RadarFL::RXX_Object::RXX_Object_Obj42_MeasurementStatus = convertRawToPhysical(raw_value, 1.0, 0.0);

    raw_value=copyBitsFromByteArrayLE( byteArray, 22220, 2);
    @CAN_RadarFL::RXX_Object::RXX_Object_Obj42_MovingStatus = convertRawToPhysical(raw_value, 1.0, 0.0);

    raw_value=copyBitsFromByteArrayLE( byteArray, 22200, 7);
    @CAN_RadarFL::RXX_Object::RXX_Object_Obj42_ObjId = convertRawToPhysical(raw_value, 1.0, 0.0);

    raw_value=copyBitsFromByteArrayLE( byteArray, 22102, 9);
    @CAN_RadarFL::RXX_Object::RXX_Object_Obj42_OrientationYaw = convertRawToPhysical(raw_value, 0.0175, -4.48);

    raw_value=copyBitsFromByteArrayLE( byteArray, 22124, 12);
    @CAN_RadarFL::RXX_Object::RXX_Object_Obj42_OrientationYawVnce = convertRawToPhysical(raw_value, 0.0003, 0.0);

    raw_value=copyBitsFromByteArrayLE( byteArray, 22016, 6);
    @CAN_RadarFL::RXX_Object::RXX_Object_Obj42_ProbClassConfidence = convertRawToPhysical(raw_value, 2.0, 0.0);

    raw_value=copyBitsFromByteArrayLE( byteArray, 22267, 4);
    @CAN_RadarFL::RXX_Object::RXX_Object_Obj42_ProbClassType = convertRawToPhysical(raw_value, 1.0, 0.0);

    raw_value=copyBitsFromByteArrayLE( byteArray, 22022, 14);
    @CAN_RadarFL::RXX_Object::RXX_Object_Obj42_Px = convertRawToPhysical(raw_value, 0.0625, -512.0);

    raw_value=copyBitsFromByteArrayLE( byteArray, 22336, 12);
    @CAN_RadarFL::RXX_Object::RXX_Object_Obj42_PxAxCoVnce = convertRawToPhysical(raw_value, 0.01, 0.0);

    raw_value=copyBitsFromByteArrayLE( byteArray, 22348, 12);
    @CAN_RadarFL::RXX_Object::RXX_Object_Obj42_PxAyCoVnce = convertRawToPhysical(raw_value, 0.01, 0.0);

    raw_value=copyBitsFromByteArrayLE( byteArray, 22252, 12);
    @CAN_RadarFL::RXX_Object::RXX_Object_Obj42_PxPyCoVnce = convertRawToPhysical(raw_value, 0.01, 0.0);

    raw_value=copyBitsFromByteArrayLE( byteArray, 22036, 12);
    @CAN_RadarFL::RXX_Object::RXX_Object_Obj42_PxVnce = convertRawToPhysical(raw_value, 0.1, 0.0);

    raw_value=copyBitsFromByteArrayLE( byteArray, 22272, 12);
    @CAN_RadarFL::RXX_Object::RXX_Object_Obj42_PxVxCoVnce = convertRawToPhysical(raw_value, 0.01, 0.0);

    raw_value=copyBitsFromByteArrayLE( byteArray, 22284, 12);
    @CAN_RadarFL::RXX_Object::RXX_Object_Obj42_PxVyCoVnce = convertRawToPhysical(raw_value, 0.01, 0.0);

    raw_value=copyBitsFromByteArrayLE( byteArray, 22048, 12);
    @CAN_RadarFL::RXX_Object::RXX_Object_Obj42_Py = convertRawToPhysical(raw_value, 0.0625, -128.0);

    raw_value=copyBitsFromByteArrayLE( byteArray, 22368, 12);
    @CAN_RadarFL::RXX_Object::RXX_Object_Obj42_PyAxCoVnce = convertRawToPhysical(raw_value, 0.01, 0.0);

    raw_value=copyBitsFromByteArrayLE( byteArray, 22380, 12);
    @CAN_RadarFL::RXX_Object::RXX_Object_Obj42_PyAyCoVnce = convertRawToPhysical(raw_value, 0.01, 0.0);

    raw_value=copyBitsFromByteArrayLE( byteArray, 22060, 12);
    @CAN_RadarFL::RXX_Object::RXX_Object_Obj42_PyVnce = convertRawToPhysical(raw_value, 0.1, 0.0);

    raw_value=copyBitsFromByteArrayLE( byteArray, 22304, 12);
    @CAN_RadarFL::RXX_Object::RXX_Object_Obj42_PyVxCoVnce = convertRawToPhysical(raw_value, 0.01, 0.0);

    raw_value=copyBitsFromByteArrayLE( byteArray, 22316, 12);
    @CAN_RadarFL::RXX_Object::RXX_Object_Obj42_PyVyCoVnce = convertRawToPhysical(raw_value, 0.01, 0.0);

    raw_value=copyBitsFromByteArrayLE( byteArray, 22156, 10);
    @CAN_RadarFL::RXX_Object::RXX_Object_Obj42_RCS = convertRawToPhysical(raw_value, 0.2, -102.4);

    raw_value=copyBitsFromByteArrayLE( byteArray, 22328, 4);
    @CAN_RadarFL::RXX_Object::RXX_Object_Obj42_ReferencePoint = convertRawToPhysical(raw_value, 1.0, 0.0);

    raw_value=copyBitsFromByteArrayLE( byteArray, 22188, 12);
    @CAN_RadarFL::RXX_Object::RXX_Object_Obj42_Vx = convertRawToPhysical(raw_value, 0.0625, -128.0);

    raw_value=copyBitsFromByteArrayLE( byteArray, 22412, 12);
    @CAN_RadarFL::RXX_Object::RXX_Object_Obj42_VxAxCoVnce = convertRawToPhysical(raw_value, 0.01, 0.0);

    raw_value=copyBitsFromByteArrayLE( byteArray, 22432, 12);
    @CAN_RadarFL::RXX_Object::RXX_Object_Obj42_VxAyCoVnce = convertRawToPhysical(raw_value, 0.01, 0.0);

    raw_value=copyBitsFromByteArrayLE( byteArray, 22208, 12);
    @CAN_RadarFL::RXX_Object::RXX_Object_Obj42_VxVnce = convertRawToPhysical(raw_value, 0.01, 0.0);

    raw_value=copyBitsFromByteArrayLE( byteArray, 22400, 12);
    @CAN_RadarFL::RXX_Object::RXX_Object_Obj42_VxVyCoVnce = convertRawToPhysical(raw_value, 0.01, 0.0);

    raw_value=copyBitsFromByteArrayLE( byteArray, 22222, 10);
    @CAN_RadarFL::RXX_Object::RXX_Object_Obj42_Vy = convertRawToPhysical(raw_value, 0.125, -64.0);

    raw_value=copyBitsFromByteArrayLE( byteArray, 22444, 12);
    @CAN_RadarFL::RXX_Object::RXX_Object_Obj42_VyAxCoVnce = convertRawToPhysical(raw_value, 0.01, 0.0);

    raw_value=copyBitsFromByteArrayLE( byteArray, 22464, 12);
    @CAN_RadarFL::RXX_Object::RXX_Object_Obj42_VyAyCoVnce = convertRawToPhysical(raw_value, 0.01, 0.0);

    raw_value=copyBitsFromByteArrayLE( byteArray, 22240, 12);
    @CAN_RadarFL::RXX_Object::RXX_Object_Obj42_VyVnce = convertRawToPhysical(raw_value, 0.01, 0.0);

    raw_value=copyBitsFromByteArrayLE( byteArray, 22136, 7);
    @CAN_RadarFL::RXX_Object::RXX_Object_Obj42_Width = convertRawToPhysical(raw_value, 0.125, 0.0);

    raw_value=copyBitsFromByteArrayLE( byteArray, 22144, 12);
    @CAN_RadarFL::RXX_Object::RXX_Object_Obj42_WidthVnce = convertRawToPhysical(raw_value, 0.01, 0.0);

    raw_value=copyBitsFromByteArrayLE( byteArray, 23008, 32);
    @CAN_RadarFL::RXX_Object::RXX_Object_Obj43_Age = convertRawToPhysical(raw_value, 1.0, 0.0);

    raw_value=copyBitsFromByteArrayLE( byteArray, 22604, 10);
    @CAN_RadarFL::RXX_Object::RXX_Object_Obj43_Ax = convertRawToPhysical(raw_value, 0.03125, -16.0);

    raw_value=copyBitsFromByteArrayLE( byteArray, 22988, 12);
    @CAN_RadarFL::RXX_Object::RXX_Object_Obj43_AxAyCoVnce = convertRawToPhysical(raw_value, 0.01, 0.0);

    raw_value=copyBitsFromByteArrayLE( byteArray, 22624, 12);
    @CAN_RadarFL::RXX_Object::RXX_Object_Obj43_AxVnce = convertRawToPhysical(raw_value, 0.01, 0.0);

    raw_value=copyBitsFromByteArrayLE( byteArray, 22678, 9);
    @CAN_RadarFL::RXX_Object::RXX_Object_Obj43_Ay = convertRawToPhysical(raw_value, 0.0625, -16.0);

    raw_value=copyBitsFromByteArrayLE( byteArray, 22688, 12);
    @CAN_RadarFL::RXX_Object::RXX_Object_Obj43_AyVnce = convertRawToPhysical(raw_value, 0.01, 0.0);

    raw_value=copyBitsFromByteArrayLE( byteArray, 22744, 6);
    @CAN_RadarFL::RXX_Object::RXX_Object_Obj43_ExistProb = convertRawToPhysical(raw_value, 2.0, 0.0);

    raw_value=copyBitsFromByteArrayLE( byteArray, 22808, 8);
    @CAN_RadarFL::RXX_Object::RXX_Object_Obj43_FilterInformation = convertRawToPhysical(raw_value, 1.0, 0.0);

    raw_value=copyBitsFromByteArrayLE( byteArray, 22584, 7);
    @CAN_RadarFL::RXX_Object::RXX_Object_Obj43_Length = convertRawToPhysical(raw_value, 0.125, 0.0);

    raw_value=copyBitsFromByteArrayLE( byteArray, 22592, 12);
    @CAN_RadarFL::RXX_Object::RXX_Object_Obj43_LengthVnce = convertRawToPhysical(raw_value, 0.01, 0.0);

    raw_value=copyBitsFromByteArrayLE( byteArray, 22776, 3);
    @CAN_RadarFL::RXX_Object::RXX_Object_Obj43_MeasurementStatus = convertRawToPhysical(raw_value, 1.0, 0.0);

    raw_value=copyBitsFromByteArrayLE( byteArray, 22732, 2);
    @CAN_RadarFL::RXX_Object::RXX_Object_Obj43_MovingStatus = convertRawToPhysical(raw_value, 1.0, 0.0);

    raw_value=copyBitsFromByteArrayLE( byteArray, 22712, 7);
    @CAN_RadarFL::RXX_Object::RXX_Object_Obj43_ObjId = convertRawToPhysical(raw_value, 1.0, 0.0);

    raw_value=copyBitsFromByteArrayLE( byteArray, 22614, 9);
    @CAN_RadarFL::RXX_Object::RXX_Object_Obj43_OrientationYaw = convertRawToPhysical(raw_value, 0.0175, -4.48);

    raw_value=copyBitsFromByteArrayLE( byteArray, 22636, 12);
    @CAN_RadarFL::RXX_Object::RXX_Object_Obj43_OrientationYawVnce = convertRawToPhysical(raw_value, 0.0003, 0.0);

    raw_value=copyBitsFromByteArrayLE( byteArray, 22528, 6);
    @CAN_RadarFL::RXX_Object::RXX_Object_Obj43_ProbClassConfidence = convertRawToPhysical(raw_value, 2.0, 0.0);

    raw_value=copyBitsFromByteArrayLE( byteArray, 22779, 4);
    @CAN_RadarFL::RXX_Object::RXX_Object_Obj43_ProbClassType = convertRawToPhysical(raw_value, 1.0, 0.0);

    raw_value=copyBitsFromByteArrayLE( byteArray, 22534, 14);
    @CAN_RadarFL::RXX_Object::RXX_Object_Obj43_Px = convertRawToPhysical(raw_value, 0.0625, -512.0);

    raw_value=copyBitsFromByteArrayLE( byteArray, 22848, 12);
    @CAN_RadarFL::RXX_Object::RXX_Object_Obj43_PxAxCoVnce = convertRawToPhysical(raw_value, 0.01, 0.0);

    raw_value=copyBitsFromByteArrayLE( byteArray, 22860, 12);
    @CAN_RadarFL::RXX_Object::RXX_Object_Obj43_PxAyCoVnce = convertRawToPhysical(raw_value, 0.01, 0.0);

    raw_value=copyBitsFromByteArrayLE( byteArray, 22764, 12);
    @CAN_RadarFL::RXX_Object::RXX_Object_Obj43_PxPyCoVnce = convertRawToPhysical(raw_value, 0.01, 0.0);

    raw_value=copyBitsFromByteArrayLE( byteArray, 22548, 12);
    @CAN_RadarFL::RXX_Object::RXX_Object_Obj43_PxVnce = convertRawToPhysical(raw_value, 0.1, 0.0);

    raw_value=copyBitsFromByteArrayLE( byteArray, 22784, 12);
    @CAN_RadarFL::RXX_Object::RXX_Object_Obj43_PxVxCoVnce = convertRawToPhysical(raw_value, 0.01, 0.0);

    raw_value=copyBitsFromByteArrayLE( byteArray, 22796, 12);
    @CAN_RadarFL::RXX_Object::RXX_Object_Obj43_PxVyCoVnce = convertRawToPhysical(raw_value, 0.01, 0.0);

    raw_value=copyBitsFromByteArrayLE( byteArray, 22560, 12);
    @CAN_RadarFL::RXX_Object::RXX_Object_Obj43_Py = convertRawToPhysical(raw_value, 0.0625, -128.0);

    raw_value=copyBitsFromByteArrayLE( byteArray, 22880, 12);
    @CAN_RadarFL::RXX_Object::RXX_Object_Obj43_PyAxCoVnce = convertRawToPhysical(raw_value, 0.01, 0.0);

    raw_value=copyBitsFromByteArrayLE( byteArray, 22892, 12);
    @CAN_RadarFL::RXX_Object::RXX_Object_Obj43_PyAyCoVnce = convertRawToPhysical(raw_value, 0.01, 0.0);

    raw_value=copyBitsFromByteArrayLE( byteArray, 22572, 12);
    @CAN_RadarFL::RXX_Object::RXX_Object_Obj43_PyVnce = convertRawToPhysical(raw_value, 0.1, 0.0);

    raw_value=copyBitsFromByteArrayLE( byteArray, 22816, 12);
    @CAN_RadarFL::RXX_Object::RXX_Object_Obj43_PyVxCoVnce = convertRawToPhysical(raw_value, 0.01, 0.0);

    raw_value=copyBitsFromByteArrayLE( byteArray, 22828, 12);
    @CAN_RadarFL::RXX_Object::RXX_Object_Obj43_PyVyCoVnce = convertRawToPhysical(raw_value, 0.01, 0.0);

    raw_value=copyBitsFromByteArrayLE( byteArray, 22668, 10);
    @CAN_RadarFL::RXX_Object::RXX_Object_Obj43_RCS = convertRawToPhysical(raw_value, 0.2, -102.4);

    raw_value=copyBitsFromByteArrayLE( byteArray, 22840, 4);
    @CAN_RadarFL::RXX_Object::RXX_Object_Obj43_ReferencePoint = convertRawToPhysical(raw_value, 1.0, 0.0);

    raw_value=copyBitsFromByteArrayLE( byteArray, 22700, 12);
    @CAN_RadarFL::RXX_Object::RXX_Object_Obj43_Vx = convertRawToPhysical(raw_value, 0.0625, -128.0);

    raw_value=copyBitsFromByteArrayLE( byteArray, 22924, 12);
    @CAN_RadarFL::RXX_Object::RXX_Object_Obj43_VxAxCoVnce = convertRawToPhysical(raw_value, 0.01, 0.0);

    raw_value=copyBitsFromByteArrayLE( byteArray, 22944, 12);
    @CAN_RadarFL::RXX_Object::RXX_Object_Obj43_VxAyCoVnce = convertRawToPhysical(raw_value, 0.01, 0.0);

    raw_value=copyBitsFromByteArrayLE( byteArray, 22720, 12);
    @CAN_RadarFL::RXX_Object::RXX_Object_Obj43_VxVnce = convertRawToPhysical(raw_value, 0.01, 0.0);

    raw_value=copyBitsFromByteArrayLE( byteArray, 22912, 12);
    @CAN_RadarFL::RXX_Object::RXX_Object_Obj43_VxVyCoVnce = convertRawToPhysical(raw_value, 0.01, 0.0);

    raw_value=copyBitsFromByteArrayLE( byteArray, 22734, 10);
    @CAN_RadarFL::RXX_Object::RXX_Object_Obj43_Vy = convertRawToPhysical(raw_value, 0.125, -64.0);

    raw_value=copyBitsFromByteArrayLE( byteArray, 22956, 12);
    @CAN_RadarFL::RXX_Object::RXX_Object_Obj43_VyAxCoVnce = convertRawToPhysical(raw_value, 0.01, 0.0);

    raw_value=copyBitsFromByteArrayLE( byteArray, 22976, 12);
    @CAN_RadarFL::RXX_Object::RXX_Object_Obj43_VyAyCoVnce = convertRawToPhysical(raw_value, 0.01, 0.0);

    raw_value=copyBitsFromByteArrayLE( byteArray, 22752, 12);
    @CAN_RadarFL::RXX_Object::RXX_Object_Obj43_VyVnce = convertRawToPhysical(raw_value, 0.01, 0.0);

    raw_value=copyBitsFromByteArrayLE( byteArray, 22648, 7);
    @CAN_RadarFL::RXX_Object::RXX_Object_Obj43_Width = convertRawToPhysical(raw_value, 0.125, 0.0);

    raw_value=copyBitsFromByteArrayLE( byteArray, 22656, 12);
    @CAN_RadarFL::RXX_Object::RXX_Object_Obj43_WidthVnce = convertRawToPhysical(raw_value, 0.01, 0.0);

    raw_value=copyBitsFromByteArrayLE( byteArray, 23520, 32);
    @CAN_RadarFL::RXX_Object::RXX_Object_Obj44_Age = convertRawToPhysical(raw_value, 1.0, 0.0);

    raw_value=copyBitsFromByteArrayLE( byteArray, 23116, 10);
    @CAN_RadarFL::RXX_Object::RXX_Object_Obj44_Ax = convertRawToPhysical(raw_value, 0.03125, -16.0);

    raw_value=copyBitsFromByteArrayLE( byteArray, 23500, 12);
    @CAN_RadarFL::RXX_Object::RXX_Object_Obj44_AxAyCoVnce = convertRawToPhysical(raw_value, 0.01, 0.0);

    raw_value=copyBitsFromByteArrayLE( byteArray, 23136, 12);
    @CAN_RadarFL::RXX_Object::RXX_Object_Obj44_AxVnce = convertRawToPhysical(raw_value, 0.01, 0.0);

    raw_value=copyBitsFromByteArrayLE( byteArray, 23190, 9);
    @CAN_RadarFL::RXX_Object::RXX_Object_Obj44_Ay = convertRawToPhysical(raw_value, 0.0625, -16.0);

    raw_value=copyBitsFromByteArrayLE( byteArray, 23200, 12);
    @CAN_RadarFL::RXX_Object::RXX_Object_Obj44_AyVnce = convertRawToPhysical(raw_value, 0.01, 0.0);

    raw_value=copyBitsFromByteArrayLE( byteArray, 23256, 6);
    @CAN_RadarFL::RXX_Object::RXX_Object_Obj44_ExistProb = convertRawToPhysical(raw_value, 2.0, 0.0);

    raw_value=copyBitsFromByteArrayLE( byteArray, 23320, 8);
    @CAN_RadarFL::RXX_Object::RXX_Object_Obj44_FilterInformation = convertRawToPhysical(raw_value, 1.0, 0.0);

    raw_value=copyBitsFromByteArrayLE( byteArray, 23096, 7);
    @CAN_RadarFL::RXX_Object::RXX_Object_Obj44_Length = convertRawToPhysical(raw_value, 0.125, 0.0);

    raw_value=copyBitsFromByteArrayLE( byteArray, 23104, 12);
    @CAN_RadarFL::RXX_Object::RXX_Object_Obj44_LengthVnce = convertRawToPhysical(raw_value, 0.01, 0.0);

    raw_value=copyBitsFromByteArrayLE( byteArray, 23288, 3);
    @CAN_RadarFL::RXX_Object::RXX_Object_Obj44_MeasurementStatus = convertRawToPhysical(raw_value, 1.0, 0.0);

    raw_value=copyBitsFromByteArrayLE( byteArray, 23244, 2);
    @CAN_RadarFL::RXX_Object::RXX_Object_Obj44_MovingStatus = convertRawToPhysical(raw_value, 1.0, 0.0);

    raw_value=copyBitsFromByteArrayLE( byteArray, 23224, 7);
    @CAN_RadarFL::RXX_Object::RXX_Object_Obj44_ObjId = convertRawToPhysical(raw_value, 1.0, 0.0);

    raw_value=copyBitsFromByteArrayLE( byteArray, 23126, 9);
    @CAN_RadarFL::RXX_Object::RXX_Object_Obj44_OrientationYaw = convertRawToPhysical(raw_value, 0.0175, -4.48);

    raw_value=copyBitsFromByteArrayLE( byteArray, 23148, 12);
    @CAN_RadarFL::RXX_Object::RXX_Object_Obj44_OrientationYawVnce = convertRawToPhysical(raw_value, 0.0003, 0.0);

    raw_value=copyBitsFromByteArrayLE( byteArray, 23040, 6);
    @CAN_RadarFL::RXX_Object::RXX_Object_Obj44_ProbClassConfidence = convertRawToPhysical(raw_value, 2.0, 0.0);

    raw_value=copyBitsFromByteArrayLE( byteArray, 23291, 4);
    @CAN_RadarFL::RXX_Object::RXX_Object_Obj44_ProbClassType = convertRawToPhysical(raw_value, 1.0, 0.0);

    raw_value=copyBitsFromByteArrayLE( byteArray, 23046, 14);
    @CAN_RadarFL::RXX_Object::RXX_Object_Obj44_Px = convertRawToPhysical(raw_value, 0.0625, -512.0);

    raw_value=copyBitsFromByteArrayLE( byteArray, 23360, 12);
    @CAN_RadarFL::RXX_Object::RXX_Object_Obj44_PxAxCoVnce = convertRawToPhysical(raw_value, 0.01, 0.0);

    raw_value=copyBitsFromByteArrayLE( byteArray, 23372, 12);
    @CAN_RadarFL::RXX_Object::RXX_Object_Obj44_PxAyCoVnce = convertRawToPhysical(raw_value, 0.01, 0.0);

    raw_value=copyBitsFromByteArrayLE( byteArray, 23276, 12);
    @CAN_RadarFL::RXX_Object::RXX_Object_Obj44_PxPyCoVnce = convertRawToPhysical(raw_value, 0.01, 0.0);

    raw_value=copyBitsFromByteArrayLE( byteArray, 23060, 12);
    @CAN_RadarFL::RXX_Object::RXX_Object_Obj44_PxVnce = convertRawToPhysical(raw_value, 0.1, 0.0);

    raw_value=copyBitsFromByteArrayLE( byteArray, 23296, 12);
    @CAN_RadarFL::RXX_Object::RXX_Object_Obj44_PxVxCoVnce = convertRawToPhysical(raw_value, 0.01, 0.0);

    raw_value=copyBitsFromByteArrayLE( byteArray, 23308, 12);
    @CAN_RadarFL::RXX_Object::RXX_Object_Obj44_PxVyCoVnce = convertRawToPhysical(raw_value, 0.01, 0.0);

    raw_value=copyBitsFromByteArrayLE( byteArray, 23072, 12);
    @CAN_RadarFL::RXX_Object::RXX_Object_Obj44_Py = convertRawToPhysical(raw_value, 0.0625, -128.0);

    raw_value=copyBitsFromByteArrayLE( byteArray, 23392, 12);
    @CAN_RadarFL::RXX_Object::RXX_Object_Obj44_PyAxCoVnce = convertRawToPhysical(raw_value, 0.01, 0.0);

    raw_value=copyBitsFromByteArrayLE( byteArray, 23404, 12);
    @CAN_RadarFL::RXX_Object::RXX_Object_Obj44_PyAyCoVnce = convertRawToPhysical(raw_value, 0.01, 0.0);

    raw_value=copyBitsFromByteArrayLE( byteArray, 23084, 12);
    @CAN_RadarFL::RXX_Object::RXX_Object_Obj44_PyVnce = convertRawToPhysical(raw_value, 0.1, 0.0);

    raw_value=copyBitsFromByteArrayLE( byteArray, 23328, 12);
    @CAN_RadarFL::RXX_Object::RXX_Object_Obj44_PyVxCoVnce = convertRawToPhysical(raw_value, 0.01, 0.0);

    raw_value=copyBitsFromByteArrayLE( byteArray, 23340, 12);
    @CAN_RadarFL::RXX_Object::RXX_Object_Obj44_PyVyCoVnce = convertRawToPhysical(raw_value, 0.01, 0.0);

    raw_value=copyBitsFromByteArrayLE( byteArray, 23180, 10);
    @CAN_RadarFL::RXX_Object::RXX_Object_Obj44_RCS = convertRawToPhysical(raw_value, 0.2, -102.4);

    raw_value=copyBitsFromByteArrayLE( byteArray, 23352, 4);
    @CAN_RadarFL::RXX_Object::RXX_Object_Obj44_ReferencePoint = convertRawToPhysical(raw_value, 1.0, 0.0);

    raw_value=copyBitsFromByteArrayLE( byteArray, 23212, 12);
    @CAN_RadarFL::RXX_Object::RXX_Object_Obj44_Vx = convertRawToPhysical(raw_value, 0.0625, -128.0);

    raw_value=copyBitsFromByteArrayLE( byteArray, 23436, 12);
    @CAN_RadarFL::RXX_Object::RXX_Object_Obj44_VxAxCoVnce = convertRawToPhysical(raw_value, 0.01, 0.0);

    raw_value=copyBitsFromByteArrayLE( byteArray, 23456, 12);
    @CAN_RadarFL::RXX_Object::RXX_Object_Obj44_VxAyCoVnce = convertRawToPhysical(raw_value, 0.01, 0.0);

    raw_value=copyBitsFromByteArrayLE( byteArray, 23232, 12);
    @CAN_RadarFL::RXX_Object::RXX_Object_Obj44_VxVnce = convertRawToPhysical(raw_value, 0.01, 0.0);

    raw_value=copyBitsFromByteArrayLE( byteArray, 23424, 12);
    @CAN_RadarFL::RXX_Object::RXX_Object_Obj44_VxVyCoVnce = convertRawToPhysical(raw_value, 0.01, 0.0);

    raw_value=copyBitsFromByteArrayLE( byteArray, 23246, 10);
    @CAN_RadarFL::RXX_Object::RXX_Object_Obj44_Vy = convertRawToPhysical(raw_value, 0.125, -64.0);

    raw_value=copyBitsFromByteArrayLE( byteArray, 23468, 12);
    @CAN_RadarFL::RXX_Object::RXX_Object_Obj44_VyAxCoVnce = convertRawToPhysical(raw_value, 0.01, 0.0);

    raw_value=copyBitsFromByteArrayLE( byteArray, 23488, 12);
    @CAN_RadarFL::RXX_Object::RXX_Object_Obj44_VyAyCoVnce = convertRawToPhysical(raw_value, 0.01, 0.0);

    raw_value=copyBitsFromByteArrayLE( byteArray, 23264, 12);
    @CAN_RadarFL::RXX_Object::RXX_Object_Obj44_VyVnce = convertRawToPhysical(raw_value, 0.01, 0.0);

    raw_value=copyBitsFromByteArrayLE( byteArray, 23160, 7);
    @CAN_RadarFL::RXX_Object::RXX_Object_Obj44_Width = convertRawToPhysical(raw_value, 0.125, 0.0);

    raw_value=copyBitsFromByteArrayLE( byteArray, 23168, 12);
    @CAN_RadarFL::RXX_Object::RXX_Object_Obj44_WidthVnce = convertRawToPhysical(raw_value, 0.01, 0.0);

    raw_value=copyBitsFromByteArrayLE( byteArray, 24032, 32);
    @CAN_RadarFL::RXX_Object::RXX_Object_Obj45_Age = convertRawToPhysical(raw_value, 1.0, 0.0);

    raw_value=copyBitsFromByteArrayLE( byteArray, 23628, 10);
    @CAN_RadarFL::RXX_Object::RXX_Object_Obj45_Ax = convertRawToPhysical(raw_value, 0.03125, -16.0);

    raw_value=copyBitsFromByteArrayLE( byteArray, 24012, 12);
    @CAN_RadarFL::RXX_Object::RXX_Object_Obj45_AxAyCoVnce = convertRawToPhysical(raw_value, 0.01, 0.0);

    raw_value=copyBitsFromByteArrayLE( byteArray, 23648, 12);
    @CAN_RadarFL::RXX_Object::RXX_Object_Obj45_AxVnce = convertRawToPhysical(raw_value, 0.01, 0.0);

    raw_value=copyBitsFromByteArrayLE( byteArray, 23702, 9);
    @CAN_RadarFL::RXX_Object::RXX_Object_Obj45_Ay = convertRawToPhysical(raw_value, 0.0625, -16.0);

    raw_value=copyBitsFromByteArrayLE( byteArray, 23712, 12);
    @CAN_RadarFL::RXX_Object::RXX_Object_Obj45_AyVnce = convertRawToPhysical(raw_value, 0.01, 0.0);

    raw_value=copyBitsFromByteArrayLE( byteArray, 23768, 6);
    @CAN_RadarFL::RXX_Object::RXX_Object_Obj45_ExistProb = convertRawToPhysical(raw_value, 2.0, 0.0);

    raw_value=copyBitsFromByteArrayLE( byteArray, 23832, 8);
    @CAN_RadarFL::RXX_Object::RXX_Object_Obj45_FilterInformation = convertRawToPhysical(raw_value, 1.0, 0.0);

    raw_value=copyBitsFromByteArrayLE( byteArray, 23608, 7);
    @CAN_RadarFL::RXX_Object::RXX_Object_Obj45_Length = convertRawToPhysical(raw_value, 0.125, 0.0);

    raw_value=copyBitsFromByteArrayLE( byteArray, 23616, 12);
    @CAN_RadarFL::RXX_Object::RXX_Object_Obj45_LengthVnce = convertRawToPhysical(raw_value, 0.01, 0.0);

    raw_value=copyBitsFromByteArrayLE( byteArray, 23800, 3);
    @CAN_RadarFL::RXX_Object::RXX_Object_Obj45_MeasurementStatus = convertRawToPhysical(raw_value, 1.0, 0.0);

    raw_value=copyBitsFromByteArrayLE( byteArray, 23756, 2);
    @CAN_RadarFL::RXX_Object::RXX_Object_Obj45_MovingStatus = convertRawToPhysical(raw_value, 1.0, 0.0);

    raw_value=copyBitsFromByteArrayLE( byteArray, 23736, 7);
    @CAN_RadarFL::RXX_Object::RXX_Object_Obj45_ObjId = convertRawToPhysical(raw_value, 1.0, 0.0);

    raw_value=copyBitsFromByteArrayLE( byteArray, 23638, 9);
    @CAN_RadarFL::RXX_Object::RXX_Object_Obj45_OrientationYaw = convertRawToPhysical(raw_value, 0.0175, -4.48);

    raw_value=copyBitsFromByteArrayLE( byteArray, 23660, 12);
    @CAN_RadarFL::RXX_Object::RXX_Object_Obj45_OrientationYawVnce = convertRawToPhysical(raw_value, 0.0003, 0.0);

    raw_value=copyBitsFromByteArrayLE( byteArray, 23552, 6);
    @CAN_RadarFL::RXX_Object::RXX_Object_Obj45_ProbClassConfidence = convertRawToPhysical(raw_value, 2.0, 0.0);

    raw_value=copyBitsFromByteArrayLE( byteArray, 23803, 4);
    @CAN_RadarFL::RXX_Object::RXX_Object_Obj45_ProbClassType = convertRawToPhysical(raw_value, 1.0, 0.0);

    raw_value=copyBitsFromByteArrayLE( byteArray, 23558, 14);
    @CAN_RadarFL::RXX_Object::RXX_Object_Obj45_Px = convertRawToPhysical(raw_value, 0.0625, -512.0);

    raw_value=copyBitsFromByteArrayLE( byteArray, 23872, 12);
    @CAN_RadarFL::RXX_Object::RXX_Object_Obj45_PxAxCoVnce = convertRawToPhysical(raw_value, 0.01, 0.0);

    raw_value=copyBitsFromByteArrayLE( byteArray, 23884, 12);
    @CAN_RadarFL::RXX_Object::RXX_Object_Obj45_PxAyCoVnce = convertRawToPhysical(raw_value, 0.01, 0.0);

    raw_value=copyBitsFromByteArrayLE( byteArray, 23788, 12);
    @CAN_RadarFL::RXX_Object::RXX_Object_Obj45_PxPyCoVnce = convertRawToPhysical(raw_value, 0.01, 0.0);

    raw_value=copyBitsFromByteArrayLE( byteArray, 23572, 12);
    @CAN_RadarFL::RXX_Object::RXX_Object_Obj45_PxVnce = convertRawToPhysical(raw_value, 0.1, 0.0);

    raw_value=copyBitsFromByteArrayLE( byteArray, 23808, 12);
    @CAN_RadarFL::RXX_Object::RXX_Object_Obj45_PxVxCoVnce = convertRawToPhysical(raw_value, 0.01, 0.0);

    raw_value=copyBitsFromByteArrayLE( byteArray, 23820, 12);
    @CAN_RadarFL::RXX_Object::RXX_Object_Obj45_PxVyCoVnce = convertRawToPhysical(raw_value, 0.01, 0.0);

    raw_value=copyBitsFromByteArrayLE( byteArray, 23584, 12);
    @CAN_RadarFL::RXX_Object::RXX_Object_Obj45_Py = convertRawToPhysical(raw_value, 0.0625, -128.0);

    raw_value=copyBitsFromByteArrayLE( byteArray, 23904, 12);
    @CAN_RadarFL::RXX_Object::RXX_Object_Obj45_PyAxCoVnce = convertRawToPhysical(raw_value, 0.01, 0.0);

    raw_value=copyBitsFromByteArrayLE( byteArray, 23916, 12);
    @CAN_RadarFL::RXX_Object::RXX_Object_Obj45_PyAyCoVnce = convertRawToPhysical(raw_value, 0.01, 0.0);

    raw_value=copyBitsFromByteArrayLE( byteArray, 23596, 12);
    @CAN_RadarFL::RXX_Object::RXX_Object_Obj45_PyVnce = convertRawToPhysical(raw_value, 0.1, 0.0);

    raw_value=copyBitsFromByteArrayLE( byteArray, 23840, 12);
    @CAN_RadarFL::RXX_Object::RXX_Object_Obj45_PyVxCoVnce = convertRawToPhysical(raw_value, 0.01, 0.0);

    raw_value=copyBitsFromByteArrayLE( byteArray, 23852, 12);
    @CAN_RadarFL::RXX_Object::RXX_Object_Obj45_PyVyCoVnce = convertRawToPhysical(raw_value, 0.01, 0.0);

    raw_value=copyBitsFromByteArrayLE( byteArray, 23692, 10);
    @CAN_RadarFL::RXX_Object::RXX_Object_Obj45_RCS = convertRawToPhysical(raw_value, 0.2, -102.4);

    raw_value=copyBitsFromByteArrayLE( byteArray, 23864, 4);
    @CAN_RadarFL::RXX_Object::RXX_Object_Obj45_ReferencePoint = convertRawToPhysical(raw_value, 1.0, 0.0);

    raw_value=copyBitsFromByteArrayLE( byteArray, 23724, 12);
    @CAN_RadarFL::RXX_Object::RXX_Object_Obj45_Vx = convertRawToPhysical(raw_value, 0.0625, -128.0);

    raw_value=copyBitsFromByteArrayLE( byteArray, 23948, 12);
    @CAN_RadarFL::RXX_Object::RXX_Object_Obj45_VxAxCoVnce = convertRawToPhysical(raw_value, 0.01, 0.0);

    raw_value=copyBitsFromByteArrayLE( byteArray, 23968, 12);
    @CAN_RadarFL::RXX_Object::RXX_Object_Obj45_VxAyCoVnce = convertRawToPhysical(raw_value, 0.01, 0.0);

    raw_value=copyBitsFromByteArrayLE( byteArray, 23744, 12);
    @CAN_RadarFL::RXX_Object::RXX_Object_Obj45_VxVnce = convertRawToPhysical(raw_value, 0.01, 0.0);

    raw_value=copyBitsFromByteArrayLE( byteArray, 23936, 12);
    @CAN_RadarFL::RXX_Object::RXX_Object_Obj45_VxVyCoVnce = convertRawToPhysical(raw_value, 0.01, 0.0);

    raw_value=copyBitsFromByteArrayLE( byteArray, 23758, 10);
    @CAN_RadarFL::RXX_Object::RXX_Object_Obj45_Vy = convertRawToPhysical(raw_value, 0.125, -64.0);

    raw_value=copyBitsFromByteArrayLE( byteArray, 23980, 12);
    @CAN_RadarFL::RXX_Object::RXX_Object_Obj45_VyAxCoVnce = convertRawToPhysical(raw_value, 0.01, 0.0);

    raw_value=copyBitsFromByteArrayLE( byteArray, 24000, 12);
    @CAN_RadarFL::RXX_Object::RXX_Object_Obj45_VyAyCoVnce = convertRawToPhysical(raw_value, 0.01, 0.0);

    raw_value=copyBitsFromByteArrayLE( byteArray, 23776, 12);
    @CAN_RadarFL::RXX_Object::RXX_Object_Obj45_VyVnce = convertRawToPhysical(raw_value, 0.01, 0.0);

    raw_value=copyBitsFromByteArrayLE( byteArray, 23672, 7);
    @CAN_RadarFL::RXX_Object::RXX_Object_Obj45_Width = convertRawToPhysical(raw_value, 0.125, 0.0);

    raw_value=copyBitsFromByteArrayLE( byteArray, 23680, 12);
    @CAN_RadarFL::RXX_Object::RXX_Object_Obj45_WidthVnce = convertRawToPhysical(raw_value, 0.01, 0.0);

    raw_value=copyBitsFromByteArrayLE( byteArray, 24544, 32);
    @CAN_RadarFL::RXX_Object::RXX_Object_Obj46_Age = convertRawToPhysical(raw_value, 1.0, 0.0);

    raw_value=copyBitsFromByteArrayLE( byteArray, 24140, 10);
    @CAN_RadarFL::RXX_Object::RXX_Object_Obj46_Ax = convertRawToPhysical(raw_value, 0.03125, -16.0);

    raw_value=copyBitsFromByteArrayLE( byteArray, 24524, 12);
    @CAN_RadarFL::RXX_Object::RXX_Object_Obj46_AxAyCoVnce = convertRawToPhysical(raw_value, 0.01, 0.0);

    raw_value=copyBitsFromByteArrayLE( byteArray, 24160, 12);
    @CAN_RadarFL::RXX_Object::RXX_Object_Obj46_AxVnce = convertRawToPhysical(raw_value, 0.01, 0.0);

    raw_value=copyBitsFromByteArrayLE( byteArray, 24214, 9);
    @CAN_RadarFL::RXX_Object::RXX_Object_Obj46_Ay = convertRawToPhysical(raw_value, 0.0625, -16.0);

    raw_value=copyBitsFromByteArrayLE( byteArray, 24224, 12);
    @CAN_RadarFL::RXX_Object::RXX_Object_Obj46_AyVnce = convertRawToPhysical(raw_value, 0.01, 0.0);

    raw_value=copyBitsFromByteArrayLE( byteArray, 24280, 6);
    @CAN_RadarFL::RXX_Object::RXX_Object_Obj46_ExistProb = convertRawToPhysical(raw_value, 2.0, 0.0);

    raw_value=copyBitsFromByteArrayLE( byteArray, 24344, 8);
    @CAN_RadarFL::RXX_Object::RXX_Object_Obj46_FilterInformation = convertRawToPhysical(raw_value, 1.0, 0.0);

    raw_value=copyBitsFromByteArrayLE( byteArray, 24120, 7);
    @CAN_RadarFL::RXX_Object::RXX_Object_Obj46_Length = convertRawToPhysical(raw_value, 0.125, 0.0);

    raw_value=copyBitsFromByteArrayLE( byteArray, 24128, 12);
    @CAN_RadarFL::RXX_Object::RXX_Object_Obj46_LengthVnce = convertRawToPhysical(raw_value, 0.01, 0.0);

    raw_value=copyBitsFromByteArrayLE( byteArray, 24312, 3);
    @CAN_RadarFL::RXX_Object::RXX_Object_Obj46_MeasurementStatus = convertRawToPhysical(raw_value, 1.0, 0.0);

    raw_value=copyBitsFromByteArrayLE( byteArray, 24268, 2);
    @CAN_RadarFL::RXX_Object::RXX_Object_Obj46_MovingStatus = convertRawToPhysical(raw_value, 1.0, 0.0);

    raw_value=copyBitsFromByteArrayLE( byteArray, 24248, 7);
    @CAN_RadarFL::RXX_Object::RXX_Object_Obj46_ObjId = convertRawToPhysical(raw_value, 1.0, 0.0);

    raw_value=copyBitsFromByteArrayLE( byteArray, 24150, 9);
    @CAN_RadarFL::RXX_Object::RXX_Object_Obj46_OrientationYaw = convertRawToPhysical(raw_value, 0.0175, -4.48);

    raw_value=copyBitsFromByteArrayLE( byteArray, 24172, 12);
    @CAN_RadarFL::RXX_Object::RXX_Object_Obj46_OrientationYawVnce = convertRawToPhysical(raw_value, 0.0003, 0.0);

    raw_value=copyBitsFromByteArrayLE( byteArray, 24064, 6);
    @CAN_RadarFL::RXX_Object::RXX_Object_Obj46_ProbClassConfidence = convertRawToPhysical(raw_value, 2.0, 0.0);

    raw_value=copyBitsFromByteArrayLE( byteArray, 24315, 4);
    @CAN_RadarFL::RXX_Object::RXX_Object_Obj46_ProbClassType = convertRawToPhysical(raw_value, 1.0, 0.0);

    raw_value=copyBitsFromByteArrayLE( byteArray, 24070, 14);
    @CAN_RadarFL::RXX_Object::RXX_Object_Obj46_Px = convertRawToPhysical(raw_value, 0.0625, -512.0);

    raw_value=copyBitsFromByteArrayLE( byteArray, 24384, 12);
    @CAN_RadarFL::RXX_Object::RXX_Object_Obj46_PxAxCoVnce = convertRawToPhysical(raw_value, 0.01, 0.0);

    raw_value=copyBitsFromByteArrayLE( byteArray, 24396, 12);
    @CAN_RadarFL::RXX_Object::RXX_Object_Obj46_PxAyCoVnce = convertRawToPhysical(raw_value, 0.01, 0.0);

    raw_value=copyBitsFromByteArrayLE( byteArray, 24300, 12);
    @CAN_RadarFL::RXX_Object::RXX_Object_Obj46_PxPyCoVnce = convertRawToPhysical(raw_value, 0.01, 0.0);

    raw_value=copyBitsFromByteArrayLE( byteArray, 24084, 12);
    @CAN_RadarFL::RXX_Object::RXX_Object_Obj46_PxVnce = convertRawToPhysical(raw_value, 0.1, 0.0);

    raw_value=copyBitsFromByteArrayLE( byteArray, 24320, 12);
    @CAN_RadarFL::RXX_Object::RXX_Object_Obj46_PxVxCoVnce = convertRawToPhysical(raw_value, 0.01, 0.0);

    raw_value=copyBitsFromByteArrayLE( byteArray, 24332, 12);
    @CAN_RadarFL::RXX_Object::RXX_Object_Obj46_PxVyCoVnce = convertRawToPhysical(raw_value, 0.01, 0.0);

    raw_value=copyBitsFromByteArrayLE( byteArray, 24096, 12);
    @CAN_RadarFL::RXX_Object::RXX_Object_Obj46_Py = convertRawToPhysical(raw_value, 0.0625, -128.0);

    raw_value=copyBitsFromByteArrayLE( byteArray, 24416, 12);
    @CAN_RadarFL::RXX_Object::RXX_Object_Obj46_PyAxCoVnce = convertRawToPhysical(raw_value, 0.01, 0.0);

    raw_value=copyBitsFromByteArrayLE( byteArray, 24428, 12);
    @CAN_RadarFL::RXX_Object::RXX_Object_Obj46_PyAyCoVnce = convertRawToPhysical(raw_value, 0.01, 0.0);

    raw_value=copyBitsFromByteArrayLE( byteArray, 24108, 12);
    @CAN_RadarFL::RXX_Object::RXX_Object_Obj46_PyVnce = convertRawToPhysical(raw_value, 0.1, 0.0);

    raw_value=copyBitsFromByteArrayLE( byteArray, 24352, 12);
    @CAN_RadarFL::RXX_Object::RXX_Object_Obj46_PyVxCoVnce = convertRawToPhysical(raw_value, 0.01, 0.0);

    raw_value=copyBitsFromByteArrayLE( byteArray, 24364, 12);
    @CAN_RadarFL::RXX_Object::RXX_Object_Obj46_PyVyCoVnce = convertRawToPhysical(raw_value, 0.01, 0.0);

    raw_value=copyBitsFromByteArrayLE( byteArray, 24204, 10);
    @CAN_RadarFL::RXX_Object::RXX_Object_Obj46_RCS = convertRawToPhysical(raw_value, 0.2, -102.4);

    raw_value=copyBitsFromByteArrayLE( byteArray, 24376, 4);
    @CAN_RadarFL::RXX_Object::RXX_Object_Obj46_ReferencePoint = convertRawToPhysical(raw_value, 1.0, 0.0);

    raw_value=copyBitsFromByteArrayLE( byteArray, 24236, 12);
    @CAN_RadarFL::RXX_Object::RXX_Object_Obj46_Vx = convertRawToPhysical(raw_value, 0.0625, -128.0);

    raw_value=copyBitsFromByteArrayLE( byteArray, 24460, 12);
    @CAN_RadarFL::RXX_Object::RXX_Object_Obj46_VxAxCoVnce = convertRawToPhysical(raw_value, 0.01, 0.0);

    raw_value=copyBitsFromByteArrayLE( byteArray, 24480, 12);
    @CAN_RadarFL::RXX_Object::RXX_Object_Obj46_VxAyCoVnce = convertRawToPhysical(raw_value, 0.01, 0.0);

    raw_value=copyBitsFromByteArrayLE( byteArray, 24256, 12);
    @CAN_RadarFL::RXX_Object::RXX_Object_Obj46_VxVnce = convertRawToPhysical(raw_value, 0.01, 0.0);

    raw_value=copyBitsFromByteArrayLE( byteArray, 24448, 12);
    @CAN_RadarFL::RXX_Object::RXX_Object_Obj46_VxVyCoVnce = convertRawToPhysical(raw_value, 0.01, 0.0);

    raw_value=copyBitsFromByteArrayLE( byteArray, 24270, 10);
    @CAN_RadarFL::RXX_Object::RXX_Object_Obj46_Vy = convertRawToPhysical(raw_value, 0.125, -64.0);

    raw_value=copyBitsFromByteArrayLE( byteArray, 24492, 12);
    @CAN_RadarFL::RXX_Object::RXX_Object_Obj46_VyAxCoVnce = convertRawToPhysical(raw_value, 0.01, 0.0);

    raw_value=copyBitsFromByteArrayLE( byteArray, 24512, 12);
    @CAN_RadarFL::RXX_Object::RXX_Object_Obj46_VyAyCoVnce = convertRawToPhysical(raw_value, 0.01, 0.0);

    raw_value=copyBitsFromByteArrayLE( byteArray, 24288, 12);
    @CAN_RadarFL::RXX_Object::RXX_Object_Obj46_VyVnce = convertRawToPhysical(raw_value, 0.01, 0.0);

    raw_value=copyBitsFromByteArrayLE( byteArray, 24184, 7);
    @CAN_RadarFL::RXX_Object::RXX_Object_Obj46_Width = convertRawToPhysical(raw_value, 0.125, 0.0);

    raw_value=copyBitsFromByteArrayLE( byteArray, 24192, 12);
    @CAN_RadarFL::RXX_Object::RXX_Object_Obj46_WidthVnce = convertRawToPhysical(raw_value, 0.01, 0.0);

    raw_value=copyBitsFromByteArrayLE( byteArray, 25056, 32);
    @CAN_RadarFL::RXX_Object::RXX_Object_Obj47_Age = convertRawToPhysical(raw_value, 1.0, 0.0);

    raw_value=copyBitsFromByteArrayLE( byteArray, 24652, 10);
    @CAN_RadarFL::RXX_Object::RXX_Object_Obj47_Ax = convertRawToPhysical(raw_value, 0.03125, -16.0);

    raw_value=copyBitsFromByteArrayLE( byteArray, 25036, 12);
    @CAN_RadarFL::RXX_Object::RXX_Object_Obj47_AxAyCoVnce = convertRawToPhysical(raw_value, 0.01, 0.0);

    raw_value=copyBitsFromByteArrayLE( byteArray, 24672, 12);
    @CAN_RadarFL::RXX_Object::RXX_Object_Obj47_AxVnce = convertRawToPhysical(raw_value, 0.01, 0.0);

    raw_value=copyBitsFromByteArrayLE( byteArray, 24726, 9);
    @CAN_RadarFL::RXX_Object::RXX_Object_Obj47_Ay = convertRawToPhysical(raw_value, 0.0625, -16.0);

    raw_value=copyBitsFromByteArrayLE( byteArray, 24736, 12);
    @CAN_RadarFL::RXX_Object::RXX_Object_Obj47_AyVnce = convertRawToPhysical(raw_value, 0.01, 0.0);

    raw_value=copyBitsFromByteArrayLE( byteArray, 24792, 6);
    @CAN_RadarFL::RXX_Object::RXX_Object_Obj47_ExistProb = convertRawToPhysical(raw_value, 2.0, 0.0);

    raw_value=copyBitsFromByteArrayLE( byteArray, 24856, 8);
    @CAN_RadarFL::RXX_Object::RXX_Object_Obj47_FilterInformation = convertRawToPhysical(raw_value, 1.0, 0.0);

    raw_value=copyBitsFromByteArrayLE( byteArray, 24632, 7);
    @CAN_RadarFL::RXX_Object::RXX_Object_Obj47_Length = convertRawToPhysical(raw_value, 0.125, 0.0);

    raw_value=copyBitsFromByteArrayLE( byteArray, 24640, 12);
    @CAN_RadarFL::RXX_Object::RXX_Object_Obj47_LengthVnce = convertRawToPhysical(raw_value, 0.01, 0.0);

    raw_value=copyBitsFromByteArrayLE( byteArray, 24824, 3);
    @CAN_RadarFL::RXX_Object::RXX_Object_Obj47_MeasurementStatus = convertRawToPhysical(raw_value, 1.0, 0.0);

    raw_value=copyBitsFromByteArrayLE( byteArray, 24780, 2);
    @CAN_RadarFL::RXX_Object::RXX_Object_Obj47_MovingStatus = convertRawToPhysical(raw_value, 1.0, 0.0);

    raw_value=copyBitsFromByteArrayLE( byteArray, 24760, 7);
    @CAN_RadarFL::RXX_Object::RXX_Object_Obj47_ObjId = convertRawToPhysical(raw_value, 1.0, 0.0);

    raw_value=copyBitsFromByteArrayLE( byteArray, 24662, 9);
    @CAN_RadarFL::RXX_Object::RXX_Object_Obj47_OrientationYaw = convertRawToPhysical(raw_value, 0.0175, -4.48);

    raw_value=copyBitsFromByteArrayLE( byteArray, 24684, 12);
    @CAN_RadarFL::RXX_Object::RXX_Object_Obj47_OrientationYawVnce = convertRawToPhysical(raw_value, 0.0003, 0.0);

    raw_value=copyBitsFromByteArrayLE( byteArray, 24576, 6);
    @CAN_RadarFL::RXX_Object::RXX_Object_Obj47_ProbClassConfidence = convertRawToPhysical(raw_value, 2.0, 0.0);

    raw_value=copyBitsFromByteArrayLE( byteArray, 24827, 4);
    @CAN_RadarFL::RXX_Object::RXX_Object_Obj47_ProbClassType = convertRawToPhysical(raw_value, 1.0, 0.0);

    raw_value=copyBitsFromByteArrayLE( byteArray, 24582, 14);
    @CAN_RadarFL::RXX_Object::RXX_Object_Obj47_Px = convertRawToPhysical(raw_value, 0.0625, -512.0);

    raw_value=copyBitsFromByteArrayLE( byteArray, 24896, 12);
    @CAN_RadarFL::RXX_Object::RXX_Object_Obj47_PxAxCoVnce = convertRawToPhysical(raw_value, 0.01, 0.0);

    raw_value=copyBitsFromByteArrayLE( byteArray, 24908, 12);
    @CAN_RadarFL::RXX_Object::RXX_Object_Obj47_PxAyCoVnce = convertRawToPhysical(raw_value, 0.01, 0.0);

    raw_value=copyBitsFromByteArrayLE( byteArray, 24812, 12);
    @CAN_RadarFL::RXX_Object::RXX_Object_Obj47_PxPyCoVnce = convertRawToPhysical(raw_value, 0.01, 0.0);

    raw_value=copyBitsFromByteArrayLE( byteArray, 24596, 12);
    @CAN_RadarFL::RXX_Object::RXX_Object_Obj47_PxVnce = convertRawToPhysical(raw_value, 0.1, 0.0);

    raw_value=copyBitsFromByteArrayLE( byteArray, 24832, 12);
    @CAN_RadarFL::RXX_Object::RXX_Object_Obj47_PxVxCoVnce = convertRawToPhysical(raw_value, 0.01, 0.0);

    raw_value=copyBitsFromByteArrayLE( byteArray, 24844, 12);
    @CAN_RadarFL::RXX_Object::RXX_Object_Obj47_PxVyCoVnce = convertRawToPhysical(raw_value, 0.01, 0.0);

    raw_value=copyBitsFromByteArrayLE( byteArray, 24608, 12);
    @CAN_RadarFL::RXX_Object::RXX_Object_Obj47_Py = convertRawToPhysical(raw_value, 0.0625, -128.0);

    raw_value=copyBitsFromByteArrayLE( byteArray, 24928, 12);
    @CAN_RadarFL::RXX_Object::RXX_Object_Obj47_PyAxCoVnce = convertRawToPhysical(raw_value, 0.01, 0.0);

    raw_value=copyBitsFromByteArrayLE( byteArray, 24940, 12);
    @CAN_RadarFL::RXX_Object::RXX_Object_Obj47_PyAyCoVnce = convertRawToPhysical(raw_value, 0.01, 0.0);

    raw_value=copyBitsFromByteArrayLE( byteArray, 24620, 12);
    @CAN_RadarFL::RXX_Object::RXX_Object_Obj47_PyVnce = convertRawToPhysical(raw_value, 0.1, 0.0);

    raw_value=copyBitsFromByteArrayLE( byteArray, 24864, 12);
    @CAN_RadarFL::RXX_Object::RXX_Object_Obj47_PyVxCoVnce = convertRawToPhysical(raw_value, 0.01, 0.0);

    raw_value=copyBitsFromByteArrayLE( byteArray, 24876, 12);
    @CAN_RadarFL::RXX_Object::RXX_Object_Obj47_PyVyCoVnce = convertRawToPhysical(raw_value, 0.01, 0.0);

    raw_value=copyBitsFromByteArrayLE( byteArray, 24716, 10);
    @CAN_RadarFL::RXX_Object::RXX_Object_Obj47_RCS = convertRawToPhysical(raw_value, 0.2, -102.4);

    raw_value=copyBitsFromByteArrayLE( byteArray, 24888, 4);
    @CAN_RadarFL::RXX_Object::RXX_Object_Obj47_ReferencePoint = convertRawToPhysical(raw_value, 1.0, 0.0);

    raw_value=copyBitsFromByteArrayLE( byteArray, 24748, 12);
    @CAN_RadarFL::RXX_Object::RXX_Object_Obj47_Vx = convertRawToPhysical(raw_value, 0.0625, -128.0);

    raw_value=copyBitsFromByteArrayLE( byteArray, 24972, 12);
    @CAN_RadarFL::RXX_Object::RXX_Object_Obj47_VxAxCoVnce = convertRawToPhysical(raw_value, 0.01, 0.0);

    raw_value=copyBitsFromByteArrayLE( byteArray, 24992, 12);
    @CAN_RadarFL::RXX_Object::RXX_Object_Obj47_VxAyCoVnce = convertRawToPhysical(raw_value, 0.01, 0.0);

    raw_value=copyBitsFromByteArrayLE( byteArray, 24768, 12);
    @CAN_RadarFL::RXX_Object::RXX_Object_Obj47_VxVnce = convertRawToPhysical(raw_value, 0.01, 0.0);

    raw_value=copyBitsFromByteArrayLE( byteArray, 24960, 12);
    @CAN_RadarFL::RXX_Object::RXX_Object_Obj47_VxVyCoVnce = convertRawToPhysical(raw_value, 0.01, 0.0);

    raw_value=copyBitsFromByteArrayLE( byteArray, 24782, 10);
    @CAN_RadarFL::RXX_Object::RXX_Object_Obj47_Vy = convertRawToPhysical(raw_value, 0.125, -64.0);

    raw_value=copyBitsFromByteArrayLE( byteArray, 25004, 12);
    @CAN_RadarFL::RXX_Object::RXX_Object_Obj47_VyAxCoVnce = convertRawToPhysical(raw_value, 0.01, 0.0);

    raw_value=copyBitsFromByteArrayLE( byteArray, 25024, 12);
    @CAN_RadarFL::RXX_Object::RXX_Object_Obj47_VyAyCoVnce = convertRawToPhysical(raw_value, 0.01, 0.0);

    raw_value=copyBitsFromByteArrayLE( byteArray, 24800, 12);
    @CAN_RadarFL::RXX_Object::RXX_Object_Obj47_VyVnce = convertRawToPhysical(raw_value, 0.01, 0.0);

    raw_value=copyBitsFromByteArrayLE( byteArray, 24696, 7);
    @CAN_RadarFL::RXX_Object::RXX_Object_Obj47_Width = convertRawToPhysical(raw_value, 0.125, 0.0);

    raw_value=copyBitsFromByteArrayLE( byteArray, 24704, 12);
    @CAN_RadarFL::RXX_Object::RXX_Object_Obj47_WidthVnce = convertRawToPhysical(raw_value, 0.01, 0.0);

    raw_value=copyBitsFromByteArrayLE( byteArray, 25568, 32);
    @CAN_RadarFL::RXX_Object::RXX_Object_Obj48_Age = convertRawToPhysical(raw_value, 1.0, 0.0);

    raw_value=copyBitsFromByteArrayLE( byteArray, 25164, 10);
    @CAN_RadarFL::RXX_Object::RXX_Object_Obj48_Ax = convertRawToPhysical(raw_value, 0.03125, -16.0);

    raw_value=copyBitsFromByteArrayLE( byteArray, 25548, 12);
    @CAN_RadarFL::RXX_Object::RXX_Object_Obj48_AxAyCoVnce = convertRawToPhysical(raw_value, 0.01, 0.0);

    raw_value=copyBitsFromByteArrayLE( byteArray, 25184, 12);
    @CAN_RadarFL::RXX_Object::RXX_Object_Obj48_AxVnce = convertRawToPhysical(raw_value, 0.01, 0.0);

    raw_value=copyBitsFromByteArrayLE( byteArray, 25238, 9);
    @CAN_RadarFL::RXX_Object::RXX_Object_Obj48_Ay = convertRawToPhysical(raw_value, 0.0625, -16.0);

    raw_value=copyBitsFromByteArrayLE( byteArray, 25248, 12);
    @CAN_RadarFL::RXX_Object::RXX_Object_Obj48_AyVnce = convertRawToPhysical(raw_value, 0.01, 0.0);

    raw_value=copyBitsFromByteArrayLE( byteArray, 25304, 6);
    @CAN_RadarFL::RXX_Object::RXX_Object_Obj48_ExistProb = convertRawToPhysical(raw_value, 2.0, 0.0);

    raw_value=copyBitsFromByteArrayLE( byteArray, 25368, 8);
    @CAN_RadarFL::RXX_Object::RXX_Object_Obj48_FilterInformation = convertRawToPhysical(raw_value, 1.0, 0.0);

    raw_value=copyBitsFromByteArrayLE( byteArray, 25144, 7);
    @CAN_RadarFL::RXX_Object::RXX_Object_Obj48_Length = convertRawToPhysical(raw_value, 0.125, 0.0);

    raw_value=copyBitsFromByteArrayLE( byteArray, 25152, 12);
    @CAN_RadarFL::RXX_Object::RXX_Object_Obj48_LengthVnce = convertRawToPhysical(raw_value, 0.01, 0.0);

    raw_value=copyBitsFromByteArrayLE( byteArray, 25336, 3);
    @CAN_RadarFL::RXX_Object::RXX_Object_Obj48_MeasurementStatus = convertRawToPhysical(raw_value, 1.0, 0.0);

    raw_value=copyBitsFromByteArrayLE( byteArray, 25292, 2);
    @CAN_RadarFL::RXX_Object::RXX_Object_Obj48_MovingStatus = convertRawToPhysical(raw_value, 1.0, 0.0);

    raw_value=copyBitsFromByteArrayLE( byteArray, 25272, 7);
    @CAN_RadarFL::RXX_Object::RXX_Object_Obj48_ObjId = convertRawToPhysical(raw_value, 1.0, 0.0);

    raw_value=copyBitsFromByteArrayLE( byteArray, 25174, 9);
    @CAN_RadarFL::RXX_Object::RXX_Object_Obj48_OrientationYaw = convertRawToPhysical(raw_value, 0.0175, -4.48);

    raw_value=copyBitsFromByteArrayLE( byteArray, 25196, 12);
    @CAN_RadarFL::RXX_Object::RXX_Object_Obj48_OrientationYawVnce = convertRawToPhysical(raw_value, 0.0003, 0.0);

    raw_value=copyBitsFromByteArrayLE( byteArray, 25088, 6);
    @CAN_RadarFL::RXX_Object::RXX_Object_Obj48_ProbClassConfidence = convertRawToPhysical(raw_value, 2.0, 0.0);

    raw_value=copyBitsFromByteArrayLE( byteArray, 25339, 4);
    @CAN_RadarFL::RXX_Object::RXX_Object_Obj48_ProbClassType = convertRawToPhysical(raw_value, 1.0, 0.0);

    raw_value=copyBitsFromByteArrayLE( byteArray, 25094, 14);
    @CAN_RadarFL::RXX_Object::RXX_Object_Obj48_Px = convertRawToPhysical(raw_value, 0.0625, -512.0);

    raw_value=copyBitsFromByteArrayLE( byteArray, 25408, 12);
    @CAN_RadarFL::RXX_Object::RXX_Object_Obj48_PxAxCoVnce = convertRawToPhysical(raw_value, 0.01, 0.0);

    raw_value=copyBitsFromByteArrayLE( byteArray, 25420, 12);
    @CAN_RadarFL::RXX_Object::RXX_Object_Obj48_PxAyCoVnce = convertRawToPhysical(raw_value, 0.01, 0.0);

    raw_value=copyBitsFromByteArrayLE( byteArray, 25324, 12);
    @CAN_RadarFL::RXX_Object::RXX_Object_Obj48_PxPyCoVnce = convertRawToPhysical(raw_value, 0.01, 0.0);

    raw_value=copyBitsFromByteArrayLE( byteArray, 25108, 12);
    @CAN_RadarFL::RXX_Object::RXX_Object_Obj48_PxVnce = convertRawToPhysical(raw_value, 0.1, 0.0);

    raw_value=copyBitsFromByteArrayLE( byteArray, 25344, 12);
    @CAN_RadarFL::RXX_Object::RXX_Object_Obj48_PxVxCoVnce = convertRawToPhysical(raw_value, 0.01, 0.0);

    raw_value=copyBitsFromByteArrayLE( byteArray, 25356, 12);
    @CAN_RadarFL::RXX_Object::RXX_Object_Obj48_PxVyCoVnce = convertRawToPhysical(raw_value, 0.01, 0.0);

    raw_value=copyBitsFromByteArrayLE( byteArray, 25120, 12);
    @CAN_RadarFL::RXX_Object::RXX_Object_Obj48_Py = convertRawToPhysical(raw_value, 0.0625, -128.0);

    raw_value=copyBitsFromByteArrayLE( byteArray, 25440, 12);
    @CAN_RadarFL::RXX_Object::RXX_Object_Obj48_PyAxCoVnce = convertRawToPhysical(raw_value, 0.01, 0.0);

    raw_value=copyBitsFromByteArrayLE( byteArray, 25452, 12);
    @CAN_RadarFL::RXX_Object::RXX_Object_Obj48_PyAyCoVnce = convertRawToPhysical(raw_value, 0.01, 0.0);

    raw_value=copyBitsFromByteArrayLE( byteArray, 25132, 12);
    @CAN_RadarFL::RXX_Object::RXX_Object_Obj48_PyVnce = convertRawToPhysical(raw_value, 0.1, 0.0);

    raw_value=copyBitsFromByteArrayLE( byteArray, 25376, 12);
    @CAN_RadarFL::RXX_Object::RXX_Object_Obj48_PyVxCoVnce = convertRawToPhysical(raw_value, 0.01, 0.0);

    raw_value=copyBitsFromByteArrayLE( byteArray, 25388, 12);
    @CAN_RadarFL::RXX_Object::RXX_Object_Obj48_PyVyCoVnce = convertRawToPhysical(raw_value, 0.01, 0.0);

    raw_value=copyBitsFromByteArrayLE( byteArray, 25228, 10);
    @CAN_RadarFL::RXX_Object::RXX_Object_Obj48_RCS = convertRawToPhysical(raw_value, 0.2, -102.4);

    raw_value=copyBitsFromByteArrayLE( byteArray, 25400, 4);
    @CAN_RadarFL::RXX_Object::RXX_Object_Obj48_ReferencePoint = convertRawToPhysical(raw_value, 1.0, 0.0);

    raw_value=copyBitsFromByteArrayLE( byteArray, 25260, 12);
    @CAN_RadarFL::RXX_Object::RXX_Object_Obj48_Vx = convertRawToPhysical(raw_value, 0.0625, -128.0);

    raw_value=copyBitsFromByteArrayLE( byteArray, 25484, 12);
    @CAN_RadarFL::RXX_Object::RXX_Object_Obj48_VxAxCoVnce = convertRawToPhysical(raw_value, 0.01, 0.0);

    raw_value=copyBitsFromByteArrayLE( byteArray, 25504, 12);
    @CAN_RadarFL::RXX_Object::RXX_Object_Obj48_VxAyCoVnce = convertRawToPhysical(raw_value, 0.01, 0.0);

    raw_value=copyBitsFromByteArrayLE( byteArray, 25280, 12);
    @CAN_RadarFL::RXX_Object::RXX_Object_Obj48_VxVnce = convertRawToPhysical(raw_value, 0.01, 0.0);

    raw_value=copyBitsFromByteArrayLE( byteArray, 25472, 12);
    @CAN_RadarFL::RXX_Object::RXX_Object_Obj48_VxVyCoVnce = convertRawToPhysical(raw_value, 0.01, 0.0);

    raw_value=copyBitsFromByteArrayLE( byteArray, 25294, 10);
    @CAN_RadarFL::RXX_Object::RXX_Object_Obj48_Vy = convertRawToPhysical(raw_value, 0.125, -64.0);

    raw_value=copyBitsFromByteArrayLE( byteArray, 25516, 12);
    @CAN_RadarFL::RXX_Object::RXX_Object_Obj48_VyAxCoVnce = convertRawToPhysical(raw_value, 0.01, 0.0);

    raw_value=copyBitsFromByteArrayLE( byteArray, 25536, 12);
    @CAN_RadarFL::RXX_Object::RXX_Object_Obj48_VyAyCoVnce = convertRawToPhysical(raw_value, 0.01, 0.0);

    raw_value=copyBitsFromByteArrayLE( byteArray, 25312, 12);
    @CAN_RadarFL::RXX_Object::RXX_Object_Obj48_VyVnce = convertRawToPhysical(raw_value, 0.01, 0.0);

    raw_value=copyBitsFromByteArrayLE( byteArray, 25208, 7);
    @CAN_RadarFL::RXX_Object::RXX_Object_Obj48_Width = convertRawToPhysical(raw_value, 0.125, 0.0);

    raw_value=copyBitsFromByteArrayLE( byteArray, 25216, 12);
    @CAN_RadarFL::RXX_Object::RXX_Object_Obj48_WidthVnce = convertRawToPhysical(raw_value, 0.01, 0.0);

    raw_value=copyBitsFromByteArrayLE( byteArray, 26080, 32);
    @CAN_RadarFL::RXX_Object::RXX_Object_Obj49_Age = convertRawToPhysical(raw_value, 1.0, 0.0);

    raw_value=copyBitsFromByteArrayLE( byteArray, 25676, 10);
    @CAN_RadarFL::RXX_Object::RXX_Object_Obj49_Ax = convertRawToPhysical(raw_value, 0.03125, -16.0);

    raw_value=copyBitsFromByteArrayLE( byteArray, 26060, 12);
    @CAN_RadarFL::RXX_Object::RXX_Object_Obj49_AxAyCoVnce = convertRawToPhysical(raw_value, 0.01, 0.0);

    raw_value=copyBitsFromByteArrayLE( byteArray, 25696, 12);
    @CAN_RadarFL::RXX_Object::RXX_Object_Obj49_AxVnce = convertRawToPhysical(raw_value, 0.01, 0.0);

    raw_value=copyBitsFromByteArrayLE( byteArray, 25750, 9);
    @CAN_RadarFL::RXX_Object::RXX_Object_Obj49_Ay = convertRawToPhysical(raw_value, 0.0625, -16.0);

    raw_value=copyBitsFromByteArrayLE( byteArray, 25760, 12);
    @CAN_RadarFL::RXX_Object::RXX_Object_Obj49_AyVnce = convertRawToPhysical(raw_value, 0.01, 0.0);

    raw_value=copyBitsFromByteArrayLE( byteArray, 25816, 6);
    @CAN_RadarFL::RXX_Object::RXX_Object_Obj49_ExistProb = convertRawToPhysical(raw_value, 2.0, 0.0);

    raw_value=copyBitsFromByteArrayLE( byteArray, 25880, 8);
    @CAN_RadarFL::RXX_Object::RXX_Object_Obj49_FilterInformation = convertRawToPhysical(raw_value, 1.0, 0.0);

    raw_value=copyBitsFromByteArrayLE( byteArray, 25656, 7);
    @CAN_RadarFL::RXX_Object::RXX_Object_Obj49_Length = convertRawToPhysical(raw_value, 0.125, 0.0);

    raw_value=copyBitsFromByteArrayLE( byteArray, 25664, 12);
    @CAN_RadarFL::RXX_Object::RXX_Object_Obj49_LengthVnce = convertRawToPhysical(raw_value, 0.01, 0.0);

    raw_value=copyBitsFromByteArrayLE( byteArray, 25848, 3);
    @CAN_RadarFL::RXX_Object::RXX_Object_Obj49_MeasurementStatus = convertRawToPhysical(raw_value, 1.0, 0.0);

    raw_value=copyBitsFromByteArrayLE( byteArray, 25804, 2);
    @CAN_RadarFL::RXX_Object::RXX_Object_Obj49_MovingStatus = convertRawToPhysical(raw_value, 1.0, 0.0);

    raw_value=copyBitsFromByteArrayLE( byteArray, 25784, 7);
    @CAN_RadarFL::RXX_Object::RXX_Object_Obj49_ObjId = convertRawToPhysical(raw_value, 1.0, 0.0);

    raw_value=copyBitsFromByteArrayLE( byteArray, 25686, 9);
    @CAN_RadarFL::RXX_Object::RXX_Object_Obj49_OrientationYaw = convertRawToPhysical(raw_value, 0.0175, -4.48);

    raw_value=copyBitsFromByteArrayLE( byteArray, 25708, 12);
    @CAN_RadarFL::RXX_Object::RXX_Object_Obj49_OrientationYawVnce = convertRawToPhysical(raw_value, 0.0003, 0.0);

    raw_value=copyBitsFromByteArrayLE( byteArray, 25600, 6);
    @CAN_RadarFL::RXX_Object::RXX_Object_Obj49_ProbClassConfidence = convertRawToPhysical(raw_value, 2.0, 0.0);

    raw_value=copyBitsFromByteArrayLE( byteArray, 25851, 4);
    @CAN_RadarFL::RXX_Object::RXX_Object_Obj49_ProbClassType = convertRawToPhysical(raw_value, 1.0, 0.0);

    raw_value=copyBitsFromByteArrayLE( byteArray, 25606, 14);
    @CAN_RadarFL::RXX_Object::RXX_Object_Obj49_Px = convertRawToPhysical(raw_value, 0.0625, -512.0);

    raw_value=copyBitsFromByteArrayLE( byteArray, 25920, 12);
    @CAN_RadarFL::RXX_Object::RXX_Object_Obj49_PxAxCoVnce = convertRawToPhysical(raw_value, 0.01, 0.0);

    raw_value=copyBitsFromByteArrayLE( byteArray, 25932, 12);
    @CAN_RadarFL::RXX_Object::RXX_Object_Obj49_PxAyCoVnce = convertRawToPhysical(raw_value, 0.01, 0.0);

    raw_value=copyBitsFromByteArrayLE( byteArray, 25836, 12);
    @CAN_RadarFL::RXX_Object::RXX_Object_Obj49_PxPyCoVnce = convertRawToPhysical(raw_value, 0.01, 0.0);

    raw_value=copyBitsFromByteArrayLE( byteArray, 25620, 12);
    @CAN_RadarFL::RXX_Object::RXX_Object_Obj49_PxVnce = convertRawToPhysical(raw_value, 0.1, 0.0);

    raw_value=copyBitsFromByteArrayLE( byteArray, 25856, 12);
    @CAN_RadarFL::RXX_Object::RXX_Object_Obj49_PxVxCoVnce = convertRawToPhysical(raw_value, 0.01, 0.0);

    raw_value=copyBitsFromByteArrayLE( byteArray, 25868, 12);
    @CAN_RadarFL::RXX_Object::RXX_Object_Obj49_PxVyCoVnce = convertRawToPhysical(raw_value, 0.01, 0.0);

    raw_value=copyBitsFromByteArrayLE( byteArray, 25632, 12);
    @CAN_RadarFL::RXX_Object::RXX_Object_Obj49_Py = convertRawToPhysical(raw_value, 0.0625, -128.0);

    raw_value=copyBitsFromByteArrayLE( byteArray, 25952, 12);
    @CAN_RadarFL::RXX_Object::RXX_Object_Obj49_PyAxCoVnce = convertRawToPhysical(raw_value, 0.01, 0.0);

    raw_value=copyBitsFromByteArrayLE( byteArray, 25964, 12);
    @CAN_RadarFL::RXX_Object::RXX_Object_Obj49_PyAyCoVnce = convertRawToPhysical(raw_value, 0.01, 0.0);

    raw_value=copyBitsFromByteArrayLE( byteArray, 25644, 12);
    @CAN_RadarFL::RXX_Object::RXX_Object_Obj49_PyVnce = convertRawToPhysical(raw_value, 0.1, 0.0);

    raw_value=copyBitsFromByteArrayLE( byteArray, 25888, 12);
    @CAN_RadarFL::RXX_Object::RXX_Object_Obj49_PyVxCoVnce = convertRawToPhysical(raw_value, 0.01, 0.0);

    raw_value=copyBitsFromByteArrayLE( byteArray, 25900, 12);
    @CAN_RadarFL::RXX_Object::RXX_Object_Obj49_PyVyCoVnce = convertRawToPhysical(raw_value, 0.01, 0.0);

    raw_value=copyBitsFromByteArrayLE( byteArray, 25740, 10);
    @CAN_RadarFL::RXX_Object::RXX_Object_Obj49_RCS = convertRawToPhysical(raw_value, 0.2, -102.4);

    raw_value=copyBitsFromByteArrayLE( byteArray, 25912, 4);
    @CAN_RadarFL::RXX_Object::RXX_Object_Obj49_ReferencePoint = convertRawToPhysical(raw_value, 1.0, 0.0);

    raw_value=copyBitsFromByteArrayLE( byteArray, 25772, 12);
    @CAN_RadarFL::RXX_Object::RXX_Object_Obj49_Vx = convertRawToPhysical(raw_value, 0.0625, -128.0);

    raw_value=copyBitsFromByteArrayLE( byteArray, 25996, 12);
    @CAN_RadarFL::RXX_Object::RXX_Object_Obj49_VxAxCoVnce = convertRawToPhysical(raw_value, 0.01, 0.0);

    raw_value=copyBitsFromByteArrayLE( byteArray, 26016, 12);
    @CAN_RadarFL::RXX_Object::RXX_Object_Obj49_VxAyCoVnce = convertRawToPhysical(raw_value, 0.01, 0.0);

    raw_value=copyBitsFromByteArrayLE( byteArray, 25792, 12);
    @CAN_RadarFL::RXX_Object::RXX_Object_Obj49_VxVnce = convertRawToPhysical(raw_value, 0.01, 0.0);

    raw_value=copyBitsFromByteArrayLE( byteArray, 25984, 12);
    @CAN_RadarFL::RXX_Object::RXX_Object_Obj49_VxVyCoVnce = convertRawToPhysical(raw_value, 0.01, 0.0);

    raw_value=copyBitsFromByteArrayLE( byteArray, 25806, 10);
    @CAN_RadarFL::RXX_Object::RXX_Object_Obj49_Vy = convertRawToPhysical(raw_value, 0.125, -64.0);

    raw_value=copyBitsFromByteArrayLE( byteArray, 26028, 12);
    @CAN_RadarFL::RXX_Object::RXX_Object_Obj49_VyAxCoVnce = convertRawToPhysical(raw_value, 0.01, 0.0);

    raw_value=copyBitsFromByteArrayLE( byteArray, 26048, 12);
    @CAN_RadarFL::RXX_Object::RXX_Object_Obj49_VyAyCoVnce = convertRawToPhysical(raw_value, 0.01, 0.0);

    raw_value=copyBitsFromByteArrayLE( byteArray, 25824, 12);
    @CAN_RadarFL::RXX_Object::RXX_Object_Obj49_VyVnce = convertRawToPhysical(raw_value, 0.01, 0.0);

    raw_value=copyBitsFromByteArrayLE( byteArray, 25720, 7);
    @CAN_RadarFL::RXX_Object::RXX_Object_Obj49_Width = convertRawToPhysical(raw_value, 0.125, 0.0);

    raw_value=copyBitsFromByteArrayLE( byteArray, 25728, 12);
    @CAN_RadarFL::RXX_Object::RXX_Object_Obj49_WidthVnce = convertRawToPhysical(raw_value, 0.01, 0.0);

    raw_value=copyBitsFromByteArrayLE( byteArray, 3040, 32);
    @CAN_RadarFL::RXX_Object::RXX_Object_Obj4_Age = convertRawToPhysical(raw_value, 1.0, 0.0);

    raw_value=copyBitsFromByteArrayLE( byteArray, 2636, 10);
    @CAN_RadarFL::RXX_Object::RXX_Object_Obj4_Ax = convertRawToPhysical(raw_value, 0.03125, -16.0);

    raw_value=copyBitsFromByteArrayLE( byteArray, 3020, 12);
    @CAN_RadarFL::RXX_Object::RXX_Object_Obj4_AxAyCoVnce = convertRawToPhysical(raw_value, 0.01, 0.0);

    raw_value=copyBitsFromByteArrayLE( byteArray, 2656, 12);
    @CAN_RadarFL::RXX_Object::RXX_Object_Obj4_AxVnce = convertRawToPhysical(raw_value, 0.01, 0.0);

    raw_value=copyBitsFromByteArrayLE( byteArray, 2710, 9);
    @CAN_RadarFL::RXX_Object::RXX_Object_Obj4_Ay = convertRawToPhysical(raw_value, 0.0625, -16.0);

    raw_value=copyBitsFromByteArrayLE( byteArray, 2720, 12);
    @CAN_RadarFL::RXX_Object::RXX_Object_Obj4_AyVnce = convertRawToPhysical(raw_value, 0.01, 0.0);

    raw_value=copyBitsFromByteArrayLE( byteArray, 2776, 6);
    @CAN_RadarFL::RXX_Object::RXX_Object_Obj4_ExistProb = convertRawToPhysical(raw_value, 2.0, 0.0);

    raw_value=copyBitsFromByteArrayLE( byteArray, 2840, 8);
    @CAN_RadarFL::RXX_Object::RXX_Object_Obj4_FilterInformation = convertRawToPhysical(raw_value, 1.0, 0.0);

    raw_value=copyBitsFromByteArrayLE( byteArray, 2616, 7);
    @CAN_RadarFL::RXX_Object::RXX_Object_Obj4_Length = convertRawToPhysical(raw_value, 0.125, 0.0);

    raw_value=copyBitsFromByteArrayLE( byteArray, 2624, 12);
    @CAN_RadarFL::RXX_Object::RXX_Object_Obj4_LengthVnce = convertRawToPhysical(raw_value, 0.01, 0.0);

    raw_value=copyBitsFromByteArrayLE( byteArray, 2808, 3);
    @CAN_RadarFL::RXX_Object::RXX_Object_Obj4_MeasurementStatus = convertRawToPhysical(raw_value, 1.0, 0.0);

    raw_value=copyBitsFromByteArrayLE( byteArray, 2764, 2);
    @CAN_RadarFL::RXX_Object::RXX_Object_Obj4_MovingStatus = convertRawToPhysical(raw_value, 1.0, 0.0);

    raw_value=copyBitsFromByteArrayLE( byteArray, 2744, 7);
    @CAN_RadarFL::RXX_Object::RXX_Object_Obj4_ObjId = convertRawToPhysical(raw_value, 1.0, 0.0);

    raw_value=copyBitsFromByteArrayLE( byteArray, 2646, 9);
    @CAN_RadarFL::RXX_Object::RXX_Object_Obj4_OrientationYaw = convertRawToPhysical(raw_value, 0.0175, -4.48);

    raw_value=copyBitsFromByteArrayLE( byteArray, 2668, 12);
    @CAN_RadarFL::RXX_Object::RXX_Object_Obj4_OrientationYawVnce = convertRawToPhysical(raw_value, 0.0003, 0.0);

    raw_value=copyBitsFromByteArrayLE( byteArray, 2560, 6);
    @CAN_RadarFL::RXX_Object::RXX_Object_Obj4_ProbClassConfidence = convertRawToPhysical(raw_value, 2.0, 0.0);

    raw_value=copyBitsFromByteArrayLE( byteArray, 2811, 4);
    @CAN_RadarFL::RXX_Object::RXX_Object_Obj4_ProbClassType = convertRawToPhysical(raw_value, 1.0, 0.0);

    raw_value=copyBitsFromByteArrayLE( byteArray, 2566, 14);
    @CAN_RadarFL::RXX_Object::RXX_Object_Obj4_Px = convertRawToPhysical(raw_value, 0.0625, -512.0);

    raw_value=copyBitsFromByteArrayLE( byteArray, 2880, 12);
    @CAN_RadarFL::RXX_Object::RXX_Object_Obj4_PxAxCoVnce = convertRawToPhysical(raw_value, 0.01, 0.0);

    raw_value=copyBitsFromByteArrayLE( byteArray, 2892, 12);
    @CAN_RadarFL::RXX_Object::RXX_Object_Obj4_PxAyCoVnce = convertRawToPhysical(raw_value, 0.01, 0.0);

    raw_value=copyBitsFromByteArrayLE( byteArray, 2796, 12);
    @CAN_RadarFL::RXX_Object::RXX_Object_Obj4_PxPyCoVnce = convertRawToPhysical(raw_value, 0.01, 0.0);

    raw_value=copyBitsFromByteArrayLE( byteArray, 2580, 12);
    @CAN_RadarFL::RXX_Object::RXX_Object_Obj4_PxVnce = convertRawToPhysical(raw_value, 0.1, 0.0);

    raw_value=copyBitsFromByteArrayLE( byteArray, 2816, 12);
    @CAN_RadarFL::RXX_Object::RXX_Object_Obj4_PxVxCoVnce = convertRawToPhysical(raw_value, 0.01, 0.0);

    raw_value=copyBitsFromByteArrayLE( byteArray, 2828, 12);
    @CAN_RadarFL::RXX_Object::RXX_Object_Obj4_PxVyCoVnce = convertRawToPhysical(raw_value, 0.01, 0.0);

    raw_value=copyBitsFromByteArrayLE( byteArray, 2592, 12);
    @CAN_RadarFL::RXX_Object::RXX_Object_Obj4_Py = convertRawToPhysical(raw_value, 0.0625, -128.0);

    raw_value=copyBitsFromByteArrayLE( byteArray, 2912, 12);
    @CAN_RadarFL::RXX_Object::RXX_Object_Obj4_PyAxCoVnce = convertRawToPhysical(raw_value, 0.01, 0.0);

    raw_value=copyBitsFromByteArrayLE( byteArray, 2924, 12);
    @CAN_RadarFL::RXX_Object::RXX_Object_Obj4_PyAyCoVnce = convertRawToPhysical(raw_value, 0.01, 0.0);

    raw_value=copyBitsFromByteArrayLE( byteArray, 2604, 12);
    @CAN_RadarFL::RXX_Object::RXX_Object_Obj4_PyVnce = convertRawToPhysical(raw_value, 0.1, 0.0);

    raw_value=copyBitsFromByteArrayLE( byteArray, 2848, 12);
    @CAN_RadarFL::RXX_Object::RXX_Object_Obj4_PyVxCoVnce = convertRawToPhysical(raw_value, 0.01, 0.0);

    raw_value=copyBitsFromByteArrayLE( byteArray, 2860, 12);
    @CAN_RadarFL::RXX_Object::RXX_Object_Obj4_PyVyCoVnce = convertRawToPhysical(raw_value, 0.01, 0.0);

    raw_value=copyBitsFromByteArrayLE( byteArray, 2700, 10);
    @CAN_RadarFL::RXX_Object::RXX_Object_Obj4_RCS = convertRawToPhysical(raw_value, 0.2, -102.4);

    raw_value=copyBitsFromByteArrayLE( byteArray, 2872, 4);
    @CAN_RadarFL::RXX_Object::RXX_Object_Obj4_ReferencePoint = convertRawToPhysical(raw_value, 1.0, 0.0);

    raw_value=copyBitsFromByteArrayLE( byteArray, 2732, 12);
    @CAN_RadarFL::RXX_Object::RXX_Object_Obj4_Vx = convertRawToPhysical(raw_value, 0.0625, -128.0);

    raw_value=copyBitsFromByteArrayLE( byteArray, 2956, 12);
    @CAN_RadarFL::RXX_Object::RXX_Object_Obj4_VxAxCoVnce = convertRawToPhysical(raw_value, 0.01, 0.0);

    raw_value=copyBitsFromByteArrayLE( byteArray, 2976, 12);
    @CAN_RadarFL::RXX_Object::RXX_Object_Obj4_VxAyCoVnce = convertRawToPhysical(raw_value, 0.01, 0.0);

    raw_value=copyBitsFromByteArrayLE( byteArray, 2752, 12);
    @CAN_RadarFL::RXX_Object::RXX_Object_Obj4_VxVnce = convertRawToPhysical(raw_value, 0.01, 0.0);

    raw_value=copyBitsFromByteArrayLE( byteArray, 2944, 12);
    @CAN_RadarFL::RXX_Object::RXX_Object_Obj4_VxVyCoVnce = convertRawToPhysical(raw_value, 0.01, 0.0);

    raw_value=copyBitsFromByteArrayLE( byteArray, 2766, 10);
    @CAN_RadarFL::RXX_Object::RXX_Object_Obj4_Vy = convertRawToPhysical(raw_value, 0.125, -64.0);

    raw_value=copyBitsFromByteArrayLE( byteArray, 2988, 12);
    @CAN_RadarFL::RXX_Object::RXX_Object_Obj4_VyAxCoVnce = convertRawToPhysical(raw_value, 0.01, 0.0);

    raw_value=copyBitsFromByteArrayLE( byteArray, 3008, 12);
    @CAN_RadarFL::RXX_Object::RXX_Object_Obj4_VyAyCoVnce = convertRawToPhysical(raw_value, 0.01, 0.0);

    raw_value=copyBitsFromByteArrayLE( byteArray, 2784, 12);
    @CAN_RadarFL::RXX_Object::RXX_Object_Obj4_VyVnce = convertRawToPhysical(raw_value, 0.01, 0.0);

    raw_value=copyBitsFromByteArrayLE( byteArray, 2680, 7);
    @CAN_RadarFL::RXX_Object::RXX_Object_Obj4_Width = convertRawToPhysical(raw_value, 0.125, 0.0);

    raw_value=copyBitsFromByteArrayLE( byteArray, 2688, 12);
    @CAN_RadarFL::RXX_Object::RXX_Object_Obj4_WidthVnce = convertRawToPhysical(raw_value, 0.01, 0.0);

    raw_value=copyBitsFromByteArrayLE( byteArray, 3552, 32);
    @CAN_RadarFL::RXX_Object::RXX_Object_Obj5_Age = convertRawToPhysical(raw_value, 1.0, 0.0);

    raw_value=copyBitsFromByteArrayLE( byteArray, 3148, 10);
    @CAN_RadarFL::RXX_Object::RXX_Object_Obj5_Ax = convertRawToPhysical(raw_value, 0.03125, -16.0);

    raw_value=copyBitsFromByteArrayLE( byteArray, 3532, 12);
    @CAN_RadarFL::RXX_Object::RXX_Object_Obj5_AxAyCoVnce = convertRawToPhysical(raw_value, 0.01, 0.0);

    raw_value=copyBitsFromByteArrayLE( byteArray, 3168, 12);
    @CAN_RadarFL::RXX_Object::RXX_Object_Obj5_AxVnce = convertRawToPhysical(raw_value, 0.01, 0.0);

    raw_value=copyBitsFromByteArrayLE( byteArray, 3222, 9);
    @CAN_RadarFL::RXX_Object::RXX_Object_Obj5_Ay = convertRawToPhysical(raw_value, 0.0625, -16.0);

    raw_value=copyBitsFromByteArrayLE( byteArray, 3232, 12);
    @CAN_RadarFL::RXX_Object::RXX_Object_Obj5_AyVnce = convertRawToPhysical(raw_value, 0.01, 0.0);

    raw_value=copyBitsFromByteArrayLE( byteArray, 3288, 6);
    @CAN_RadarFL::RXX_Object::RXX_Object_Obj5_ExistProb = convertRawToPhysical(raw_value, 2.0, 0.0);

    raw_value=copyBitsFromByteArrayLE( byteArray, 3352, 8);
    @CAN_RadarFL::RXX_Object::RXX_Object_Obj5_FilterInformation = convertRawToPhysical(raw_value, 1.0, 0.0);

    raw_value=copyBitsFromByteArrayLE( byteArray, 3128, 7);
    @CAN_RadarFL::RXX_Object::RXX_Object_Obj5_Length = convertRawToPhysical(raw_value, 0.125, 0.0);

    raw_value=copyBitsFromByteArrayLE( byteArray, 3136, 12);
    @CAN_RadarFL::RXX_Object::RXX_Object_Obj5_LengthVnce = convertRawToPhysical(raw_value, 0.01, 0.0);

    raw_value=copyBitsFromByteArrayLE( byteArray, 3320, 3);
    @CAN_RadarFL::RXX_Object::RXX_Object_Obj5_MeasurementStatus = convertRawToPhysical(raw_value, 1.0, 0.0);

    raw_value=copyBitsFromByteArrayLE( byteArray, 3276, 2);
    @CAN_RadarFL::RXX_Object::RXX_Object_Obj5_MovingStatus = convertRawToPhysical(raw_value, 1.0, 0.0);

    raw_value=copyBitsFromByteArrayLE( byteArray, 3256, 7);
    @CAN_RadarFL::RXX_Object::RXX_Object_Obj5_ObjId = convertRawToPhysical(raw_value, 1.0, 0.0);

    raw_value=copyBitsFromByteArrayLE( byteArray, 3158, 9);
    @CAN_RadarFL::RXX_Object::RXX_Object_Obj5_OrientationYaw = convertRawToPhysical(raw_value, 0.0175, -4.48);

    raw_value=copyBitsFromByteArrayLE( byteArray, 3180, 12);
    @CAN_RadarFL::RXX_Object::RXX_Object_Obj5_OrientationYawVnce = convertRawToPhysical(raw_value, 0.0003, 0.0);

    raw_value=copyBitsFromByteArrayLE( byteArray, 3072, 6);
    @CAN_RadarFL::RXX_Object::RXX_Object_Obj5_ProbClassConfidence = convertRawToPhysical(raw_value, 2.0, 0.0);

    raw_value=copyBitsFromByteArrayLE( byteArray, 3323, 4);
    @CAN_RadarFL::RXX_Object::RXX_Object_Obj5_ProbClassType = convertRawToPhysical(raw_value, 1.0, 0.0);

    raw_value=copyBitsFromByteArrayLE( byteArray, 3078, 14);
    @CAN_RadarFL::RXX_Object::RXX_Object_Obj5_Px = convertRawToPhysical(raw_value, 0.0625, -512.0);

    raw_value=copyBitsFromByteArrayLE( byteArray, 3392, 12);
    @CAN_RadarFL::RXX_Object::RXX_Object_Obj5_PxAxCoVnce = convertRawToPhysical(raw_value, 0.01, 0.0);

    raw_value=copyBitsFromByteArrayLE( byteArray, 3404, 12);
    @CAN_RadarFL::RXX_Object::RXX_Object_Obj5_PxAyCoVnce = convertRawToPhysical(raw_value, 0.01, 0.0);

    raw_value=copyBitsFromByteArrayLE( byteArray, 3308, 12);
    @CAN_RadarFL::RXX_Object::RXX_Object_Obj5_PxPyCoVnce = convertRawToPhysical(raw_value, 0.01, 0.0);

    raw_value=copyBitsFromByteArrayLE( byteArray, 3092, 12);
    @CAN_RadarFL::RXX_Object::RXX_Object_Obj5_PxVnce = convertRawToPhysical(raw_value, 0.1, 0.0);

    raw_value=copyBitsFromByteArrayLE( byteArray, 3328, 12);
    @CAN_RadarFL::RXX_Object::RXX_Object_Obj5_PxVxCoVnce = convertRawToPhysical(raw_value, 0.01, 0.0);

    raw_value=copyBitsFromByteArrayLE( byteArray, 3340, 12);
    @CAN_RadarFL::RXX_Object::RXX_Object_Obj5_PxVyCoVnce = convertRawToPhysical(raw_value, 0.01, 0.0);

    raw_value=copyBitsFromByteArrayLE( byteArray, 3104, 12);
    @CAN_RadarFL::RXX_Object::RXX_Object_Obj5_Py = convertRawToPhysical(raw_value, 0.0625, -128.0);

    raw_value=copyBitsFromByteArrayLE( byteArray, 3424, 12);
    @CAN_RadarFL::RXX_Object::RXX_Object_Obj5_PyAxCoVnce = convertRawToPhysical(raw_value, 0.01, 0.0);

    raw_value=copyBitsFromByteArrayLE( byteArray, 3436, 12);
    @CAN_RadarFL::RXX_Object::RXX_Object_Obj5_PyAyCoVnce = convertRawToPhysical(raw_value, 0.01, 0.0);

    raw_value=copyBitsFromByteArrayLE( byteArray, 3116, 12);
    @CAN_RadarFL::RXX_Object::RXX_Object_Obj5_PyVnce = convertRawToPhysical(raw_value, 0.1, 0.0);

    raw_value=copyBitsFromByteArrayLE( byteArray, 3360, 12);
    @CAN_RadarFL::RXX_Object::RXX_Object_Obj5_PyVxCoVnce = convertRawToPhysical(raw_value, 0.01, 0.0);

    raw_value=copyBitsFromByteArrayLE( byteArray, 3372, 12);
    @CAN_RadarFL::RXX_Object::RXX_Object_Obj5_PyVyCoVnce = convertRawToPhysical(raw_value, 0.01, 0.0);

    raw_value=copyBitsFromByteArrayLE( byteArray, 3212, 10);
    @CAN_RadarFL::RXX_Object::RXX_Object_Obj5_RCS = convertRawToPhysical(raw_value, 0.2, -102.4);

    raw_value=copyBitsFromByteArrayLE( byteArray, 3384, 4);
    @CAN_RadarFL::RXX_Object::RXX_Object_Obj5_ReferencePoint = convertRawToPhysical(raw_value, 1.0, 0.0);

    raw_value=copyBitsFromByteArrayLE( byteArray, 3244, 12);
    @CAN_RadarFL::RXX_Object::RXX_Object_Obj5_Vx = convertRawToPhysical(raw_value, 0.0625, -128.0);

    raw_value=copyBitsFromByteArrayLE( byteArray, 3468, 12);
    @CAN_RadarFL::RXX_Object::RXX_Object_Obj5_VxAxCoVnce = convertRawToPhysical(raw_value, 0.01, 0.0);

    raw_value=copyBitsFromByteArrayLE( byteArray, 3488, 12);
    @CAN_RadarFL::RXX_Object::RXX_Object_Obj5_VxAyCoVnce = convertRawToPhysical(raw_value, 0.01, 0.0);

    raw_value=copyBitsFromByteArrayLE( byteArray, 3264, 12);
    @CAN_RadarFL::RXX_Object::RXX_Object_Obj5_VxVnce = convertRawToPhysical(raw_value, 0.01, 0.0);

    raw_value=copyBitsFromByteArrayLE( byteArray, 3456, 12);
    @CAN_RadarFL::RXX_Object::RXX_Object_Obj5_VxVyCoVnce = convertRawToPhysical(raw_value, 0.01, 0.0);

    raw_value=copyBitsFromByteArrayLE( byteArray, 3278, 10);
    @CAN_RadarFL::RXX_Object::RXX_Object_Obj5_Vy = convertRawToPhysical(raw_value, 0.125, -64.0);

    raw_value=copyBitsFromByteArrayLE( byteArray, 3500, 12);
    @CAN_RadarFL::RXX_Object::RXX_Object_Obj5_VyAxCoVnce = convertRawToPhysical(raw_value, 0.01, 0.0);

    raw_value=copyBitsFromByteArrayLE( byteArray, 3520, 12);
    @CAN_RadarFL::RXX_Object::RXX_Object_Obj5_VyAyCoVnce = convertRawToPhysical(raw_value, 0.01, 0.0);

    raw_value=copyBitsFromByteArrayLE( byteArray, 3296, 12);
    @CAN_RadarFL::RXX_Object::RXX_Object_Obj5_VyVnce = convertRawToPhysical(raw_value, 0.01, 0.0);

    raw_value=copyBitsFromByteArrayLE( byteArray, 3192, 7);
    @CAN_RadarFL::RXX_Object::RXX_Object_Obj5_Width = convertRawToPhysical(raw_value, 0.125, 0.0);

    raw_value=copyBitsFromByteArrayLE( byteArray, 3200, 12);
    @CAN_RadarFL::RXX_Object::RXX_Object_Obj5_WidthVnce = convertRawToPhysical(raw_value, 0.01, 0.0);

    raw_value=copyBitsFromByteArrayLE( byteArray, 4064, 32);
    @CAN_RadarFL::RXX_Object::RXX_Object_Obj6_Age = convertRawToPhysical(raw_value, 1.0, 0.0);

    raw_value=copyBitsFromByteArrayLE( byteArray, 3660, 10);
    @CAN_RadarFL::RXX_Object::RXX_Object_Obj6_Ax = convertRawToPhysical(raw_value, 0.03125, -16.0);

    raw_value=copyBitsFromByteArrayLE( byteArray, 4044, 12);
    @CAN_RadarFL::RXX_Object::RXX_Object_Obj6_AxAyCoVnce = convertRawToPhysical(raw_value, 0.01, 0.0);

    raw_value=copyBitsFromByteArrayLE( byteArray, 3680, 12);
    @CAN_RadarFL::RXX_Object::RXX_Object_Obj6_AxVnce = convertRawToPhysical(raw_value, 0.01, 0.0);

    raw_value=copyBitsFromByteArrayLE( byteArray, 3734, 9);
    @CAN_RadarFL::RXX_Object::RXX_Object_Obj6_Ay = convertRawToPhysical(raw_value, 0.0625, -16.0);

    raw_value=copyBitsFromByteArrayLE( byteArray, 3744, 12);
    @CAN_RadarFL::RXX_Object::RXX_Object_Obj6_AyVnce = convertRawToPhysical(raw_value, 0.01, 0.0);

    raw_value=copyBitsFromByteArrayLE( byteArray, 3800, 6);
    @CAN_RadarFL::RXX_Object::RXX_Object_Obj6_ExistProb = convertRawToPhysical(raw_value, 2.0, 0.0);

    raw_value=copyBitsFromByteArrayLE( byteArray, 3864, 8);
    @CAN_RadarFL::RXX_Object::RXX_Object_Obj6_FilterInformation = convertRawToPhysical(raw_value, 1.0, 0.0);

    raw_value=copyBitsFromByteArrayLE( byteArray, 3640, 7);
    @CAN_RadarFL::RXX_Object::RXX_Object_Obj6_Length = convertRawToPhysical(raw_value, 0.125, 0.0);

    raw_value=copyBitsFromByteArrayLE( byteArray, 3648, 12);
    @CAN_RadarFL::RXX_Object::RXX_Object_Obj6_LengthVnce = convertRawToPhysical(raw_value, 0.01, 0.0);

    raw_value=copyBitsFromByteArrayLE( byteArray, 3832, 3);
    @CAN_RadarFL::RXX_Object::RXX_Object_Obj6_MeasurementStatus = convertRawToPhysical(raw_value, 1.0, 0.0);

    raw_value=copyBitsFromByteArrayLE( byteArray, 3788, 2);
    @CAN_RadarFL::RXX_Object::RXX_Object_Obj6_MovingStatus = convertRawToPhysical(raw_value, 1.0, 0.0);

    raw_value=copyBitsFromByteArrayLE( byteArray, 3768, 7);
    @CAN_RadarFL::RXX_Object::RXX_Object_Obj6_ObjId = convertRawToPhysical(raw_value, 1.0, 0.0);

    raw_value=copyBitsFromByteArrayLE( byteArray, 3670, 9);
    @CAN_RadarFL::RXX_Object::RXX_Object_Obj6_OrientationYaw = convertRawToPhysical(raw_value, 0.0175, -4.48);

    raw_value=copyBitsFromByteArrayLE( byteArray, 3692, 12);
    @CAN_RadarFL::RXX_Object::RXX_Object_Obj6_OrientationYawVnce = convertRawToPhysical(raw_value, 0.0003, 0.0);

    raw_value=copyBitsFromByteArrayLE( byteArray, 3584, 6);
    @CAN_RadarFL::RXX_Object::RXX_Object_Obj6_ProbClassConfidence = convertRawToPhysical(raw_value, 2.0, 0.0);

    raw_value=copyBitsFromByteArrayLE( byteArray, 3835, 4);
    @CAN_RadarFL::RXX_Object::RXX_Object_Obj6_ProbClassType = convertRawToPhysical(raw_value, 1.0, 0.0);

    raw_value=copyBitsFromByteArrayLE( byteArray, 3590, 14);
    @CAN_RadarFL::RXX_Object::RXX_Object_Obj6_Px = convertRawToPhysical(raw_value, 0.0625, -512.0);

    raw_value=copyBitsFromByteArrayLE( byteArray, 3904, 12);
    @CAN_RadarFL::RXX_Object::RXX_Object_Obj6_PxAxCoVnce = convertRawToPhysical(raw_value, 0.01, 0.0);

    raw_value=copyBitsFromByteArrayLE( byteArray, 3916, 12);
    @CAN_RadarFL::RXX_Object::RXX_Object_Obj6_PxAyCoVnce = convertRawToPhysical(raw_value, 0.01, 0.0);

    raw_value=copyBitsFromByteArrayLE( byteArray, 3820, 12);
    @CAN_RadarFL::RXX_Object::RXX_Object_Obj6_PxPyCoVnce = convertRawToPhysical(raw_value, 0.01, 0.0);

    raw_value=copyBitsFromByteArrayLE( byteArray, 3604, 12);
    @CAN_RadarFL::RXX_Object::RXX_Object_Obj6_PxVnce = convertRawToPhysical(raw_value, 0.1, 0.0);

    raw_value=copyBitsFromByteArrayLE( byteArray, 3840, 12);
    @CAN_RadarFL::RXX_Object::RXX_Object_Obj6_PxVxCoVnce = convertRawToPhysical(raw_value, 0.01, 0.0);

    raw_value=copyBitsFromByteArrayLE( byteArray, 3852, 12);
    @CAN_RadarFL::RXX_Object::RXX_Object_Obj6_PxVyCoVnce = convertRawToPhysical(raw_value, 0.01, 0.0);

    raw_value=copyBitsFromByteArrayLE( byteArray, 3616, 12);
    @CAN_RadarFL::RXX_Object::RXX_Object_Obj6_Py = convertRawToPhysical(raw_value, 0.0625, -128.0);

    raw_value=copyBitsFromByteArrayLE( byteArray, 3936, 12);
    @CAN_RadarFL::RXX_Object::RXX_Object_Obj6_PyAxCoVnce = convertRawToPhysical(raw_value, 0.01, 0.0);

    raw_value=copyBitsFromByteArrayLE( byteArray, 3948, 12);
    @CAN_RadarFL::RXX_Object::RXX_Object_Obj6_PyAyCoVnce = convertRawToPhysical(raw_value, 0.01, 0.0);

    raw_value=copyBitsFromByteArrayLE( byteArray, 3628, 12);
    @CAN_RadarFL::RXX_Object::RXX_Object_Obj6_PyVnce = convertRawToPhysical(raw_value, 0.1, 0.0);

    raw_value=copyBitsFromByteArrayLE( byteArray, 3872, 12);
    @CAN_RadarFL::RXX_Object::RXX_Object_Obj6_PyVxCoVnce = convertRawToPhysical(raw_value, 0.01, 0.0);

    raw_value=copyBitsFromByteArrayLE( byteArray, 3884, 12);
    @CAN_RadarFL::RXX_Object::RXX_Object_Obj6_PyVyCoVnce = convertRawToPhysical(raw_value, 0.01, 0.0);

    raw_value=copyBitsFromByteArrayLE( byteArray, 3724, 10);
    @CAN_RadarFL::RXX_Object::RXX_Object_Obj6_RCS = convertRawToPhysical(raw_value, 0.2, -102.4);

    raw_value=copyBitsFromByteArrayLE( byteArray, 3896, 4);
    @CAN_RadarFL::RXX_Object::RXX_Object_Obj6_ReferencePoint = convertRawToPhysical(raw_value, 1.0, 0.0);

    raw_value=copyBitsFromByteArrayLE( byteArray, 3756, 12);
    @CAN_RadarFL::RXX_Object::RXX_Object_Obj6_Vx = convertRawToPhysical(raw_value, 0.0625, -128.0);

    raw_value=copyBitsFromByteArrayLE( byteArray, 3980, 12);
    @CAN_RadarFL::RXX_Object::RXX_Object_Obj6_VxAxCoVnce = convertRawToPhysical(raw_value, 0.01, 0.0);

    raw_value=copyBitsFromByteArrayLE( byteArray, 4000, 12);
    @CAN_RadarFL::RXX_Object::RXX_Object_Obj6_VxAyCoVnce = convertRawToPhysical(raw_value, 0.01, 0.0);

    raw_value=copyBitsFromByteArrayLE( byteArray, 3776, 12);
    @CAN_RadarFL::RXX_Object::RXX_Object_Obj6_VxVnce = convertRawToPhysical(raw_value, 0.01, 0.0);

    raw_value=copyBitsFromByteArrayLE( byteArray, 3968, 12);
    @CAN_RadarFL::RXX_Object::RXX_Object_Obj6_VxVyCoVnce = convertRawToPhysical(raw_value, 0.01, 0.0);

    raw_value=copyBitsFromByteArrayLE( byteArray, 3790, 10);
    @CAN_RadarFL::RXX_Object::RXX_Object_Obj6_Vy = convertRawToPhysical(raw_value, 0.125, -64.0);

    raw_value=copyBitsFromByteArrayLE( byteArray, 4012, 12);
    @CAN_RadarFL::RXX_Object::RXX_Object_Obj6_VyAxCoVnce = convertRawToPhysical(raw_value, 0.01, 0.0);

    raw_value=copyBitsFromByteArrayLE( byteArray, 4032, 12);
    @CAN_RadarFL::RXX_Object::RXX_Object_Obj6_VyAyCoVnce = convertRawToPhysical(raw_value, 0.01, 0.0);

    raw_value=copyBitsFromByteArrayLE( byteArray, 3808, 12);
    @CAN_RadarFL::RXX_Object::RXX_Object_Obj6_VyVnce = convertRawToPhysical(raw_value, 0.01, 0.0);

    raw_value=copyBitsFromByteArrayLE( byteArray, 3704, 7);
    @CAN_RadarFL::RXX_Object::RXX_Object_Obj6_Width = convertRawToPhysical(raw_value, 0.125, 0.0);

    raw_value=copyBitsFromByteArrayLE( byteArray, 3712, 12);
    @CAN_RadarFL::RXX_Object::RXX_Object_Obj6_WidthVnce = convertRawToPhysical(raw_value, 0.01, 0.0);

    raw_value=copyBitsFromByteArrayLE( byteArray, 4576, 32);
    @CAN_RadarFL::RXX_Object::RXX_Object_Obj7_Age = convertRawToPhysical(raw_value, 1.0, 0.0);

    raw_value=copyBitsFromByteArrayLE( byteArray, 4172, 10);
    @CAN_RadarFL::RXX_Object::RXX_Object_Obj7_Ax = convertRawToPhysical(raw_value, 0.03125, -16.0);

    raw_value=copyBitsFromByteArrayLE( byteArray, 4556, 12);
    @CAN_RadarFL::RXX_Object::RXX_Object_Obj7_AxAyCoVnce = convertRawToPhysical(raw_value, 0.01, 0.0);

    raw_value=copyBitsFromByteArrayLE( byteArray, 4192, 12);
    @CAN_RadarFL::RXX_Object::RXX_Object_Obj7_AxVnce = convertRawToPhysical(raw_value, 0.01, 0.0);

    raw_value=copyBitsFromByteArrayLE( byteArray, 4246, 9);
    @CAN_RadarFL::RXX_Object::RXX_Object_Obj7_Ay = convertRawToPhysical(raw_value, 0.0625, -16.0);

    raw_value=copyBitsFromByteArrayLE( byteArray, 4256, 12);
    @CAN_RadarFL::RXX_Object::RXX_Object_Obj7_AyVnce = convertRawToPhysical(raw_value, 0.01, 0.0);

    raw_value=copyBitsFromByteArrayLE( byteArray, 4312, 6);
    @CAN_RadarFL::RXX_Object::RXX_Object_Obj7_ExistProb = convertRawToPhysical(raw_value, 2.0, 0.0);

    raw_value=copyBitsFromByteArrayLE( byteArray, 4376, 8);
    @CAN_RadarFL::RXX_Object::RXX_Object_Obj7_FilterInformation = convertRawToPhysical(raw_value, 1.0, 0.0);

    raw_value=copyBitsFromByteArrayLE( byteArray, 4152, 7);
    @CAN_RadarFL::RXX_Object::RXX_Object_Obj7_Length = convertRawToPhysical(raw_value, 0.125, 0.0);

    raw_value=copyBitsFromByteArrayLE( byteArray, 4160, 12);
    @CAN_RadarFL::RXX_Object::RXX_Object_Obj7_LengthVnce = convertRawToPhysical(raw_value, 0.01, 0.0);

    raw_value=copyBitsFromByteArrayLE( byteArray, 4344, 3);
    @CAN_RadarFL::RXX_Object::RXX_Object_Obj7_MeasurementStatus = convertRawToPhysical(raw_value, 1.0, 0.0);

    raw_value=copyBitsFromByteArrayLE( byteArray, 4300, 2);
    @CAN_RadarFL::RXX_Object::RXX_Object_Obj7_MovingStatus = convertRawToPhysical(raw_value, 1.0, 0.0);

    raw_value=copyBitsFromByteArrayLE( byteArray, 4280, 7);
    @CAN_RadarFL::RXX_Object::RXX_Object_Obj7_ObjId = convertRawToPhysical(raw_value, 1.0, 0.0);

    raw_value=copyBitsFromByteArrayLE( byteArray, 4182, 9);
    @CAN_RadarFL::RXX_Object::RXX_Object_Obj7_OrientationYaw = convertRawToPhysical(raw_value, 0.0175, -4.48);

    raw_value=copyBitsFromByteArrayLE( byteArray, 4204, 12);
    @CAN_RadarFL::RXX_Object::RXX_Object_Obj7_OrientationYawVnce = convertRawToPhysical(raw_value, 0.0003, 0.0);

    raw_value=copyBitsFromByteArrayLE( byteArray, 4096, 6);
    @CAN_RadarFL::RXX_Object::RXX_Object_Obj7_ProbClassConfidence = convertRawToPhysical(raw_value, 2.0, 0.0);

    raw_value=copyBitsFromByteArrayLE( byteArray, 4347, 4);
    @CAN_RadarFL::RXX_Object::RXX_Object_Obj7_ProbClassType = convertRawToPhysical(raw_value, 1.0, 0.0);

    raw_value=copyBitsFromByteArrayLE( byteArray, 4102, 14);
    @CAN_RadarFL::RXX_Object::RXX_Object_Obj7_Px = convertRawToPhysical(raw_value, 0.0625, -512.0);

    raw_value=copyBitsFromByteArrayLE( byteArray, 4416, 12);
    @CAN_RadarFL::RXX_Object::RXX_Object_Obj7_PxAxCoVnce = convertRawToPhysical(raw_value, 0.01, 0.0);

    raw_value=copyBitsFromByteArrayLE( byteArray, 4428, 12);
    @CAN_RadarFL::RXX_Object::RXX_Object_Obj7_PxAyCoVnce = convertRawToPhysical(raw_value, 0.01, 0.0);

    raw_value=copyBitsFromByteArrayLE( byteArray, 4332, 12);
    @CAN_RadarFL::RXX_Object::RXX_Object_Obj7_PxPyCoVnce = convertRawToPhysical(raw_value, 0.01, 0.0);

    raw_value=copyBitsFromByteArrayLE( byteArray, 4116, 12);
    @CAN_RadarFL::RXX_Object::RXX_Object_Obj7_PxVnce = convertRawToPhysical(raw_value, 0.1, 0.0);

    raw_value=copyBitsFromByteArrayLE( byteArray, 4352, 12);
    @CAN_RadarFL::RXX_Object::RXX_Object_Obj7_PxVxCoVnce = convertRawToPhysical(raw_value, 0.01, 0.0);

    raw_value=copyBitsFromByteArrayLE( byteArray, 4364, 12);
    @CAN_RadarFL::RXX_Object::RXX_Object_Obj7_PxVyCoVnce = convertRawToPhysical(raw_value, 0.01, 0.0);

    raw_value=copyBitsFromByteArrayLE( byteArray, 4128, 12);
    @CAN_RadarFL::RXX_Object::RXX_Object_Obj7_Py = convertRawToPhysical(raw_value, 0.0625, -128.0);

    raw_value=copyBitsFromByteArrayLE( byteArray, 4448, 12);
    @CAN_RadarFL::RXX_Object::RXX_Object_Obj7_PyAxCoVnce = convertRawToPhysical(raw_value, 0.01, 0.0);

    raw_value=copyBitsFromByteArrayLE( byteArray, 4460, 12);
    @CAN_RadarFL::RXX_Object::RXX_Object_Obj7_PyAyCoVnce = convertRawToPhysical(raw_value, 0.01, 0.0);

    raw_value=copyBitsFromByteArrayLE( byteArray, 4140, 12);
    @CAN_RadarFL::RXX_Object::RXX_Object_Obj7_PyVnce = convertRawToPhysical(raw_value, 0.1, 0.0);

    raw_value=copyBitsFromByteArrayLE( byteArray, 4384, 12);
    @CAN_RadarFL::RXX_Object::RXX_Object_Obj7_PyVxCoVnce = convertRawToPhysical(raw_value, 0.01, 0.0);

    raw_value=copyBitsFromByteArrayLE( byteArray, 4396, 12);
    @CAN_RadarFL::RXX_Object::RXX_Object_Obj7_PyVyCoVnce = convertRawToPhysical(raw_value, 0.01, 0.0);

    raw_value=copyBitsFromByteArrayLE( byteArray, 4236, 10);
    @CAN_RadarFL::RXX_Object::RXX_Object_Obj7_RCS = convertRawToPhysical(raw_value, 0.2, -102.4);

    raw_value=copyBitsFromByteArrayLE( byteArray, 4408, 4);
    @CAN_RadarFL::RXX_Object::RXX_Object_Obj7_ReferencePoint = convertRawToPhysical(raw_value, 1.0, 0.0);

    raw_value=copyBitsFromByteArrayLE( byteArray, 4268, 12);
    @CAN_RadarFL::RXX_Object::RXX_Object_Obj7_Vx = convertRawToPhysical(raw_value, 0.0625, -128.0);

    raw_value=copyBitsFromByteArrayLE( byteArray, 4492, 12);
    @CAN_RadarFL::RXX_Object::RXX_Object_Obj7_VxAxCoVnce = convertRawToPhysical(raw_value, 0.01, 0.0);

    raw_value=copyBitsFromByteArrayLE( byteArray, 4512, 12);
    @CAN_RadarFL::RXX_Object::RXX_Object_Obj7_VxAyCoVnce = convertRawToPhysical(raw_value, 0.01, 0.0);

    raw_value=copyBitsFromByteArrayLE( byteArray, 4288, 12);
    @CAN_RadarFL::RXX_Object::RXX_Object_Obj7_VxVnce = convertRawToPhysical(raw_value, 0.01, 0.0);

    raw_value=copyBitsFromByteArrayLE( byteArray, 4480, 12);
    @CAN_RadarFL::RXX_Object::RXX_Object_Obj7_VxVyCoVnce = convertRawToPhysical(raw_value, 0.01, 0.0);

    raw_value=copyBitsFromByteArrayLE( byteArray, 4302, 10);
    @CAN_RadarFL::RXX_Object::RXX_Object_Obj7_Vy = convertRawToPhysical(raw_value, 0.125, -64.0);

    raw_value=copyBitsFromByteArrayLE( byteArray, 4524, 12);
    @CAN_RadarFL::RXX_Object::RXX_Object_Obj7_VyAxCoVnce = convertRawToPhysical(raw_value, 0.01, 0.0);

    raw_value=copyBitsFromByteArrayLE( byteArray, 4544, 12);
    @CAN_RadarFL::RXX_Object::RXX_Object_Obj7_VyAyCoVnce = convertRawToPhysical(raw_value, 0.01, 0.0);

    raw_value=copyBitsFromByteArrayLE( byteArray, 4320, 12);
    @CAN_RadarFL::RXX_Object::RXX_Object_Obj7_VyVnce = convertRawToPhysical(raw_value, 0.01, 0.0);

    raw_value=copyBitsFromByteArrayLE( byteArray, 4216, 7);
    @CAN_RadarFL::RXX_Object::RXX_Object_Obj7_Width = convertRawToPhysical(raw_value, 0.125, 0.0);

    raw_value=copyBitsFromByteArrayLE( byteArray, 4224, 12);
    @CAN_RadarFL::RXX_Object::RXX_Object_Obj7_WidthVnce = convertRawToPhysical(raw_value, 0.01, 0.0);

    raw_value=copyBitsFromByteArrayLE( byteArray, 5088, 32);
    @CAN_RadarFL::RXX_Object::RXX_Object_Obj8_Age = convertRawToPhysical(raw_value, 1.0, 0.0);

    raw_value=copyBitsFromByteArrayLE( byteArray, 4684, 10);
    @CAN_RadarFL::RXX_Object::RXX_Object_Obj8_Ax = convertRawToPhysical(raw_value, 0.03125, -16.0);

    raw_value=copyBitsFromByteArrayLE( byteArray, 5068, 12);
    @CAN_RadarFL::RXX_Object::RXX_Object_Obj8_AxAyCoVnce = convertRawToPhysical(raw_value, 0.01, 0.0);

    raw_value=copyBitsFromByteArrayLE( byteArray, 4704, 12);
    @CAN_RadarFL::RXX_Object::RXX_Object_Obj8_AxVnce = convertRawToPhysical(raw_value, 0.01, 0.0);

    raw_value=copyBitsFromByteArrayLE( byteArray, 4758, 9);
    @CAN_RadarFL::RXX_Object::RXX_Object_Obj8_Ay = convertRawToPhysical(raw_value, 0.0625, -16.0);

    raw_value=copyBitsFromByteArrayLE( byteArray, 4768, 12);
    @CAN_RadarFL::RXX_Object::RXX_Object_Obj8_AyVnce = convertRawToPhysical(raw_value, 0.01, 0.0);

    raw_value=copyBitsFromByteArrayLE( byteArray, 4824, 6);
    @CAN_RadarFL::RXX_Object::RXX_Object_Obj8_ExistProb = convertRawToPhysical(raw_value, 2.0, 0.0);

    raw_value=copyBitsFromByteArrayLE( byteArray, 4888, 8);
    @CAN_RadarFL::RXX_Object::RXX_Object_Obj8_FilterInformation = convertRawToPhysical(raw_value, 1.0, 0.0);

    raw_value=copyBitsFromByteArrayLE( byteArray, 4664, 7);
    @CAN_RadarFL::RXX_Object::RXX_Object_Obj8_Length = convertRawToPhysical(raw_value, 0.125, 0.0);

    raw_value=copyBitsFromByteArrayLE( byteArray, 4672, 12);
    @CAN_RadarFL::RXX_Object::RXX_Object_Obj8_LengthVnce = convertRawToPhysical(raw_value, 0.01, 0.0);

    raw_value=copyBitsFromByteArrayLE( byteArray, 4856, 3);
    @CAN_RadarFL::RXX_Object::RXX_Object_Obj8_MeasurementStatus = convertRawToPhysical(raw_value, 1.0, 0.0);

    raw_value=copyBitsFromByteArrayLE( byteArray, 4812, 2);
    @CAN_RadarFL::RXX_Object::RXX_Object_Obj8_MovingStatus = convertRawToPhysical(raw_value, 1.0, 0.0);

    raw_value=copyBitsFromByteArrayLE( byteArray, 4792, 7);
    @CAN_RadarFL::RXX_Object::RXX_Object_Obj8_ObjId = convertRawToPhysical(raw_value, 1.0, 0.0);

    raw_value=copyBitsFromByteArrayLE( byteArray, 4694, 9);
    @CAN_RadarFL::RXX_Object::RXX_Object_Obj8_OrientationYaw = convertRawToPhysical(raw_value, 0.0175, -4.48);

    raw_value=copyBitsFromByteArrayLE( byteArray, 4716, 12);
    @CAN_RadarFL::RXX_Object::RXX_Object_Obj8_OrientationYawVnce = convertRawToPhysical(raw_value, 0.0003, 0.0);

    raw_value=copyBitsFromByteArrayLE( byteArray, 4608, 6);
    @CAN_RadarFL::RXX_Object::RXX_Object_Obj8_ProbClassConfidence = convertRawToPhysical(raw_value, 2.0, 0.0);

    raw_value=copyBitsFromByteArrayLE( byteArray, 4859, 4);
    @CAN_RadarFL::RXX_Object::RXX_Object_Obj8_ProbClassType = convertRawToPhysical(raw_value, 1.0, 0.0);

    raw_value=copyBitsFromByteArrayLE( byteArray, 4614, 14);
    @CAN_RadarFL::RXX_Object::RXX_Object_Obj8_Px = convertRawToPhysical(raw_value, 0.0625, -512.0);

    raw_value=copyBitsFromByteArrayLE( byteArray, 4928, 12);
    @CAN_RadarFL::RXX_Object::RXX_Object_Obj8_PxAxCoVnce = convertRawToPhysical(raw_value, 0.01, 0.0);

    raw_value=copyBitsFromByteArrayLE( byteArray, 4940, 12);
    @CAN_RadarFL::RXX_Object::RXX_Object_Obj8_PxAyCoVnce = convertRawToPhysical(raw_value, 0.01, 0.0);

    raw_value=copyBitsFromByteArrayLE( byteArray, 4844, 12);
    @CAN_RadarFL::RXX_Object::RXX_Object_Obj8_PxPyCoVnce = convertRawToPhysical(raw_value, 0.01, 0.0);

    raw_value=copyBitsFromByteArrayLE( byteArray, 4628, 12);
    @CAN_RadarFL::RXX_Object::RXX_Object_Obj8_PxVnce = convertRawToPhysical(raw_value, 0.1, 0.0);

    raw_value=copyBitsFromByteArrayLE( byteArray, 4864, 12);
    @CAN_RadarFL::RXX_Object::RXX_Object_Obj8_PxVxCoVnce = convertRawToPhysical(raw_value, 0.01, 0.0);

    raw_value=copyBitsFromByteArrayLE( byteArray, 4876, 12);
    @CAN_RadarFL::RXX_Object::RXX_Object_Obj8_PxVyCoVnce = convertRawToPhysical(raw_value, 0.01, 0.0);

    raw_value=copyBitsFromByteArrayLE( byteArray, 4640, 12);
    @CAN_RadarFL::RXX_Object::RXX_Object_Obj8_Py = convertRawToPhysical(raw_value, 0.0625, -128.0);

    raw_value=copyBitsFromByteArrayLE( byteArray, 4960, 12);
    @CAN_RadarFL::RXX_Object::RXX_Object_Obj8_PyAxCoVnce = convertRawToPhysical(raw_value, 0.01, 0.0);

    raw_value=copyBitsFromByteArrayLE( byteArray, 4972, 12);
    @CAN_RadarFL::RXX_Object::RXX_Object_Obj8_PyAyCoVnce = convertRawToPhysical(raw_value, 0.01, 0.0);

    raw_value=copyBitsFromByteArrayLE( byteArray, 4652, 12);
    @CAN_RadarFL::RXX_Object::RXX_Object_Obj8_PyVnce = convertRawToPhysical(raw_value, 0.1, 0.0);

    raw_value=copyBitsFromByteArrayLE( byteArray, 4896, 12);
    @CAN_RadarFL::RXX_Object::RXX_Object_Obj8_PyVxCoVnce = convertRawToPhysical(raw_value, 0.01, 0.0);

    raw_value=copyBitsFromByteArrayLE( byteArray, 4908, 12);
    @CAN_RadarFL::RXX_Object::RXX_Object_Obj8_PyVyCoVnce = convertRawToPhysical(raw_value, 0.01, 0.0);

    raw_value=copyBitsFromByteArrayLE( byteArray, 4748, 10);
    @CAN_RadarFL::RXX_Object::RXX_Object_Obj8_RCS = convertRawToPhysical(raw_value, 0.2, -102.4);

    raw_value=copyBitsFromByteArrayLE( byteArray, 4920, 4);
    @CAN_RadarFL::RXX_Object::RXX_Object_Obj8_ReferencePoint = convertRawToPhysical(raw_value, 1.0, 0.0);

    raw_value=copyBitsFromByteArrayLE( byteArray, 4780, 12);
    @CAN_RadarFL::RXX_Object::RXX_Object_Obj8_Vx = convertRawToPhysical(raw_value, 0.0625, -128.0);

    raw_value=copyBitsFromByteArrayLE( byteArray, 5004, 12);
    @CAN_RadarFL::RXX_Object::RXX_Object_Obj8_VxAxCoVnce = convertRawToPhysical(raw_value, 0.01, 0.0);

    raw_value=copyBitsFromByteArrayLE( byteArray, 5024, 12);
    @CAN_RadarFL::RXX_Object::RXX_Object_Obj8_VxAyCoVnce = convertRawToPhysical(raw_value, 0.01, 0.0);

    raw_value=copyBitsFromByteArrayLE( byteArray, 4800, 12);
    @CAN_RadarFL::RXX_Object::RXX_Object_Obj8_VxVnce = convertRawToPhysical(raw_value, 0.01, 0.0);

    raw_value=copyBitsFromByteArrayLE( byteArray, 4992, 12);
    @CAN_RadarFL::RXX_Object::RXX_Object_Obj8_VxVyCoVnce = convertRawToPhysical(raw_value, 0.01, 0.0);

    raw_value=copyBitsFromByteArrayLE( byteArray, 4814, 10);
    @CAN_RadarFL::RXX_Object::RXX_Object_Obj8_Vy = convertRawToPhysical(raw_value, 0.125, -64.0);

    raw_value=copyBitsFromByteArrayLE( byteArray, 5036, 12);
    @CAN_RadarFL::RXX_Object::RXX_Object_Obj8_VyAxCoVnce = convertRawToPhysical(raw_value, 0.01, 0.0);

    raw_value=copyBitsFromByteArrayLE( byteArray, 5056, 12);
    @CAN_RadarFL::RXX_Object::RXX_Object_Obj8_VyAyCoVnce = convertRawToPhysical(raw_value, 0.01, 0.0);

    raw_value=copyBitsFromByteArrayLE( byteArray, 4832, 12);
    @CAN_RadarFL::RXX_Object::RXX_Object_Obj8_VyVnce = convertRawToPhysical(raw_value, 0.01, 0.0);

    raw_value=copyBitsFromByteArrayLE( byteArray, 4728, 7);
    @CAN_RadarFL::RXX_Object::RXX_Object_Obj8_Width = convertRawToPhysical(raw_value, 0.125, 0.0);

    raw_value=copyBitsFromByteArrayLE( byteArray, 4736, 12);
    @CAN_RadarFL::RXX_Object::RXX_Object_Obj8_WidthVnce = convertRawToPhysical(raw_value, 0.01, 0.0);

    raw_value=copyBitsFromByteArrayLE( byteArray, 5600, 32);
    @CAN_RadarFL::RXX_Object::RXX_Object_Obj9_Age = convertRawToPhysical(raw_value, 1.0, 0.0);

    raw_value=copyBitsFromByteArrayLE( byteArray, 5196, 10);
    @CAN_RadarFL::RXX_Object::RXX_Object_Obj9_Ax = convertRawToPhysical(raw_value, 0.03125, -16.0);

    raw_value=copyBitsFromByteArrayLE( byteArray, 5580, 12);
    @CAN_RadarFL::RXX_Object::RXX_Object_Obj9_AxAyCoVnce = convertRawToPhysical(raw_value, 0.01, 0.0);

    raw_value=copyBitsFromByteArrayLE( byteArray, 5216, 12);
    @CAN_RadarFL::RXX_Object::RXX_Object_Obj9_AxVnce = convertRawToPhysical(raw_value, 0.01, 0.0);

    raw_value=copyBitsFromByteArrayLE( byteArray, 5270, 9);
    @CAN_RadarFL::RXX_Object::RXX_Object_Obj9_Ay = convertRawToPhysical(raw_value, 0.0625, -16.0);

    raw_value=copyBitsFromByteArrayLE( byteArray, 5280, 12);
    @CAN_RadarFL::RXX_Object::RXX_Object_Obj9_AyVnce = convertRawToPhysical(raw_value, 0.01, 0.0);

    raw_value=copyBitsFromByteArrayLE( byteArray, 5336, 6);
    @CAN_RadarFL::RXX_Object::RXX_Object_Obj9_ExistProb = convertRawToPhysical(raw_value, 2.0, 0.0);

    raw_value=copyBitsFromByteArrayLE( byteArray, 5400, 8);
    @CAN_RadarFL::RXX_Object::RXX_Object_Obj9_FilterInformation = convertRawToPhysical(raw_value, 1.0, 0.0);

    raw_value=copyBitsFromByteArrayLE( byteArray, 5176, 7);
    @CAN_RadarFL::RXX_Object::RXX_Object_Obj9_Length = convertRawToPhysical(raw_value, 0.125, 0.0);

    raw_value=copyBitsFromByteArrayLE( byteArray, 5184, 12);
    @CAN_RadarFL::RXX_Object::RXX_Object_Obj9_LengthVnce = convertRawToPhysical(raw_value, 0.01, 0.0);

    raw_value=copyBitsFromByteArrayLE( byteArray, 5368, 3);
    @CAN_RadarFL::RXX_Object::RXX_Object_Obj9_MeasurementStatus = convertRawToPhysical(raw_value, 1.0, 0.0);

    raw_value=copyBitsFromByteArrayLE( byteArray, 5324, 2);
    @CAN_RadarFL::RXX_Object::RXX_Object_Obj9_MovingStatus = convertRawToPhysical(raw_value, 1.0, 0.0);

    raw_value=copyBitsFromByteArrayLE( byteArray, 5304, 7);
    @CAN_RadarFL::RXX_Object::RXX_Object_Obj9_ObjId = convertRawToPhysical(raw_value, 1.0, 0.0);

    raw_value=copyBitsFromByteArrayLE( byteArray, 5206, 9);
    @CAN_RadarFL::RXX_Object::RXX_Object_Obj9_OrientationYaw = convertRawToPhysical(raw_value, 0.0175, -4.48);

    raw_value=copyBitsFromByteArrayLE( byteArray, 5228, 12);
    @CAN_RadarFL::RXX_Object::RXX_Object_Obj9_OrientationYawVnce = convertRawToPhysical(raw_value, 0.0003, 0.0);

    raw_value=copyBitsFromByteArrayLE( byteArray, 5120, 6);
    @CAN_RadarFL::RXX_Object::RXX_Object_Obj9_ProbClassConfidence = convertRawToPhysical(raw_value, 2.0, 0.0);

    raw_value=copyBitsFromByteArrayLE( byteArray, 5371, 4);
    @CAN_RadarFL::RXX_Object::RXX_Object_Obj9_ProbClassType = convertRawToPhysical(raw_value, 1.0, 0.0);

    raw_value=copyBitsFromByteArrayLE( byteArray, 5126, 14);
    @CAN_RadarFL::RXX_Object::RXX_Object_Obj9_Px = convertRawToPhysical(raw_value, 0.0625, -512.0);

    raw_value=copyBitsFromByteArrayLE( byteArray, 5440, 12);
    @CAN_RadarFL::RXX_Object::RXX_Object_Obj9_PxAxCoVnce = convertRawToPhysical(raw_value, 0.01, 0.0);

    raw_value=copyBitsFromByteArrayLE( byteArray, 5452, 12);
    @CAN_RadarFL::RXX_Object::RXX_Object_Obj9_PxAyCoVnce = convertRawToPhysical(raw_value, 0.01, 0.0);

    raw_value=copyBitsFromByteArrayLE( byteArray, 5356, 12);
    @CAN_RadarFL::RXX_Object::RXX_Object_Obj9_PxPyCoVnce = convertRawToPhysical(raw_value, 0.01, 0.0);

    raw_value=copyBitsFromByteArrayLE( byteArray, 5140, 12);
    @CAN_RadarFL::RXX_Object::RXX_Object_Obj9_PxVnce = convertRawToPhysical(raw_value, 0.1, 0.0);

    raw_value=copyBitsFromByteArrayLE( byteArray, 5376, 12);
    @CAN_RadarFL::RXX_Object::RXX_Object_Obj9_PxVxCoVnce = convertRawToPhysical(raw_value, 0.01, 0.0);

    raw_value=copyBitsFromByteArrayLE( byteArray, 5388, 12);
    @CAN_RadarFL::RXX_Object::RXX_Object_Obj9_PxVyCoVnce = convertRawToPhysical(raw_value, 0.01, 0.0);

    raw_value=copyBitsFromByteArrayLE( byteArray, 5152, 12);
    @CAN_RadarFL::RXX_Object::RXX_Object_Obj9_Py = convertRawToPhysical(raw_value, 0.0625, -128.0);

    raw_value=copyBitsFromByteArrayLE( byteArray, 5472, 12);
    @CAN_RadarFL::RXX_Object::RXX_Object_Obj9_PyAxCoVnce = convertRawToPhysical(raw_value, 0.01, 0.0);

    raw_value=copyBitsFromByteArrayLE( byteArray, 5484, 12);
    @CAN_RadarFL::RXX_Object::RXX_Object_Obj9_PyAyCoVnce = convertRawToPhysical(raw_value, 0.01, 0.0);

    raw_value=copyBitsFromByteArrayLE( byteArray, 5164, 12);
    @CAN_RadarFL::RXX_Object::RXX_Object_Obj9_PyVnce = convertRawToPhysical(raw_value, 0.1, 0.0);

    raw_value=copyBitsFromByteArrayLE( byteArray, 5408, 12);
    @CAN_RadarFL::RXX_Object::RXX_Object_Obj9_PyVxCoVnce = convertRawToPhysical(raw_value, 0.01, 0.0);

    raw_value=copyBitsFromByteArrayLE( byteArray, 5420, 12);
    @CAN_RadarFL::RXX_Object::RXX_Object_Obj9_PyVyCoVnce = convertRawToPhysical(raw_value, 0.01, 0.0);

    raw_value=copyBitsFromByteArrayLE( byteArray, 5260, 10);
    @CAN_RadarFL::RXX_Object::RXX_Object_Obj9_RCS = convertRawToPhysical(raw_value, 0.2, -102.4);

    raw_value=copyBitsFromByteArrayLE( byteArray, 5432, 4);
    @CAN_RadarFL::RXX_Object::RXX_Object_Obj9_ReferencePoint = convertRawToPhysical(raw_value, 1.0, 0.0);

    raw_value=copyBitsFromByteArrayLE( byteArray, 5292, 12);
    @CAN_RadarFL::RXX_Object::RXX_Object_Obj9_Vx = convertRawToPhysical(raw_value, 0.0625, -128.0);

    raw_value=copyBitsFromByteArrayLE( byteArray, 5516, 12);
    @CAN_RadarFL::RXX_Object::RXX_Object_Obj9_VxAxCoVnce = convertRawToPhysical(raw_value, 0.01, 0.0);

    raw_value=copyBitsFromByteArrayLE( byteArray, 5536, 12);
    @CAN_RadarFL::RXX_Object::RXX_Object_Obj9_VxAyCoVnce = convertRawToPhysical(raw_value, 0.01, 0.0);

    raw_value=copyBitsFromByteArrayLE( byteArray, 5312, 12);
    @CAN_RadarFL::RXX_Object::RXX_Object_Obj9_VxVnce = convertRawToPhysical(raw_value, 0.01, 0.0);

    raw_value=copyBitsFromByteArrayLE( byteArray, 5504, 12);
    @CAN_RadarFL::RXX_Object::RXX_Object_Obj9_VxVyCoVnce = convertRawToPhysical(raw_value, 0.01, 0.0);

    raw_value=copyBitsFromByteArrayLE( byteArray, 5326, 10);
    @CAN_RadarFL::RXX_Object::RXX_Object_Obj9_Vy = convertRawToPhysical(raw_value, 0.125, -64.0);

    raw_value=copyBitsFromByteArrayLE( byteArray, 5548, 12);
    @CAN_RadarFL::RXX_Object::RXX_Object_Obj9_VyAxCoVnce = convertRawToPhysical(raw_value, 0.01, 0.0);

    raw_value=copyBitsFromByteArrayLE( byteArray, 5568, 12);
    @CAN_RadarFL::RXX_Object::RXX_Object_Obj9_VyAyCoVnce = convertRawToPhysical(raw_value, 0.01, 0.0);

    raw_value=copyBitsFromByteArrayLE( byteArray, 5344, 12);
    @CAN_RadarFL::RXX_Object::RXX_Object_Obj9_VyVnce = convertRawToPhysical(raw_value, 0.01, 0.0);

    raw_value=copyBitsFromByteArrayLE( byteArray, 5240, 7);
    @CAN_RadarFL::RXX_Object::RXX_Object_Obj9_Width = convertRawToPhysical(raw_value, 0.125, 0.0);

    raw_value=copyBitsFromByteArrayLE( byteArray, 5248, 12);
    @CAN_RadarFL::RXX_Object::RXX_Object_Obj9_WidthVnce = convertRawToPhysical(raw_value, 0.01, 0.0);

    raw_value=copyBitsFromByteArrayLE( byteArray, 82, 1);
    @CAN_RadarFL::RXX_Object::RXX_Object_ObjHdr_LocDownSel = convertRawToPhysical(raw_value, 1.0, 0.0);

    raw_value=copyBitsFromByteArrayLE( byteArray, 72, 10);
    @CAN_RadarFL::RXX_Object::RXX_Object_ObjHdr_NumValidObjects = convertRawToPhysical(raw_value, 1.0, 0.0);

    raw_value=copyBitsFromByteArrayLE( byteArray, 32, 32);
    @CAN_RadarFL::RXX_Object::RXX_Object_ObjHdr_TimeStamp = convertRawToPhysical(raw_value, 1.0, 0.0);

    raw_value=copyBitsFromByteArrayLE( byteArray, 64, 8);
    @CAN_RadarFL::RXX_Object::RXX_Object_ObjHdr_TimeStampStatus = convertRawToPhysical(raw_value, 1.0, 0.0);

    raw_value=copyBitsFromByteArrayLE( byteArray, 0, 8);
    @CAN_RadarFL::RXX_Object::RXX_Object_ObjHdr_VersionIdMajor = convertRawToPhysical(raw_value, 1.0, 0.0);

    raw_value=copyBitsFromByteArrayLE( byteArray, 8, 8);
    @CAN_RadarFL::RXX_Object::RXX_Object_ObjHdr_VersionIdMinor = convertRawToPhysical(raw_value, 1.0, 0.0);

    raw_value=copyBitsFromByteArrayLE( byteArray, 960, 2);
    @CAN_RadarFL::RXX_Object::RXX_Object_ShiiHdr_DataMeasured = convertRawToPhysical(raw_value, 1.0, 0.0);

    raw_value=copyBitsFromByteArrayLE( byteArray, 976, 8);
    @CAN_RadarFL::RXX_Object::RXX_Object_ShiiHdr_MisAzOOPCause = convertRawToPhysical(raw_value, 1.0, 0.0);

    raw_value=copyBitsFromByteArrayLE( byteArray, 984, 8);
    @CAN_RadarFL::RXX_Object::RXX_Object_ShiiHdr_MisElOOPCause = convertRawToPhysical(raw_value, 1.0, 0.0);

    raw_value=copyBitsFromByteArrayLE( byteArray, 968, 1);
    @CAN_RadarFL::RXX_Object::RXX_Object_ShiiHdr_SensorCalExtStat = convertRawToPhysical(raw_value, 1.0, 0.0);

    raw_value=copyBitsFromByteArrayLE( byteArray, 969, 1);
    @CAN_RadarFL::RXX_Object::RXX_Object_ShiiHdr_SensorCalIntStat = convertRawToPhysical(raw_value, 1.0, 0.0);

    raw_value=copyBitsFromByteArrayLE( byteArray, 972, 4);
    @CAN_RadarFL::RXX_Object::RXX_Object_ShiiHdr_SensorCalOnlStat = convertRawToPhysical(raw_value, 1.0, 0.0);

    raw_value=copyBitsFromByteArrayLE( byteArray, 992, 16);
    @CAN_RadarFL::RXX_Object::RXX_Object_ShiiHdr_SensorFailureReas = convertRawToPhysical(raw_value, 1.0, 0.0);

    raw_value=copyBitsFromByteArrayLE( byteArray, 970, 2);
    @CAN_RadarFL::RXX_Object::RXX_Object_ShiiHdr_SensorHeatingStatus = convertRawToPhysical(raw_value, 1.0, 0.0);

    raw_value=copyBitsFromByteArrayLE( byteArray, 1008, 8);
    @CAN_RadarFL::RXX_Object::RXX_Object_ShiiHdr_SensorOmmOpMode = convertRawToPhysical(raw_value, 1.0, 0.0);

    raw_value=copyBitsFromByteArrayLE( byteArray, 931, 6);
    @CAN_RadarFL::RXX_Object::RXX_Object_SpiHdr_BldFov_Confidence = convertRawToPhysical(raw_value, 2.0, 0.0);

    raw_value=copyBitsFromByteArrayLE( byteArray, 928, 3);
    @CAN_RadarFL::RXX_Object::RXX_Object_SpiHdr_BldFov_Status = convertRawToPhysical(raw_value, 1.0, 0.0);

    raw_value=copyBitsFromByteArrayLE( byteArray, 208, 16);
    @CAN_RadarFL::RXX_Object::RXX_Object_SpiHdr_DistMaxProc = convertRawToPhysical(raw_value, 0.01, 0.0);

    raw_value=copyBitsFromByteArrayLE( byteArray, 192, 16);
    @CAN_RadarFL::RXX_Object::RXX_Object_SpiHdr_DistMeasMaxMod = convertRawToPhysical(raw_value, 0.01, 0.0);

    raw_value=copyBitsFromByteArrayLE( byteArray, 171, 10);
    @CAN_RadarFL::RXX_Object::RXX_Object_SpiHdr_DistMeasMinMod = convertRawToPhysical(raw_value, 0.01, 0.0);

    raw_value=copyBitsFromByteArrayLE( byteArray, 144, 13);
    @CAN_RadarFL::RXX_Object::RXX_Object_SpiHdr_DistPrec = convertRawToPhysical(raw_value, 0.0001, 0.0);

    raw_value=copyBitsFromByteArrayLE( byteArray, 115, 10);
    @CAN_RadarFL::RXX_Object::RXX_Object_SpiHdr_DistSep = convertRawToPhysical(raw_value, 0.01, 0.0);

    raw_value=copyBitsFromByteArrayLE( byteArray, 128, 16);
    @CAN_RadarFL::RXX_Object::RXX_Object_SpiHdr_DistStartProcDegraded = convertRawToPhysical(raw_value, 0.01, 0.0);

    raw_value=copyBitsFromByteArrayLE( byteArray, 96, 6);
    @CAN_RadarFL::RXX_Object::RXX_Object_SpiHdr_DmpId = convertRawToPhysical(raw_value, 1.0, 0.0);

    raw_value=copyBitsFromByteArrayLE( byteArray, 656, 10);
    @CAN_RadarFL::RXX_Object::RXX_Object_SpiHdr_FovRtrAzDetRng00 = convertRawToPhysical(raw_value, 1.0, 0.0);

    raw_value=copyBitsFromByteArrayLE( byteArray, 672, 10);
    @CAN_RadarFL::RXX_Object::RXX_Object_SpiHdr_FovRtrAzDetRng01 = convertRawToPhysical(raw_value, 1.0, 0.0);

    raw_value=copyBitsFromByteArrayLE( byteArray, 682, 10);
    @CAN_RadarFL::RXX_Object::RXX_Object_SpiHdr_FovRtrAzDetRng02 = convertRawToPhysical(raw_value, 1.0, 0.0);

    raw_value=copyBitsFromByteArrayLE( byteArray, 692, 10);
    @CAN_RadarFL::RXX_Object::RXX_Object_SpiHdr_FovRtrAzDetRng03 = convertRawToPhysical(raw_value, 1.0, 0.0);

    raw_value=copyBitsFromByteArrayLE( byteArray, 704, 10);
    @CAN_RadarFL::RXX_Object::RXX_Object_SpiHdr_FovRtrAzDetRng04 = convertRawToPhysical(raw_value, 1.0, 0.0);

    raw_value=copyBitsFromByteArrayLE( byteArray, 714, 10);
    @CAN_RadarFL::RXX_Object::RXX_Object_SpiHdr_FovRtrAzDetRng05 = convertRawToPhysical(raw_value, 1.0, 0.0);

    raw_value=copyBitsFromByteArrayLE( byteArray, 724, 10);
    @CAN_RadarFL::RXX_Object::RXX_Object_SpiHdr_FovRtrAzDetRng06 = convertRawToPhysical(raw_value, 1.0, 0.0);

    raw_value=copyBitsFromByteArrayLE( byteArray, 736, 10);
    @CAN_RadarFL::RXX_Object::RXX_Object_SpiHdr_FovRtrAzDetRng07 = convertRawToPhysical(raw_value, 1.0, 0.0);

    raw_value=copyBitsFromByteArrayLE( byteArray, 746, 10);
    @CAN_RadarFL::RXX_Object::RXX_Object_SpiHdr_FovRtrAzDetRng08 = convertRawToPhysical(raw_value, 1.0, 0.0);

    raw_value=copyBitsFromByteArrayLE( byteArray, 756, 10);
    @CAN_RadarFL::RXX_Object::RXX_Object_SpiHdr_FovRtrAzDetRng09 = convertRawToPhysical(raw_value, 1.0, 0.0);

    raw_value=copyBitsFromByteArrayLE( byteArray, 768, 10);
    @CAN_RadarFL::RXX_Object::RXX_Object_SpiHdr_FovRtrAzDetRng10 = convertRawToPhysical(raw_value, 1.0, 0.0);

    raw_value=copyBitsFromByteArrayLE( byteArray, 778, 10);
    @CAN_RadarFL::RXX_Object::RXX_Object_SpiHdr_FovRtrAzDetRng11 = convertRawToPhysical(raw_value, 1.0, 0.0);

    raw_value=copyBitsFromByteArrayLE( byteArray, 788, 10);
    @CAN_RadarFL::RXX_Object::RXX_Object_SpiHdr_FovRtrAzDetRng12 = convertRawToPhysical(raw_value, 1.0, 0.0);

    raw_value=copyBitsFromByteArrayLE( byteArray, 800, 10);
    @CAN_RadarFL::RXX_Object::RXX_Object_SpiHdr_FovRtrAzDetRng13 = convertRawToPhysical(raw_value, 1.0, 0.0);

    raw_value=copyBitsFromByteArrayLE( byteArray, 820, 10);
    @CAN_RadarFL::RXX_Object::RXX_Object_SpiHdr_FovRtrAzDetRng14 = convertRawToPhysical(raw_value, 1.0, 0.0);

    raw_value=copyBitsFromByteArrayLE( byteArray, 810, 10);
    @CAN_RadarFL::RXX_Object::RXX_Object_SpiHdr_FovRtrAzDetRng15 = convertRawToPhysical(raw_value, 1.0, 0.0);

    raw_value=copyBitsFromByteArrayLE( byteArray, 832, 10);
    @CAN_RadarFL::RXX_Object::RXX_Object_SpiHdr_FovRtrAzDetRng16 = convertRawToPhysical(raw_value, 1.0, 0.0);

    raw_value=copyBitsFromByteArrayLE( byteArray, 842, 10);
    @CAN_RadarFL::RXX_Object::RXX_Object_SpiHdr_FovRtrAzDetRng17 = convertRawToPhysical(raw_value, 1.0, 0.0);

    raw_value=copyBitsFromByteArrayLE( byteArray, 852, 10);
    @CAN_RadarFL::RXX_Object::RXX_Object_SpiHdr_FovRtrAzDetRng18 = convertRawToPhysical(raw_value, 1.0, 0.0);

    raw_value=copyBitsFromByteArrayLE( byteArray, 864, 10);
    @CAN_RadarFL::RXX_Object::RXX_Object_SpiHdr_FovRtrAzDetRng19 = convertRawToPhysical(raw_value, 1.0, 0.0);

    raw_value=copyBitsFromByteArrayLE( byteArray, 874, 10);
    @CAN_RadarFL::RXX_Object::RXX_Object_SpiHdr_FovRtrAzDetRng20 = convertRawToPhysical(raw_value, 1.0, 0.0);

    raw_value=copyBitsFromByteArrayLE( byteArray, 884, 10);
    @CAN_RadarFL::RXX_Object::RXX_Object_SpiHdr_FovRtrAzDetRng21 = convertRawToPhysical(raw_value, 1.0, 0.0);

    raw_value=copyBitsFromByteArrayLE( byteArray, 896, 10);
    @CAN_RadarFL::RXX_Object::RXX_Object_SpiHdr_FovRtrAzDetRng22 = convertRawToPhysical(raw_value, 1.0, 0.0);

    raw_value=copyBitsFromByteArrayLE( byteArray, 906, 10);
    @CAN_RadarFL::RXX_Object::RXX_Object_SpiHdr_FovRtrAzDetRng23 = convertRawToPhysical(raw_value, 1.0, 0.0);

    raw_value=copyBitsFromByteArrayLE( byteArray, 916, 10);
    @CAN_RadarFL::RXX_Object::RXX_Object_SpiHdr_FovRtrAzDetRng24 = convertRawToPhysical(raw_value, 1.0, 0.0);

    raw_value=copyBitsFromByteArrayLE( byteArray, 455, 8);
    @CAN_RadarFL::RXX_Object::RXX_Object_SpiHdr_FovRtrAzSegBrdr00 = convertRawToPhysical(raw_value, 0.0175, -2.24);

    raw_value=copyBitsFromByteArrayLE( byteArray, 463, 8);
    @CAN_RadarFL::RXX_Object::RXX_Object_SpiHdr_FovRtrAzSegBrdr01 = convertRawToPhysical(raw_value, 0.0175, -2.24);

    raw_value=copyBitsFromByteArrayLE( byteArray, 471, 8);
    @CAN_RadarFL::RXX_Object::RXX_Object_SpiHdr_FovRtrAzSegBrdr02 = convertRawToPhysical(raw_value, 0.0175, -2.24);

    raw_value=copyBitsFromByteArrayLE( byteArray, 480, 8);
    @CAN_RadarFL::RXX_Object::RXX_Object_SpiHdr_FovRtrAzSegBrdr03 = convertRawToPhysical(raw_value, 0.0175, -2.24);

    raw_value=copyBitsFromByteArrayLE( byteArray, 488, 8);
    @CAN_RadarFL::RXX_Object::RXX_Object_SpiHdr_FovRtrAzSegBrdr04 = convertRawToPhysical(raw_value, 0.0175, -2.24);

    raw_value=copyBitsFromByteArrayLE( byteArray, 496, 8);
    @CAN_RadarFL::RXX_Object::RXX_Object_SpiHdr_FovRtrAzSegBrdr05 = convertRawToPhysical(raw_value, 0.0175, -2.24);

    raw_value=copyBitsFromByteArrayLE( byteArray, 504, 8);
    @CAN_RadarFL::RXX_Object::RXX_Object_SpiHdr_FovRtrAzSegBrdr06 = convertRawToPhysical(raw_value, 0.0175, -2.24);

    raw_value=copyBitsFromByteArrayLE( byteArray, 512, 8);
    @CAN_RadarFL::RXX_Object::RXX_Object_SpiHdr_FovRtrAzSegBrdr07 = convertRawToPhysical(raw_value, 0.0175, -2.24);

    raw_value=copyBitsFromByteArrayLE( byteArray, 520, 8);
    @CAN_RadarFL::RXX_Object::RXX_Object_SpiHdr_FovRtrAzSegBrdr08 = convertRawToPhysical(raw_value, 0.0175, -2.24);

    raw_value=copyBitsFromByteArrayLE( byteArray, 528, 8);
    @CAN_RadarFL::RXX_Object::RXX_Object_SpiHdr_FovRtrAzSegBrdr09 = convertRawToPhysical(raw_value, 0.0175, -2.24);

    raw_value=copyBitsFromByteArrayLE( byteArray, 544, 8);
    @CAN_RadarFL::RXX_Object::RXX_Object_SpiHdr_FovRtrAzSegBrdr10 = convertRawToPhysical(raw_value, 0.0175, -2.24);

    raw_value=copyBitsFromByteArrayLE( byteArray, 536, 8);
    @CAN_RadarFL::RXX_Object::RXX_Object_SpiHdr_FovRtrAzSegBrdr11 = convertRawToPhysical(raw_value, 0.0175, -2.24);

    raw_value=copyBitsFromByteArrayLE( byteArray, 552, 8);
    @CAN_RadarFL::RXX_Object::RXX_Object_SpiHdr_FovRtrAzSegBrdr12 = convertRawToPhysical(raw_value, 0.0175, -2.24);

    raw_value=copyBitsFromByteArrayLE( byteArray, 560, 8);
    @CAN_RadarFL::RXX_Object::RXX_Object_SpiHdr_FovRtrAzSegBrdr13 = convertRawToPhysical(raw_value, 0.0175, -2.24);

    raw_value=copyBitsFromByteArrayLE( byteArray, 568, 8);
    @CAN_RadarFL::RXX_Object::RXX_Object_SpiHdr_FovRtrAzSegBrdr14 = convertRawToPhysical(raw_value, 0.0175, -2.24);

    raw_value=copyBitsFromByteArrayLE( byteArray, 576, 8);
    @CAN_RadarFL::RXX_Object::RXX_Object_SpiHdr_FovRtrAzSegBrdr15 = convertRawToPhysical(raw_value, 0.0175, -2.24);

    raw_value=copyBitsFromByteArrayLE( byteArray, 584, 8);
    @CAN_RadarFL::RXX_Object::RXX_Object_SpiHdr_FovRtrAzSegBrdr16 = convertRawToPhysical(raw_value, 0.0175, -2.24);

    raw_value=copyBitsFromByteArrayLE( byteArray, 592, 8);
    @CAN_RadarFL::RXX_Object::RXX_Object_SpiHdr_FovRtrAzSegBrdr17 = convertRawToPhysical(raw_value, 0.0175, -2.24);

    raw_value=copyBitsFromByteArrayLE( byteArray, 600, 8);
    @CAN_RadarFL::RXX_Object::RXX_Object_SpiHdr_FovRtrAzSegBrdr18 = convertRawToPhysical(raw_value, 0.0175, -2.24);

    raw_value=copyBitsFromByteArrayLE( byteArray, 608, 8);
    @CAN_RadarFL::RXX_Object::RXX_Object_SpiHdr_FovRtrAzSegBrdr19 = convertRawToPhysical(raw_value, 0.0175, -2.24);

    raw_value=copyBitsFromByteArrayLE( byteArray, 616, 8);
    @CAN_RadarFL::RXX_Object::RXX_Object_SpiHdr_FovRtrAzSegBrdr20 = convertRawToPhysical(raw_value, 0.0175, -2.24);

    raw_value=copyBitsFromByteArrayLE( byteArray, 624, 8);
    @CAN_RadarFL::RXX_Object::RXX_Object_SpiHdr_FovRtrAzSegBrdr21 = convertRawToPhysical(raw_value, 0.0175, -2.24);

    raw_value=copyBitsFromByteArrayLE( byteArray, 632, 8);
    @CAN_RadarFL::RXX_Object::RXX_Object_SpiHdr_FovRtrAzSegBrdr22 = convertRawToPhysical(raw_value, 0.0175, -2.24);

    raw_value=copyBitsFromByteArrayLE( byteArray, 640, 8);
    @CAN_RadarFL::RXX_Object::RXX_Object_SpiHdr_FovRtrAzSegBrdr23 = convertRawToPhysical(raw_value, 0.0175, -2.24);

    raw_value=copyBitsFromByteArrayLE( byteArray, 648, 8);
    @CAN_RadarFL::RXX_Object::RXX_Object_SpiHdr_FovRtrAzSegBrdr24 = convertRawToPhysical(raw_value, 0.0175, -2.24);

    raw_value=copyBitsFromByteArrayLE( byteArray, 320, 7);
    @CAN_RadarFL::RXX_Object::RXX_Object_SpiHdr_FovRtrElRngGEnd00 = convertRawToPhysical(raw_value, 0.01, 0.0);

    raw_value=copyBitsFromByteArrayLE( byteArray, 327, 7);
    @CAN_RadarFL::RXX_Object::RXX_Object_SpiHdr_FovRtrElRngGEnd01 = convertRawToPhysical(raw_value, 0.01, 0.0);

    raw_value=copyBitsFromByteArrayLE( byteArray, 334, 7);
    @CAN_RadarFL::RXX_Object::RXX_Object_SpiHdr_FovRtrElRngGEnd02 = convertRawToPhysical(raw_value, 0.01, 0.0);

    raw_value=copyBitsFromByteArrayLE( byteArray, 341, 7);
    @CAN_RadarFL::RXX_Object::RXX_Object_SpiHdr_FovRtrElRngGEnd03 = convertRawToPhysical(raw_value, 0.01, 0.0);

    raw_value=copyBitsFromByteArrayLE( byteArray, 352, 7);
    @CAN_RadarFL::RXX_Object::RXX_Object_SpiHdr_FovRtrElRngGEnd04 = convertRawToPhysical(raw_value, 0.01, 0.0);

    raw_value=copyBitsFromByteArrayLE( byteArray, 359, 7);
    @CAN_RadarFL::RXX_Object::RXX_Object_SpiHdr_FovRtrElRngGEnd05 = convertRawToPhysical(raw_value, 0.01, 0.0);

    raw_value=copyBitsFromByteArrayLE( byteArray, 366, 7);
    @CAN_RadarFL::RXX_Object::RXX_Object_SpiHdr_FovRtrElRngGEnd06 = convertRawToPhysical(raw_value, 0.01, 0.0);

    raw_value=copyBitsFromByteArrayLE( byteArray, 373, 7);
    @CAN_RadarFL::RXX_Object::RXX_Object_SpiHdr_FovRtrElRngGEnd07 = convertRawToPhysical(raw_value, 0.01, 0.0);

    raw_value=copyBitsFromByteArrayLE( byteArray, 384, 7);
    @CAN_RadarFL::RXX_Object::RXX_Object_SpiHdr_FovRtrElRngGEnd08 = convertRawToPhysical(raw_value, 0.01, 0.0);

    raw_value=copyBitsFromByteArrayLE( byteArray, 391, 7);
    @CAN_RadarFL::RXX_Object::RXX_Object_SpiHdr_FovRtrElRngGEnd09 = convertRawToPhysical(raw_value, 0.01, 0.0);

    raw_value=copyBitsFromByteArrayLE( byteArray, 398, 7);
    @CAN_RadarFL::RXX_Object::RXX_Object_SpiHdr_FovRtrElRngGEnd10 = convertRawToPhysical(raw_value, 0.01, 0.0);

    raw_value=copyBitsFromByteArrayLE( byteArray, 235, 7);
    @CAN_RadarFL::RXX_Object::RXX_Object_SpiHdr_FovRtrElSegBrdr00 = convertRawToPhysical(raw_value, 0.0175, -1.12);

    raw_value=copyBitsFromByteArrayLE( byteArray, 242, 7);
    @CAN_RadarFL::RXX_Object::RXX_Object_SpiHdr_FovRtrElSegBrdr01 = convertRawToPhysical(raw_value, 0.0175, -1.12);

    raw_value=copyBitsFromByteArrayLE( byteArray, 249, 7);
    @CAN_RadarFL::RXX_Object::RXX_Object_SpiHdr_FovRtrElSegBrdr02 = convertRawToPhysical(raw_value, 0.0175, -1.12);

    raw_value=copyBitsFromByteArrayLE( byteArray, 256, 7);
    @CAN_RadarFL::RXX_Object::RXX_Object_SpiHdr_FovRtrElSegBrdr03 = convertRawToPhysical(raw_value, 0.0175, -1.12);

    raw_value=copyBitsFromByteArrayLE( byteArray, 263, 7);
    @CAN_RadarFL::RXX_Object::RXX_Object_SpiHdr_FovRtrElSegBrdr04 = convertRawToPhysical(raw_value, 0.0175, -1.12);

    raw_value=copyBitsFromByteArrayLE( byteArray, 270, 7);
    @CAN_RadarFL::RXX_Object::RXX_Object_SpiHdr_FovRtrElSegBrdr05 = convertRawToPhysical(raw_value, 0.0175, -1.12);

    raw_value=copyBitsFromByteArrayLE( byteArray, 277, 7);
    @CAN_RadarFL::RXX_Object::RXX_Object_SpiHdr_FovRtrElSegBrdr06 = convertRawToPhysical(raw_value, 0.0175, -1.12);

    raw_value=copyBitsFromByteArrayLE( byteArray, 288, 7);
    @CAN_RadarFL::RXX_Object::RXX_Object_SpiHdr_FovRtrElSegBrdr07 = convertRawToPhysical(raw_value, 0.0175, -1.12);

    raw_value=copyBitsFromByteArrayLE( byteArray, 295, 7);
    @CAN_RadarFL::RXX_Object::RXX_Object_SpiHdr_FovRtrElSegBrdr08 = convertRawToPhysical(raw_value, 0.0175, -1.12);

    raw_value=copyBitsFromByteArrayLE( byteArray, 302, 7);
    @CAN_RadarFL::RXX_Object::RXX_Object_SpiHdr_FovRtrElSegBrdr09 = convertRawToPhysical(raw_value, 0.0175, -1.12);

    raw_value=copyBitsFromByteArrayLE( byteArray, 309, 7);
    @CAN_RadarFL::RXX_Object::RXX_Object_SpiHdr_FovRtrElSegBrdr10 = convertRawToPhysical(raw_value, 0.0175, -1.12);

    raw_value=copyBitsFromByteArrayLE( byteArray, 102, 13);
    @CAN_RadarFL::RXX_Object::RXX_Object_SpiHdr_ModId = convertRawToPhysical(raw_value, 1.0, 0.0);

    raw_value=copyBitsFromByteArrayLE( byteArray, 448, 7);
    @CAN_RadarFL::RXX_Object::RXX_Object_SpiHdr_RngGainRfInterfere = convertRawToPhysical(raw_value, 1.0, 0.0);

    raw_value=copyBitsFromByteArrayLE( byteArray, 444, 3);
    @CAN_RadarFL::RXX_Object::RXX_Object_SpiHdr_SensorExtDisturbed = convertRawToPhysical(raw_value, 1.0, 0.0);

    raw_value=copyBitsFromByteArrayLE( byteArray, 432, 12);
    @CAN_RadarFL::RXX_Object::RXX_Object_SpiHdr_SensorOrientPitch = convertRawToPhysical(raw_value, 0.00017, -0.34816);

    raw_value=copyBitsFromByteArrayLE( byteArray, 416, 16);
    @CAN_RadarFL::RXX_Object::RXX_Object_SpiHdr_SensorOrientYaw = convertRawToPhysical(raw_value, 0.00017, -5.57056);

    raw_value=copyBitsFromByteArrayLE( byteArray, 447, 1);
    @CAN_RadarFL::RXX_Object::RXX_Object_SpiHdr_SensorOrientation = convertRawToPhysical(raw_value, 1.0, 0.0);

    raw_value=copyBitsFromByteArrayLE( byteArray, 937, 9);
    @CAN_RadarFL::RXX_Object::RXX_Object_SpiHdr_SensorOriginPointX = convertRawToPhysical(raw_value, 0.02, -5.12);

    raw_value=copyBitsFromByteArrayLE( byteArray, 946, 8);
    @CAN_RadarFL::RXX_Object::RXX_Object_SpiHdr_SensorOriginPointY = convertRawToPhysical(raw_value, 0.01, -1.28);

    raw_value=copyBitsFromByteArrayLE( byteArray, 954, 5);
    @CAN_RadarFL::RXX_Object::RXX_Object_SpiHdr_SensorOriginPointZ = convertRawToPhysical(raw_value, 0.05, 0.0);

    raw_value=copyBitsFromByteArrayLE( byteArray, 224, 11);
    @CAN_RadarFL::RXX_Object::RXX_Object_SpiHdr_VelMeasMax = convertRawToPhysical(raw_value, 0.1, 0.0);

    raw_value=copyBitsFromByteArrayLE( byteArray, 405, 11);
    @CAN_RadarFL::RXX_Object::RXX_Object_SpiHdr_VelMeasMin = convertRawToPhysical(raw_value, 0.1, -150.0);

    raw_value=copyBitsFromByteArrayLE( byteArray, 160, 11);
    @CAN_RadarFL::RXX_Object::RXX_Object_SpiHdr_VelPrec = convertRawToPhysical(raw_value, 0.0001, 0.0);

    raw_value=copyBitsFromByteArrayLE( byteArray, 181, 10);
    @CAN_RadarFL::RXX_Object::RXX_Object_SpiHdr_VelSep = convertRawToPhysical(raw_value, 0.01, 0.0);
}

on sysvar_update CAN_RadarFL_RXX_Object::Read_No_signals
{
  for (i=1;i<=@this;i++) //enable signal read;
   {
    snprintf(sysvarElementName, elcount(sysvarElementName), "RXX_Location_Loc%d.Read", i );
    sysSetVariableint(mSysVarNameSpace_CAN_RadarFL_RXX_Object,sysvarElementName, 1);
   }
  for (i=@this;i<=500;i++) //disable signal read;
   {
    snprintf(sysvarElementName, elcount(sysvarElementName),  "RXX_Location_Loc%d.Read", i );
    sysSetVariableInt(mSysVarNameSpace_CAN_RadarFL_RXX_Object, sysvarElementName, 0);
   }
}