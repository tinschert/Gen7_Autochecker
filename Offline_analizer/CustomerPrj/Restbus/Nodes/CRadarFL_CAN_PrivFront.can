/*@!Encoding:1252*/
/**
 * @file CRadarFL_CAN_PrivFront.can
 * @author ADAS_HIL_TEAM
 * @date 10-04-2022
 * @brief 
 *
 * ################################################################
 * C O P Y R I G H T S
 * ----------------------------------------------------------------
 * Copyright (c) 2022-2023 by Robert Bosch GmbH. All rights reserved.
 
 * The reproduction, distribution and utilization of this file as
 * well as the communication of its contents to others without express
 * authorization is prohibited. Offenders will be held liable for the
 * payment of damages. All rights reserved in the event of the grant
 * of a patent, utility model or design.
 *
 * ################################################################
*/

// Autogenerated by -> Platform\Classe\Scripts\Rbs_Scripts\create_nodes.py
includes
{
  #pragma library ("C:\ProgramData\Vector\AddOn Packages\Vector AddOn\vModules\CANoeILNLVector.vmodule")
  #include "CAPL\DataHandling.cin" /*DataHandling for IL*/
  #include "CAPL\E2E.cin" /*OD Specific for CRC calculation */
}

variables {
  message RFL_AEB_Request Msg_RFL_AEB_Request;
  message RFL_ObjHdr Msg_RFL_ObjHdr;
  message RFL_Obj00A Msg_RFL_Obj00A;
  message RFL_Obj00B Msg_RFL_Obj00B;
  message RFL_Obj01A Msg_RFL_Obj01A;
  message RFL_Obj01B Msg_RFL_Obj01B;
  message RFL_Obj02A Msg_RFL_Obj02A;
  message RFL_Obj02B Msg_RFL_Obj02B;
  message RFL_Obj03A Msg_RFL_Obj03A;
  message RFL_Obj03B Msg_RFL_Obj03B;
  message RFL_Obj04A Msg_RFL_Obj04A;
  message RFL_Obj04B Msg_RFL_Obj04B;
  message RFL_Obj05A Msg_RFL_Obj05A;
  message RFL_Obj05B Msg_RFL_Obj05B;
  message RFL_Obj06A Msg_RFL_Obj06A;
  message RFL_Obj06B Msg_RFL_Obj06B;
  message RFL_Obj07A Msg_RFL_Obj07A;
  message RFL_Obj07B Msg_RFL_Obj07B;
  message RFL_Obj08A Msg_RFL_Obj08A;
  message RFL_Obj08B Msg_RFL_Obj08B;
  message RFL_Obj09A Msg_RFL_Obj09A;
  message RFL_Obj09B Msg_RFL_Obj09B;
  message RFL_Status Msg_RFL_Status;

  word counter_RFL_AEB_Request_RFL_AEB_AC;
  word counter_RFL_ObjHdr_RFL_ObjHdr_AliveCtr;
  word counter_RFL_Obj00A_RFL_Obj00A_AliveCtr;
  word counter_RFL_Obj00B_RFL_Obj00B_AliveCtr;
  word counter_RFL_Obj01A_RFL_Obj01A_AliveCtr;
  word counter_RFL_Obj01B_RFL_Obj01B_AliveCtr;
  word counter_RFL_Obj02A_RFL_Obj02A_AliveCtr;
  word counter_RFL_Obj02B_RFL_Obj02B_AliveCtr;
  word counter_RFL_Obj03A_RFL_Obj03A_AliveCtr;
  word counter_RFL_Obj03B_RFL_Obj03B_AliveCtr;
  word counter_RFL_Obj04A_RFL_Obj04A_AliveCtr;
  word counter_RFL_Obj04B_RFL_Obj04B_AliveCtr;
  word counter_RFL_Obj05A_RFL_Obj05A_AliveCtr;
  word counter_RFL_Obj05B_RFL_Obj05B_AliveCtr;
  word counter_RFL_Obj06A_RFL_Obj06A_AliveCtr;
  word counter_RFL_Obj06B_RFL_Obj06B_AliveCtr;
  word counter_RFL_Obj07A_RFL_Obj07A_AliveCtr;
  word counter_RFL_Obj07B_RFL_Obj07B_AliveCtr;
  word counter_RFL_Obj08A_RFL_Obj08A_AliveCtr;
  word counter_RFL_Obj08B_RFL_Obj08B_AliveCtr;
  word counter_RFL_Obj09A_RFL_Obj09A_AliveCtr;
  word counter_RFL_Obj09B_RFL_Obj09B_AliveCtr;
  word counter_RFL_Status_RFL_Status_AliveCtr;

  dword bc_RFL_ObjHdr_RFL_ObjHdr_ProtBlockCtr;
  dword bc_RFL_Object_ProtBlockCtr;
  dword bc_RFL_Obj00A_RFL_Obj00A_ProtBlockCtr;
  dword bc_RFL_Obj00B_RFL_Obj00B_ProtBlockCtr;
  dword bc_RFL_Obj01A_RFL_Obj01A_ProtBlockCtr;
  dword bc_RFL_Obj01B_RFL_Obj01B_ProtBlockCtr;
  dword bc_RFL_Obj02A_RFL_Obj02A_ProtBlockCtr;
  dword bc_RFL_Obj02B_RFL_Obj02B_ProtBlockCtr;
  dword bc_RFL_Obj03A_RFL_Obj03A_ProtBlockCtr;
  dword bc_RFL_Obj03B_RFL_Obj03B_ProtBlockCtr;
  dword bc_RFL_Obj04A_RFL_Obj04A_ProtBlockCtr;
  dword bc_RFL_Obj04B_RFL_Obj04B_ProtBlockCtr;
  dword bc_RFL_Obj05A_RFL_Obj05A_ProtBlockCtr;
  dword bc_RFL_Obj05B_RFL_Obj05B_ProtBlockCtr;
  dword bc_RFL_Obj06A_RFL_Obj06A_ProtBlockCtr;
  dword bc_RFL_Obj06B_RFL_Obj06B_ProtBlockCtr;
  dword bc_RFL_Obj07A_RFL_Obj07A_ProtBlockCtr;
  dword bc_RFL_Obj07B_RFL_Obj07B_ProtBlockCtr;
  dword bc_RFL_Obj08A_RFL_Obj08A_ProtBlockCtr;
  dword bc_RFL_Obj08B_RFL_Obj08B_ProtBlockCtr;
  dword bc_RFL_Obj09A_RFL_Obj09A_ProtBlockCtr;
  dword bc_RFL_Obj09B_RFL_Obj09B_ProtBlockCtr;

  byte crc_RFL_AEB_Request_RFL_AEB_CRC;
  dword crc_RFL_ObjHdr_RFL_ObjHdr_CRC;
  dword crc_RFL_Obj00A_RFL_Obj00A_CRC;
  dword crc_RFL_Obj00B_RFL_Obj00B_CRC;
  dword crc_RFL_Obj01A_RFL_Obj01A_CRC;
  dword crc_RFL_Obj01B_RFL_Obj01B_CRC;
  dword crc_RFL_Obj02A_RFL_Obj02A_CRC;
  dword crc_RFL_Obj02B_RFL_Obj02B_CRC;
  dword crc_RFL_Obj03A_RFL_Obj03A_CRC;
  dword crc_RFL_Obj03B_RFL_Obj03B_CRC;
  dword crc_RFL_Obj04A_RFL_Obj04A_CRC;
  dword crc_RFL_Obj04B_RFL_Obj04B_CRC;
  dword crc_RFL_Obj05A_RFL_Obj05A_CRC;
  dword crc_RFL_Obj05B_RFL_Obj05B_CRC;
  dword crc_RFL_Obj06A_RFL_Obj06A_CRC;
  dword crc_RFL_Obj06B_RFL_Obj06B_CRC;
  dword crc_RFL_Obj07A_RFL_Obj07A_CRC;
  dword crc_RFL_Obj07B_RFL_Obj07B_CRC;
  dword crc_RFL_Obj08A_RFL_Obj08A_CRC;
  dword crc_RFL_Obj08B_RFL_Obj08B_CRC;
  dword crc_RFL_Obj09A_RFL_Obj09A_CRC;
  dword crc_RFL_Obj09B_RFL_Obj09B_CRC;
  byte crc_RFL_Status_RFL_Status_CRC;

}

on preStart {
  long result;
  result=ILControlInit ();//Initialization of CANoe IL,to prevent the IL autostart function.
  switch(result)
  {
    case  0   : write("ILControlInit :: CRadarFL :: No error."); break;
    case -1   : write("ILControlInit :: CRadarFL :: Momentary state of the IL does not permit this query."); break;
    case -50  : write("ILControlInit :: CRadarFL :: Nodelayer is inactive - possibly deactivated in the nodes configuration dialog.");  break;
   }

  CRadarFL_sim_Disable();
  CRadarFL_sim_SetCycleTimeOffset();
}

on start {

  ILControlSimulationOn();//Starts the simulation of the IL.
  CRadarFL_sim_SetCANFDParameter();
  ILControlStart ();//Cyclical sending starts; setting signals is now possible.
  CRadarFL_sim_Reset();
}

on stopMeasurement {

  CRadarFL_sim_DisableMsg();
  CRadarFL_sim_Disable();
  ILControlStop();//Cyclical sending is stopped; setting signals is now no longer possible.
  ILControlSimulationOff();//Stops the simulation of the IL. After that no other function to control the IL has an effect to the IL.

}

on sysvar_update hil_ctrl::radar_fl_sim
{
  CRadarFL_sim_Reset();
}

on sysvar_update hil_ctrl::variant
{
  CRadarFL_sim_Reset();
}

on sysvar_update Cus_bus::bus_CAN_PrivFront_ON_OFF
{
  CRadarFL_sim_Reset();
}

void CRadarFL_sim_Reset()
{

  CRadarFL_sim_DisableMsg();
  CRadarFL_sim_Disable();

  if ((@Cus_bus::bus_CAN_PrivFront_ON_OFF == 1) && (@hil_ctrl::radar_fl_sim == 1))
  {
    switch(@hil_ctrl::variant)
    {
      case a_variant:CRadarFL_sim_start_a_variant();break;
      case b_variant:CRadarFL_sim_start_b_variant();break;
    }
    if (@hil_ctrl::hil_mode == @hil_ctrl::hil_mode::Restbus) 
    {
       CRadarFL_sim_EnableEventMsg();
    }
    else
    {
       CRadarFL_sim_DisableEventMsg();
    }
  }
}

void CRadarFL_sim_start_a_variant()
{
  @CAN_PrivFront::RFL_Status::RFL_Status_ON_OFF = 1;
}

void CRadarFL_sim_start_b_variant()
{
  @CAN_PrivFront::RFL_Status::RFL_Status_ON_OFF = 1;
}

void CRadarFL_sim_Disable()
{
  @CAN_PrivFront::RFL_AEB_Request::RFL_AEB_Request_ON_OFF = 0;
  @CAN_PrivFront::RFL_ObjHdr::RFL_ObjHdr_ON_OFF = 0;
  @CAN_PrivFront::RFL_Obj00A::RFL_Obj00A_ON_OFF = 0;
  @CAN_PrivFront::RFL_Obj00B::RFL_Obj00B_ON_OFF = 0;
  @CAN_PrivFront::RFL_Obj01A::RFL_Obj01A_ON_OFF = 0;
  @CAN_PrivFront::RFL_Obj01B::RFL_Obj01B_ON_OFF = 0;
  @CAN_PrivFront::RFL_Obj02A::RFL_Obj02A_ON_OFF = 0;
  @CAN_PrivFront::RFL_Obj02B::RFL_Obj02B_ON_OFF = 0;
  @CAN_PrivFront::RFL_Obj03A::RFL_Obj03A_ON_OFF = 0;
  @CAN_PrivFront::RFL_Obj03B::RFL_Obj03B_ON_OFF = 0;
  @CAN_PrivFront::RFL_Obj04A::RFL_Obj04A_ON_OFF = 0;
  @CAN_PrivFront::RFL_Obj04B::RFL_Obj04B_ON_OFF = 0;
  @CAN_PrivFront::RFL_Obj05A::RFL_Obj05A_ON_OFF = 0;
  @CAN_PrivFront::RFL_Obj05B::RFL_Obj05B_ON_OFF = 0;
  @CAN_PrivFront::RFL_Obj06A::RFL_Obj06A_ON_OFF = 0;
  @CAN_PrivFront::RFL_Obj06B::RFL_Obj06B_ON_OFF = 0;
  @CAN_PrivFront::RFL_Obj07A::RFL_Obj07A_ON_OFF = 0;
  @CAN_PrivFront::RFL_Obj07B::RFL_Obj07B_ON_OFF = 0;
  @CAN_PrivFront::RFL_Obj08A::RFL_Obj08A_ON_OFF = 0;
  @CAN_PrivFront::RFL_Obj08B::RFL_Obj08B_ON_OFF = 0;
  @CAN_PrivFront::RFL_Obj09A::RFL_Obj09A_ON_OFF = 0;
  @CAN_PrivFront::RFL_Obj09B::RFL_Obj09B_ON_OFF = 0;
  @CAN_PrivFront::RFL_Status::RFL_Status_ON_OFF = 0;
}

void CRadarFL_sim_DisableMsg()
{
   ILFaultInjectionDisableMsg(RFL_AEB_Request);
   ILFaultInjectionDisableMsg(RFL_ObjHdr);
   ILFaultInjectionDisableMsg(RFL_Obj00A);
   ILFaultInjectionDisableMsg(RFL_Obj00B);
   ILFaultInjectionDisableMsg(RFL_Obj01A);
   ILFaultInjectionDisableMsg(RFL_Obj01B);
   ILFaultInjectionDisableMsg(RFL_Obj02A);
   ILFaultInjectionDisableMsg(RFL_Obj02B);
   ILFaultInjectionDisableMsg(RFL_Obj03A);
   ILFaultInjectionDisableMsg(RFL_Obj03B);
   ILFaultInjectionDisableMsg(RFL_Obj04A);
   ILFaultInjectionDisableMsg(RFL_Obj04B);
   ILFaultInjectionDisableMsg(RFL_Obj05A);
   ILFaultInjectionDisableMsg(RFL_Obj05B);
   ILFaultInjectionDisableMsg(RFL_Obj06A);
   ILFaultInjectionDisableMsg(RFL_Obj06B);
   ILFaultInjectionDisableMsg(RFL_Obj07A);
   ILFaultInjectionDisableMsg(RFL_Obj07B);
   ILFaultInjectionDisableMsg(RFL_Obj08A);
   ILFaultInjectionDisableMsg(RFL_Obj08B);
   ILFaultInjectionDisableMsg(RFL_Obj09A);
   ILFaultInjectionDisableMsg(RFL_Obj09B);
   ILFaultInjectionDisableMsg(RFL_Status);
}
on sysvar hil_ctrl::hil_mode
{
  CRadarFL_sim_Reset();
}

void CRadarFL_sim_DisableEventMsg()
{
   ILFaultInjectionDisableMsg(RFL_AEB_Request);
   ILFaultInjectionDisableMsg(RFL_ObjHdr);
   ILFaultInjectionDisableMsg(RFL_Obj00A);
   ILFaultInjectionDisableMsg(RFL_Obj00B);
   ILFaultInjectionDisableMsg(RFL_Obj01A);
   ILFaultInjectionDisableMsg(RFL_Obj01B);
   ILFaultInjectionDisableMsg(RFL_Obj02A);
   ILFaultInjectionDisableMsg(RFL_Obj02B);
   ILFaultInjectionDisableMsg(RFL_Obj03A);
   ILFaultInjectionDisableMsg(RFL_Obj03B);
   ILFaultInjectionDisableMsg(RFL_Obj04A);
   ILFaultInjectionDisableMsg(RFL_Obj04B);
   ILFaultInjectionDisableMsg(RFL_Obj05A);
   ILFaultInjectionDisableMsg(RFL_Obj05B);
   ILFaultInjectionDisableMsg(RFL_Obj06A);
   ILFaultInjectionDisableMsg(RFL_Obj06B);
   ILFaultInjectionDisableMsg(RFL_Obj07A);
   ILFaultInjectionDisableMsg(RFL_Obj07B);
   ILFaultInjectionDisableMsg(RFL_Obj08A);
   ILFaultInjectionDisableMsg(RFL_Obj08B);
   ILFaultInjectionDisableMsg(RFL_Obj09A);
   ILFaultInjectionDisableMsg(RFL_Obj09B);

}

void CRadarFL_sim_EnableEventMsg()
{
   ILFaultInjectionEnableMsg(RFL_AEB_Request);
   ILFaultInjectionEnableMsg(RFL_ObjHdr);
   ILFaultInjectionEnableMsg(RFL_Obj00A);
   ILFaultInjectionEnableMsg(RFL_Obj00B);
   ILFaultInjectionEnableMsg(RFL_Obj01A);
   ILFaultInjectionEnableMsg(RFL_Obj01B);
   ILFaultInjectionEnableMsg(RFL_Obj02A);
   ILFaultInjectionEnableMsg(RFL_Obj02B);
   ILFaultInjectionEnableMsg(RFL_Obj03A);
   ILFaultInjectionEnableMsg(RFL_Obj03B);
   ILFaultInjectionEnableMsg(RFL_Obj04A);
   ILFaultInjectionEnableMsg(RFL_Obj04B);
   ILFaultInjectionEnableMsg(RFL_Obj05A);
   ILFaultInjectionEnableMsg(RFL_Obj05B);
   ILFaultInjectionEnableMsg(RFL_Obj06A);
   ILFaultInjectionEnableMsg(RFL_Obj06B);
   ILFaultInjectionEnableMsg(RFL_Obj07A);
   ILFaultInjectionEnableMsg(RFL_Obj07B);
   ILFaultInjectionEnableMsg(RFL_Obj08A);
   ILFaultInjectionEnableMsg(RFL_Obj08B);
   ILFaultInjectionEnableMsg(RFL_Obj09A);
   ILFaultInjectionEnableMsg(RFL_Obj09B);

}
void CRadarFL_sim_SetCANParameter()
{
  //For future purpose
  //ILFaultInjectionSetMsgDlc(dbMsg msg, dword dlc)
  //ILFaultInjectionSetMsgLength(dbMsg msg, dword msgLength)
  //ILFaultInjectionResetMsgDlc(dbMsg msg)
  //ILFaultInjectionResetMsgLength (dbMsg msg)
}

void CRadarFL_sim_SetCANFDParameter()
{
   //CAN FD Parameter Setting
   int FDF =1;
   int BRS =1;
   ILSetCANFDParam(RFL_AEB_Request,FDF,BRS,RFL_AEB_Request.dlc);
   ILSetCANFDParam(RFL_ObjHdr,FDF,BRS,RFL_ObjHdr.dlc);
   ILSetCANFDParam(RFL_Obj00A,FDF,BRS,RFL_Obj00A.dlc);
   ILSetCANFDParam(RFL_Obj00B,FDF,BRS,RFL_Obj00B.dlc);
   ILSetCANFDParam(RFL_Obj01A,FDF,BRS,RFL_Obj01A.dlc);
   ILSetCANFDParam(RFL_Obj01B,FDF,BRS,RFL_Obj01B.dlc);
   ILSetCANFDParam(RFL_Obj02A,FDF,BRS,RFL_Obj02A.dlc);
   ILSetCANFDParam(RFL_Obj02B,FDF,BRS,RFL_Obj02B.dlc);
   ILSetCANFDParam(RFL_Obj03A,FDF,BRS,RFL_Obj03A.dlc);
   ILSetCANFDParam(RFL_Obj03B,FDF,BRS,RFL_Obj03B.dlc);
   ILSetCANFDParam(RFL_Obj04A,FDF,BRS,RFL_Obj04A.dlc);
   ILSetCANFDParam(RFL_Obj04B,FDF,BRS,RFL_Obj04B.dlc);
   ILSetCANFDParam(RFL_Obj05A,FDF,BRS,RFL_Obj05A.dlc);
   ILSetCANFDParam(RFL_Obj05B,FDF,BRS,RFL_Obj05B.dlc);
   ILSetCANFDParam(RFL_Obj06A,FDF,BRS,RFL_Obj06A.dlc);
   ILSetCANFDParam(RFL_Obj06B,FDF,BRS,RFL_Obj06B.dlc);
   ILSetCANFDParam(RFL_Obj07A,FDF,BRS,RFL_Obj07A.dlc);
   ILSetCANFDParam(RFL_Obj07B,FDF,BRS,RFL_Obj07B.dlc);
   ILSetCANFDParam(RFL_Obj08A,FDF,BRS,RFL_Obj08A.dlc);
   ILSetCANFDParam(RFL_Obj08B,FDF,BRS,RFL_Obj08B.dlc);
   ILSetCANFDParam(RFL_Obj09A,FDF,BRS,RFL_Obj09A.dlc);
   ILSetCANFDParam(RFL_Obj09B,FDF,BRS,RFL_Obj09B.dlc);
   ILSetCANFDParam(RFL_Status,FDF,BRS,RFL_Status.dlc);
}

dword applILTxPending (long aId, dword aDlc, byte data[])//This callback is being called before the IL sends a message to the bus
{
  switch(aId)
  {
    case RFL_AEB_Request.id:cfg_Msg_RFL_AEB_Request(aDlc, data);break;
    case RFL_ObjHdr.id:cfg_Msg_RFL_ObjHdr(aDlc, data);break;
    case RFL_Obj00A.id:cfg_Msg_RFL_Obj00A(aDlc, data);break;
    case RFL_Obj00B.id:cfg_Msg_RFL_Obj00B(aDlc, data);break;
    case RFL_Obj01A.id:cfg_Msg_RFL_Obj01A(aDlc, data);break;
    case RFL_Obj01B.id:cfg_Msg_RFL_Obj01B(aDlc, data);break;
    case RFL_Obj02A.id:cfg_Msg_RFL_Obj02A(aDlc, data);break;
    case RFL_Obj02B.id:cfg_Msg_RFL_Obj02B(aDlc, data);break;
    case RFL_Obj03A.id:cfg_Msg_RFL_Obj03A(aDlc, data);break;
    case RFL_Obj03B.id:cfg_Msg_RFL_Obj03B(aDlc, data);break;
    case RFL_Obj04A.id:cfg_Msg_RFL_Obj04A(aDlc, data);break;
    case RFL_Obj04B.id:cfg_Msg_RFL_Obj04B(aDlc, data);break;
    case RFL_Obj05A.id:cfg_Msg_RFL_Obj05A(aDlc, data);break;
    case RFL_Obj05B.id:cfg_Msg_RFL_Obj05B(aDlc, data);break;
    case RFL_Obj06A.id:cfg_Msg_RFL_Obj06A(aDlc, data);break;
    case RFL_Obj06B.id:cfg_Msg_RFL_Obj06B(aDlc, data);break;
    case RFL_Obj07A.id:cfg_Msg_RFL_Obj07A(aDlc, data);break;
    case RFL_Obj07B.id:cfg_Msg_RFL_Obj07B(aDlc, data);break;
    case RFL_Obj08A.id:cfg_Msg_RFL_Obj08A(aDlc, data);break;
    case RFL_Obj08B.id:cfg_Msg_RFL_Obj08B(aDlc, data);break;
    case RFL_Obj09A.id:cfg_Msg_RFL_Obj09A(aDlc, data);break;
    case RFL_Obj09B.id:cfg_Msg_RFL_Obj09B(aDlc, data);break;
    case RFL_Status.id:cfg_Msg_RFL_Status(aDlc, data);break;
    default :;//write("Node:CRadarFL ::No Cyclic event");
           break;
  }
  return 1; // don't prevent sending of the message
}

on sysvar CAN_PrivFront::RFL_AEB_Request::RFL_AEB_Request_ON_OFF
{
  if (@this == 1)
  {
     ILSetMsgEvent(RFL_AEB_Request);
     @CAN_PrivFront::RFL_AEB_Request::RFL_AEB_Request_ON_OFF = 0;
  }
}

void cfg_Msg_RFL_AEB_Request(dword aDlc, byte data[])
{
   int64 i,k;//For looping
   byte xor,data_byte;
   dword crcTemp;
   byte DataLength;
   dword Msg_id;
   
   DataLength = Msg_RFL_AEB_Request.DataLength;//Message Data Length
   Msg_id  = Msg_RFL_AEB_Request.id;//Message ID
   
    if (@CAN_PrivFront::RFL_AEB_Request::RFL_AEB_AC_FaultInject != 3)//AC: user defined value
    {

    clearBitsInByteArrayLE(data,8,4); //Intel / little-endian

    }
    if (@CAN_PrivFront::RFL_AEB_Request::RFL_AEB_AC_FaultInject == 0)//AC: No Error, calculate AC
    {
      ++counter_RFL_AEB_Request_RFL_AEB_AC;
      counter_RFL_AEB_Request_RFL_AEB_AC %=16;

      copyBitsToByteArrayLE(counter_RFL_AEB_Request_RFL_AEB_AC,data,8,4); //Intel / little-endian;
    }
    else if (@CAN_PrivFront::RFL_AEB_Request::RFL_AEB_AC_FaultInject == 1)//AC: Error sequence: set AC = 0
    {

      copyBitsToByteArrayLE(0,data,8,4); //Intel / little-endian;
    }
    else if (@CAN_PrivFront::RFL_AEB_Request::RFL_AEB_AC_FaultInject == 2)//AC: Error sequence: Freeze last valid value
    {

      copyBitsToByteArrayLE(counter_RFL_AEB_Request_RFL_AEB_AC,data,8,4); //Intel / little-endian;
    }
    if (@CAN_PrivFront::RFL_AEB_Request::RFL_AEB_CRC_FaultInject != 3)//CRC: user defined value
    {

    clearBitsInByteArrayLE(data,0,8); //Intel / little-endian

    }
    if(@CAN_PrivFront::RFL_AEB_Request::RFL_AEB_CRC_FaultInject == 0)//CRC: No Error, calculate CRC
    {
      xor = initialization_value;
      for(i = 0; i < DataLength; i++)
      {
        if(i==0)
          xor = CRC8_SAE_J1850_Poly_1D_Lookup[Data_ID_Lookup_PRIVATE(Msg_id) ^ xor];
        else
          xor = CRC8_SAE_J1850_Poly_1D_Lookup[ data[i] ^ xor ];
      }
      crc_RFL_AEB_Request_RFL_AEB_CRC = result_XOR_value ^ xor;

      copyBitsToByteArrayLE(crc_RFL_AEB_Request_RFL_AEB_CRC,data,0,8); //Intel / little-endian;
    }
    else if(@CAN_PrivFront::RFL_AEB_Request::RFL_AEB_CRC_FaultInject == 1)//CRC: Error, set to Zero
    {

      copyBitsToByteArrayLE(0,data,0,8); //Intel / little-endian;
    }
    else if(@CAN_PrivFront::RFL_AEB_Request::RFL_AEB_CRC_FaultInject == 2)//CRC: Error, Freeze last valid value
    {

      copyBitsToByteArrayLE(crc_RFL_AEB_Request_RFL_AEB_CRC,data,0,8); //Intel / little-endian;
    }
}


on sysvar CAN_PrivFront::RFL_Obj00A::RFL_Obj00A_ON_OFF
{
  if (@this == 1)
  {
     ILSetMsgEvent(RFL_Obj00A);
     @CAN_PrivFront::RFL_Obj00A::RFL_Obj00A_ON_OFF = 0;
  }
}

void cfg_Msg_RFL_Obj00A(dword aDlc, byte data[])
{
   int64 i,k;//For looping
   byte xor,data_byte;
   dword crcTemp;
   byte DataLength;
   dword Msg_id;
   
   DataLength = Msg_RFL_Obj00A.DataLength;//Message Data Length
   Msg_id  = Msg_RFL_Obj00A.id;//Message ID
   
    if (@CAN_PrivFront::RFL_Obj00A::RFL_Obj00A_AliveCtr_FaultInject != 3)//AC: user defined value
    {

    clearBitsInByteArrayLE(data,16,8); //Intel / little-endian

    }
    if (@CAN_PrivFront::RFL_Obj00A::RFL_Obj00A_AliveCtr_FaultInject == 0)//AC: No Error, calculate AC
    {
      ++counter_RFL_Obj00A_RFL_Obj00A_AliveCtr;
      counter_RFL_Obj00A_RFL_Obj00A_AliveCtr %=256;

      copyBitsToByteArrayLE(counter_RFL_Obj00A_RFL_Obj00A_AliveCtr,data,16,8); //Intel / little-endian;
    }
    else if (@CAN_PrivFront::RFL_Obj00A::RFL_Obj00A_AliveCtr_FaultInject == 1)//AC: Error sequence: set AC = 0
    {

      copyBitsToByteArrayLE(0,data,16,8); //Intel / little-endian;
    }
    else if (@CAN_PrivFront::RFL_Obj00A::RFL_Obj00A_AliveCtr_FaultInject == 2)//AC: Error sequence: Freeze last valid value
    {

      copyBitsToByteArrayLE(counter_RFL_Obj00A_RFL_Obj00A_AliveCtr,data,16,8); //Intel / little-endian;
    }
    if (@CAN_PrivFront::RFL_Obj00A::RFL_Obj00A_ProtBlockCtr_FaultInject != 3)//BC: user defined value
    {

    clearBitsInByteArrayLE(data,24,4); //Intel / little-endian

    }
    if (@CAN_PrivFront::RFL_Obj00A::RFL_Obj00A_ProtBlockCtr_FaultInject == 0)//BC: No Error, calculate BC
    {
      bc_RFL_Obj00A_RFL_Obj00A_ProtBlockCtr = bc_RFL_Object_ProtBlockCtr ;

      copyBitsToByteArrayLE(bc_RFL_Obj00A_RFL_Obj00A_ProtBlockCtr,data,24,4); //Intel / little-endian;
    }
    else if (@CAN_PrivFront::RFL_Obj00A::RFL_Obj00A_ProtBlockCtr_FaultInject == 1)//BC: Error sequence: set BC = 0
    {

      copyBitsToByteArrayLE(0,data,24,4); //Intel / little-endian;
    }
    else if (@CAN_PrivFront::RFL_Obj00A::RFL_Obj00A_ProtBlockCtr_FaultInject == 2)//BC: Error sequence: Freeze last valid value
    {

      copyBitsToByteArrayLE(bc_RFL_Obj00A_RFL_Obj00A_ProtBlockCtr,data,24,4); //Intel / little-endian;
    }
    if (@CAN_PrivFront::RFL_Obj00A::RFL_Obj00A_CRC_FaultInject != 3)//CRC: user defined value
    {

    clearBitsInByteArrayLE(data,0,16); //Intel / little-endian

    }
    if(@CAN_PrivFront::RFL_Obj00A::RFL_Obj00A_CRC_FaultInject == 0)//CRC: No Error, calculate CRC
    {
      crcTemp = CRC16_INIT;
      for(i = 2; i < (DataLength+2); i++)
      {
        if(i < DataLength)
          data_byte = data[i] ;
        else if(i == DataLength)
          data_byte = (Data_ID_Lookup_PRIVATE(Msg_id) & 0x00FF);
        else if(i == (DataLength+1))
          data_byte = (Data_ID_Lookup_PRIVATE(Msg_id) & 0xFF00) >> 8;
        else
          write("Error: DLC exceeded in CRC calculation");
        crcTemp ^= data_byte << 8;
        crcTemp = (crcTemp << (8)) ^ CRC16_CCITT_FALSE_POLY_1021H_Lookup[(crcTemp >> (8)) & (0xFF)];
      }
      crcTemp ^= CRC16_XOR;
      crc_RFL_Obj00A_RFL_Obj00A_CRC = crcTemp;

      copyBitsToByteArrayLE(crc_RFL_Obj00A_RFL_Obj00A_CRC,data,0,16); //Intel / little-endian;
    }
    else if(@CAN_PrivFront::RFL_Obj00A::RFL_Obj00A_CRC_FaultInject == 1)//CRC: Error, set to Zero
    {

      copyBitsToByteArrayLE(0,data,0,16); //Intel / little-endian;
    }
    else if(@CAN_PrivFront::RFL_Obj00A::RFL_Obj00A_CRC_FaultInject == 2)//CRC: Error, Freeze last valid value
    {

      copyBitsToByteArrayLE(crc_RFL_Obj00A_RFL_Obj00A_CRC,data,0,16); //Intel / little-endian;
    }
}


on sysvar CAN_PrivFront::RFL_Obj00B::RFL_Obj00B_ON_OFF
{
  if (@this == 1)
  {
     ILSetMsgEvent(RFL_Obj00B);
     @CAN_PrivFront::RFL_Obj00B::RFL_Obj00B_ON_OFF = 0;
  }
}

void cfg_Msg_RFL_Obj00B(dword aDlc, byte data[])
{
   int64 i,k;//For looping
   byte xor,data_byte;
   dword crcTemp;
   byte DataLength;
   dword Msg_id;
   
   DataLength = Msg_RFL_Obj00B.DataLength;//Message Data Length
   Msg_id  = Msg_RFL_Obj00B.id;//Message ID
   
    if (@CAN_PrivFront::RFL_Obj00B::RFL_Obj00B_AliveCtr_FaultInject != 3)//AC: user defined value
    {

    clearBitsInByteArrayLE(data,16,8); //Intel / little-endian

    }
    if (@CAN_PrivFront::RFL_Obj00B::RFL_Obj00B_AliveCtr_FaultInject == 0)//AC: No Error, calculate AC
    {
      ++counter_RFL_Obj00B_RFL_Obj00B_AliveCtr;
      counter_RFL_Obj00B_RFL_Obj00B_AliveCtr %=256;

      copyBitsToByteArrayLE(counter_RFL_Obj00B_RFL_Obj00B_AliveCtr,data,16,8); //Intel / little-endian;
    }
    else if (@CAN_PrivFront::RFL_Obj00B::RFL_Obj00B_AliveCtr_FaultInject == 1)//AC: Error sequence: set AC = 0
    {

      copyBitsToByteArrayLE(0,data,16,8); //Intel / little-endian;
    }
    else if (@CAN_PrivFront::RFL_Obj00B::RFL_Obj00B_AliveCtr_FaultInject == 2)//AC: Error sequence: Freeze last valid value
    {

      copyBitsToByteArrayLE(counter_RFL_Obj00B_RFL_Obj00B_AliveCtr,data,16,8); //Intel / little-endian;
    }
    if (@CAN_PrivFront::RFL_Obj00B::RFL_Obj00B_ProtBlockCtr_FaultInject != 3)//BC: user defined value
    {

    clearBitsInByteArrayLE(data,24,4); //Intel / little-endian

    }
    if (@CAN_PrivFront::RFL_Obj00B::RFL_Obj00B_ProtBlockCtr_FaultInject == 0)//BC: No Error, calculate BC
    {
      bc_RFL_Obj00B_RFL_Obj00B_ProtBlockCtr = bc_RFL_Object_ProtBlockCtr ;

      copyBitsToByteArrayLE(bc_RFL_Obj00B_RFL_Obj00B_ProtBlockCtr,data,24,4); //Intel / little-endian;
    }
    else if (@CAN_PrivFront::RFL_Obj00B::RFL_Obj00B_ProtBlockCtr_FaultInject == 1)//BC: Error sequence: set BC = 0
    {

      copyBitsToByteArrayLE(0,data,24,4); //Intel / little-endian;
    }
    else if (@CAN_PrivFront::RFL_Obj00B::RFL_Obj00B_ProtBlockCtr_FaultInject == 2)//BC: Error sequence: Freeze last valid value
    {

      copyBitsToByteArrayLE(bc_RFL_Obj00B_RFL_Obj00B_ProtBlockCtr,data,24,4); //Intel / little-endian;
    }
    if (@CAN_PrivFront::RFL_Obj00B::RFL_Obj00B_CRC_FaultInject != 3)//CRC: user defined value
    {

    clearBitsInByteArrayLE(data,0,16); //Intel / little-endian

    }
    if(@CAN_PrivFront::RFL_Obj00B::RFL_Obj00B_CRC_FaultInject == 0)//CRC: No Error, calculate CRC
    {
      crcTemp = CRC16_INIT;
      for(i = 2; i < (DataLength+2); i++)
      {
        if(i < DataLength)
          data_byte = data[i] ;
        else if(i == DataLength)
          data_byte = (Data_ID_Lookup_PRIVATE(Msg_id) & 0x00FF);
        else if(i == (DataLength+1))
          data_byte = (Data_ID_Lookup_PRIVATE(Msg_id) & 0xFF00) >> 8;
        else
          write("Error: DLC exceeded in CRC calculation");
        crcTemp ^= data_byte << 8;
        crcTemp = (crcTemp << (8)) ^ CRC16_CCITT_FALSE_POLY_1021H_Lookup[(crcTemp >> (8)) & (0xFF)];
      }
      crcTemp ^= CRC16_XOR;
      crc_RFL_Obj00B_RFL_Obj00B_CRC = crcTemp;

      copyBitsToByteArrayLE(crc_RFL_Obj00B_RFL_Obj00B_CRC,data,0,16); //Intel / little-endian;
    }
    else if(@CAN_PrivFront::RFL_Obj00B::RFL_Obj00B_CRC_FaultInject == 1)//CRC: Error, set to Zero
    {

      copyBitsToByteArrayLE(0,data,0,16); //Intel / little-endian;
    }
    else if(@CAN_PrivFront::RFL_Obj00B::RFL_Obj00B_CRC_FaultInject == 2)//CRC: Error, Freeze last valid value
    {

      copyBitsToByteArrayLE(crc_RFL_Obj00B_RFL_Obj00B_CRC,data,0,16); //Intel / little-endian;
    }
}


on sysvar CAN_PrivFront::RFL_Obj01A::RFL_Obj01A_ON_OFF
{
  if (@this == 1)
  {
     ILSetMsgEvent(RFL_Obj01A);
     @CAN_PrivFront::RFL_Obj01A::RFL_Obj01A_ON_OFF = 0;
  }
}

void cfg_Msg_RFL_Obj01A(dword aDlc, byte data[])
{
   int64 i,k;//For looping
   byte xor,data_byte;
   dword crcTemp;
   byte DataLength;
   dword Msg_id;
   
   DataLength = Msg_RFL_Obj01A.DataLength;//Message Data Length
   Msg_id  = Msg_RFL_Obj01A.id;//Message ID
   
    if (@CAN_PrivFront::RFL_Obj01A::RFL_Obj01A_AliveCtr_FaultInject != 3)//AC: user defined value
    {

    clearBitsInByteArrayLE(data,16,8); //Intel / little-endian

    }
    if (@CAN_PrivFront::RFL_Obj01A::RFL_Obj01A_AliveCtr_FaultInject == 0)//AC: No Error, calculate AC
    {
      ++counter_RFL_Obj01A_RFL_Obj01A_AliveCtr;
      counter_RFL_Obj01A_RFL_Obj01A_AliveCtr %=256;

      copyBitsToByteArrayLE(counter_RFL_Obj01A_RFL_Obj01A_AliveCtr,data,16,8); //Intel / little-endian;
    }
    else if (@CAN_PrivFront::RFL_Obj01A::RFL_Obj01A_AliveCtr_FaultInject == 1)//AC: Error sequence: set AC = 0
    {

      copyBitsToByteArrayLE(0,data,16,8); //Intel / little-endian;
    }
    else if (@CAN_PrivFront::RFL_Obj01A::RFL_Obj01A_AliveCtr_FaultInject == 2)//AC: Error sequence: Freeze last valid value
    {

      copyBitsToByteArrayLE(counter_RFL_Obj01A_RFL_Obj01A_AliveCtr,data,16,8); //Intel / little-endian;
    }
    if (@CAN_PrivFront::RFL_Obj01A::RFL_Obj01A_ProtBlockCtr_FaultInject != 3)//BC: user defined value
    {

    clearBitsInByteArrayLE(data,24,4); //Intel / little-endian

    }
    if (@CAN_PrivFront::RFL_Obj01A::RFL_Obj01A_ProtBlockCtr_FaultInject == 0)//BC: No Error, calculate BC
    {
      bc_RFL_Obj01A_RFL_Obj01A_ProtBlockCtr = bc_RFL_Object_ProtBlockCtr ;

      copyBitsToByteArrayLE(bc_RFL_Obj01A_RFL_Obj01A_ProtBlockCtr,data,24,4); //Intel / little-endian;
    }
    else if (@CAN_PrivFront::RFL_Obj01A::RFL_Obj01A_ProtBlockCtr_FaultInject == 1)//BC: Error sequence: set BC = 0
    {

      copyBitsToByteArrayLE(0,data,24,4); //Intel / little-endian;
    }
    else if (@CAN_PrivFront::RFL_Obj01A::RFL_Obj01A_ProtBlockCtr_FaultInject == 2)//BC: Error sequence: Freeze last valid value
    {

      copyBitsToByteArrayLE(bc_RFL_Obj01A_RFL_Obj01A_ProtBlockCtr,data,24,4); //Intel / little-endian;
    }
    if (@CAN_PrivFront::RFL_Obj01A::RFL_Obj01A_CRC_FaultInject != 3)//CRC: user defined value
    {

    clearBitsInByteArrayLE(data,0,16); //Intel / little-endian

    }
    if(@CAN_PrivFront::RFL_Obj01A::RFL_Obj01A_CRC_FaultInject == 0)//CRC: No Error, calculate CRC
    {
      crcTemp = CRC16_INIT;
      for(i = 2; i < (DataLength+2); i++)
      {
        if(i < DataLength)
          data_byte = data[i] ;
        else if(i == DataLength)
          data_byte = (Data_ID_Lookup_PRIVATE(Msg_id) & 0x00FF);
        else if(i == (DataLength+1))
          data_byte = (Data_ID_Lookup_PRIVATE(Msg_id) & 0xFF00) >> 8;
        else
          write("Error: DLC exceeded in CRC calculation");
        crcTemp ^= data_byte << 8;
        crcTemp = (crcTemp << (8)) ^ CRC16_CCITT_FALSE_POLY_1021H_Lookup[(crcTemp >> (8)) & (0xFF)];
      }
      crcTemp ^= CRC16_XOR;
      crc_RFL_Obj01A_RFL_Obj01A_CRC = crcTemp;

      copyBitsToByteArrayLE(crc_RFL_Obj01A_RFL_Obj01A_CRC,data,0,16); //Intel / little-endian;
    }
    else if(@CAN_PrivFront::RFL_Obj01A::RFL_Obj01A_CRC_FaultInject == 1)//CRC: Error, set to Zero
    {

      copyBitsToByteArrayLE(0,data,0,16); //Intel / little-endian;
    }
    else if(@CAN_PrivFront::RFL_Obj01A::RFL_Obj01A_CRC_FaultInject == 2)//CRC: Error, Freeze last valid value
    {

      copyBitsToByteArrayLE(crc_RFL_Obj01A_RFL_Obj01A_CRC,data,0,16); //Intel / little-endian;
    }
}


on sysvar CAN_PrivFront::RFL_Obj01B::RFL_Obj01B_ON_OFF
{
  if (@this == 1)
  {
     ILSetMsgEvent(RFL_Obj01B);
     @CAN_PrivFront::RFL_Obj01B::RFL_Obj01B_ON_OFF = 0;
  }
}

void cfg_Msg_RFL_Obj01B(dword aDlc, byte data[])
{
   int64 i,k;//For looping
   byte xor,data_byte;
   dword crcTemp;
   byte DataLength;
   dword Msg_id;
   
   DataLength = Msg_RFL_Obj01B.DataLength;//Message Data Length
   Msg_id  = Msg_RFL_Obj01B.id;//Message ID
   
    if (@CAN_PrivFront::RFL_Obj01B::RFL_Obj01B_AliveCtr_FaultInject != 3)//AC: user defined value
    {

    clearBitsInByteArrayLE(data,16,8); //Intel / little-endian

    }
    if (@CAN_PrivFront::RFL_Obj01B::RFL_Obj01B_AliveCtr_FaultInject == 0)//AC: No Error, calculate AC
    {
      ++counter_RFL_Obj01B_RFL_Obj01B_AliveCtr;
      counter_RFL_Obj01B_RFL_Obj01B_AliveCtr %=256;

      copyBitsToByteArrayLE(counter_RFL_Obj01B_RFL_Obj01B_AliveCtr,data,16,8); //Intel / little-endian;
    }
    else if (@CAN_PrivFront::RFL_Obj01B::RFL_Obj01B_AliveCtr_FaultInject == 1)//AC: Error sequence: set AC = 0
    {

      copyBitsToByteArrayLE(0,data,16,8); //Intel / little-endian;
    }
    else if (@CAN_PrivFront::RFL_Obj01B::RFL_Obj01B_AliveCtr_FaultInject == 2)//AC: Error sequence: Freeze last valid value
    {

      copyBitsToByteArrayLE(counter_RFL_Obj01B_RFL_Obj01B_AliveCtr,data,16,8); //Intel / little-endian;
    }
    if (@CAN_PrivFront::RFL_Obj01B::RFL_Obj01B_ProtBlockCtr_FaultInject != 3)//BC: user defined value
    {

    clearBitsInByteArrayLE(data,24,4); //Intel / little-endian

    }
    if (@CAN_PrivFront::RFL_Obj01B::RFL_Obj01B_ProtBlockCtr_FaultInject == 0)//BC: No Error, calculate BC
    {
      bc_RFL_Obj01B_RFL_Obj01B_ProtBlockCtr = bc_RFL_Object_ProtBlockCtr ;

      copyBitsToByteArrayLE(bc_RFL_Obj01B_RFL_Obj01B_ProtBlockCtr,data,24,4); //Intel / little-endian;
    }
    else if (@CAN_PrivFront::RFL_Obj01B::RFL_Obj01B_ProtBlockCtr_FaultInject == 1)//BC: Error sequence: set BC = 0
    {

      copyBitsToByteArrayLE(0,data,24,4); //Intel / little-endian;
    }
    else if (@CAN_PrivFront::RFL_Obj01B::RFL_Obj01B_ProtBlockCtr_FaultInject == 2)//BC: Error sequence: Freeze last valid value
    {

      copyBitsToByteArrayLE(bc_RFL_Obj01B_RFL_Obj01B_ProtBlockCtr,data,24,4); //Intel / little-endian;
    }
    if (@CAN_PrivFront::RFL_Obj01B::RFL_Obj01B_CRC_FaultInject != 3)//CRC: user defined value
    {

    clearBitsInByteArrayLE(data,0,16); //Intel / little-endian

    }
    if(@CAN_PrivFront::RFL_Obj01B::RFL_Obj01B_CRC_FaultInject == 0)//CRC: No Error, calculate CRC
    {
      crcTemp = CRC16_INIT;
      for(i = 2; i < (DataLength+2); i++)
      {
        if(i < DataLength)
          data_byte = data[i] ;
        else if(i == DataLength)
          data_byte = (Data_ID_Lookup_PRIVATE(Msg_id) & 0x00FF);
        else if(i == (DataLength+1))
          data_byte = (Data_ID_Lookup_PRIVATE(Msg_id) & 0xFF00) >> 8;
        else
          write("Error: DLC exceeded in CRC calculation");
        crcTemp ^= data_byte << 8;
        crcTemp = (crcTemp << (8)) ^ CRC16_CCITT_FALSE_POLY_1021H_Lookup[(crcTemp >> (8)) & (0xFF)];
      }
      crcTemp ^= CRC16_XOR;
      crc_RFL_Obj01B_RFL_Obj01B_CRC = crcTemp;

      copyBitsToByteArrayLE(crc_RFL_Obj01B_RFL_Obj01B_CRC,data,0,16); //Intel / little-endian;
    }
    else if(@CAN_PrivFront::RFL_Obj01B::RFL_Obj01B_CRC_FaultInject == 1)//CRC: Error, set to Zero
    {

      copyBitsToByteArrayLE(0,data,0,16); //Intel / little-endian;
    }
    else if(@CAN_PrivFront::RFL_Obj01B::RFL_Obj01B_CRC_FaultInject == 2)//CRC: Error, Freeze last valid value
    {

      copyBitsToByteArrayLE(crc_RFL_Obj01B_RFL_Obj01B_CRC,data,0,16); //Intel / little-endian;
    }
}


on sysvar CAN_PrivFront::RFL_Obj02A::RFL_Obj02A_ON_OFF
{
  if (@this == 1)
  {
     ILSetMsgEvent(RFL_Obj02A);
     @CAN_PrivFront::RFL_Obj02A::RFL_Obj02A_ON_OFF = 0;
  }
}

void cfg_Msg_RFL_Obj02A(dword aDlc, byte data[])
{
   int64 i,k;//For looping
   byte xor,data_byte;
   dword crcTemp;
   byte DataLength;
   dword Msg_id;
   
   DataLength = Msg_RFL_Obj02A.DataLength;//Message Data Length
   Msg_id  = Msg_RFL_Obj02A.id;//Message ID
   
    if (@CAN_PrivFront::RFL_Obj02A::RFL_Obj02A_AliveCtr_FaultInject != 3)//AC: user defined value
    {

    clearBitsInByteArrayLE(data,16,8); //Intel / little-endian

    }
    if (@CAN_PrivFront::RFL_Obj02A::RFL_Obj02A_AliveCtr_FaultInject == 0)//AC: No Error, calculate AC
    {
      ++counter_RFL_Obj02A_RFL_Obj02A_AliveCtr;
      counter_RFL_Obj02A_RFL_Obj02A_AliveCtr %=256;

      copyBitsToByteArrayLE(counter_RFL_Obj02A_RFL_Obj02A_AliveCtr,data,16,8); //Intel / little-endian;
    }
    else if (@CAN_PrivFront::RFL_Obj02A::RFL_Obj02A_AliveCtr_FaultInject == 1)//AC: Error sequence: set AC = 0
    {

      copyBitsToByteArrayLE(0,data,16,8); //Intel / little-endian;
    }
    else if (@CAN_PrivFront::RFL_Obj02A::RFL_Obj02A_AliveCtr_FaultInject == 2)//AC: Error sequence: Freeze last valid value
    {

      copyBitsToByteArrayLE(counter_RFL_Obj02A_RFL_Obj02A_AliveCtr,data,16,8); //Intel / little-endian;
    }
    if (@CAN_PrivFront::RFL_Obj02A::RFL_Obj02A_ProtBlockCtr_FaultInject != 3)//BC: user defined value
    {

    clearBitsInByteArrayLE(data,24,4); //Intel / little-endian

    }
    if (@CAN_PrivFront::RFL_Obj02A::RFL_Obj02A_ProtBlockCtr_FaultInject == 0)//BC: No Error, calculate BC
    {
      bc_RFL_Obj02A_RFL_Obj02A_ProtBlockCtr = bc_RFL_Object_ProtBlockCtr ;

      copyBitsToByteArrayLE(bc_RFL_Obj02A_RFL_Obj02A_ProtBlockCtr,data,24,4); //Intel / little-endian;
    }
    else if (@CAN_PrivFront::RFL_Obj02A::RFL_Obj02A_ProtBlockCtr_FaultInject == 1)//BC: Error sequence: set BC = 0
    {

      copyBitsToByteArrayLE(0,data,24,4); //Intel / little-endian;
    }
    else if (@CAN_PrivFront::RFL_Obj02A::RFL_Obj02A_ProtBlockCtr_FaultInject == 2)//BC: Error sequence: Freeze last valid value
    {

      copyBitsToByteArrayLE(bc_RFL_Obj02A_RFL_Obj02A_ProtBlockCtr,data,24,4); //Intel / little-endian;
    }
    if (@CAN_PrivFront::RFL_Obj02A::RFL_Obj02A_CRC_FaultInject != 3)//CRC: user defined value
    {

    clearBitsInByteArrayLE(data,0,16); //Intel / little-endian

    }
    if(@CAN_PrivFront::RFL_Obj02A::RFL_Obj02A_CRC_FaultInject == 0)//CRC: No Error, calculate CRC
    {
      crcTemp = CRC16_INIT;
      for(i = 2; i < (DataLength+2); i++)
      {
        if(i < DataLength)
          data_byte = data[i] ;
        else if(i == DataLength)
          data_byte = (Data_ID_Lookup_PRIVATE(Msg_id) & 0x00FF);
        else if(i == (DataLength+1))
          data_byte = (Data_ID_Lookup_PRIVATE(Msg_id) & 0xFF00) >> 8;
        else
          write("Error: DLC exceeded in CRC calculation");
        crcTemp ^= data_byte << 8;
        crcTemp = (crcTemp << (8)) ^ CRC16_CCITT_FALSE_POLY_1021H_Lookup[(crcTemp >> (8)) & (0xFF)];
      }
      crcTemp ^= CRC16_XOR;
      crc_RFL_Obj02A_RFL_Obj02A_CRC = crcTemp;

      copyBitsToByteArrayLE(crc_RFL_Obj02A_RFL_Obj02A_CRC,data,0,16); //Intel / little-endian;
    }
    else if(@CAN_PrivFront::RFL_Obj02A::RFL_Obj02A_CRC_FaultInject == 1)//CRC: Error, set to Zero
    {

      copyBitsToByteArrayLE(0,data,0,16); //Intel / little-endian;
    }
    else if(@CAN_PrivFront::RFL_Obj02A::RFL_Obj02A_CRC_FaultInject == 2)//CRC: Error, Freeze last valid value
    {

      copyBitsToByteArrayLE(crc_RFL_Obj02A_RFL_Obj02A_CRC,data,0,16); //Intel / little-endian;
    }
}


on sysvar CAN_PrivFront::RFL_Obj02B::RFL_Obj02B_ON_OFF
{
  if (@this == 1)
  {
     ILSetMsgEvent(RFL_Obj02B);
     @CAN_PrivFront::RFL_Obj02B::RFL_Obj02B_ON_OFF = 0;
  }
}

void cfg_Msg_RFL_Obj02B(dword aDlc, byte data[])
{
   int64 i,k;//For looping
   byte xor,data_byte;
   dword crcTemp;
   byte DataLength;
   dword Msg_id;
   
   DataLength = Msg_RFL_Obj02B.DataLength;//Message Data Length
   Msg_id  = Msg_RFL_Obj02B.id;//Message ID
   
    if (@CAN_PrivFront::RFL_Obj02B::RFL_Obj02B_AliveCtr_FaultInject != 3)//AC: user defined value
    {

    clearBitsInByteArrayLE(data,16,8); //Intel / little-endian

    }
    if (@CAN_PrivFront::RFL_Obj02B::RFL_Obj02B_AliveCtr_FaultInject == 0)//AC: No Error, calculate AC
    {
      ++counter_RFL_Obj02B_RFL_Obj02B_AliveCtr;
      counter_RFL_Obj02B_RFL_Obj02B_AliveCtr %=256;

      copyBitsToByteArrayLE(counter_RFL_Obj02B_RFL_Obj02B_AliveCtr,data,16,8); //Intel / little-endian;
    }
    else if (@CAN_PrivFront::RFL_Obj02B::RFL_Obj02B_AliveCtr_FaultInject == 1)//AC: Error sequence: set AC = 0
    {

      copyBitsToByteArrayLE(0,data,16,8); //Intel / little-endian;
    }
    else if (@CAN_PrivFront::RFL_Obj02B::RFL_Obj02B_AliveCtr_FaultInject == 2)//AC: Error sequence: Freeze last valid value
    {

      copyBitsToByteArrayLE(counter_RFL_Obj02B_RFL_Obj02B_AliveCtr,data,16,8); //Intel / little-endian;
    }
    if (@CAN_PrivFront::RFL_Obj02B::RFL_Obj02B_ProtBlockCtr_FaultInject != 3)//BC: user defined value
    {

    clearBitsInByteArrayLE(data,24,4); //Intel / little-endian

    }
    if (@CAN_PrivFront::RFL_Obj02B::RFL_Obj02B_ProtBlockCtr_FaultInject == 0)//BC: No Error, calculate BC
    {
      bc_RFL_Obj02B_RFL_Obj02B_ProtBlockCtr = bc_RFL_Object_ProtBlockCtr ;

      copyBitsToByteArrayLE(bc_RFL_Obj02B_RFL_Obj02B_ProtBlockCtr,data,24,4); //Intel / little-endian;
    }
    else if (@CAN_PrivFront::RFL_Obj02B::RFL_Obj02B_ProtBlockCtr_FaultInject == 1)//BC: Error sequence: set BC = 0
    {

      copyBitsToByteArrayLE(0,data,24,4); //Intel / little-endian;
    }
    else if (@CAN_PrivFront::RFL_Obj02B::RFL_Obj02B_ProtBlockCtr_FaultInject == 2)//BC: Error sequence: Freeze last valid value
    {

      copyBitsToByteArrayLE(bc_RFL_Obj02B_RFL_Obj02B_ProtBlockCtr,data,24,4); //Intel / little-endian;
    }
    if (@CAN_PrivFront::RFL_Obj02B::RFL_Obj02B_CRC_FaultInject != 3)//CRC: user defined value
    {

    clearBitsInByteArrayLE(data,0,16); //Intel / little-endian

    }
    if(@CAN_PrivFront::RFL_Obj02B::RFL_Obj02B_CRC_FaultInject == 0)//CRC: No Error, calculate CRC
    {
      crcTemp = CRC16_INIT;
      for(i = 2; i < (DataLength+2); i++)
      {
        if(i < DataLength)
          data_byte = data[i] ;
        else if(i == DataLength)
          data_byte = (Data_ID_Lookup_PRIVATE(Msg_id) & 0x00FF);
        else if(i == (DataLength+1))
          data_byte = (Data_ID_Lookup_PRIVATE(Msg_id) & 0xFF00) >> 8;
        else
          write("Error: DLC exceeded in CRC calculation");
        crcTemp ^= data_byte << 8;
        crcTemp = (crcTemp << (8)) ^ CRC16_CCITT_FALSE_POLY_1021H_Lookup[(crcTemp >> (8)) & (0xFF)];
      }
      crcTemp ^= CRC16_XOR;
      crc_RFL_Obj02B_RFL_Obj02B_CRC = crcTemp;

      copyBitsToByteArrayLE(crc_RFL_Obj02B_RFL_Obj02B_CRC,data,0,16); //Intel / little-endian;
    }
    else if(@CAN_PrivFront::RFL_Obj02B::RFL_Obj02B_CRC_FaultInject == 1)//CRC: Error, set to Zero
    {

      copyBitsToByteArrayLE(0,data,0,16); //Intel / little-endian;
    }
    else if(@CAN_PrivFront::RFL_Obj02B::RFL_Obj02B_CRC_FaultInject == 2)//CRC: Error, Freeze last valid value
    {

      copyBitsToByteArrayLE(crc_RFL_Obj02B_RFL_Obj02B_CRC,data,0,16); //Intel / little-endian;
    }
}


on sysvar CAN_PrivFront::RFL_Obj03A::RFL_Obj03A_ON_OFF
{
  if (@this == 1)
  {
     ILSetMsgEvent(RFL_Obj03A);
     @CAN_PrivFront::RFL_Obj03A::RFL_Obj03A_ON_OFF = 0;
  }
}

void cfg_Msg_RFL_Obj03A(dword aDlc, byte data[])
{
   int64 i,k;//For looping
   byte xor,data_byte;
   dword crcTemp;
   byte DataLength;
   dword Msg_id;
   
   DataLength = Msg_RFL_Obj03A.DataLength;//Message Data Length
   Msg_id  = Msg_RFL_Obj03A.id;//Message ID
   
    if (@CAN_PrivFront::RFL_Obj03A::RFL_Obj03A_AliveCtr_FaultInject != 3)//AC: user defined value
    {

    clearBitsInByteArrayLE(data,16,8); //Intel / little-endian

    }
    if (@CAN_PrivFront::RFL_Obj03A::RFL_Obj03A_AliveCtr_FaultInject == 0)//AC: No Error, calculate AC
    {
      ++counter_RFL_Obj03A_RFL_Obj03A_AliveCtr;
      counter_RFL_Obj03A_RFL_Obj03A_AliveCtr %=256;

      copyBitsToByteArrayLE(counter_RFL_Obj03A_RFL_Obj03A_AliveCtr,data,16,8); //Intel / little-endian;
    }
    else if (@CAN_PrivFront::RFL_Obj03A::RFL_Obj03A_AliveCtr_FaultInject == 1)//AC: Error sequence: set AC = 0
    {

      copyBitsToByteArrayLE(0,data,16,8); //Intel / little-endian;
    }
    else if (@CAN_PrivFront::RFL_Obj03A::RFL_Obj03A_AliveCtr_FaultInject == 2)//AC: Error sequence: Freeze last valid value
    {

      copyBitsToByteArrayLE(counter_RFL_Obj03A_RFL_Obj03A_AliveCtr,data,16,8); //Intel / little-endian;
    }
    if (@CAN_PrivFront::RFL_Obj03A::RFL_Obj03A_ProtBlockCtr_FaultInject != 3)//BC: user defined value
    {

    clearBitsInByteArrayLE(data,24,4); //Intel / little-endian

    }
    if (@CAN_PrivFront::RFL_Obj03A::RFL_Obj03A_ProtBlockCtr_FaultInject == 0)//BC: No Error, calculate BC
    {
      bc_RFL_Obj03A_RFL_Obj03A_ProtBlockCtr = bc_RFL_Object_ProtBlockCtr ;

      copyBitsToByteArrayLE(bc_RFL_Obj03A_RFL_Obj03A_ProtBlockCtr,data,24,4); //Intel / little-endian;
    }
    else if (@CAN_PrivFront::RFL_Obj03A::RFL_Obj03A_ProtBlockCtr_FaultInject == 1)//BC: Error sequence: set BC = 0
    {

      copyBitsToByteArrayLE(0,data,24,4); //Intel / little-endian;
    }
    else if (@CAN_PrivFront::RFL_Obj03A::RFL_Obj03A_ProtBlockCtr_FaultInject == 2)//BC: Error sequence: Freeze last valid value
    {

      copyBitsToByteArrayLE(bc_RFL_Obj03A_RFL_Obj03A_ProtBlockCtr,data,24,4); //Intel / little-endian;
    }
    if (@CAN_PrivFront::RFL_Obj03A::RFL_Obj03A_CRC_FaultInject != 3)//CRC: user defined value
    {

    clearBitsInByteArrayLE(data,0,16); //Intel / little-endian

    }
    if(@CAN_PrivFront::RFL_Obj03A::RFL_Obj03A_CRC_FaultInject == 0)//CRC: No Error, calculate CRC
    {
      crcTemp = CRC16_INIT;
      for(i = 2; i < (DataLength+2); i++)
      {
        if(i < DataLength)
          data_byte = data[i] ;
        else if(i == DataLength)
          data_byte = (Data_ID_Lookup_PRIVATE(Msg_id) & 0x00FF);
        else if(i == (DataLength+1))
          data_byte = (Data_ID_Lookup_PRIVATE(Msg_id) & 0xFF00) >> 8;
        else
          write("Error: DLC exceeded in CRC calculation");
        crcTemp ^= data_byte << 8;
        crcTemp = (crcTemp << (8)) ^ CRC16_CCITT_FALSE_POLY_1021H_Lookup[(crcTemp >> (8)) & (0xFF)];
      }
      crcTemp ^= CRC16_XOR;
      crc_RFL_Obj03A_RFL_Obj03A_CRC = crcTemp;

      copyBitsToByteArrayLE(crc_RFL_Obj03A_RFL_Obj03A_CRC,data,0,16); //Intel / little-endian;
    }
    else if(@CAN_PrivFront::RFL_Obj03A::RFL_Obj03A_CRC_FaultInject == 1)//CRC: Error, set to Zero
    {

      copyBitsToByteArrayLE(0,data,0,16); //Intel / little-endian;
    }
    else if(@CAN_PrivFront::RFL_Obj03A::RFL_Obj03A_CRC_FaultInject == 2)//CRC: Error, Freeze last valid value
    {

      copyBitsToByteArrayLE(crc_RFL_Obj03A_RFL_Obj03A_CRC,data,0,16); //Intel / little-endian;
    }
}


on sysvar CAN_PrivFront::RFL_Obj03B::RFL_Obj03B_ON_OFF
{
  if (@this == 1)
  {
     ILSetMsgEvent(RFL_Obj03B);
     @CAN_PrivFront::RFL_Obj03B::RFL_Obj03B_ON_OFF = 0;
  }
}

void cfg_Msg_RFL_Obj03B(dword aDlc, byte data[])
{
   int64 i,k;//For looping
   byte xor,data_byte;
   dword crcTemp;
   byte DataLength;
   dword Msg_id;
   
   DataLength = Msg_RFL_Obj03B.DataLength;//Message Data Length
   Msg_id  = Msg_RFL_Obj03B.id;//Message ID
   
    if (@CAN_PrivFront::RFL_Obj03B::RFL_Obj03B_AliveCtr_FaultInject != 3)//AC: user defined value
    {

    clearBitsInByteArrayLE(data,16,8); //Intel / little-endian

    }
    if (@CAN_PrivFront::RFL_Obj03B::RFL_Obj03B_AliveCtr_FaultInject == 0)//AC: No Error, calculate AC
    {
      ++counter_RFL_Obj03B_RFL_Obj03B_AliveCtr;
      counter_RFL_Obj03B_RFL_Obj03B_AliveCtr %=256;

      copyBitsToByteArrayLE(counter_RFL_Obj03B_RFL_Obj03B_AliveCtr,data,16,8); //Intel / little-endian;
    }
    else if (@CAN_PrivFront::RFL_Obj03B::RFL_Obj03B_AliveCtr_FaultInject == 1)//AC: Error sequence: set AC = 0
    {

      copyBitsToByteArrayLE(0,data,16,8); //Intel / little-endian;
    }
    else if (@CAN_PrivFront::RFL_Obj03B::RFL_Obj03B_AliveCtr_FaultInject == 2)//AC: Error sequence: Freeze last valid value
    {

      copyBitsToByteArrayLE(counter_RFL_Obj03B_RFL_Obj03B_AliveCtr,data,16,8); //Intel / little-endian;
    }
    if (@CAN_PrivFront::RFL_Obj03B::RFL_Obj03B_ProtBlockCtr_FaultInject != 3)//BC: user defined value
    {

    clearBitsInByteArrayLE(data,24,4); //Intel / little-endian

    }
    if (@CAN_PrivFront::RFL_Obj03B::RFL_Obj03B_ProtBlockCtr_FaultInject == 0)//BC: No Error, calculate BC
    {
      bc_RFL_Obj03B_RFL_Obj03B_ProtBlockCtr = bc_RFL_Object_ProtBlockCtr ;

      copyBitsToByteArrayLE(bc_RFL_Obj03B_RFL_Obj03B_ProtBlockCtr,data,24,4); //Intel / little-endian;
    }
    else if (@CAN_PrivFront::RFL_Obj03B::RFL_Obj03B_ProtBlockCtr_FaultInject == 1)//BC: Error sequence: set BC = 0
    {

      copyBitsToByteArrayLE(0,data,24,4); //Intel / little-endian;
    }
    else if (@CAN_PrivFront::RFL_Obj03B::RFL_Obj03B_ProtBlockCtr_FaultInject == 2)//BC: Error sequence: Freeze last valid value
    {

      copyBitsToByteArrayLE(bc_RFL_Obj03B_RFL_Obj03B_ProtBlockCtr,data,24,4); //Intel / little-endian;
    }
    if (@CAN_PrivFront::RFL_Obj03B::RFL_Obj03B_CRC_FaultInject != 3)//CRC: user defined value
    {

    clearBitsInByteArrayLE(data,0,16); //Intel / little-endian

    }
    if(@CAN_PrivFront::RFL_Obj03B::RFL_Obj03B_CRC_FaultInject == 0)//CRC: No Error, calculate CRC
    {
      crcTemp = CRC16_INIT;
      for(i = 2; i < (DataLength+2); i++)
      {
        if(i < DataLength)
          data_byte = data[i] ;
        else if(i == DataLength)
          data_byte = (Data_ID_Lookup_PRIVATE(Msg_id) & 0x00FF);
        else if(i == (DataLength+1))
          data_byte = (Data_ID_Lookup_PRIVATE(Msg_id) & 0xFF00) >> 8;
        else
          write("Error: DLC exceeded in CRC calculation");
        crcTemp ^= data_byte << 8;
        crcTemp = (crcTemp << (8)) ^ CRC16_CCITT_FALSE_POLY_1021H_Lookup[(crcTemp >> (8)) & (0xFF)];
      }
      crcTemp ^= CRC16_XOR;
      crc_RFL_Obj03B_RFL_Obj03B_CRC = crcTemp;

      copyBitsToByteArrayLE(crc_RFL_Obj03B_RFL_Obj03B_CRC,data,0,16); //Intel / little-endian;
    }
    else if(@CAN_PrivFront::RFL_Obj03B::RFL_Obj03B_CRC_FaultInject == 1)//CRC: Error, set to Zero
    {

      copyBitsToByteArrayLE(0,data,0,16); //Intel / little-endian;
    }
    else if(@CAN_PrivFront::RFL_Obj03B::RFL_Obj03B_CRC_FaultInject == 2)//CRC: Error, Freeze last valid value
    {

      copyBitsToByteArrayLE(crc_RFL_Obj03B_RFL_Obj03B_CRC,data,0,16); //Intel / little-endian;
    }
}


on sysvar CAN_PrivFront::RFL_Obj04A::RFL_Obj04A_ON_OFF
{
  if (@this == 1)
  {
     ILSetMsgEvent(RFL_Obj04A);
     @CAN_PrivFront::RFL_Obj04A::RFL_Obj04A_ON_OFF = 0;
  }
}

void cfg_Msg_RFL_Obj04A(dword aDlc, byte data[])
{
   int64 i,k;//For looping
   byte xor,data_byte;
   dword crcTemp;
   byte DataLength;
   dword Msg_id;
   
   DataLength = Msg_RFL_Obj04A.DataLength;//Message Data Length
   Msg_id  = Msg_RFL_Obj04A.id;//Message ID
   
    if (@CAN_PrivFront::RFL_Obj04A::RFL_Obj04A_AliveCtr_FaultInject != 3)//AC: user defined value
    {

    clearBitsInByteArrayLE(data,16,8); //Intel / little-endian

    }
    if (@CAN_PrivFront::RFL_Obj04A::RFL_Obj04A_AliveCtr_FaultInject == 0)//AC: No Error, calculate AC
    {
      ++counter_RFL_Obj04A_RFL_Obj04A_AliveCtr;
      counter_RFL_Obj04A_RFL_Obj04A_AliveCtr %=256;

      copyBitsToByteArrayLE(counter_RFL_Obj04A_RFL_Obj04A_AliveCtr,data,16,8); //Intel / little-endian;
    }
    else if (@CAN_PrivFront::RFL_Obj04A::RFL_Obj04A_AliveCtr_FaultInject == 1)//AC: Error sequence: set AC = 0
    {

      copyBitsToByteArrayLE(0,data,16,8); //Intel / little-endian;
    }
    else if (@CAN_PrivFront::RFL_Obj04A::RFL_Obj04A_AliveCtr_FaultInject == 2)//AC: Error sequence: Freeze last valid value
    {

      copyBitsToByteArrayLE(counter_RFL_Obj04A_RFL_Obj04A_AliveCtr,data,16,8); //Intel / little-endian;
    }
    if (@CAN_PrivFront::RFL_Obj04A::RFL_Obj04A_ProtBlockCtr_FaultInject != 3)//BC: user defined value
    {

    clearBitsInByteArrayLE(data,24,4); //Intel / little-endian

    }
    if (@CAN_PrivFront::RFL_Obj04A::RFL_Obj04A_ProtBlockCtr_FaultInject == 0)//BC: No Error, calculate BC
    {
      bc_RFL_Obj04A_RFL_Obj04A_ProtBlockCtr = bc_RFL_Object_ProtBlockCtr ;

      copyBitsToByteArrayLE(bc_RFL_Obj04A_RFL_Obj04A_ProtBlockCtr,data,24,4); //Intel / little-endian;
    }
    else if (@CAN_PrivFront::RFL_Obj04A::RFL_Obj04A_ProtBlockCtr_FaultInject == 1)//BC: Error sequence: set BC = 0
    {

      copyBitsToByteArrayLE(0,data,24,4); //Intel / little-endian;
    }
    else if (@CAN_PrivFront::RFL_Obj04A::RFL_Obj04A_ProtBlockCtr_FaultInject == 2)//BC: Error sequence: Freeze last valid value
    {

      copyBitsToByteArrayLE(bc_RFL_Obj04A_RFL_Obj04A_ProtBlockCtr,data,24,4); //Intel / little-endian;
    }
    if (@CAN_PrivFront::RFL_Obj04A::RFL_Obj04A_CRC_FaultInject != 3)//CRC: user defined value
    {

    clearBitsInByteArrayLE(data,0,16); //Intel / little-endian

    }
    if(@CAN_PrivFront::RFL_Obj04A::RFL_Obj04A_CRC_FaultInject == 0)//CRC: No Error, calculate CRC
    {
      crcTemp = CRC16_INIT;
      for(i = 2; i < (DataLength+2); i++)
      {
        if(i < DataLength)
          data_byte = data[i] ;
        else if(i == DataLength)
          data_byte = (Data_ID_Lookup_PRIVATE(Msg_id) & 0x00FF);
        else if(i == (DataLength+1))
          data_byte = (Data_ID_Lookup_PRIVATE(Msg_id) & 0xFF00) >> 8;
        else
          write("Error: DLC exceeded in CRC calculation");
        crcTemp ^= data_byte << 8;
        crcTemp = (crcTemp << (8)) ^ CRC16_CCITT_FALSE_POLY_1021H_Lookup[(crcTemp >> (8)) & (0xFF)];
      }
      crcTemp ^= CRC16_XOR;
      crc_RFL_Obj04A_RFL_Obj04A_CRC = crcTemp;

      copyBitsToByteArrayLE(crc_RFL_Obj04A_RFL_Obj04A_CRC,data,0,16); //Intel / little-endian;
    }
    else if(@CAN_PrivFront::RFL_Obj04A::RFL_Obj04A_CRC_FaultInject == 1)//CRC: Error, set to Zero
    {

      copyBitsToByteArrayLE(0,data,0,16); //Intel / little-endian;
    }
    else if(@CAN_PrivFront::RFL_Obj04A::RFL_Obj04A_CRC_FaultInject == 2)//CRC: Error, Freeze last valid value
    {

      copyBitsToByteArrayLE(crc_RFL_Obj04A_RFL_Obj04A_CRC,data,0,16); //Intel / little-endian;
    }
}


on sysvar CAN_PrivFront::RFL_Obj04B::RFL_Obj04B_ON_OFF
{
  if (@this == 1)
  {
     ILSetMsgEvent(RFL_Obj04B);
     @CAN_PrivFront::RFL_Obj04B::RFL_Obj04B_ON_OFF = 0;
  }
}

void cfg_Msg_RFL_Obj04B(dword aDlc, byte data[])
{
   int64 i,k;//For looping
   byte xor,data_byte;
   dword crcTemp;
   byte DataLength;
   dword Msg_id;
   
   DataLength = Msg_RFL_Obj04B.DataLength;//Message Data Length
   Msg_id  = Msg_RFL_Obj04B.id;//Message ID
   
    if (@CAN_PrivFront::RFL_Obj04B::RFL_Obj04B_AliveCtr_FaultInject != 3)//AC: user defined value
    {

    clearBitsInByteArrayLE(data,16,8); //Intel / little-endian

    }
    if (@CAN_PrivFront::RFL_Obj04B::RFL_Obj04B_AliveCtr_FaultInject == 0)//AC: No Error, calculate AC
    {
      ++counter_RFL_Obj04B_RFL_Obj04B_AliveCtr;
      counter_RFL_Obj04B_RFL_Obj04B_AliveCtr %=256;

      copyBitsToByteArrayLE(counter_RFL_Obj04B_RFL_Obj04B_AliveCtr,data,16,8); //Intel / little-endian;
    }
    else if (@CAN_PrivFront::RFL_Obj04B::RFL_Obj04B_AliveCtr_FaultInject == 1)//AC: Error sequence: set AC = 0
    {

      copyBitsToByteArrayLE(0,data,16,8); //Intel / little-endian;
    }
    else if (@CAN_PrivFront::RFL_Obj04B::RFL_Obj04B_AliveCtr_FaultInject == 2)//AC: Error sequence: Freeze last valid value
    {

      copyBitsToByteArrayLE(counter_RFL_Obj04B_RFL_Obj04B_AliveCtr,data,16,8); //Intel / little-endian;
    }
    if (@CAN_PrivFront::RFL_Obj04B::RFL_Obj04B_ProtBlockCtr_FaultInject != 3)//BC: user defined value
    {

    clearBitsInByteArrayLE(data,24,4); //Intel / little-endian

    }
    if (@CAN_PrivFront::RFL_Obj04B::RFL_Obj04B_ProtBlockCtr_FaultInject == 0)//BC: No Error, calculate BC
    {
      bc_RFL_Obj04B_RFL_Obj04B_ProtBlockCtr = bc_RFL_Object_ProtBlockCtr ;

      copyBitsToByteArrayLE(bc_RFL_Obj04B_RFL_Obj04B_ProtBlockCtr,data,24,4); //Intel / little-endian;
    }
    else if (@CAN_PrivFront::RFL_Obj04B::RFL_Obj04B_ProtBlockCtr_FaultInject == 1)//BC: Error sequence: set BC = 0
    {

      copyBitsToByteArrayLE(0,data,24,4); //Intel / little-endian;
    }
    else if (@CAN_PrivFront::RFL_Obj04B::RFL_Obj04B_ProtBlockCtr_FaultInject == 2)//BC: Error sequence: Freeze last valid value
    {

      copyBitsToByteArrayLE(bc_RFL_Obj04B_RFL_Obj04B_ProtBlockCtr,data,24,4); //Intel / little-endian;
    }
    if (@CAN_PrivFront::RFL_Obj04B::RFL_Obj04B_CRC_FaultInject != 3)//CRC: user defined value
    {

    clearBitsInByteArrayLE(data,0,16); //Intel / little-endian

    }
    if(@CAN_PrivFront::RFL_Obj04B::RFL_Obj04B_CRC_FaultInject == 0)//CRC: No Error, calculate CRC
    {
      crcTemp = CRC16_INIT;
      for(i = 2; i < (DataLength+2); i++)
      {
        if(i < DataLength)
          data_byte = data[i] ;
        else if(i == DataLength)
          data_byte = (Data_ID_Lookup_PRIVATE(Msg_id) & 0x00FF);
        else if(i == (DataLength+1))
          data_byte = (Data_ID_Lookup_PRIVATE(Msg_id) & 0xFF00) >> 8;
        else
          write("Error: DLC exceeded in CRC calculation");
        crcTemp ^= data_byte << 8;
        crcTemp = (crcTemp << (8)) ^ CRC16_CCITT_FALSE_POLY_1021H_Lookup[(crcTemp >> (8)) & (0xFF)];
      }
      crcTemp ^= CRC16_XOR;
      crc_RFL_Obj04B_RFL_Obj04B_CRC = crcTemp;

      copyBitsToByteArrayLE(crc_RFL_Obj04B_RFL_Obj04B_CRC,data,0,16); //Intel / little-endian;
    }
    else if(@CAN_PrivFront::RFL_Obj04B::RFL_Obj04B_CRC_FaultInject == 1)//CRC: Error, set to Zero
    {

      copyBitsToByteArrayLE(0,data,0,16); //Intel / little-endian;
    }
    else if(@CAN_PrivFront::RFL_Obj04B::RFL_Obj04B_CRC_FaultInject == 2)//CRC: Error, Freeze last valid value
    {

      copyBitsToByteArrayLE(crc_RFL_Obj04B_RFL_Obj04B_CRC,data,0,16); //Intel / little-endian;
    }
}


on sysvar CAN_PrivFront::RFL_Obj05A::RFL_Obj05A_ON_OFF
{
  if (@this == 1)
  {
     ILSetMsgEvent(RFL_Obj05A);
     @CAN_PrivFront::RFL_Obj05A::RFL_Obj05A_ON_OFF = 0;
  }
}

void cfg_Msg_RFL_Obj05A(dword aDlc, byte data[])
{
   int64 i,k;//For looping
   byte xor,data_byte;
   dword crcTemp;
   byte DataLength;
   dword Msg_id;
   
   DataLength = Msg_RFL_Obj05A.DataLength;//Message Data Length
   Msg_id  = Msg_RFL_Obj05A.id;//Message ID
   
    if (@CAN_PrivFront::RFL_Obj05A::RFL_Obj05A_AliveCtr_FaultInject != 3)//AC: user defined value
    {

    clearBitsInByteArrayLE(data,16,8); //Intel / little-endian

    }
    if (@CAN_PrivFront::RFL_Obj05A::RFL_Obj05A_AliveCtr_FaultInject == 0)//AC: No Error, calculate AC
    {
      ++counter_RFL_Obj05A_RFL_Obj05A_AliveCtr;
      counter_RFL_Obj05A_RFL_Obj05A_AliveCtr %=256;

      copyBitsToByteArrayLE(counter_RFL_Obj05A_RFL_Obj05A_AliveCtr,data,16,8); //Intel / little-endian;
    }
    else if (@CAN_PrivFront::RFL_Obj05A::RFL_Obj05A_AliveCtr_FaultInject == 1)//AC: Error sequence: set AC = 0
    {

      copyBitsToByteArrayLE(0,data,16,8); //Intel / little-endian;
    }
    else if (@CAN_PrivFront::RFL_Obj05A::RFL_Obj05A_AliveCtr_FaultInject == 2)//AC: Error sequence: Freeze last valid value
    {

      copyBitsToByteArrayLE(counter_RFL_Obj05A_RFL_Obj05A_AliveCtr,data,16,8); //Intel / little-endian;
    }
    if (@CAN_PrivFront::RFL_Obj05A::RFL_Obj05A_ProtBlockCtr_FaultInject != 3)//BC: user defined value
    {

    clearBitsInByteArrayLE(data,24,4); //Intel / little-endian

    }
    if (@CAN_PrivFront::RFL_Obj05A::RFL_Obj05A_ProtBlockCtr_FaultInject == 0)//BC: No Error, calculate BC
    {
      bc_RFL_Obj05A_RFL_Obj05A_ProtBlockCtr = bc_RFL_Object_ProtBlockCtr ;

      copyBitsToByteArrayLE(bc_RFL_Obj05A_RFL_Obj05A_ProtBlockCtr,data,24,4); //Intel / little-endian;
    }
    else if (@CAN_PrivFront::RFL_Obj05A::RFL_Obj05A_ProtBlockCtr_FaultInject == 1)//BC: Error sequence: set BC = 0
    {

      copyBitsToByteArrayLE(0,data,24,4); //Intel / little-endian;
    }
    else if (@CAN_PrivFront::RFL_Obj05A::RFL_Obj05A_ProtBlockCtr_FaultInject == 2)//BC: Error sequence: Freeze last valid value
    {

      copyBitsToByteArrayLE(bc_RFL_Obj05A_RFL_Obj05A_ProtBlockCtr,data,24,4); //Intel / little-endian;
    }
    if (@CAN_PrivFront::RFL_Obj05A::RFL_Obj05A_CRC_FaultInject != 3)//CRC: user defined value
    {

    clearBitsInByteArrayLE(data,0,16); //Intel / little-endian

    }
    if(@CAN_PrivFront::RFL_Obj05A::RFL_Obj05A_CRC_FaultInject == 0)//CRC: No Error, calculate CRC
    {
      crcTemp = CRC16_INIT;
      for(i = 2; i < (DataLength+2); i++)
      {
        if(i < DataLength)
          data_byte = data[i] ;
        else if(i == DataLength)
          data_byte = (Data_ID_Lookup_PRIVATE(Msg_id) & 0x00FF);
        else if(i == (DataLength+1))
          data_byte = (Data_ID_Lookup_PRIVATE(Msg_id) & 0xFF00) >> 8;
        else
          write("Error: DLC exceeded in CRC calculation");
        crcTemp ^= data_byte << 8;
        crcTemp = (crcTemp << (8)) ^ CRC16_CCITT_FALSE_POLY_1021H_Lookup[(crcTemp >> (8)) & (0xFF)];
      }
      crcTemp ^= CRC16_XOR;
      crc_RFL_Obj05A_RFL_Obj05A_CRC = crcTemp;

      copyBitsToByteArrayLE(crc_RFL_Obj05A_RFL_Obj05A_CRC,data,0,16); //Intel / little-endian;
    }
    else if(@CAN_PrivFront::RFL_Obj05A::RFL_Obj05A_CRC_FaultInject == 1)//CRC: Error, set to Zero
    {

      copyBitsToByteArrayLE(0,data,0,16); //Intel / little-endian;
    }
    else if(@CAN_PrivFront::RFL_Obj05A::RFL_Obj05A_CRC_FaultInject == 2)//CRC: Error, Freeze last valid value
    {

      copyBitsToByteArrayLE(crc_RFL_Obj05A_RFL_Obj05A_CRC,data,0,16); //Intel / little-endian;
    }
}


on sysvar CAN_PrivFront::RFL_Obj05B::RFL_Obj05B_ON_OFF
{
  if (@this == 1)
  {
     ILSetMsgEvent(RFL_Obj05B);
     @CAN_PrivFront::RFL_Obj05B::RFL_Obj05B_ON_OFF = 0;
  }
}

void cfg_Msg_RFL_Obj05B(dword aDlc, byte data[])
{
   int64 i,k;//For looping
   byte xor,data_byte;
   dword crcTemp;
   byte DataLength;
   dword Msg_id;
   
   DataLength = Msg_RFL_Obj05B.DataLength;//Message Data Length
   Msg_id  = Msg_RFL_Obj05B.id;//Message ID
   
    if (@CAN_PrivFront::RFL_Obj05B::RFL_Obj05B_AliveCtr_FaultInject != 3)//AC: user defined value
    {

    clearBitsInByteArrayLE(data,16,8); //Intel / little-endian

    }
    if (@CAN_PrivFront::RFL_Obj05B::RFL_Obj05B_AliveCtr_FaultInject == 0)//AC: No Error, calculate AC
    {
      ++counter_RFL_Obj05B_RFL_Obj05B_AliveCtr;
      counter_RFL_Obj05B_RFL_Obj05B_AliveCtr %=256;

      copyBitsToByteArrayLE(counter_RFL_Obj05B_RFL_Obj05B_AliveCtr,data,16,8); //Intel / little-endian;
    }
    else if (@CAN_PrivFront::RFL_Obj05B::RFL_Obj05B_AliveCtr_FaultInject == 1)//AC: Error sequence: set AC = 0
    {

      copyBitsToByteArrayLE(0,data,16,8); //Intel / little-endian;
    }
    else if (@CAN_PrivFront::RFL_Obj05B::RFL_Obj05B_AliveCtr_FaultInject == 2)//AC: Error sequence: Freeze last valid value
    {

      copyBitsToByteArrayLE(counter_RFL_Obj05B_RFL_Obj05B_AliveCtr,data,16,8); //Intel / little-endian;
    }
    if (@CAN_PrivFront::RFL_Obj05B::RFL_Obj05B_ProtBlockCtr_FaultInject != 3)//BC: user defined value
    {

    clearBitsInByteArrayLE(data,24,4); //Intel / little-endian

    }
    if (@CAN_PrivFront::RFL_Obj05B::RFL_Obj05B_ProtBlockCtr_FaultInject == 0)//BC: No Error, calculate BC
    {
      bc_RFL_Obj05B_RFL_Obj05B_ProtBlockCtr = bc_RFL_Object_ProtBlockCtr ;

      copyBitsToByteArrayLE(bc_RFL_Obj05B_RFL_Obj05B_ProtBlockCtr,data,24,4); //Intel / little-endian;
    }
    else if (@CAN_PrivFront::RFL_Obj05B::RFL_Obj05B_ProtBlockCtr_FaultInject == 1)//BC: Error sequence: set BC = 0
    {

      copyBitsToByteArrayLE(0,data,24,4); //Intel / little-endian;
    }
    else if (@CAN_PrivFront::RFL_Obj05B::RFL_Obj05B_ProtBlockCtr_FaultInject == 2)//BC: Error sequence: Freeze last valid value
    {

      copyBitsToByteArrayLE(bc_RFL_Obj05B_RFL_Obj05B_ProtBlockCtr,data,24,4); //Intel / little-endian;
    }
    if (@CAN_PrivFront::RFL_Obj05B::RFL_Obj05B_CRC_FaultInject != 3)//CRC: user defined value
    {

    clearBitsInByteArrayLE(data,0,16); //Intel / little-endian

    }
    if(@CAN_PrivFront::RFL_Obj05B::RFL_Obj05B_CRC_FaultInject == 0)//CRC: No Error, calculate CRC
    {
      crcTemp = CRC16_INIT;
      for(i = 2; i < (DataLength+2); i++)
      {
        if(i < DataLength)
          data_byte = data[i] ;
        else if(i == DataLength)
          data_byte = (Data_ID_Lookup_PRIVATE(Msg_id) & 0x00FF);
        else if(i == (DataLength+1))
          data_byte = (Data_ID_Lookup_PRIVATE(Msg_id) & 0xFF00) >> 8;
        else
          write("Error: DLC exceeded in CRC calculation");
        crcTemp ^= data_byte << 8;
        crcTemp = (crcTemp << (8)) ^ CRC16_CCITT_FALSE_POLY_1021H_Lookup[(crcTemp >> (8)) & (0xFF)];
      }
      crcTemp ^= CRC16_XOR;
      crc_RFL_Obj05B_RFL_Obj05B_CRC = crcTemp;

      copyBitsToByteArrayLE(crc_RFL_Obj05B_RFL_Obj05B_CRC,data,0,16); //Intel / little-endian;
    }
    else if(@CAN_PrivFront::RFL_Obj05B::RFL_Obj05B_CRC_FaultInject == 1)//CRC: Error, set to Zero
    {

      copyBitsToByteArrayLE(0,data,0,16); //Intel / little-endian;
    }
    else if(@CAN_PrivFront::RFL_Obj05B::RFL_Obj05B_CRC_FaultInject == 2)//CRC: Error, Freeze last valid value
    {

      copyBitsToByteArrayLE(crc_RFL_Obj05B_RFL_Obj05B_CRC,data,0,16); //Intel / little-endian;
    }
}


on sysvar CAN_PrivFront::RFL_Obj06A::RFL_Obj06A_ON_OFF
{
  if (@this == 1)
  {
     ILSetMsgEvent(RFL_Obj06A);
     @CAN_PrivFront::RFL_Obj06A::RFL_Obj06A_ON_OFF = 0;
  }
}

void cfg_Msg_RFL_Obj06A(dword aDlc, byte data[])
{
   int64 i,k;//For looping
   byte xor,data_byte;
   dword crcTemp;
   byte DataLength;
   dword Msg_id;
   
   DataLength = Msg_RFL_Obj06A.DataLength;//Message Data Length
   Msg_id  = Msg_RFL_Obj06A.id;//Message ID
   
    if (@CAN_PrivFront::RFL_Obj06A::RFL_Obj06A_AliveCtr_FaultInject != 3)//AC: user defined value
    {

    clearBitsInByteArrayLE(data,16,8); //Intel / little-endian

    }
    if (@CAN_PrivFront::RFL_Obj06A::RFL_Obj06A_AliveCtr_FaultInject == 0)//AC: No Error, calculate AC
    {
      ++counter_RFL_Obj06A_RFL_Obj06A_AliveCtr;
      counter_RFL_Obj06A_RFL_Obj06A_AliveCtr %=256;

      copyBitsToByteArrayLE(counter_RFL_Obj06A_RFL_Obj06A_AliveCtr,data,16,8); //Intel / little-endian;
    }
    else if (@CAN_PrivFront::RFL_Obj06A::RFL_Obj06A_AliveCtr_FaultInject == 1)//AC: Error sequence: set AC = 0
    {

      copyBitsToByteArrayLE(0,data,16,8); //Intel / little-endian;
    }
    else if (@CAN_PrivFront::RFL_Obj06A::RFL_Obj06A_AliveCtr_FaultInject == 2)//AC: Error sequence: Freeze last valid value
    {

      copyBitsToByteArrayLE(counter_RFL_Obj06A_RFL_Obj06A_AliveCtr,data,16,8); //Intel / little-endian;
    }
    if (@CAN_PrivFront::RFL_Obj06A::RFL_Obj06A_ProtBlockCtr_FaultInject != 3)//BC: user defined value
    {

    clearBitsInByteArrayLE(data,24,4); //Intel / little-endian

    }
    if (@CAN_PrivFront::RFL_Obj06A::RFL_Obj06A_ProtBlockCtr_FaultInject == 0)//BC: No Error, calculate BC
    {
      bc_RFL_Obj06A_RFL_Obj06A_ProtBlockCtr = bc_RFL_Object_ProtBlockCtr ;

      copyBitsToByteArrayLE(bc_RFL_Obj06A_RFL_Obj06A_ProtBlockCtr,data,24,4); //Intel / little-endian;
    }
    else if (@CAN_PrivFront::RFL_Obj06A::RFL_Obj06A_ProtBlockCtr_FaultInject == 1)//BC: Error sequence: set BC = 0
    {

      copyBitsToByteArrayLE(0,data,24,4); //Intel / little-endian;
    }
    else if (@CAN_PrivFront::RFL_Obj06A::RFL_Obj06A_ProtBlockCtr_FaultInject == 2)//BC: Error sequence: Freeze last valid value
    {

      copyBitsToByteArrayLE(bc_RFL_Obj06A_RFL_Obj06A_ProtBlockCtr,data,24,4); //Intel / little-endian;
    }
    if (@CAN_PrivFront::RFL_Obj06A::RFL_Obj06A_CRC_FaultInject != 3)//CRC: user defined value
    {

    clearBitsInByteArrayLE(data,0,16); //Intel / little-endian

    }
    if(@CAN_PrivFront::RFL_Obj06A::RFL_Obj06A_CRC_FaultInject == 0)//CRC: No Error, calculate CRC
    {
      crcTemp = CRC16_INIT;
      for(i = 2; i < (DataLength+2); i++)
      {
        if(i < DataLength)
          data_byte = data[i] ;
        else if(i == DataLength)
          data_byte = (Data_ID_Lookup_PRIVATE(Msg_id) & 0x00FF);
        else if(i == (DataLength+1))
          data_byte = (Data_ID_Lookup_PRIVATE(Msg_id) & 0xFF00) >> 8;
        else
          write("Error: DLC exceeded in CRC calculation");
        crcTemp ^= data_byte << 8;
        crcTemp = (crcTemp << (8)) ^ CRC16_CCITT_FALSE_POLY_1021H_Lookup[(crcTemp >> (8)) & (0xFF)];
      }
      crcTemp ^= CRC16_XOR;
      crc_RFL_Obj06A_RFL_Obj06A_CRC = crcTemp;

      copyBitsToByteArrayLE(crc_RFL_Obj06A_RFL_Obj06A_CRC,data,0,16); //Intel / little-endian;
    }
    else if(@CAN_PrivFront::RFL_Obj06A::RFL_Obj06A_CRC_FaultInject == 1)//CRC: Error, set to Zero
    {

      copyBitsToByteArrayLE(0,data,0,16); //Intel / little-endian;
    }
    else if(@CAN_PrivFront::RFL_Obj06A::RFL_Obj06A_CRC_FaultInject == 2)//CRC: Error, Freeze last valid value
    {

      copyBitsToByteArrayLE(crc_RFL_Obj06A_RFL_Obj06A_CRC,data,0,16); //Intel / little-endian;
    }
}


on sysvar CAN_PrivFront::RFL_Obj06B::RFL_Obj06B_ON_OFF
{
  if (@this == 1)
  {
     ILSetMsgEvent(RFL_Obj06B);
     @CAN_PrivFront::RFL_Obj06B::RFL_Obj06B_ON_OFF = 0;
  }
}

void cfg_Msg_RFL_Obj06B(dword aDlc, byte data[])
{
   int64 i,k;//For looping
   byte xor,data_byte;
   dword crcTemp;
   byte DataLength;
   dword Msg_id;
   
   DataLength = Msg_RFL_Obj06B.DataLength;//Message Data Length
   Msg_id  = Msg_RFL_Obj06B.id;//Message ID
   
    if (@CAN_PrivFront::RFL_Obj06B::RFL_Obj06B_AliveCtr_FaultInject != 3)//AC: user defined value
    {

    clearBitsInByteArrayLE(data,16,8); //Intel / little-endian

    }
    if (@CAN_PrivFront::RFL_Obj06B::RFL_Obj06B_AliveCtr_FaultInject == 0)//AC: No Error, calculate AC
    {
      ++counter_RFL_Obj06B_RFL_Obj06B_AliveCtr;
      counter_RFL_Obj06B_RFL_Obj06B_AliveCtr %=256;

      copyBitsToByteArrayLE(counter_RFL_Obj06B_RFL_Obj06B_AliveCtr,data,16,8); //Intel / little-endian;
    }
    else if (@CAN_PrivFront::RFL_Obj06B::RFL_Obj06B_AliveCtr_FaultInject == 1)//AC: Error sequence: set AC = 0
    {

      copyBitsToByteArrayLE(0,data,16,8); //Intel / little-endian;
    }
    else if (@CAN_PrivFront::RFL_Obj06B::RFL_Obj06B_AliveCtr_FaultInject == 2)//AC: Error sequence: Freeze last valid value
    {

      copyBitsToByteArrayLE(counter_RFL_Obj06B_RFL_Obj06B_AliveCtr,data,16,8); //Intel / little-endian;
    }
    if (@CAN_PrivFront::RFL_Obj06B::RFL_Obj06B_ProtBlockCtr_FaultInject != 3)//BC: user defined value
    {

    clearBitsInByteArrayLE(data,24,4); //Intel / little-endian

    }
    if (@CAN_PrivFront::RFL_Obj06B::RFL_Obj06B_ProtBlockCtr_FaultInject == 0)//BC: No Error, calculate BC
    {
      bc_RFL_Obj06B_RFL_Obj06B_ProtBlockCtr = bc_RFL_Object_ProtBlockCtr ;

      copyBitsToByteArrayLE(bc_RFL_Obj06B_RFL_Obj06B_ProtBlockCtr,data,24,4); //Intel / little-endian;
    }
    else if (@CAN_PrivFront::RFL_Obj06B::RFL_Obj06B_ProtBlockCtr_FaultInject == 1)//BC: Error sequence: set BC = 0
    {

      copyBitsToByteArrayLE(0,data,24,4); //Intel / little-endian;
    }
    else if (@CAN_PrivFront::RFL_Obj06B::RFL_Obj06B_ProtBlockCtr_FaultInject == 2)//BC: Error sequence: Freeze last valid value
    {

      copyBitsToByteArrayLE(bc_RFL_Obj06B_RFL_Obj06B_ProtBlockCtr,data,24,4); //Intel / little-endian;
    }
    if (@CAN_PrivFront::RFL_Obj06B::RFL_Obj06B_CRC_FaultInject != 3)//CRC: user defined value
    {

    clearBitsInByteArrayLE(data,0,16); //Intel / little-endian

    }
    if(@CAN_PrivFront::RFL_Obj06B::RFL_Obj06B_CRC_FaultInject == 0)//CRC: No Error, calculate CRC
    {
      crcTemp = CRC16_INIT;
      for(i = 2; i < (DataLength+2); i++)
      {
        if(i < DataLength)
          data_byte = data[i] ;
        else if(i == DataLength)
          data_byte = (Data_ID_Lookup_PRIVATE(Msg_id) & 0x00FF);
        else if(i == (DataLength+1))
          data_byte = (Data_ID_Lookup_PRIVATE(Msg_id) & 0xFF00) >> 8;
        else
          write("Error: DLC exceeded in CRC calculation");
        crcTemp ^= data_byte << 8;
        crcTemp = (crcTemp << (8)) ^ CRC16_CCITT_FALSE_POLY_1021H_Lookup[(crcTemp >> (8)) & (0xFF)];
      }
      crcTemp ^= CRC16_XOR;
      crc_RFL_Obj06B_RFL_Obj06B_CRC = crcTemp;

      copyBitsToByteArrayLE(crc_RFL_Obj06B_RFL_Obj06B_CRC,data,0,16); //Intel / little-endian;
    }
    else if(@CAN_PrivFront::RFL_Obj06B::RFL_Obj06B_CRC_FaultInject == 1)//CRC: Error, set to Zero
    {

      copyBitsToByteArrayLE(0,data,0,16); //Intel / little-endian;
    }
    else if(@CAN_PrivFront::RFL_Obj06B::RFL_Obj06B_CRC_FaultInject == 2)//CRC: Error, Freeze last valid value
    {

      copyBitsToByteArrayLE(crc_RFL_Obj06B_RFL_Obj06B_CRC,data,0,16); //Intel / little-endian;
    }
}


on sysvar CAN_PrivFront::RFL_Obj07A::RFL_Obj07A_ON_OFF
{
  if (@this == 1)
  {
     ILSetMsgEvent(RFL_Obj07A);
     @CAN_PrivFront::RFL_Obj07A::RFL_Obj07A_ON_OFF = 0;
  }
}

void cfg_Msg_RFL_Obj07A(dword aDlc, byte data[])
{
   int64 i,k;//For looping
   byte xor,data_byte;
   dword crcTemp;
   byte DataLength;
   dword Msg_id;
   
   DataLength = Msg_RFL_Obj07A.DataLength;//Message Data Length
   Msg_id  = Msg_RFL_Obj07A.id;//Message ID
   
    if (@CAN_PrivFront::RFL_Obj07A::RFL_Obj07A_AliveCtr_FaultInject != 3)//AC: user defined value
    {

    clearBitsInByteArrayLE(data,16,8); //Intel / little-endian

    }
    if (@CAN_PrivFront::RFL_Obj07A::RFL_Obj07A_AliveCtr_FaultInject == 0)//AC: No Error, calculate AC
    {
      ++counter_RFL_Obj07A_RFL_Obj07A_AliveCtr;
      counter_RFL_Obj07A_RFL_Obj07A_AliveCtr %=256;

      copyBitsToByteArrayLE(counter_RFL_Obj07A_RFL_Obj07A_AliveCtr,data,16,8); //Intel / little-endian;
    }
    else if (@CAN_PrivFront::RFL_Obj07A::RFL_Obj07A_AliveCtr_FaultInject == 1)//AC: Error sequence: set AC = 0
    {

      copyBitsToByteArrayLE(0,data,16,8); //Intel / little-endian;
    }
    else if (@CAN_PrivFront::RFL_Obj07A::RFL_Obj07A_AliveCtr_FaultInject == 2)//AC: Error sequence: Freeze last valid value
    {

      copyBitsToByteArrayLE(counter_RFL_Obj07A_RFL_Obj07A_AliveCtr,data,16,8); //Intel / little-endian;
    }
    if (@CAN_PrivFront::RFL_Obj07A::RFL_Obj07A_ProtBlockCtr_FaultInject != 3)//BC: user defined value
    {

    clearBitsInByteArrayLE(data,24,4); //Intel / little-endian

    }
    if (@CAN_PrivFront::RFL_Obj07A::RFL_Obj07A_ProtBlockCtr_FaultInject == 0)//BC: No Error, calculate BC
    {
      bc_RFL_Obj07A_RFL_Obj07A_ProtBlockCtr = bc_RFL_Object_ProtBlockCtr ;

      copyBitsToByteArrayLE(bc_RFL_Obj07A_RFL_Obj07A_ProtBlockCtr,data,24,4); //Intel / little-endian;
    }
    else if (@CAN_PrivFront::RFL_Obj07A::RFL_Obj07A_ProtBlockCtr_FaultInject == 1)//BC: Error sequence: set BC = 0
    {

      copyBitsToByteArrayLE(0,data,24,4); //Intel / little-endian;
    }
    else if (@CAN_PrivFront::RFL_Obj07A::RFL_Obj07A_ProtBlockCtr_FaultInject == 2)//BC: Error sequence: Freeze last valid value
    {

      copyBitsToByteArrayLE(bc_RFL_Obj07A_RFL_Obj07A_ProtBlockCtr,data,24,4); //Intel / little-endian;
    }
    if (@CAN_PrivFront::RFL_Obj07A::RFL_Obj07A_CRC_FaultInject != 3)//CRC: user defined value
    {

    clearBitsInByteArrayLE(data,0,16); //Intel / little-endian

    }
    if(@CAN_PrivFront::RFL_Obj07A::RFL_Obj07A_CRC_FaultInject == 0)//CRC: No Error, calculate CRC
    {
      crcTemp = CRC16_INIT;
      for(i = 2; i < (DataLength+2); i++)
      {
        if(i < DataLength)
          data_byte = data[i] ;
        else if(i == DataLength)
          data_byte = (Data_ID_Lookup_PRIVATE(Msg_id) & 0x00FF);
        else if(i == (DataLength+1))
          data_byte = (Data_ID_Lookup_PRIVATE(Msg_id) & 0xFF00) >> 8;
        else
          write("Error: DLC exceeded in CRC calculation");
        crcTemp ^= data_byte << 8;
        crcTemp = (crcTemp << (8)) ^ CRC16_CCITT_FALSE_POLY_1021H_Lookup[(crcTemp >> (8)) & (0xFF)];
      }
      crcTemp ^= CRC16_XOR;
      crc_RFL_Obj07A_RFL_Obj07A_CRC = crcTemp;

      copyBitsToByteArrayLE(crc_RFL_Obj07A_RFL_Obj07A_CRC,data,0,16); //Intel / little-endian;
    }
    else if(@CAN_PrivFront::RFL_Obj07A::RFL_Obj07A_CRC_FaultInject == 1)//CRC: Error, set to Zero
    {

      copyBitsToByteArrayLE(0,data,0,16); //Intel / little-endian;
    }
    else if(@CAN_PrivFront::RFL_Obj07A::RFL_Obj07A_CRC_FaultInject == 2)//CRC: Error, Freeze last valid value
    {

      copyBitsToByteArrayLE(crc_RFL_Obj07A_RFL_Obj07A_CRC,data,0,16); //Intel / little-endian;
    }
}


on sysvar CAN_PrivFront::RFL_Obj07B::RFL_Obj07B_ON_OFF
{
  if (@this == 1)
  {
     ILSetMsgEvent(RFL_Obj07B);
     @CAN_PrivFront::RFL_Obj07B::RFL_Obj07B_ON_OFF = 0;
  }
}

void cfg_Msg_RFL_Obj07B(dword aDlc, byte data[])
{
   int64 i,k;//For looping
   byte xor,data_byte;
   dword crcTemp;
   byte DataLength;
   dword Msg_id;
   
   DataLength = Msg_RFL_Obj07B.DataLength;//Message Data Length
   Msg_id  = Msg_RFL_Obj07B.id;//Message ID
   
    if (@CAN_PrivFront::RFL_Obj07B::RFL_Obj07B_AliveCtr_FaultInject != 3)//AC: user defined value
    {

    clearBitsInByteArrayLE(data,16,8); //Intel / little-endian

    }
    if (@CAN_PrivFront::RFL_Obj07B::RFL_Obj07B_AliveCtr_FaultInject == 0)//AC: No Error, calculate AC
    {
      ++counter_RFL_Obj07B_RFL_Obj07B_AliveCtr;
      counter_RFL_Obj07B_RFL_Obj07B_AliveCtr %=256;

      copyBitsToByteArrayLE(counter_RFL_Obj07B_RFL_Obj07B_AliveCtr,data,16,8); //Intel / little-endian;
    }
    else if (@CAN_PrivFront::RFL_Obj07B::RFL_Obj07B_AliveCtr_FaultInject == 1)//AC: Error sequence: set AC = 0
    {

      copyBitsToByteArrayLE(0,data,16,8); //Intel / little-endian;
    }
    else if (@CAN_PrivFront::RFL_Obj07B::RFL_Obj07B_AliveCtr_FaultInject == 2)//AC: Error sequence: Freeze last valid value
    {

      copyBitsToByteArrayLE(counter_RFL_Obj07B_RFL_Obj07B_AliveCtr,data,16,8); //Intel / little-endian;
    }
    if (@CAN_PrivFront::RFL_Obj07B::RFL_Obj07B_ProtBlockCtr_FaultInject != 3)//BC: user defined value
    {

    clearBitsInByteArrayLE(data,24,4); //Intel / little-endian

    }
    if (@CAN_PrivFront::RFL_Obj07B::RFL_Obj07B_ProtBlockCtr_FaultInject == 0)//BC: No Error, calculate BC
    {
      bc_RFL_Obj07B_RFL_Obj07B_ProtBlockCtr = bc_RFL_Object_ProtBlockCtr ;

      copyBitsToByteArrayLE(bc_RFL_Obj07B_RFL_Obj07B_ProtBlockCtr,data,24,4); //Intel / little-endian;
    }
    else if (@CAN_PrivFront::RFL_Obj07B::RFL_Obj07B_ProtBlockCtr_FaultInject == 1)//BC: Error sequence: set BC = 0
    {

      copyBitsToByteArrayLE(0,data,24,4); //Intel / little-endian;
    }
    else if (@CAN_PrivFront::RFL_Obj07B::RFL_Obj07B_ProtBlockCtr_FaultInject == 2)//BC: Error sequence: Freeze last valid value
    {

      copyBitsToByteArrayLE(bc_RFL_Obj07B_RFL_Obj07B_ProtBlockCtr,data,24,4); //Intel / little-endian;
    }
    if (@CAN_PrivFront::RFL_Obj07B::RFL_Obj07B_CRC_FaultInject != 3)//CRC: user defined value
    {

    clearBitsInByteArrayLE(data,0,16); //Intel / little-endian

    }
    if(@CAN_PrivFront::RFL_Obj07B::RFL_Obj07B_CRC_FaultInject == 0)//CRC: No Error, calculate CRC
    {
      crcTemp = CRC16_INIT;
      for(i = 2; i < (DataLength+2); i++)
      {
        if(i < DataLength)
          data_byte = data[i] ;
        else if(i == DataLength)
          data_byte = (Data_ID_Lookup_PRIVATE(Msg_id) & 0x00FF);
        else if(i == (DataLength+1))
          data_byte = (Data_ID_Lookup_PRIVATE(Msg_id) & 0xFF00) >> 8;
        else
          write("Error: DLC exceeded in CRC calculation");
        crcTemp ^= data_byte << 8;
        crcTemp = (crcTemp << (8)) ^ CRC16_CCITT_FALSE_POLY_1021H_Lookup[(crcTemp >> (8)) & (0xFF)];
      }
      crcTemp ^= CRC16_XOR;
      crc_RFL_Obj07B_RFL_Obj07B_CRC = crcTemp;

      copyBitsToByteArrayLE(crc_RFL_Obj07B_RFL_Obj07B_CRC,data,0,16); //Intel / little-endian;
    }
    else if(@CAN_PrivFront::RFL_Obj07B::RFL_Obj07B_CRC_FaultInject == 1)//CRC: Error, set to Zero
    {

      copyBitsToByteArrayLE(0,data,0,16); //Intel / little-endian;
    }
    else if(@CAN_PrivFront::RFL_Obj07B::RFL_Obj07B_CRC_FaultInject == 2)//CRC: Error, Freeze last valid value
    {

      copyBitsToByteArrayLE(crc_RFL_Obj07B_RFL_Obj07B_CRC,data,0,16); //Intel / little-endian;
    }
}


on sysvar CAN_PrivFront::RFL_Obj08A::RFL_Obj08A_ON_OFF
{
  if (@this == 1)
  {
     ILSetMsgEvent(RFL_Obj08A);
     @CAN_PrivFront::RFL_Obj08A::RFL_Obj08A_ON_OFF = 0;
  }
}

void cfg_Msg_RFL_Obj08A(dword aDlc, byte data[])
{
   int64 i,k;//For looping
   byte xor,data_byte;
   dword crcTemp;
   byte DataLength;
   dword Msg_id;
   
   DataLength = Msg_RFL_Obj08A.DataLength;//Message Data Length
   Msg_id  = Msg_RFL_Obj08A.id;//Message ID
   
    if (@CAN_PrivFront::RFL_Obj08A::RFL_Obj08A_AliveCtr_FaultInject != 3)//AC: user defined value
    {

    clearBitsInByteArrayLE(data,16,8); //Intel / little-endian

    }
    if (@CAN_PrivFront::RFL_Obj08A::RFL_Obj08A_AliveCtr_FaultInject == 0)//AC: No Error, calculate AC
    {
      ++counter_RFL_Obj08A_RFL_Obj08A_AliveCtr;
      counter_RFL_Obj08A_RFL_Obj08A_AliveCtr %=256;

      copyBitsToByteArrayLE(counter_RFL_Obj08A_RFL_Obj08A_AliveCtr,data,16,8); //Intel / little-endian;
    }
    else if (@CAN_PrivFront::RFL_Obj08A::RFL_Obj08A_AliveCtr_FaultInject == 1)//AC: Error sequence: set AC = 0
    {

      copyBitsToByteArrayLE(0,data,16,8); //Intel / little-endian;
    }
    else if (@CAN_PrivFront::RFL_Obj08A::RFL_Obj08A_AliveCtr_FaultInject == 2)//AC: Error sequence: Freeze last valid value
    {

      copyBitsToByteArrayLE(counter_RFL_Obj08A_RFL_Obj08A_AliveCtr,data,16,8); //Intel / little-endian;
    }
    if (@CAN_PrivFront::RFL_Obj08A::RFL_Obj08A_ProtBlockCtr_FaultInject != 3)//BC: user defined value
    {

    clearBitsInByteArrayLE(data,24,4); //Intel / little-endian

    }
    if (@CAN_PrivFront::RFL_Obj08A::RFL_Obj08A_ProtBlockCtr_FaultInject == 0)//BC: No Error, calculate BC
    {
      bc_RFL_Obj08A_RFL_Obj08A_ProtBlockCtr = bc_RFL_Object_ProtBlockCtr ;

      copyBitsToByteArrayLE(bc_RFL_Obj08A_RFL_Obj08A_ProtBlockCtr,data,24,4); //Intel / little-endian;
    }
    else if (@CAN_PrivFront::RFL_Obj08A::RFL_Obj08A_ProtBlockCtr_FaultInject == 1)//BC: Error sequence: set BC = 0
    {

      copyBitsToByteArrayLE(0,data,24,4); //Intel / little-endian;
    }
    else if (@CAN_PrivFront::RFL_Obj08A::RFL_Obj08A_ProtBlockCtr_FaultInject == 2)//BC: Error sequence: Freeze last valid value
    {

      copyBitsToByteArrayLE(bc_RFL_Obj08A_RFL_Obj08A_ProtBlockCtr,data,24,4); //Intel / little-endian;
    }
    if (@CAN_PrivFront::RFL_Obj08A::RFL_Obj08A_CRC_FaultInject != 3)//CRC: user defined value
    {

    clearBitsInByteArrayLE(data,0,16); //Intel / little-endian

    }
    if(@CAN_PrivFront::RFL_Obj08A::RFL_Obj08A_CRC_FaultInject == 0)//CRC: No Error, calculate CRC
    {
      crcTemp = CRC16_INIT;
      for(i = 2; i < (DataLength+2); i++)
      {
        if(i < DataLength)
          data_byte = data[i] ;
        else if(i == DataLength)
          data_byte = (Data_ID_Lookup_PRIVATE(Msg_id) & 0x00FF);
        else if(i == (DataLength+1))
          data_byte = (Data_ID_Lookup_PRIVATE(Msg_id) & 0xFF00) >> 8;
        else
          write("Error: DLC exceeded in CRC calculation");
        crcTemp ^= data_byte << 8;
        crcTemp = (crcTemp << (8)) ^ CRC16_CCITT_FALSE_POLY_1021H_Lookup[(crcTemp >> (8)) & (0xFF)];
      }
      crcTemp ^= CRC16_XOR;
      crc_RFL_Obj08A_RFL_Obj08A_CRC = crcTemp;

      copyBitsToByteArrayLE(crc_RFL_Obj08A_RFL_Obj08A_CRC,data,0,16); //Intel / little-endian;
    }
    else if(@CAN_PrivFront::RFL_Obj08A::RFL_Obj08A_CRC_FaultInject == 1)//CRC: Error, set to Zero
    {

      copyBitsToByteArrayLE(0,data,0,16); //Intel / little-endian;
    }
    else if(@CAN_PrivFront::RFL_Obj08A::RFL_Obj08A_CRC_FaultInject == 2)//CRC: Error, Freeze last valid value
    {

      copyBitsToByteArrayLE(crc_RFL_Obj08A_RFL_Obj08A_CRC,data,0,16); //Intel / little-endian;
    }
}


on sysvar CAN_PrivFront::RFL_Obj08B::RFL_Obj08B_ON_OFF
{
  if (@this == 1)
  {
     ILSetMsgEvent(RFL_Obj08B);
     @CAN_PrivFront::RFL_Obj08B::RFL_Obj08B_ON_OFF = 0;
  }
}

void cfg_Msg_RFL_Obj08B(dword aDlc, byte data[])
{
   int64 i,k;//For looping
   byte xor,data_byte;
   dword crcTemp;
   byte DataLength;
   dword Msg_id;
   
   DataLength = Msg_RFL_Obj08B.DataLength;//Message Data Length
   Msg_id  = Msg_RFL_Obj08B.id;//Message ID
   
    if (@CAN_PrivFront::RFL_Obj08B::RFL_Obj08B_AliveCtr_FaultInject != 3)//AC: user defined value
    {

    clearBitsInByteArrayLE(data,16,8); //Intel / little-endian

    }
    if (@CAN_PrivFront::RFL_Obj08B::RFL_Obj08B_AliveCtr_FaultInject == 0)//AC: No Error, calculate AC
    {
      ++counter_RFL_Obj08B_RFL_Obj08B_AliveCtr;
      counter_RFL_Obj08B_RFL_Obj08B_AliveCtr %=256;

      copyBitsToByteArrayLE(counter_RFL_Obj08B_RFL_Obj08B_AliveCtr,data,16,8); //Intel / little-endian;
    }
    else if (@CAN_PrivFront::RFL_Obj08B::RFL_Obj08B_AliveCtr_FaultInject == 1)//AC: Error sequence: set AC = 0
    {

      copyBitsToByteArrayLE(0,data,16,8); //Intel / little-endian;
    }
    else if (@CAN_PrivFront::RFL_Obj08B::RFL_Obj08B_AliveCtr_FaultInject == 2)//AC: Error sequence: Freeze last valid value
    {

      copyBitsToByteArrayLE(counter_RFL_Obj08B_RFL_Obj08B_AliveCtr,data,16,8); //Intel / little-endian;
    }
    if (@CAN_PrivFront::RFL_Obj08B::RFL_Obj08B_ProtBlockCtr_FaultInject != 3)//BC: user defined value
    {

    clearBitsInByteArrayLE(data,24,4); //Intel / little-endian

    }
    if (@CAN_PrivFront::RFL_Obj08B::RFL_Obj08B_ProtBlockCtr_FaultInject == 0)//BC: No Error, calculate BC
    {
      bc_RFL_Obj08B_RFL_Obj08B_ProtBlockCtr = bc_RFL_Object_ProtBlockCtr ;

      copyBitsToByteArrayLE(bc_RFL_Obj08B_RFL_Obj08B_ProtBlockCtr,data,24,4); //Intel / little-endian;
    }
    else if (@CAN_PrivFront::RFL_Obj08B::RFL_Obj08B_ProtBlockCtr_FaultInject == 1)//BC: Error sequence: set BC = 0
    {

      copyBitsToByteArrayLE(0,data,24,4); //Intel / little-endian;
    }
    else if (@CAN_PrivFront::RFL_Obj08B::RFL_Obj08B_ProtBlockCtr_FaultInject == 2)//BC: Error sequence: Freeze last valid value
    {

      copyBitsToByteArrayLE(bc_RFL_Obj08B_RFL_Obj08B_ProtBlockCtr,data,24,4); //Intel / little-endian;
    }
    if (@CAN_PrivFront::RFL_Obj08B::RFL_Obj08B_CRC_FaultInject != 3)//CRC: user defined value
    {

    clearBitsInByteArrayLE(data,0,16); //Intel / little-endian

    }
    if(@CAN_PrivFront::RFL_Obj08B::RFL_Obj08B_CRC_FaultInject == 0)//CRC: No Error, calculate CRC
    {
      crcTemp = CRC16_INIT;
      for(i = 2; i < (DataLength+2); i++)
      {
        if(i < DataLength)
          data_byte = data[i] ;
        else if(i == DataLength)
          data_byte = (Data_ID_Lookup_PRIVATE(Msg_id) & 0x00FF);
        else if(i == (DataLength+1))
          data_byte = (Data_ID_Lookup_PRIVATE(Msg_id) & 0xFF00) >> 8;
        else
          write("Error: DLC exceeded in CRC calculation");
        crcTemp ^= data_byte << 8;
        crcTemp = (crcTemp << (8)) ^ CRC16_CCITT_FALSE_POLY_1021H_Lookup[(crcTemp >> (8)) & (0xFF)];
      }
      crcTemp ^= CRC16_XOR;
      crc_RFL_Obj08B_RFL_Obj08B_CRC = crcTemp;

      copyBitsToByteArrayLE(crc_RFL_Obj08B_RFL_Obj08B_CRC,data,0,16); //Intel / little-endian;
    }
    else if(@CAN_PrivFront::RFL_Obj08B::RFL_Obj08B_CRC_FaultInject == 1)//CRC: Error, set to Zero
    {

      copyBitsToByteArrayLE(0,data,0,16); //Intel / little-endian;
    }
    else if(@CAN_PrivFront::RFL_Obj08B::RFL_Obj08B_CRC_FaultInject == 2)//CRC: Error, Freeze last valid value
    {

      copyBitsToByteArrayLE(crc_RFL_Obj08B_RFL_Obj08B_CRC,data,0,16); //Intel / little-endian;
    }
}


on sysvar CAN_PrivFront::RFL_Obj09A::RFL_Obj09A_ON_OFF
{
  if (@this == 1)
  {
     ILSetMsgEvent(RFL_Obj09A);
     @CAN_PrivFront::RFL_Obj09A::RFL_Obj09A_ON_OFF = 0;
  }
}

void cfg_Msg_RFL_Obj09A(dword aDlc, byte data[])
{
   int64 i,k;//For looping
   byte xor,data_byte;
   dword crcTemp;
   byte DataLength;
   dword Msg_id;
   
   DataLength = Msg_RFL_Obj09A.DataLength;//Message Data Length
   Msg_id  = Msg_RFL_Obj09A.id;//Message ID
   
    if (@CAN_PrivFront::RFL_Obj09A::RFL_Obj09A_AliveCtr_FaultInject != 3)//AC: user defined value
    {

    clearBitsInByteArrayLE(data,16,8); //Intel / little-endian

    }
    if (@CAN_PrivFront::RFL_Obj09A::RFL_Obj09A_AliveCtr_FaultInject == 0)//AC: No Error, calculate AC
    {
      ++counter_RFL_Obj09A_RFL_Obj09A_AliveCtr;
      counter_RFL_Obj09A_RFL_Obj09A_AliveCtr %=256;

      copyBitsToByteArrayLE(counter_RFL_Obj09A_RFL_Obj09A_AliveCtr,data,16,8); //Intel / little-endian;
    }
    else if (@CAN_PrivFront::RFL_Obj09A::RFL_Obj09A_AliveCtr_FaultInject == 1)//AC: Error sequence: set AC = 0
    {

      copyBitsToByteArrayLE(0,data,16,8); //Intel / little-endian;
    }
    else if (@CAN_PrivFront::RFL_Obj09A::RFL_Obj09A_AliveCtr_FaultInject == 2)//AC: Error sequence: Freeze last valid value
    {

      copyBitsToByteArrayLE(counter_RFL_Obj09A_RFL_Obj09A_AliveCtr,data,16,8); //Intel / little-endian;
    }
    if (@CAN_PrivFront::RFL_Obj09A::RFL_Obj09A_ProtBlockCtr_FaultInject != 3)//BC: user defined value
    {

    clearBitsInByteArrayLE(data,24,4); //Intel / little-endian

    }
    if (@CAN_PrivFront::RFL_Obj09A::RFL_Obj09A_ProtBlockCtr_FaultInject == 0)//BC: No Error, calculate BC
    {
      bc_RFL_Obj09A_RFL_Obj09A_ProtBlockCtr = bc_RFL_Object_ProtBlockCtr ;

      copyBitsToByteArrayLE(bc_RFL_Obj09A_RFL_Obj09A_ProtBlockCtr,data,24,4); //Intel / little-endian;
    }
    else if (@CAN_PrivFront::RFL_Obj09A::RFL_Obj09A_ProtBlockCtr_FaultInject == 1)//BC: Error sequence: set BC = 0
    {

      copyBitsToByteArrayLE(0,data,24,4); //Intel / little-endian;
    }
    else if (@CAN_PrivFront::RFL_Obj09A::RFL_Obj09A_ProtBlockCtr_FaultInject == 2)//BC: Error sequence: Freeze last valid value
    {

      copyBitsToByteArrayLE(bc_RFL_Obj09A_RFL_Obj09A_ProtBlockCtr,data,24,4); //Intel / little-endian;
    }
    if (@CAN_PrivFront::RFL_Obj09A::RFL_Obj09A_CRC_FaultInject != 3)//CRC: user defined value
    {

    clearBitsInByteArrayLE(data,0,16); //Intel / little-endian

    }
    if(@CAN_PrivFront::RFL_Obj09A::RFL_Obj09A_CRC_FaultInject == 0)//CRC: No Error, calculate CRC
    {
      crcTemp = CRC16_INIT;
      for(i = 2; i < (DataLength+2); i++)
      {
        if(i < DataLength)
          data_byte = data[i] ;
        else if(i == DataLength)
          data_byte = (Data_ID_Lookup_PRIVATE(Msg_id) & 0x00FF);
        else if(i == (DataLength+1))
          data_byte = (Data_ID_Lookup_PRIVATE(Msg_id) & 0xFF00) >> 8;
        else
          write("Error: DLC exceeded in CRC calculation");
        crcTemp ^= data_byte << 8;
        crcTemp = (crcTemp << (8)) ^ CRC16_CCITT_FALSE_POLY_1021H_Lookup[(crcTemp >> (8)) & (0xFF)];
      }
      crcTemp ^= CRC16_XOR;
      crc_RFL_Obj09A_RFL_Obj09A_CRC = crcTemp;

      copyBitsToByteArrayLE(crc_RFL_Obj09A_RFL_Obj09A_CRC,data,0,16); //Intel / little-endian;
    }
    else if(@CAN_PrivFront::RFL_Obj09A::RFL_Obj09A_CRC_FaultInject == 1)//CRC: Error, set to Zero
    {

      copyBitsToByteArrayLE(0,data,0,16); //Intel / little-endian;
    }
    else if(@CAN_PrivFront::RFL_Obj09A::RFL_Obj09A_CRC_FaultInject == 2)//CRC: Error, Freeze last valid value
    {

      copyBitsToByteArrayLE(crc_RFL_Obj09A_RFL_Obj09A_CRC,data,0,16); //Intel / little-endian;
    }
}


on sysvar CAN_PrivFront::RFL_Obj09B::RFL_Obj09B_ON_OFF
{
  if (@this == 1)
  {
     ILSetMsgEvent(RFL_Obj09B);
     @CAN_PrivFront::RFL_Obj09B::RFL_Obj09B_ON_OFF = 0;
  }
}

void cfg_Msg_RFL_Obj09B(dword aDlc, byte data[])
{
   int64 i,k;//For looping
   byte xor,data_byte;
   dword crcTemp;
   byte DataLength;
   dword Msg_id;
   
   DataLength = Msg_RFL_Obj09B.DataLength;//Message Data Length
   Msg_id  = Msg_RFL_Obj09B.id;//Message ID
   
    if (@CAN_PrivFront::RFL_Obj09B::RFL_Obj09B_AliveCtr_FaultInject != 3)//AC: user defined value
    {

    clearBitsInByteArrayLE(data,16,8); //Intel / little-endian

    }
    if (@CAN_PrivFront::RFL_Obj09B::RFL_Obj09B_AliveCtr_FaultInject == 0)//AC: No Error, calculate AC
    {
      ++counter_RFL_Obj09B_RFL_Obj09B_AliveCtr;
      counter_RFL_Obj09B_RFL_Obj09B_AliveCtr %=256;

      copyBitsToByteArrayLE(counter_RFL_Obj09B_RFL_Obj09B_AliveCtr,data,16,8); //Intel / little-endian;
    }
    else if (@CAN_PrivFront::RFL_Obj09B::RFL_Obj09B_AliveCtr_FaultInject == 1)//AC: Error sequence: set AC = 0
    {

      copyBitsToByteArrayLE(0,data,16,8); //Intel / little-endian;
    }
    else if (@CAN_PrivFront::RFL_Obj09B::RFL_Obj09B_AliveCtr_FaultInject == 2)//AC: Error sequence: Freeze last valid value
    {

      copyBitsToByteArrayLE(counter_RFL_Obj09B_RFL_Obj09B_AliveCtr,data,16,8); //Intel / little-endian;
    }
    if (@CAN_PrivFront::RFL_Obj09B::RFL_Obj09B_ProtBlockCtr_FaultInject != 3)//BC: user defined value
    {

    clearBitsInByteArrayLE(data,24,4); //Intel / little-endian

    }
    if (@CAN_PrivFront::RFL_Obj09B::RFL_Obj09B_ProtBlockCtr_FaultInject == 0)//BC: No Error, calculate BC
    {
      bc_RFL_Obj09B_RFL_Obj09B_ProtBlockCtr = bc_RFL_Object_ProtBlockCtr ;

      copyBitsToByteArrayLE(bc_RFL_Obj09B_RFL_Obj09B_ProtBlockCtr,data,24,4); //Intel / little-endian;
    }
    else if (@CAN_PrivFront::RFL_Obj09B::RFL_Obj09B_ProtBlockCtr_FaultInject == 1)//BC: Error sequence: set BC = 0
    {

      copyBitsToByteArrayLE(0,data,24,4); //Intel / little-endian;
    }
    else if (@CAN_PrivFront::RFL_Obj09B::RFL_Obj09B_ProtBlockCtr_FaultInject == 2)//BC: Error sequence: Freeze last valid value
    {

      copyBitsToByteArrayLE(bc_RFL_Obj09B_RFL_Obj09B_ProtBlockCtr,data,24,4); //Intel / little-endian;
    }
    if (@CAN_PrivFront::RFL_Obj09B::RFL_Obj09B_CRC_FaultInject != 3)//CRC: user defined value
    {

    clearBitsInByteArrayLE(data,0,16); //Intel / little-endian

    }
    if(@CAN_PrivFront::RFL_Obj09B::RFL_Obj09B_CRC_FaultInject == 0)//CRC: No Error, calculate CRC
    {
      crcTemp = CRC16_INIT;
      for(i = 2; i < (DataLength+2); i++)
      {
        if(i < DataLength)
          data_byte = data[i] ;
        else if(i == DataLength)
          data_byte = (Data_ID_Lookup_PRIVATE(Msg_id) & 0x00FF);
        else if(i == (DataLength+1))
          data_byte = (Data_ID_Lookup_PRIVATE(Msg_id) & 0xFF00) >> 8;
        else
          write("Error: DLC exceeded in CRC calculation");
        crcTemp ^= data_byte << 8;
        crcTemp = (crcTemp << (8)) ^ CRC16_CCITT_FALSE_POLY_1021H_Lookup[(crcTemp >> (8)) & (0xFF)];
      }
      crcTemp ^= CRC16_XOR;
      crc_RFL_Obj09B_RFL_Obj09B_CRC = crcTemp;

      copyBitsToByteArrayLE(crc_RFL_Obj09B_RFL_Obj09B_CRC,data,0,16); //Intel / little-endian;
    }
    else if(@CAN_PrivFront::RFL_Obj09B::RFL_Obj09B_CRC_FaultInject == 1)//CRC: Error, set to Zero
    {

      copyBitsToByteArrayLE(0,data,0,16); //Intel / little-endian;
    }
    else if(@CAN_PrivFront::RFL_Obj09B::RFL_Obj09B_CRC_FaultInject == 2)//CRC: Error, Freeze last valid value
    {

      copyBitsToByteArrayLE(crc_RFL_Obj09B_RFL_Obj09B_CRC,data,0,16); //Intel / little-endian;
    }
}


on sysvar CAN_PrivFront::RFL_ObjHdr::RFL_ObjHdr_ON_OFF
{
  if (@this == 1)
  {
     ILSetMsgEvent(RFL_ObjHdr);
     @CAN_PrivFront::RFL_ObjHdr::RFL_ObjHdr_ON_OFF = 0;
  }
}

void cfg_Msg_RFL_ObjHdr(dword aDlc, byte data[])
{
   int64 i,k;//For looping
   byte xor,data_byte;
   dword crcTemp;
   byte DataLength;
   dword Msg_id;
   
   DataLength = Msg_RFL_ObjHdr.DataLength;//Message Data Length
   Msg_id  = Msg_RFL_ObjHdr.id;//Message ID
   
    if (@CAN_PrivFront::RFL_ObjHdr::RFL_ObjHdr_AliveCtr_FaultInject != 3)//AC: user defined value
    {

    clearBitsInByteArrayLE(data,16,8); //Intel / little-endian

    }
    if (@CAN_PrivFront::RFL_ObjHdr::RFL_ObjHdr_AliveCtr_FaultInject == 0)//AC: No Error, calculate AC
    {
      ++counter_RFL_ObjHdr_RFL_ObjHdr_AliveCtr;
      counter_RFL_ObjHdr_RFL_ObjHdr_AliveCtr %=256;

      copyBitsToByteArrayLE(counter_RFL_ObjHdr_RFL_ObjHdr_AliveCtr,data,16,8); //Intel / little-endian;
    }
    else if (@CAN_PrivFront::RFL_ObjHdr::RFL_ObjHdr_AliveCtr_FaultInject == 1)//AC: Error sequence: set AC = 0
    {

      copyBitsToByteArrayLE(0,data,16,8); //Intel / little-endian;
    }
    else if (@CAN_PrivFront::RFL_ObjHdr::RFL_ObjHdr_AliveCtr_FaultInject == 2)//AC: Error sequence: Freeze last valid value
    {

      copyBitsToByteArrayLE(counter_RFL_ObjHdr_RFL_ObjHdr_AliveCtr,data,16,8); //Intel / little-endian;
    }
    if (@CAN_PrivFront::RFL_ObjHdr::RFL_ObjHdr_ProtBlockCtr_FaultInject != 3)//BC: user defined value
    {

    clearBitsInByteArrayLE(data,24,4); //Intel / little-endian

    }
    if (@CAN_PrivFront::RFL_ObjHdr::RFL_ObjHdr_ProtBlockCtr_FaultInject == 0)//BC: No Error, calculate BC
    {
      ++bc_RFL_ObjHdr_RFL_ObjHdr_ProtBlockCtr;
      bc_RFL_ObjHdr_RFL_ObjHdr_ProtBlockCtr %=16;
      bc_RFL_Object_ProtBlockCtr = bc_RFL_ObjHdr_RFL_ObjHdr_ProtBlockCtr ;

      copyBitsToByteArrayLE(bc_RFL_ObjHdr_RFL_ObjHdr_ProtBlockCtr,data,24,4); //Intel / little-endian;
    }
    else if (@CAN_PrivFront::RFL_ObjHdr::RFL_ObjHdr_ProtBlockCtr_FaultInject == 1)//BC: Error sequence: set BC = 0
    {

      copyBitsToByteArrayLE(0,data,24,4); //Intel / little-endian;
    }
    else if (@CAN_PrivFront::RFL_ObjHdr::RFL_ObjHdr_ProtBlockCtr_FaultInject == 2)//BC: Error sequence: Freeze last valid value
    {

      copyBitsToByteArrayLE(bc_RFL_ObjHdr_RFL_ObjHdr_ProtBlockCtr,data,24,4); //Intel / little-endian;
    }

    clearBitsInByteArrayLE(data,96,26); //Intel / little-endian

    //Msg_RFL_ObjHdr.RFL_ObjHdr_TimeStamp = @CAN_PrivFront::RFL_ObjHdr::RFL_ObjHdr_TimeStamp_FaultInject +(timeNowNS()/1000000);

      copyBitsToByteArrayLE(@CAN_PrivFront::RFL_ObjHdr::RFL_ObjHdr_TimeStamp_FaultInject +(timeNowNS()/1000000),data,96,26); //Intel / little-endian;
    if (@CAN_PrivFront::RFL_ObjHdr::RFL_ObjHdr_CRC_FaultInject != 3)//CRC: user defined value
    {

    clearBitsInByteArrayLE(data,0,16); //Intel / little-endian

    }
    if(@CAN_PrivFront::RFL_ObjHdr::RFL_ObjHdr_CRC_FaultInject == 0)//CRC: No Error, calculate CRC
    {
      crcTemp = CRC16_INIT;
      for(i = 2; i < (DataLength+2); i++)
      {
        if(i < DataLength)
          data_byte = data[i] ;
        else if(i == DataLength)
          data_byte = (Data_ID_Lookup_PRIVATE(Msg_id) & 0x00FF);
        else if(i == (DataLength+1))
          data_byte = (Data_ID_Lookup_PRIVATE(Msg_id) & 0xFF00) >> 8;
        else
          write("Error: DLC exceeded in CRC calculation");
        crcTemp ^= data_byte << 8;
        crcTemp = (crcTemp << (8)) ^ CRC16_CCITT_FALSE_POLY_1021H_Lookup[(crcTemp >> (8)) & (0xFF)];
      }
      crcTemp ^= CRC16_XOR;
      crc_RFL_ObjHdr_RFL_ObjHdr_CRC = crcTemp;

      copyBitsToByteArrayLE(crc_RFL_ObjHdr_RFL_ObjHdr_CRC,data,0,16); //Intel / little-endian;
    }
    else if(@CAN_PrivFront::RFL_ObjHdr::RFL_ObjHdr_CRC_FaultInject == 1)//CRC: Error, set to Zero
    {

      copyBitsToByteArrayLE(0,data,0,16); //Intel / little-endian;
    }
    else if(@CAN_PrivFront::RFL_ObjHdr::RFL_ObjHdr_CRC_FaultInject == 2)//CRC: Error, Freeze last valid value
    {

      copyBitsToByteArrayLE(crc_RFL_ObjHdr_RFL_ObjHdr_CRC,data,0,16); //Intel / little-endian;
    }
}


on sysvar CAN_PrivFront::RFL_Status::RFL_Status_ON_OFF
{
  if (@this == 1)
  {
    ILFaultInjectionEnableMsg(RFL_Status);
  }
  else{
         ILFaultInjectionDisableMsg(RFL_Status);
      }
}

void cfg_Msg_RFL_Status(dword aDlc, byte data[])
{
   int64 i,k;//For looping
   byte xor,data_byte;
   dword crcTemp;
   byte DataLength;
   dword Msg_id;
   
   DataLength = Msg_RFL_Status.DataLength;//Message Data Length
   Msg_id  = Msg_RFL_Status.id;//Message ID
   
    if (@CAN_PrivFront::RFL_Status::RFL_Status_AliveCtr_FaultInject != 3)//AC: user defined value
    {

    clearBitsInByteArrayLE(data,8,4); //Intel / little-endian

    }
    if (@CAN_PrivFront::RFL_Status::RFL_Status_AliveCtr_FaultInject == 0)//AC: No Error, calculate AC
    {
      ++counter_RFL_Status_RFL_Status_AliveCtr;
      counter_RFL_Status_RFL_Status_AliveCtr %=16;

      copyBitsToByteArrayLE(counter_RFL_Status_RFL_Status_AliveCtr,data,8,4); //Intel / little-endian;
    }
    else if (@CAN_PrivFront::RFL_Status::RFL_Status_AliveCtr_FaultInject == 1)//AC: Error sequence: set AC = 0
    {

      copyBitsToByteArrayLE(0,data,8,4); //Intel / little-endian;
    }
    else if (@CAN_PrivFront::RFL_Status::RFL_Status_AliveCtr_FaultInject == 2)//AC: Error sequence: Freeze last valid value
    {

      copyBitsToByteArrayLE(counter_RFL_Status_RFL_Status_AliveCtr,data,8,4); //Intel / little-endian;
    }
    if (@CAN_PrivFront::RFL_Status::RFL_Status_CRC_FaultInject != 3)//CRC: user defined value
    {

    clearBitsInByteArrayLE(data,0,8); //Intel / little-endian

    }
    if(@CAN_PrivFront::RFL_Status::RFL_Status_CRC_FaultInject == 0)//CRC: No Error, calculate CRC
    {
      xor = initialization_value;
      for(i = 0; i < DataLength; i++)
      {
        if(i==0)
          xor = CRC8_SAE_J1850_Poly_1D_Lookup[Data_ID_Lookup_PRIVATE(Msg_id) ^ xor];
        else
          xor = CRC8_SAE_J1850_Poly_1D_Lookup[ data[i] ^ xor ];
      }
      crc_RFL_Status_RFL_Status_CRC = result_XOR_value ^ xor;

      copyBitsToByteArrayLE(crc_RFL_Status_RFL_Status_CRC,data,0,8); //Intel / little-endian;
    }
    else if(@CAN_PrivFront::RFL_Status::RFL_Status_CRC_FaultInject == 1)//CRC: Error, set to Zero
    {

      copyBitsToByteArrayLE(0,data,0,8); //Intel / little-endian;
    }
    else if(@CAN_PrivFront::RFL_Status::RFL_Status_CRC_FaultInject == 2)//CRC: Error, Freeze last valid value
    {

      copyBitsToByteArrayLE(crc_RFL_Status_RFL_Status_CRC,data,0,8); //Intel / little-endian;
    }
}


on sysvar CAN_PrivFront::RFL_Status::RFL_Status_CycleTime
{
  ILFaultInjectionSetMsgCycleTime(RFL_Status,@this);
  //ILFaultInjectionResetMsgCycleTime(RFL_Status);
}

void CRadarFL_sim_SetCycleTimeOffset()
{

//  ILNodeSetPDUTimingCyclic (dbMsg dbMessage, long TrueOrFalse, long offset, long period, long disturbanceCount, long flags);
//  TrueOrFalse ; 0: denotes the False timing; 1: denotes the True timing; 3: denotes the True and the False timing.
//  offset :Defines the delay in [ms] from now when the first cyclic transmission will start.
//  period :Defines the period in [ms] for the cyclic transmission.
//  disturbanceCount :Reserved/unused; should be set to -1 (infinite).
//  flags :Reserved; should be set to 0.

}