/*@!Encoding:65001*/
includes
{
  
}

variables
{
  
}

on key 'a'

{
  
////   @sysvar::CAN_RadarFL::Toliman::RXX_Location_NPdu_FC::GeneralSettings::sysTxIdentifier = 0x409;
////   @sysvar::CAN_RadarFL::Toliman::RXX_Location_NPdu_FC::GeneralSettings::sysRxIdentifier = 0x408;
//   @sysvar::CAN_RadarFL::Toliman::RXX_Location_NPdu_FC::GeneralSettings::sysECUAddress = 0;
//   @sysvar::CAN_RadarFL::Toliman::RXX_Location_NPdu_FC::GeneralSettings::sysTargetAddress = 3;
  
//   @sysvar::CAN_RadarFL::Toliman::RXX_Location_NPdu_FC::GeneralSettings::sysAddrMode = 0; chan
//   @sysvar::CAN_RadarFL::Toliman::RXX_Location_NPdu_FC::GeneralSettings::sysAddrExtension = 0x7;
//   @sysvar::CAN_RadarFL::Toliman::RXX_Location_NPdu_FC::GeneralSettings::sysBaseAddress = 0x600;
//   @sysvar::CAN_RadarFL::Toliman::RXX_Location_NPdu_FC::GeneralSettings::sysUseExtId = 0;
////   @sysvar::CAN_RadarFL::Toliman::RXX_Location_NPdu_FC::GeneralSettings::sysMaxFDFrameLen = 64;
  
  // Flow control
////   @sysvar::CAN_RadarFL::Toliman::RXX_Location_NPdu_FC::GeneralSettings::sysUseFC = 1;
////   @sysvar::CAN_RadarFL::Toliman::RXX_Location_NPdu_FC::GeneralSettings::sysBlockSize = 0;
////   @sysvar::CAN_RadarFL::Toliman::RXX_Location_NPdu_FC::GeneralSettings::sysSTmin = 0;
////   @sysvar::CAN_RadarFL::Toliman::RXX_Location_NPdu_FC::GeneralSettings::sysFlowControlDelay = 0;
////   @sysvar::CAN_RadarFL::Toliman::RXX_Location_NPdu_FC::GeneralSettings::sysUseFCBlockSize = 0;
  
  
  // Miscellaenous
 //  @sysvar::CAN_RadarFL::Toliman::RXX_Location_NPdu_FC::GeneralSettings::sysStartSN = 1;
////   @sysvar::CAN_RadarFL::Toliman::RXX_Location_NPdu_FC::GeneralSettings::sysMaxReceiveLength = 429496;
 //  @sysvar::CAN_RadarFL::Toliman::RXX_Location_NPdu_FC::GeneralSettings::sysPaddingValue = 0;
////   @sysvar::CAN_RadarFL::Toliman::RXX_Location_NPdu_FC::GeneralSettings::sysBitRateSwitch = 1; chan
  
//  @Toliman::RXX_Location_NPdu_FC::sysNoOfBytesToFill = 200;
//  @Toliman::RXX_Location_NPdu_FC::sysFillData = 1;
//   @sysvar::CAN_RadarFL::Toliman::RXX_Location_NPdu_FC::GeneralSettings::sysSendData = 1;
  // @sysvar::CAN_RadarFL::Toliman::RXX_Location_NPdu_FC::GeneralSettings::sysSendData = 0;

////  @sysvar::CAN_RadarFL::CRadarFL::RXX_Location_NPdu_Data::GeneralSettings::sysTxIdentifier = 0x408;
////  @sysvar::CAN_RadarFL::CRadarFL::RXX_Location_NPdu_Data::GeneralSettings::sysRxIdentifier = 0x409;
  
//  @sysvar::CAN_RadarFL::CRadarFL::RXX_Location_NPdu_Data::GeneralSettings::sysECUAddress = 0;
//  @sysvar::CAN_RadarFL::CRadarFL::RXX_Location_NPdu_Data::GeneralSettings::sysTargetAddress = 3;
  
// // @sysvar::CAN_RadarFL::CRadarFL::RXX_Location_NPdu_Data::GeneralSettings::sysAddrMode = 0;  changed
//  @sysvar::CAN_RadarFL::CRadarFL::RXX_Location_NPdu_Data::GeneralSettings::sysAddrExtension = 0x7;
//  @sysvar::CAN_RadarFL::CRadarFL::RXX_Location_NPdu_Data::GeneralSettings::sysBaseAddress = 0x600;
//  @sysvar::CAN_RadarFL::CRadarFL::RXX_Location_NPdu_Data::GeneralSettings::sysUseExtId = 0;
////  @sysvar::CAN_RadarFL::CRadarFL::RXX_Location_NPdu_Data::GeneralSettings::sysMaxFDFrameLen = 64;
  
  // Flow control
//  @sysvar::CAN_RadarFL::CRadarFL::RXX_Location_NPdu_Data::GeneralSettings::sysUseFC = 1;
//  @sysvar::CAN_RadarFL::CRadarFL::RXX_Location_NPdu_Data::GeneralSettings::sysBlockSize = 2;
//  @CRadarFL::RXX_Location_NPdu_FC::GeneralSettings::sysSTmin = 0x14;
//  @CRadarFL::RXX_Location_NPdu_FC::GeneralSettings::sysFlowControlDelay = 10;
//  @sysvar::CAN_RadarFL::CRadarFL::RXX_Location_NPdu_Data::GeneralSettings::sysUseFCBlockSize = 0;
  
  // Miscellaenous
//  @sysvar::CAN_RadarFL::CRadarFL::RXX_Location_NPdu_Data::GeneralSettings::sysStartSN = 1;
 // @sysvar::CAN_RadarFL::CRadarFL::RXX_Location_NPdu_Data::GeneralSettings::sysMaxReceiveLength = 4095;
//  @CRadarFL::RXX_Location_NPdu_FC::GeneralSettings::sysPaddingValue = 0;
//  //@sysvar::CAN_RadarFL::CRadarFL::RXX_Location_NPdu_Data::GeneralSettings::sysBitRateSwitch = 1;   changed
  
//  @CRadarFL::RXX_Location_NPdu_Data::sysNoOfBytesToFill = 200;
//  @CRadarFL::RXX_Location_NPdu_Data::sysFillData = 1;
//  @CRadarFL::RXX_Location_NPdu_Data::GeneralSettings::sysSendData = 1;
  //@CRadarFL::RXX_Location_NPdu_Data::GeneralSettings::sysSendData = 0;
////   @sysvar::CAN_RadarFL::CRadarFL::RXX_Location_NPdu_Data::sysNoOfBytesToFill = 400;
////  @sysvar::CAN_RadarFL::CRadarFL::RXX_Location_NPdu_Data::sysFillData = 1;
//// @sysvar::CAN_RadarFL::CRadarFL::RXX_Location_NPdu_Data::GeneralSettings::sysSendData = 1;
  @sysvar::CAN_RadarFL::RXX_Location::RXX_Location_ON_OFF = 1; 
  
}
