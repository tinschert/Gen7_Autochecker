/*@!Encoding:1252*/
/**
 * @file Test_Sensor_Data_Protocol_PrivFront_RFL_RFR.can
 * @author ADAS_HIL_TEAM
 * @date 11-10-2023
 * @brief 
 *
 * ################################################################
 * C O P Y R I G H T S
 * ----------------------------------------------------------------
 * Copyright (c) 2023 by Robert Bosch GmbH. All rights reserved.
 
 * The reproduction, distribution and utilization of this file as
 * well as the communication of its contents to others without express
 * authorization is prohibited. Offenders will be held liable for the
 * payment of damages. All rights reserved in the event of the grant
 * of a patent, utility model or design.
 *
 * ################################################################
*/

variables
{
  //RFL
  int g_flag = 0;
  int g_flag_1 = 0;
  message can3.0x210 msg5;
  message can3.0x211 msg6;
  message can3.0x212 msg7;
  message can3.0x213 msg8;
  //RFR
  int g_flag_RFR = 0;
  int g_flag_1_RFR = 0;
  message can3.0x610 msg1;
  message can3.0x611 msg2;
  message can3.0x612 msg3;
  message can3.0x613 msg4;
}

//For RFL
on key '9'//wrong data
{
g_flag=1;
}
on key '8'//stop
{
  g_flag = 0;
  g_flag_1 = 0;
}

on key '7'//right data
{
  g_flag_1 = 1;
}

//For RFR
on key 'c'//wrong data
{
g_flag_RFR=1;
}
on key 'b'//stop
{
  g_flag_RFR = 0;
  g_flag_1_RFR = 0;
}

on key 'a'//right data
{
  g_flag_1_RFR = 1;
}

//For RFL
on message CAN_PrivFront::RFL_ObjHdr
{
  if ((this.msgChannel==3) &&(this.id==517) )//Added msg ID here as we were getting 2 msgs at a time
  { 
    if (g_flag==1)//key 'b'
    {
    Output(msg6);  
    Output(msg7);
    Output(msg5);  
    Output(msg8);
    }
    if (g_flag_1==1)
    {
    //write("key a, start sending location data");
    Output(msg5);  
    Output(msg6);
    Output(msg7);  
    Output(msg8);
    }
  }
}


//For RFR
on message CAN_PrivFront::RFR_ObjHdr
{
  if ((this.msgChannel==3) &&(this.id==1541) )
  { 
    if (g_flag_RFR==1)//key 'h'
    {
    Output(msg2);  
    Output(msg3);
    Output(msg1);  
    Output(msg4);
    }
    if (g_flag_1_RFR==1)
    {
    //write("key g, start sending location data");
    Output(msg1);  
    Output(msg2);
    Output(msg3);  
    Output(msg4);
    }
  }
}

on start
{
  g_flag = 0;
  g_flag_1 = 0;
  
  g_flag_RFR = 0;
  g_flag_1_RFR = 0;
}
on stopMeasurement
{
  g_flag = 0;
  g_flag_1 = 0;
  
  g_flag_RFR = 0;
  g_flag_1_RFR = 0;
}