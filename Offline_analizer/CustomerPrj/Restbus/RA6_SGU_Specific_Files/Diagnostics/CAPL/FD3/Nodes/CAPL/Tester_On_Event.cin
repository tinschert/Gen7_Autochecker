/*@!Encoding:1252*/
/*******************************************************************************
	MODULEFILE_DESCRIPTION:DIAG_FD3
	COPYRIGHT:
	Robert Bosch GmbH reserves all rights even in the event of industrial
	property. We reserve all rights of disposal such as copying and passing
	on to third parties.
	COPYRIGHT_END:

	PROJECT:		  Implements Basic UDS functionality as a Tester Node
	FILENAME:		  GenericTester1.cin

	DESCRIPTION:  CAPL-Program for DIAG/UDS over CAN/CAN-FD simulation via OSEK_TP.
  REFERENCE  :  Sample Osek Configuration [Vector standards  ]

	HISTORY:
        Version1: 28.08.2021 ; DUE1KOR ; Initial Version 

*****************************************************************************/
variables
{
  msTimer tSwitchOffRxLEDTester1;
  msTimer tSwitchOffTxLEDTester1;
  msTimer tSwitchOffErrLEDTester1;
  msTimer tFlashRxLEDTester1;
  msTimer tFlashTxLEDTester1;
  msTimer tFlashErrLEDTester1;
  long gHandleTester1;

  long gECUAddress_Tester1 = 0;
  long gTargetAddress_Tester1 = 0;
  long gTxIdentifier_Tester1 = 0;
  long gRxIdentifier_Tester1 = 0;
}

on timer tSwitchOffRxLEDTester1
{
  // Switch off led for RcvdData
  cancelTimer(tFlashRxLEDTester1);
  @sysvar::DIAG_FD3::GeneralSettings::sysDataReceivedInd = 0;
}

on timer tSwitchOffTxLEDTester1
{
  cancelTimer(tFlashTxLEDTester1);
  @sysvar::DIAG_FD3::GeneralSettings::sysDataTransmittedConf = 0;
}

on timer tSwitchOffErrLEDTester1
{
  cancelTimer(tFlashErrLEDTester1);
  @sysvar::DIAG_FD3::GeneralSettings::sysErrorInd = 0;
}

on timer tFlashRxLEDTester1
{
  // toggle Rx LED
  @sysvar::DIAG_FD3::GeneralSettings::sysDataReceivedInd = @sysvar::DIAG_FD3::GeneralSettings::sysDataReceivedInd ? 0 : 1;
}

on timer tFlashTxLEDTester1
{
  // toggle Tx LED
  @sysvar::DIAG_FD3::GeneralSettings::sysDataTransmittedConf = @sysvar::DIAG_FD3::GeneralSettings::sysDataTransmittedConf ? 0 : 1;
}

on timer tFlashErrLEDTester1
{
  // toggle Err LED
  @sysvar::DIAG_FD3::GeneralSettings::sysErrorInd = @sysvar::DIAG_FD3::GeneralSettings::sysErrorInd ? 0 : 1;
}

on sysVar sysvar::DIAG_FD3::GeneralSettings::sysTxIdentifier
{
  long addressingMode;
  long extIdFlag;
  
  extIdFlag = 0;

  if (@this == gTxIdentifier_Tester1) {
    //change has already been done in Init function
    return;
  }

  gTxIdentifier_Tester1 = @this;
  addressingMode = CanTpGetAddressingMode(gHandleTester1);

  if (addressingMode == kNormal ||
      addressingMode == kExtendedFree ||
      addressingMode == kMixed11Bit)
  {
    if (@sysvar::DIAG_FD3::GeneralSettings::sysUseExtId) {
      extIdFlag = 0x80000000;
    }
    CanTpSetTxIdentifier(gHandleTester1, extIdFlag | @this);
    writeDbgLevel(1, "%s, connection %d: Tx Id = 0x%x", gECU, kIdTester1,
                  CanTpGetTxIdentifier(gHandleTester1));
  }
}

on sysVar sysvar::DIAG_FD3::GeneralSettings::sysTargetAddress
{
  long addressingMode;

  if (@this == gTargetAddress_Tester1) {
    //change has already been done in Init function
    return;
  }

  gTargetAddress_Tester1 = @this;
  addressingMode = CanTpGetAddressingMode(gHandleTester1);

  if (addressingMode == kExtendedBased ||
      addressingMode == kExtendedFree ||
      addressingMode == kNormalFixed ||
      addressingMode == kMixed)
  {
    CanTpSetTargetAddress(gHandleTester1, @this);
    writeDbgLevel(1,"%s, connection %d: Target address = 0x%x", gECU, kIdTester1,
                  CanTpGetTargetAddress(gHandleTester1));
  }
}

on sysVar sysvar::DIAG_FD3::GeneralSettings::sysRxIdentifier
{
  long addressingMode;
  long extIdFlag;
  
  extIdFlag = 0;

  if (@this == gRxIdentifier_Tester1) {
    //change has already been done in Init function
    return;
  }

  gRxIdentifier_Tester1 = @this;
  addressingMode = CanTpGetAddressingMode(gHandleTester1);

  if (addressingMode == kNormal ||
      addressingMode == kExtendedFree ||
      addressingMode == kMixed11Bit)
  {
    if (@sysvar::DIAG_FD3::GeneralSettings::sysUseExtId) {
      extIdFlag = 0x80000000;
    }
    CanTpSetRxIdentifier(gHandleTester1, extIdFlag | @this);
    writeDbgLevel(1, "%s, connection %d: Rx Id = 0x%x", gECU, kIdTester1,
                  CanTpGetRxIdentifier(gHandleTester1));
  }
}

on sysVar sysvar::DIAG_FD3::GeneralSettings::sysECUAddress
{
  long addressingMode;

  if (@this == gECUAddress_Tester1) {
    //change has already been done in Init function
    return;
  }

  gECUAddress_Tester1 = @this;
  addressingMode = CanTpGetAddressingMode(gHandleTester1);

  if (addressingMode == kExtendedBased ||
      addressingMode == kExtendedFree ||
      addressingMode == kNormalFixed ||
      addressingMode == kMixed)
  {
    CanTpSetEcuAddress(gHandleTester1, @this);
    writeDbgLevel(1,"%s, connection %d: ECU address = 0x%02x", gECU, kIdTester1,
                  CanTpGetEcuAddress(gHandleTester1));
  }
}

on sysVar sysvar::DIAG_FD3::GeneralSettings::sysAddrMode
{
  InitTester1();
}

on sysVar sysvar::DIAG_FD3::GeneralSettings::sysBaseAddress
{
  long addressingMode;

  addressingMode = CanTpGetAddressingMode(gHandleTester1);
  if (addressingMode == kExtendedBased)
  {
    CanTpSetBaseIdentifier(gHandleTester1, @this);
    writeDbgLevel(1,"%s, connection %d: Base address = 0x%x",
                  gECU, kIdTester1, CanTpGetBaseIdentifier(gHandleTester1));
  }
}

on sysVar sysvar::DIAG_FD3::GeneralSettings::sysAddrExtension
{
  long addressingMode;

  addressingMode = CanTpGetAddressingMode(gHandleTester1);
  if (addressingMode == kMixed || addressingMode == kMixed11Bit)
  {
    CanTpSetAddressExtension(gHandleTester1, @this);
    writeDbgLevel(1,"%s, connection %d: Address extension = %d",
                  gECU, kIdTester1, CanTpGetAddressExtension(gHandleTester1));
  }
}

on sysVar sysvar::DIAG_FD3::GeneralSettings::sysUseExtId
{
  InitTester1();
}

on sysVar sysvar::DIAG_FD3::GeneralSettings::sysUseFC
{
  CanTpUseFlowControlFrames(gHandleTester1, @this);
  writeDbgLevel(1,"%s, connection %d: Use flow control = %d",
                gECU, kIdTester1, CanTpIsUseFlowControlFrames(gHandleTester1));
}

on sysVar sysvar::DIAG_FD3::GeneralSettings::sysBlockSize
{
  CanTpSetBlockSize(gHandleTester1, @this);
  writeDbgLevel(1,"%s, connection %d: Block size = %d",
                gECU, kIdTester1, CanTpGetBlockSize(gHandleTester1));
}

on sysVar sysvar::DIAG_FD3::GeneralSettings::sysSTmin
{
  CanTpSetSTmin(gHandleTester1, @this);
  writeDbgLevel(1,"%s, connection %d: ST min = %d",
                gECU, kIdTester1, CanTpGetSTmin(gHandleTester1));
}

on sysVar sysvar::DIAG_FD3::GeneralSettings::sysFlowControlDelay
{
  CanTpSetFlowControlDelay(gHandleTester1, @this);
  writeDbgLevel(1,"%s, connection %d: Flow control delay = %d ms",
                gECU, kIdTester1, @this);
}

on sysVar sysvar::DIAG_FD3::GeneralSettings::sysUseFCBlockSize
{
  CanTpUseFlowControlBlockSize(gHandleTester1, @this);
  writeDbgLevel(1,"%s, connection %d: Use FC block size setting in panel = %d",
                gECU, kIdTester1, @this);
  writeDbgLevel(1,"%s, connection %d: Use FC block size = %d",
                gECU, kIdTester1, CanTpIsUseFlowControlBlockSize(gHandleTester1));
}

on sysVar sysvar::DIAG_FD3::GeneralSettings::sysStartSN
{
  CanTpSetFirstSequenceNumber(gHandleTester1, @this);
  writeDbgLevel(1,"%s, connection %d: Start SN = %d",
                gECU, kIdTester1, CanTpGetFirstSequenceNumber(gHandleTester1));
}

on sysVar sysvar::DIAG_FD3::GeneralSettings::sysMaxReceiveLength
{
  CanTpSetMaximumReceiveLength(gHandleTester1, @this);
  writeDbgLevel(1,"%s, connection %d: Max. receiver length = %d",
                gECU, kIdTester1, CanTpGetMaximumReceiveLength(gHandleTester1));
}

on sysVar sysvar::DIAG_FD3::GeneralSettings::sysPaddingValue
{
  set_sysPaddingValue(@this);
}

set_sysPaddingValue(int64 PaddingValue)
{
    CanTpSetPadding(gHandleTester1, PaddingValue);
  writeDbgLevel(1,"%s, connection %d: Padding value = %d",
                gECU, kIdTester1, CanTpGetPadding(gHandleTester1));
}

on sysVar sysvar::DIAG_FD3::GeneralSettings::sysBitRateSwitch
{
 
  if( 1 != gbCANFDactive)
  {
    writeDbgLevel( 0, "%s, sysCANFDactive: Cannot configure CAN FD since not active", gECU);
    return;
  }

  CanTpSetBitRateSwitch(gHandleTester1, @this);
  writeDbgLevel(1,"%s, connection %d: CAN FD bit rate switch = %d",
                gECU, kIdTester1, @this);
}

on sysVar sysvar::DIAG_FD3::GeneralSettings::sysMaxFDFrameLen
{
  set_sysMaxFDFrameLen(@this);
}

set_sysMaxFDFrameLen(int64 FDFrameLen)
{
  if( 1 != gbCANFDactive)
  {
    writeDbgLevel( 0, "%s, sysMaxFDFrameLen: Cannot configure CAN FD since not active", gECU);
    return;
  }

  CanTpSetMaxCANFDFrameLength(gHandleTester1, FDFrameLen);
  
  if( FDFrameLen > 0)
    writeDbgLevel(1,"%s, connection %d: Max CAN FD frame length = %d",
                  gECU, kIdTester1, FDFrameLen);
  else
    writeDbgLevel(1,"%s, connection %d: Activating CAN 2.0",
                  gECU, kIdTester1);
  
  {
    // Update padding value since the default may have changed
    long paddingValue;
    paddingValue = CanTpGetPadding( gHandleTester1); // same default for all configurations
    writeDbgLevel( 1, "%s, connection %d: Padding value = %d"
    , gECU, kIdTester1, paddingValue);
    @sysvar::DIAG_FD3::GeneralSettings::sysPaddingValue = paddingValue;
  }
}

on sysVar sysvar::DIAG_FD3::GeneralSettings::sysSendData
{
  // Prevent from sending when button is released
  if (@this == 0)
      return;

  DirectTxDataLen = GetDataToTransmit(TxDataBuffer);
  StartDiagService( DIRECT_RQ );

}

on sysVar sysvar::DIAG_FD3::GeneralSettings::sysResetToDefaultSettings
{
  if (@this > 0) {
    ResetToDefaultSettingsTester1();
  }
}

on sysVar sysvar::DIAG_FD3::sysClearData
{
  if (@this)
  {
     ClearReceivedData();
  }
}

on sysVar sysvar::DIAG_FD3::sysFillData
{
  long i, txCount;
  byte sendString[kBufferSizeJumbo];
  
  // No action if button is released

  if (@this==0)
      return;

  txCount = @sysvar::DIAG_FD3::sysNoOfBytesToFill;

  // don't write over array limits
  // limit size to prevent extremely long transfers

  if( txCount>kBufferSizeJumbo)
  {
    txCount=kBufferSizeJumbo;
    @sysvar::DIAG_FD3::sysNoOfBytesToFill = txCount;
    writeDbgLevel(1,"%s: Length of data string to be sent is limited to %d bytes",
                  gECU, kBufferSizeJumbo);
  }

  for( i=0; i<txCount; i++ )
  {
    sendString[i] = '0'+i%75;
  }

  sysSetVariableData(sysvar::DIAG_FD3::sysDataToTransmit, sendString, txCount);
}

on sysvar sysvar::DIAG_FD3::sysDataToTransmit
{
  byte sendString[kBufferSizeJumbo];
  
  long copiedBytes;

  if (sysGetVariableArrayLength(this) >= elcount( sendString)) {
    writeDbgLevel(1,"%s: Data string to be sent is too large (%d), truncated to %d bytes",
                  gECU, sysGetVariableArrayLength(this), kBufferSizeJumbo);
    sysGetVariableData(this, sendString, copiedBytes);
    sysSetVariableData(this, sendString, elcount( sendString));
    // sysVar handler will be called again
  } else {
    sysGetVariableData(this, sendString, copiedBytes);
    @sysvar::DIAG_FD3::sysNoOfBytesToSend = copiedBytes;
  }
}

on sysVar sysvar::sysDbgLevel
{
  setwriteDbgLevel(@this);
}

on sysVar sysvar::sysTPVerboseLevel
{
  CanTpSetVerbosity(@this);
}


