/*@!Encoding:1252*/
/*******************************************************************************
	MODULEFILE_DESCRIPTION:DIAG_TESTER
	COPYRIGHT:
	Robert Bosch GmbH reserves all rights even in the event of industrial
	property. We reserve all rights of disposal such as copying and passing
	on to third parties.
	COPYRIGHT_END:

	PROJECT:		  Implements Basic UDS functionality as a Tester Node
	FILENAME:		  DIAG_TESTER.cin

	DESCRIPTION:  CAPL-Program for DIAG/UDS over CAN/CAN-FD simulation via OSEK_TP.
  REFERENCE  :  Sample Osek Configuration [Vector standards  ]

	HISTORY:
        Version1: 28.08.2021 ; DUE1KOR ; Initial Version 

*****************************************************************************/
includes
{
  #include "GenericNode.cin"
}

variables
{
}

