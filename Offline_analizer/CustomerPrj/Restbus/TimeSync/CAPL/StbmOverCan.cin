/*@!Encoding:1252*/
/**
 * @file StbmOverCan.cin
 * @author ADAS_HIL_TEAM
 * @date 09-26-2023
 * @brief Generic function defination for stbm over CAN ADAS.
 *
 * ################################################################
 * C O P Y R I G H T S
 * ----------------------------------------------------------------
 * Copyright (c) 2023 by Robert Bosch GmbH. All rights reserved.
 
 * The reproduction, distribution and utilization of this file as
 * well as the communication of its contents to others without express
 * authorization is prohibited. Offenders will be held liable for the
 * payment of damages. All rights reserved in the event of the grant
 * of a patent, utility model or design.
 *
 * ################################################################
*/

variables
{
  byte CRC_INITIAL_VALUE8H2F = 0xFF;
  const FALSE	=	0;
	const TRUE 	= 	!FALSE;
  byte CRC_XOR_VALUE8H2F = 0xFF;
  byte crc_buffer_index = 0;
  byte crc_buffer[7] = {0,0,0,0,0,0,0};
 
  //Reference
  //Doors:https://rb-alm-13-p-dwa.de.bosch.com:8443/dwa/rm/urn:rational::1-4147106800294823-O-1224-00186f2c?doors.view=00000006
  //Docupedia::https://inside-docupedia.bosch.com/confluence/display/CCD/Time+Synchronization#TimeSynchronization-ECUconfiguration
  
  byte DataIDList_Sync[16]={10, 90, 149, 154, 192, 228, 12, 92, 225, 93, 230, 6, 173, 5, 236, 55}; //Sync Data-IDs for RA6
  byte DataIDList_Fup[16] ={74, 205, 180, 22, 232, 113, 36, 223, 153, 248, 90, 13, 89, 243, 139, 59}; //Follow-up Data-IDs for RA6
  
  byte Crc8C2Pol_UB[256] = {
      /*    0: */    0x0,     0x2f,    0x5e,    0x71,    0xbc,    0x93,    0xe2,    0xcd,
			/*    8: */    0x57,    0x78,    0x9,     0x26,    0xeb,    0xc4,    0xb5,    0x9a,
			/*   16: */    0xae,    0x81,    0xf0,    0xdf,    0x12,    0x3d,    0x4c,    0x63,
			/*   24: */    0xf9,    0xd6,    0xa7,    0x88,    0x45,    0x6a,    0x1b,    0x34,
			/*   32: */    0x73,    0x5c,    0x2d,    0x2,     0xcf,    0xe0,    0x91,    0xbe,
			/*   40: */    0x24,    0xb,     0x7a,    0x55,    0x98,    0xb7,    0xc6,    0xe9,
			/*   48: */    0xdd,    0xf2,    0x83,    0xac,    0x61,    0x4e,    0x3f,    0x10,
			/*   56: */    0x8a,    0xa5,    0xd4,    0xfb,    0x36,    0x19,    0x68,    0x47,
			/*   64: */    0xe6,    0xc9,    0xb8,    0x97,    0x5a,    0x75,    0x4,     0x2b,
			/*   72: */    0xb1,    0x9e,    0xef,    0xc0,    0xd,     0x22,    0x53,    0x7c,
			/*   80: */    0x48,    0x67,    0x16,    0x39,    0xf4,    0xdb,    0xaa,    0x85,
			/*   88: */    0x1f,    0x30,    0x41,    0x6e,    0xa3,    0x8c,    0xfd,    0xd2,
			/*   96: */    0x95,    0xba,    0xcb,    0xe4,    0x29,    0x6,     0x77,    0x58,
			/*  104: */    0xc2,    0xed,    0x9c,    0xb3,    0x7e,    0x51,    0x20,    0xf,
			/*  112: */    0x3b,    0x14,    0x65,    0x4a,    0x87,    0xa8,    0xd9,    0xf6,
			/*  120: */    0x6c,    0x43,    0x32,    0x1d,    0xd0,    0xff,    0x8e,    0xa1,
			/*  128: */    0xe3,    0xcc,    0xbd,    0x92,    0x5f,    0x70,    0x1,     0x2e,
			/*  136: */    0xb4,    0x9b,    0xea,    0xc5,    0x8,     0x27,    0x56,    0x79,
			/*  144: */    0x4d,    0x62,    0x13,    0x3c,    0xf1,    0xde,    0xaf,    0x80,
			/*  152: */    0x1a,    0x35,    0x44,    0x6b,    0xa6,    0x89,    0xf8,    0xd7,
			/*  160: */    0x90,    0xbf,    0xce,    0xe1,    0x2c,    0x3,     0x72,    0x5d,
			/*  168: */    0xc7,    0xe8,    0x99,    0xb6,    0x7b,    0x54,    0x25,    0xa,
			/*  176: */    0x3e,    0x11,    0x60,    0x4f,    0x82,    0xad,    0xdc,    0xf3,
			/*  184: */    0x69,    0x46,    0x37,    0x18,    0xd5,    0xfa,    0x8b,    0xa4,
			/*  192: */    0x5,     0x2a,    0x5b,    0x74,    0xb9,    0x96,    0xe7,    0xc8,
			/*  200: */    0x52,    0x7d,    0xc,     0x23,    0xee,    0xc1,    0xb0,    0x9f,
			/*  208: */    0xab,    0x84,    0xf5,    0xda,    0x17,    0x38,    0x49,    0x66,
			/*  216: */    0xfc,    0xd3,    0xa2,    0x8d,    0x40,    0x6f,    0x1e,    0x31,
			/*  224: */    0x76,    0x59,    0x28,    0x7,     0xca,    0xe5,    0x94,    0xbb,
			/*  232: */    0x21,    0xe,     0x7f,    0x50,    0x9d,    0xb2,    0xc3,    0xec,
			/*  240: */    0xd8,    0xf7,    0x86,    0xa9,    0x64,    0x4b,    0x3a,    0x15,
			/*  248: */    0x8f,    0xa0,    0xd1,    0xfe,    0x33,    0x1c,    0x6d,    0x42
    };
    
}


byte PROJ_CRC_Cal(byte Crc_DataPtr[], int Crc_Length, int Crc_StartValue8, int Crc_IsFirstCall)//function of calculate the CRC
{
    byte  index;
    byte  crcTemp;
    byte  result;


    if (Crc_IsFirstCall != FALSE)
    {
    	  crcTemp = (CRC_INITIAL_VALUE8H2F);
    }
    else
    {
  	    crcTemp = (Crc_StartValue8^(CRC_XOR_VALUE8H2F));
    }

    for (index = 0; index < Crc_Length; ++index)
    {
        /* Impact of temporary rest on next crc rest */
        crcTemp ^= Crc_DataPtr.byte(index);

        /* Next temporary crc rest */
        crcTemp  = Crc8C2Pol_UB[crcTemp];
    }
    result = crcTemp^(CRC_XOR_VALUE8H2F);
	
    return (result);
}

dword  calculateTotalTime(dword  seconds, dword  nanoseconds) //microseconds 
{
    dword totalTime,secondsToMicroseconds,nanosecondsToMicroseconds;

    // Convert time in seconds to microseconds
    secondsToMicroseconds = seconds * 1000000;
    //write("Debugging:secondsToMicroseconds:::%d",secondsToMicroseconds);

    // Convert time in nanoseconds to microseconds
    nanosecondsToMicroseconds = nanoseconds / 1000;
    //write("Debugging:nanosecondsToMicroseconds:::%d",nanosecondsToMicroseconds);

    // Calculate total time in microseconds
    totalTime = secondsToMicroseconds + nanosecondsToMicroseconds;
    //write("Debugging:totalTime:::%d %X",totalTime,totalTime);
  
    return totalTime;
}