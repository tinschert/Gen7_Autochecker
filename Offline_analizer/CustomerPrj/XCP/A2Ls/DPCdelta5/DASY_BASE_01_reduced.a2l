ASAP2_VERSION 1 71
/begin PROJECT jlr_my20_base ""
/begin MODULE CPP ""
/begin MOD_COMMON "" ALIGNMENT_BYTE 1 ALIGNMENT_WORD 2 ALIGNMENT_LONG 4 ALIGNMENT_FLOAT16_IEEE 2 ALIGNMENT_FLOAT32_IEEE 4 ALIGNMENT_FLOAT64_IEEE 4 ALIGNMENT_INT64 4 /end MOD_COMMON
/begin MEASUREMENT _g_PL_AD_fw_OneDrivingSW_fct_fct_mainproc_ods_fct_ods_fct_mainproc_RunnableMainProc_m_portMainProc_out_local.m_estSignalsExt.m_estBrakeJerkRequestStatus "" UBYTE NO_COMPU_METHOD 0 0 0 255 BYTE_ORDER MSB_LAST ECU_ADDRESS 0xB0032631 ECU_ADDRESS_EXTENSION 0x8 /end MEASUREMENT
/begin MEASUREMENT _g_PL_AD_fw_OneDrivingSW_fct_fct_mainproc_ods_fct_ods_fct_mainproc_RunnableMainProc_m_portMainProc_out_local.m_estSignalsExt.m_estSystemReactionSignals.m_estHazardLightActivationRequestStatus "" UBYTE NO_COMPU_METHOD 0 0 0 255 BYTE_ORDER MSB_LAST ECU_ADDRESS 0xB0032634 ECU_ADDRESS_EXTENSION 0x8 /end MEASUREMENT
/begin MEASUREMENT _g_PL_AD_fw_OneDrivingSW_fct_fct_mainproc_ods_fct_ods_fct_mainproc_RunnableMainProc_m_portMainProc_out_local.m_estSignalsExt.m_estSystemReactionSignals.m_estHeadlightActivationRequestStatus "" UBYTE NO_COMPU_METHOD 0 0 0 255 BYTE_ORDER MSB_LAST ECU_ADDRESS 0xB0032635 ECU_ADDRESS_EXTENSION 0x8 /end MEASUREMENT
/begin MEASUREMENT _g_PL_AD_fw_OneDrivingSW_fct_fct_mainproc_ods_fct_ods_fct_mainproc_RunnableMainProc_m_portMainProc_out_local.m_estSignalsExt.m_estSystemReactionSignals.m_estHornActivationRequestStatus "" UBYTE NO_COMPU_METHOD 0 0 0 255 BYTE_ORDER MSB_LAST ECU_ADDRESS 0xB0032637 ECU_ADDRESS_EXTENSION 0x8 /end MEASUREMENT
/begin MEASUREMENT _g_PL_AD_fw_OneDrivingSW_fct_fct_mainproc_ods_fct_ods_fct_mainproc_RunnableMainProc_m_portMainProc_out_local.m_estSignalsExt.m_estSystemReactionSignals.m_estHvacInAutoModeStatus "" UBYTE NO_COMPU_METHOD 0 0 0 255 BYTE_ORDER MSB_LAST ECU_ADDRESS 0xB0032638 ECU_ADDRESS_EXTENSION 0x8 /end MEASUREMENT
/begin MEASUREMENT _g_PL_AD_fw_OneDrivingSW_fct_fct_mainproc_ods_fct_ods_fct_mainproc_RunnableMainProc_m_portMainProc_out_local.m_estSignalsExt.m_estSystemReactionSignals.m_estTaillightActivationRequestStatus "" UBYTE NO_COMPU_METHOD 0 0 0 255 BYTE_ORDER MSB_LAST ECU_ADDRESS 0xB0032636 ECU_ADDRESS_EXTENSION 0x8 /end MEASUREMENT
/begin MEASUREMENT _g_PL_AD_fw_OneDrivingSW_perEnv_EnvModel_PerEimTprRunnable_PerEimTprRunnable_m_fusObjPort_out_local.FusObj_st.i0.b_un.b_st.AdditionalSensorAssociated_b "" UBYTE NO_COMPU_METHOD 0 0 0 1 BIT_MASK 0x8 BYTE_ORDER MSB_LAST ECU_ADDRESS 0xB0097164 ECU_ADDRESS_EXTENSION 0x2 /end MEASUREMENT
/begin MEASUREMENT _g_PL_AD_fw_OneDrivingSW_perEnv_EnvModel_PerEimTprRunnable_PerEimTprRunnable_m_fusObjPort_out_local.FusObj_st.i1.b_un.b_st.AdditionalSensorAssociated_b "" UBYTE NO_COMPU_METHOD 0 0 0 1 BIT_MASK 0x8 BYTE_ORDER MSB_LAST ECU_ADDRESS 0xB0097234 ECU_ADDRESS_EXTENSION 0x2 /end MEASUREMENT
/begin MEASUREMENT _g_PL_AD_fw_OneDrivingSW_perEnv_EnvModel_PerEimTprRunnable_PerEimTprRunnable_m_fusObjPort_out_local.FusObj_st.i2.b_un.b_st.AdditionalSensorAssociated_b "" UBYTE NO_COMPU_METHOD 0 0 0 1 BIT_MASK 0x8 BYTE_ORDER MSB_LAST ECU_ADDRESS 0xB0097304 ECU_ADDRESS_EXTENSION 0x2 /end MEASUREMENT
/begin MEASUREMENT _g_PL_AD_fw_OneDrivingSW_perEnv_EnvModel_PerEimTprRunnable_PerEimTprRunnable_m_fusObjPort_out_local.FusObj_st.i3.b_un.b_st.AdditionalSensorAssociated_b "" UBYTE NO_COMPU_METHOD 0 0 0 1 BIT_MASK 0x8 BYTE_ORDER MSB_LAST ECU_ADDRESS 0xB00973D4 ECU_ADDRESS_EXTENSION 0x2 /end MEASUREMENT
/begin MEASUREMENT _g_PL_AD_fw_OneDrivingSW_perEnv_EnvModel_PerEimTprRunnable_PerEimTprRunnable_m_fusObjPort_out_local.FusObj_st.i4.b_un.b_st.AdditionalSensorAssociated_b "" UBYTE NO_COMPU_METHOD 0 0 0 1 BIT_MASK 0x8 BYTE_ORDER MSB_LAST ECU_ADDRESS 0xB00974A4 ECU_ADDRESS_EXTENSION 0x2 /end MEASUREMENT
/begin MEASUREMENT _g_PL_AD_fw_OneDrivingSW_perEnv_EnvModel_PerEimTprRunnable_PerEimTprRunnable_m_fusObjPort_out_local.FusObj_st.i5.b_un.b_st.AdditionalSensorAssociated_b "" UBYTE NO_COMPU_METHOD 0 0 0 1 BIT_MASK 0x8 BYTE_ORDER MSB_LAST ECU_ADDRESS 0xB0097574 ECU_ADDRESS_EXTENSION 0x2 /end MEASUREMENT
/begin MEASUREMENT _g_PL_AD_fw_OneDrivingSW_perHv_HV_PerPmeRunnable_PerPmeRunnable_m_serviceStatus_out_local.m_oosId "" ULONG NO_COMPU_METHOD 0 0 0 4294967295 BYTE_ORDER MSB_LAST ECU_ADDRESS 0x4000D4A0 ECU_ADDRESS_EXTENSION 0x8 /end MEASUREMENT
/begin MEASUREMENT _g_PL_AD_fw_OneDrivingSW_rpm_RpmExecution_RpmExecution_RpmExecution_m_portServiceStatus_local.m_currentLcState "" UBYTE LcState 0 0 0 255 BYTE_ORDER MSB_LAST ECU_ADDRESS 0x4000D4D4 ECU_ADDRESS_EXTENSION 0x8 /end MEASUREMENT
/begin MEASUREMENT _g_PL_AD_fw_OneDrivingSW_sitBa_Ba_timba_TimbaRunnable_m_targetGatewayObjects_local.m_objectDataList.i0.m_dx.m_value "" FLOAT32_IEEE NO_COMPU_METHOD 0 0 -3.4028234663852886E+38 3.4028234663852886E+38 BYTE_ORDER MSB_LAST ECU_ADDRESS 0xB0016630 ECU_ADDRESS_EXTENSION 0x2 /end MEASUREMENT
/begin MEASUREMENT _g_PL_AD_fw_fal_dpc_apl_PER_PerSppEnvRunnable_PerSppEnvRunnable_m_CameraSensor_Events_out_local.m_sequenceNumber "" UWORD NO_COMPU_METHOD 0 0 0 65535 BYTE_ORDER MSB_LAST ECU_ADDRESS 0x7002F2CE ECU_ADDRESS_EXTENSION 0x1 /end MEASUREMENT
/begin MEASUREMENT _g_PL_AD_fw_fal_dpc_apl_PER_PerSppEnvRunnable_PerSppEnvRunnable_m_FrontCenterRadar_Events_out_local.m_sequenceNumber "" UWORD NO_COMPU_METHOD 0 0 0 65535 BYTE_ORDER MSB_LAST ECU_ADDRESS 0x700275E2 ECU_ADDRESS_EXTENSION 0x1 /end MEASUREMENT
/begin MEASUREMENT _g_PL_AD_fw_fal_dpc_apl_PER_PerSppEnvRunnable_PerSppEnvRunnable_m_FrontCornerRadar_Events_out_local.m_sequenceNumber "" UWORD NO_COMPU_METHOD 0 0 0 65535 BYTE_ORDER MSB_LAST ECU_ADDRESS 0x7002F2FA ECU_ADDRESS_EXTENSION 0x1 /end MEASUREMENT
/begin MEASUREMENT _g_PL_AD_fw_fal_dpc_apl_PER_PerSppEnvRunnable_PerSppEnvRunnable_m_RearCornerRadar_Events_out_local.m_sequenceNumber "" UWORD NO_COMPU_METHOD 0 0 0 65535 BYTE_ORDER MSB_LAST ECU_ADDRESS 0x7002F31E ECU_ADDRESS_EXTENSION 0x1 /end MEASUREMENT
/begin MEASUREMENT _g_PL_AD_fw_fal_dpc_apl_PER_PerSppEnvRunnable_PerSppEnvRunnable_m_ensRLocFCSensorPort_out_local.m_sequenceNumber "" UWORD NO_COMPU_METHOD 0 0 0 65535 BYTE_ORDER MSB_LAST ECU_ADDRESS 0xB00DC322 ECU_ADDRESS_EXTENSION 0x4 /end MEASUREMENT
/begin MEASUREMENT _g_PL_AD_fw_fal_dpc_apl_PER_PerSppEnvRunnable_PerSppEnvRunnable_m_ensRObjFLSensorPort_out_local.m_sequenceNumber "" UWORD NO_COMPU_METHOD 0 0 0 65535 BYTE_ORDER MSB_LAST ECU_ADDRESS 0xB000655E ECU_ADDRESS_EXTENSION 0x1 /end MEASUREMENT
/begin MEASUREMENT _g_PL_AD_fw_fal_dpc_apl_PER_PerSppEnvRunnable_PerSppEnvRunnable_m_ensRObjFRSensorPort_out_local.m_sequenceNumber "" UWORD NO_COMPU_METHOD 0 0 0 65535 BYTE_ORDER MSB_LAST ECU_ADDRESS 0x50015B9A ECU_ADDRESS_EXTENSION 0x4 /end MEASUREMENT
/begin MEASUREMENT _g_PL_AD_fw_fal_dpc_apl_PER_PerSppEnvRunnable_PerSppEnvRunnable_m_ensRObjRLSensorPort_out_local.m_sequenceNumber "" UWORD NO_COMPU_METHOD 0 0 0 65535 BYTE_ORDER MSB_LAST ECU_ADDRESS 0xB00074BA ECU_ADDRESS_EXTENSION 0x1 /end MEASUREMENT
/begin MEASUREMENT _g_PL_AD_fw_fal_dpc_apl_PER_PerSppEnvRunnable_PerSppEnvRunnable_m_ensRObjRRSensorPort_out_local.m_sequenceNumber "" UWORD NO_COMPU_METHOD 0 0 0 65535 BYTE_ORDER MSB_LAST ECU_ADDRESS 0xB001445A ECU_ADDRESS_EXTENSION 0x2 /end MEASUREMENT
/begin MEASUREMENT _g_PL_AD_fw_fal_dpc_apl_PER_PerSppEnvRunnable_PerSppEnvRunnable_m_ensVLanesPolynomPort_out_local.m_sequenceNumber "" UWORD NO_COMPU_METHOD 0 0 0 65535 BYTE_ORDER MSB_LAST ECU_ADDRESS 0x60016E7E ECU_ADDRESS_EXTENSION 0x2 /end MEASUREMENT
/begin MEASUREMENT _g_PL_AD_fw_fal_dpc_apl_PER_PerSppEnvRunnable_PerSppEnvRunnable_m_ensVLanesPort_out_local.m_sequenceNumber "" UWORD NO_COMPU_METHOD 0 0 0 65535 BYTE_ORDER MSB_LAST ECU_ADDRESS 0x70108866 ECU_ADDRESS_EXTENSION 0x1 /end MEASUREMENT
/begin MEASUREMENT _g_PL_AD_fw_fal_dpc_apl_PER_PerSppEnvRunnable_PerSppEnvRunnable_m_ensVObjFCSensorPort_out_local.m_sequenceNumber "" UWORD NO_COMPU_METHOD 0 0 0 65535 BYTE_ORDER MSB_LAST ECU_ADDRESS 0xB004A57A ECU_ADDRESS_EXTENSION 0x1 /end MEASUREMENT
/begin MEASUREMENT _g_PL_AD_fw_fal_dpc_apl_PER_PerSppEnvRunnable_PerSppEnvRunnable_m_ensVRoadSignPort_out_local.m_sequenceNumber "" UWORD NO_COMPU_METHOD 0 0 0 65535 BYTE_ORDER MSB_LAST ECU_ADDRESS 0x60029DFA ECU_ADDRESS_EXTENSION 0x2 /end MEASUREMENT
/begin MEASUREMENT _g_PL_AD_fw_fal_dpc_apl_VMC_CVMCPostprocessing_CVMCPostprocessing_m_NetTx_CAN_2_MRR_0x25A_Port_out_local.m_netsigState_ADAS_Decel_AEB_MRR_0x25A "" SBYTE rbNetCom_State_e 0 0 -128 127 BYTE_ORDER MSB_LAST ECU_ADDRESS 0x70011E72 ECU_ADDRESS_EXTENSION 0x1 /end MEASUREMENT
/begin MEASUREMENT _g_PL_AD_fw_fal_preproc_preproc_RunnablePreProc_m_preProc_local.m_vehicleInfo.m_directionIndicatorStatus "" UBYTE DirectionIndicatorStatus 0 0 0 255 BYTE_ORDER MSB_LAST ECU_ADDRESS 0xB0035A2D ECU_ADDRESS_EXTENSION 0x8 /end MEASUREMENT
/begin MEASUREMENT _g_PL_AD_fw_fal_preproc_preproc_RunnablePreProc_m_steeringSystemFeedback_local.m_isPadServiceAvailable "" UBYTE NO_COMPU_METHOD 0 0 0 255 BYTE_ORDER MSB_LAST ECU_ADDRESS 0x4000E0D0 ECU_ADDRESS_EXTENSION 0x8 /end MEASUREMENT
/begin MEASUREMENT _g_PL_AD_fw_fsi_fsi_apl_net_apl_g_netRunnable_m_NetRx_RadarFC_RFC_Status_SenderPort_local.m_sequenceNumber "" UWORD NO_COMPU_METHOD 0 0 0 65535 BYTE_ORDER MSB_LAST ECU_ADDRESS 0x7002F8FA ECU_ADDRESS_EXTENSION 0x1 /end MEASUREMENT
/begin MEASUREMENT _g_PL_AD_fw_fsi_fsi_apl_net_apl_g_netRunnable_m_NetRx_RadarFL_Private_CANFD_RFL_Status_SenderPort_local.m_sequenceNumber "" UWORD NO_COMPU_METHOD 0 0 0 65535 BYTE_ORDER MSB_LAST ECU_ADDRESS 0x6002B316 ECU_ADDRESS_EXTENSION 0x2 /end MEASUREMENT
/begin MEASUREMENT _g_PL_AD_fw_fsi_fsi_apl_net_apl_g_netRunnable_m_NetRx_RadarFR_Private_CANFD_RFR_Status_SenderPort_local.m_sequenceNumber "" UWORD NO_COMPU_METHOD 0 0 0 65535 BYTE_ORDER MSB_LAST ECU_ADDRESS 0x70012672 ECU_ADDRESS_EXTENSION 0x1 /end MEASUREMENT
/begin MEASUREMENT _g_PL_AD_fw_fsi_fsi_apl_net_apl_g_netRunnable_m_NetRx_RadarRL_Private_CANFD_RRL_Status_SenderPort_local.m_sequenceNumber "" UWORD NO_COMPU_METHOD 0 0 0 65535 BYTE_ORDER MSB_LAST ECU_ADDRESS 0x700126C6 ECU_ADDRESS_EXTENSION 0x1 /end MEASUREMENT
/begin MEASUREMENT _g_PL_AD_fw_fsi_fsi_apl_net_apl_g_netRunnable_m_NetRx_RadarRR_Private_CANFD_RRR_Status_SenderPort_local.m_sequenceNumber "" UWORD NO_COMPU_METHOD 0 0 0 65535 BYTE_ORDER MSB_LAST ECU_ADDRESS 0x7001271A ECU_ADDRESS_EXTENSION 0x1 /end MEASUREMENT
/begin MEASUREMENT _g_PL_AD_fw_fsi_fsi_apl_net_apl_g_netRunnable_m_NetRx_VideoPrivate_CANFD_VFC_Status_SenderPort_local.m_sequenceNumber "" UWORD NO_COMPU_METHOD 0 0 0 65535 BYTE_ORDER MSB_LAST ECU_ADDRESS 0x50017076 ECU_ADDRESS_EXTENSION 0x4 /end MEASUREMENT
/begin MEASUREMENT _g_PL_AD_fw_fsi_fsi_apl_net_apl_g_netRunnable_rbDyNet_RFC_Loc_serializer_m_CNetRFC_LOC_SenderPort_local.m_sequenceNumber "" UWORD NO_COMPU_METHOD 0 0 0 65535 BYTE_ORDER MSB_LAST ECU_ADDRESS 0x4001170E ECU_ADDRESS_EXTENSION 0x8 /end MEASUREMENT
/begin MEASUREMENT _g_PL_AD_fw_fsi_fsi_apl_net_apl_g_netRunnable_rbDyNet_RFL_Obj_serializer_m_CNetRFL_OBJ_SenderPort_local.m_sequenceNumber "" UWORD NO_COMPU_METHOD 0 0 0 65535 BYTE_ORDER MSB_LAST ECU_ADDRESS 0xB00CEFFA ECU_ADDRESS_EXTENSION 0x4 /end MEASUREMENT
/begin MEASUREMENT _g_PL_AD_fw_fsi_fsi_apl_net_apl_g_netRunnable_rbDyNet_RFR_Obj_serializer_m_CNetRFR_OBJ_SenderPort_local.m_sequenceNumber "" UWORD NO_COMPU_METHOD 0 0 0 65535 BYTE_ORDER MSB_LAST ECU_ADDRESS 0xB00082DE ECU_ADDRESS_EXTENSION 0x1 /end MEASUREMENT
/begin MEASUREMENT _g_PL_AD_fw_fsi_fsi_apl_net_apl_g_netRunnable_rbDyNet_RRL_Obj_serializer_m_CNetRRL_OBJ_SenderPort_local.m_sequenceNumber "" UWORD NO_COMPU_METHOD 0 0 0 65535 BYTE_ORDER MSB_LAST ECU_ADDRESS 0xB0009272 ECU_ADDRESS_EXTENSION 0x1 /end MEASUREMENT
/begin MEASUREMENT _g_PL_AD_fw_fsi_fsi_apl_net_apl_g_netRunnable_rbDyNet_RRR_Obj_serializer_m_CNetRRR_OBJ_SenderPort_local.m_sequenceNumber "" UWORD NO_COMPU_METHOD 0 0 0 65535 BYTE_ORDER MSB_LAST ECU_ADDRESS 0xB0015562 ECU_ADDRESS_EXTENSION 0x2 /end MEASUREMENT
/begin MEASUREMENT _g_PL_AD_fw_fsi_fsi_apl_net_apl_g_netRunnable_rbDyNet_VFC_Obj_serializer_m_CNetVFC_Obj_SenderPort_local.m_sequenceNumber "" UWORD NO_COMPU_METHOD 0 0 0 65535 BYTE_ORDER MSB_LAST ECU_ADDRESS 0xB004D58A ECU_ADDRESS_EXTENSION 0x1 /end MEASUREMENT
/begin MEASUREMENT _g_PL_AD_fw_fsi_fsi_apl_net_apl_g_netRunnable_rbDyNet_VFC_Road_serializer_m_CNetVFC_Road_SenderPort_local.m_sequenceNumber "" UWORD NO_COMPU_METHOD 0 0 0 65535 BYTE_ORDER MSB_LAST ECU_ADDRESS 0x6002B82E ECU_ADDRESS_EXTENSION 0x2 /end MEASUREMENT
/begin MEASUREMENT _g_PL_AD_fw_fsi_fsi_apl_net_apl_g_netRunnable_rbDyNet_VFC_TS_serializer_m_CNetVFC_TS_SenderPort_local.m_sequenceNumber "" UWORD NO_COMPU_METHOD 0 0 0 65535 BYTE_ORDER MSB_LAST ECU_ADDRESS 0xB0005ABA ECU_ADDRESS_EXTENSION 0x1 /end MEASUREMENT
/begin MEASUREMENT _rbMonReact_State "" SBYTE rbMonReact_State_en 0 0 -128 127 BYTE_ORDER MSB_LAST ECU_ADDRESS 0xB004063B ECU_ADDRESS_EXTENSION 0x1 /end MEASUREMENT
/begin MEASUREMENT _rbOsSetup_TaskC010ms_st "" UBYTE NO_COMPU_METHOD 0 0 0 255 BYTE_ORDER MSB_LAST ECU_ADDRESS 0x7000EC20 ECU_ADDRESS_EXTENSION 0x1 /end MEASUREMENT
/begin COMPU_METHOD DirectionIndicatorStatus "enumeration table" TAB_VERB "%.0" "" COMPU_TAB_REF DirectionIndicatorStatus /end COMPU_METHOD
/begin COMPU_METHOD LcState "enumeration table" TAB_VERB "%.0" "" COMPU_TAB_REF LcState /end COMPU_METHOD
/begin COMPU_METHOD RoadsideBarrierType "enumeration table" TAB_VERB "%.0" "" COMPU_TAB_REF RoadsideBarrierType /end COMPU_METHOD
/begin COMPU_METHOD RoadsideBoundaryCategory "enumeration table" TAB_VERB "%.0" "" COMPU_TAB_REF RoadsideBoundaryCategory /end COMPU_METHOD
/begin COMPU_METHOD RoundaboutStates "enumeration table" TAB_VERB "%.0" "" COMPU_TAB_REF RoundaboutStates /end COMPU_METHOD
/begin COMPU_METHOD RuleProtection "enumeration table" TAB_VERB "%.0" "" COMPU_TAB_REF RuleProtection /end COMPU_METHOD
/begin COMPU_METHOD RuleSource "enumeration table" TAB_VERB "%.0" "" COMPU_TAB_REF RuleSource /end COMPU_METHOD
/begin COMPU_METHOD RuleTypeGroup "enumeration table" TAB_VERB "%.0" "" COMPU_TAB_REF RuleTypeGroup /end COMPU_METHOD
/begin COMPU_METHOD SLSDisplayStatus "enumeration table" TAB_VERB "%.0" "" COMPU_TAB_REF SLSDisplayStatus /end COMPU_METHOD
/begin COMPU_METHOD SLSOverSpeedOffsetUnit "enumeration table" TAB_VERB "%.0" "" COMPU_TAB_REF SLSOverSpeedOffsetUnit /end COMPU_METHOD
/begin COMPU_METHOD SLSSpeedLimitChangeNotificationStatus "enumeration table" TAB_VERB "%.0" "" COMPU_TAB_REF SLSSpeedLimitChangeNotificationStatus /end COMPU_METHOD
/begin COMPU_METHOD SLWFWarningMode "enumeration table" TAB_VERB "%.0" "" COMPU_TAB_REF SLWFWarningMode /end COMPU_METHOD
/begin COMPU_METHOD SegmentModelType "enumeration table" TAB_VERB "%.0" "" COMPU_TAB_REF SegmentModelType /end COMPU_METHOD
/begin COMPU_METHOD SensorConfirmationLevel "enumeration table" TAB_VERB "%.0" "" COMPU_TAB_REF SensorConfirmationLevel /end COMPU_METHOD
/begin COMPU_METHOD SeparationFromOtpResult "enumeration table" TAB_VERB "%.0" "" COMPU_TAB_REF SeparationFromOtpResult /end COMPU_METHOD
/begin COMPU_METHOD ServiceId "enumeration table" TAB_VERB "%.0" "" COMPU_TAB_REF ServiceId /end COMPU_METHOD
/begin COMPU_METHOD SetSpeedInteractionType "enumeration table" TAB_VERB "%.0" "" COMPU_TAB_REF SetSpeedInteractionType /end COMPU_METHOD
/begin COMPU_METHOD ShapeType "enumeration table" TAB_VERB "%.0" "" COMPU_TAB_REF ShapeType /end COMPU_METHOD
/begin COMPU_METHOD ShapeType_Copy1 "enumeration table" TAB_VERB "%.0" "" COMPU_TAB_REF ShapeType_Copy1 /end COMPU_METHOD
/begin COMPU_METHOD ShortUserNotificationRequest "enumeration table" TAB_VERB "%.0" "" COMPU_TAB_REF ShortUserNotificationRequest /end COMPU_METHOD
/begin COMPU_METHOD Side "enumeration table" TAB_VERB "%.0" "" COMPU_TAB_REF Side /end COMPU_METHOD
/begin COMPU_METHOD Side_Copy1 "enumeration table" TAB_VERB "%.0" "" COMPU_TAB_REF Side_Copy1 /end COMPU_METHOD
/begin COMPU_METHOD SignLocation "enumeration table" TAB_VERB "%.0" "" COMPU_TAB_REF SignLocation /end COMPU_METHOD
/begin COMPU_METHOD SignState "enumeration table" TAB_VERB "%.0" "" COMPU_TAB_REF SignState /end COMPU_METHOD
/begin COMPU_METHOD SlotMode "enumeration table" TAB_VERB "%.0" "" COMPU_TAB_REF SlotMode /end COMPU_METHOD
/begin COMPU_METHOD SlsSlwfActiveWarningType "enumeration table" TAB_VERB "%.0" "" COMPU_TAB_REF SlsSlwfActiveWarningType /end COMPU_METHOD
/begin COMPU_METHOD SlsStates "enumeration table" TAB_VERB "%.0" "" COMPU_TAB_REF SlsStates /end COMPU_METHOD
/begin COMPU_METHOD SlwfMode "enumeration table" TAB_VERB "%.0" "" COMPU_TAB_REF SlwfMode /end COMPU_METHOD
/begin COMPU_METHOD SmStateId "enumeration table" TAB_VERB "%.0" "" COMPU_TAB_REF SmStateId /end COMPU_METHOD
/begin COMPU_METHOD SmoothType4dSet "enumeration table" TAB_VERB "%.0" "" COMPU_TAB_REF SmoothType4dSet /end COMPU_METHOD
/begin COMPU_METHOD SpeedProfileIndex "enumeration table" TAB_VERB "%.0" "" COMPU_TAB_REF SpeedProfileIndex /end COMPU_METHOD
/begin COMPU_METHOD SpeedUnit "enumeration table" TAB_VERB "%.0" "" COMPU_TAB_REF SpeedUnit /end COMPU_METHOD
/begin COMPU_METHOD SpeedUpFunction "enumeration table" TAB_VERB "%.0" "" COMPU_TAB_REF SpeedUpFunction /end COMPU_METHOD
/begin COMPU_METHOD SsmPhase "enumeration table" TAB_VERB "%.0" "" COMPU_TAB_REF SsmPhase /end COMPU_METHOD
/begin COMPU_METHOD StartLaneReaction "enumeration table" TAB_VERB "%.0" "" COMPU_TAB_REF StartLaneReaction /end COMPU_METHOD
/begin COMPU_METHOD Static2DMotionGoal "enumeration table" TAB_VERB "%.0" "" COMPU_TAB_REF Static2DMotionGoal /end COMPU_METHOD
/begin COMPU_METHOD Static2DMotionGoal_v0 "enumeration table" TAB_VERB "%.0" "" COMPU_TAB_REF Static2DMotionGoal_v0 /end COMPU_METHOD
/begin COMPU_METHOD StationaryHoldMode "enumeration table" TAB_VERB "%.0" "" COMPU_TAB_REF StationaryHoldMode /end COMPU_METHOD
/begin COMPU_METHOD StatusIndicator "enumeration table" TAB_VERB "%.0" "" COMPU_TAB_REF StatusIndicator /end COMPU_METHOD
/begin COMPU_METHOD StreetClassDetectionStates "enumeration table" TAB_VERB "%.0" "" COMPU_TAB_REF StreetClassDetectionStates /end COMPU_METHOD
/begin COMPU_METHOD SupplementarySign "enumeration table" TAB_VERB "%.0" "" COMPU_TAB_REF SupplementarySign /end COMPU_METHOD
/begin COMPU_METHOD SuppressionReason "enumeration table" TAB_VERB "%.0" "" COMPU_TAB_REF SuppressionReason /end COMPU_METHOD
/begin COMPU_METHOD SuppressionValue "enumeration table" TAB_VERB "%.0" "" COMPU_TAB_REF SuppressionValue /end COMPU_METHOD
/begin COMPU_METHOD SystemStatus "enumeration table" TAB_VERB "%.0" "" COMPU_TAB_REF SystemStatus /end COMPU_METHOD
/begin COMPU_METHOD Table_0 "enumeration table" TAB_VERB "%.0" "" COMPU_TAB_REF Table_0 /end COMPU_METHOD
/begin COMPU_METHOD Table_1043 "enumeration table" TAB_VERB "%.0" "" COMPU_TAB_REF Table_1043 /end COMPU_METHOD
/begin COMPU_METHOD Table_1236 "enumeration table" TAB_VERB "%.0" "" COMPU_TAB_REF Table_1236 /end COMPU_METHOD
/begin COMPU_METHOD Table_1237 "enumeration table" TAB_VERB "%.0" "" COMPU_TAB_REF Table_1237 /end COMPU_METHOD
/begin COMPU_METHOD Table_1238 "enumeration table" TAB_VERB "%.0" "" COMPU_TAB_REF Table_1238 /end COMPU_METHOD
/begin COMPU_METHOD Table_1242 "enumeration table" TAB_VERB "%.0" "" COMPU_TAB_REF Table_1242 /end COMPU_METHOD
/begin COMPU_METHOD Table_1244 "enumeration table" TAB_VERB "%.0" "" COMPU_TAB_REF Table_1244 /end COMPU_METHOD
/begin COMPU_METHOD Table_1246 "enumeration table" TAB_VERB "%.0" "" COMPU_TAB_REF Table_1246 /end COMPU_METHOD
/begin COMPU_METHOD Table_1252 "enumeration table" TAB_VERB "%.0" "" COMPU_TAB_REF Table_1252 /end COMPU_METHOD
/begin COMPU_METHOD Table_1256 "enumeration table" TAB_VERB "%.0" "" COMPU_TAB_REF Table_1256 /end COMPU_METHOD
/begin COMPU_METHOD Table_1257 "enumeration table" TAB_VERB "%.0" "" COMPU_TAB_REF Table_1257 /end COMPU_METHOD
/begin COMPU_METHOD Table_1258 "enumeration table" TAB_VERB "%.0" "" COMPU_TAB_REF Table_1258 /end COMPU_METHOD
/begin COMPU_METHOD Table_1260 "enumeration table" TAB_VERB "%.0" "" COMPU_TAB_REF Table_1260 /end COMPU_METHOD
/begin COMPU_METHOD Table_1261 "enumeration table" TAB_VERB "%.0" "" COMPU_TAB_REF Table_1261 /end COMPU_METHOD
/begin COMPU_METHOD Table_1263 "enumeration table" TAB_VERB "%.0" "" COMPU_TAB_REF Table_1263 /end COMPU_METHOD
/begin COMPU_METHOD Table_1265 "enumeration table" TAB_VERB "%.0" "" COMPU_TAB_REF Table_1265 /end COMPU_METHOD
/begin COMPU_METHOD Table_1266 "enumeration table" TAB_VERB "%.0" "" COMPU_TAB_REF Table_1266 /end COMPU_METHOD
/begin COMPU_METHOD Table_1267 "enumeration table" TAB_VERB "%.0" "" COMPU_TAB_REF Table_1267 /end COMPU_METHOD
/begin COMPU_METHOD Table_1268 "enumeration table" TAB_VERB "%.0" "" COMPU_TAB_REF Table_1268 /end COMPU_METHOD
/begin COMPU_METHOD Table_1270 "enumeration table" TAB_VERB "%.0" "" COMPU_TAB_REF Table_1270 /end COMPU_METHOD
/begin COMPU_METHOD Table_1272 "enumeration table" TAB_VERB "%.0" "" COMPU_TAB_REF Table_1272 /end COMPU_METHOD
/begin COMPU_METHOD Table_1274 "enumeration table" TAB_VERB "%.0" "" COMPU_TAB_REF Table_1274 /end COMPU_METHOD
/begin COMPU_METHOD Table_1276 "enumeration table" TAB_VERB "%.0" "" COMPU_TAB_REF Table_1276 /end COMPU_METHOD
/begin COMPU_METHOD Table_1277 "enumeration table" TAB_VERB "%.0" "" COMPU_TAB_REF Table_1277 /end COMPU_METHOD
/begin COMPU_METHOD Table_1285 "enumeration table" TAB_VERB "%.0" "" COMPU_TAB_REF Table_1285 /end COMPU_METHOD
/begin COMPU_METHOD Table_1286 "enumeration table" TAB_VERB "%.0" "" COMPU_TAB_REF Table_1286 /end COMPU_METHOD
/begin COMPU_METHOD Table_1287 "enumeration table" TAB_VERB "%.0" "" COMPU_TAB_REF Table_1287 /end COMPU_METHOD
/begin COMPU_METHOD Table_1288 "enumeration table" TAB_VERB "%.0" "" COMPU_TAB_REF Table_1288 /end COMPU_METHOD
/begin COMPU_METHOD Table_1290 "enumeration table" TAB_VERB "%.0" "" COMPU_TAB_REF Table_1290 /end COMPU_METHOD
/begin COMPU_METHOD Table_1291 "enumeration table" TAB_VERB "%.0" "" COMPU_TAB_REF Table_1291 /end COMPU_METHOD
/begin COMPU_METHOD Table_1292 "enumeration table" TAB_VERB "%.0" "" COMPU_TAB_REF Table_1292 /end COMPU_METHOD
/begin COMPU_METHOD Table_1293 "enumeration table" TAB_VERB "%.0" "" COMPU_TAB_REF Table_1293 /end COMPU_METHOD
/begin COMPU_METHOD Table_1294 "enumeration table" TAB_VERB "%.0" "" COMPU_TAB_REF Table_1294 /end COMPU_METHOD
/begin COMPU_METHOD Table_1295 "enumeration table" TAB_VERB "%.0" "" COMPU_TAB_REF Table_1295 /end COMPU_METHOD
/begin COMPU_METHOD Table_1296 "enumeration table" TAB_VERB "%.0" "" COMPU_TAB_REF Table_1296 /end COMPU_METHOD
/begin COMPU_METHOD Table_199 "enumeration table" TAB_VERB "%.0" "" COMPU_TAB_REF Table_199 /end COMPU_METHOD
/begin COMPU_METHOD Table_2 "enumeration table" TAB_VERB "%.0" "" COMPU_TAB_REF Table_2 /end COMPU_METHOD
/begin COMPU_METHOD Table_201 "enumeration table" TAB_VERB "%.0" "" COMPU_TAB_REF Table_201 /end COMPU_METHOD
/begin COMPU_METHOD Table_202 "enumeration table" TAB_VERB "%.0" "" COMPU_TAB_REF Table_202 /end COMPU_METHOD
/begin COMPU_METHOD Table_220 "enumeration table" TAB_VERB "%.0" "" COMPU_TAB_REF Table_220 /end COMPU_METHOD
/begin COMPU_METHOD Table_231 "enumeration table" TAB_VERB "%.0" "" COMPU_TAB_REF Table_231 /end COMPU_METHOD
/begin COMPU_METHOD Table_232 "enumeration table" TAB_VERB "%.0" "" COMPU_TAB_REF Table_232 /end COMPU_METHOD
/begin COMPU_METHOD Table_233 "enumeration table" TAB_VERB "%.0" "" COMPU_TAB_REF Table_233 /end COMPU_METHOD
/begin COMPU_METHOD Table_239 "enumeration table" TAB_VERB "%.0" "" COMPU_TAB_REF Table_239 /end COMPU_METHOD
/begin COMPU_METHOD Table_246 "enumeration table" TAB_VERB "%.0" "" COMPU_TAB_REF Table_246 /end COMPU_METHOD
/begin COMPU_METHOD Table_254 "enumeration table" TAB_VERB "%.0" "" COMPU_TAB_REF Table_254 /end COMPU_METHOD
/begin COMPU_METHOD Table_255 "enumeration table" TAB_VERB "%.0" "" COMPU_TAB_REF Table_255 /end COMPU_METHOD
/begin COMPU_METHOD Table_256 "enumeration table" TAB_VERB "%.0" "" COMPU_TAB_REF Table_256 /end COMPU_METHOD
/begin COMPU_METHOD Table_3 "enumeration table" TAB_VERB "%.0" "" COMPU_TAB_REF Table_3 /end COMPU_METHOD
/begin COMPU_METHOD Table_315 "enumeration table" TAB_VERB "%.0" "" COMPU_TAB_REF Table_315 /end COMPU_METHOD
/begin COMPU_METHOD Table_316 "enumeration table" TAB_VERB "%.0" "" COMPU_TAB_REF Table_316 /end COMPU_METHOD
/begin COMPU_METHOD Table_317 "enumeration table" TAB_VERB "%.0" "" COMPU_TAB_REF Table_317 /end COMPU_METHOD
/begin COMPU_METHOD Table_368 "enumeration table" TAB_VERB "%.0" "" COMPU_TAB_REF Table_368 /end COMPU_METHOD
/begin COMPU_METHOD Table_374 "enumeration table" TAB_VERB "%.0" "" COMPU_TAB_REF Table_374 /end COMPU_METHOD
/begin COMPU_METHOD Table_375 "enumeration table" TAB_VERB "%.0" "" COMPU_TAB_REF Table_375 /end COMPU_METHOD
/begin COMPU_METHOD Table_382 "enumeration table" TAB_VERB "%.0" "" COMPU_TAB_REF Table_382 /end COMPU_METHOD
/begin COMPU_METHOD Table_4 "enumeration table" TAB_VERB "%.0" "" COMPU_TAB_REF Table_4 /end COMPU_METHOD
/begin COMPU_METHOD Table_414 "enumeration table" TAB_VERB "%.0" "" COMPU_TAB_REF Table_414 /end COMPU_METHOD
/begin COMPU_METHOD Table_433 "enumeration table" TAB_VERB "%.0" "" COMPU_TAB_REF Table_433 /end COMPU_METHOD
/begin COMPU_METHOD Table_445 "enumeration table" TAB_VERB "%.0" "" COMPU_TAB_REF Table_445 /end COMPU_METHOD
/begin COMPU_METHOD Table_457 "enumeration table" TAB_VERB "%.0" "" COMPU_TAB_REF Table_457 /end COMPU_METHOD
/begin COMPU_METHOD Table_458 "enumeration table" TAB_VERB "%.0" "" COMPU_TAB_REF Table_458 /end COMPU_METHOD
/begin COMPU_METHOD Table_5 "enumeration table" TAB_VERB "%.0" "" COMPU_TAB_REF Table_5 /end COMPU_METHOD
/begin COMPU_METHOD Table_523 "enumeration table" TAB_VERB "%.0" "" COMPU_TAB_REF Table_523 /end COMPU_METHOD
/begin COMPU_METHOD Table_524 "enumeration table" TAB_VERB "%.0" "" COMPU_TAB_REF Table_524 /end COMPU_METHOD
/begin COMPU_METHOD Table_540 "enumeration table" TAB_VERB "%.0" "" COMPU_TAB_REF Table_540 /end COMPU_METHOD
/begin COMPU_METHOD Table_614 "enumeration table" TAB_VERB "%.0" "" COMPU_TAB_REF Table_614 /end COMPU_METHOD
/begin COMPU_METHOD Table_627 "enumeration table" TAB_VERB "%.0" "" COMPU_TAB_REF Table_627 /end COMPU_METHOD
/begin COMPU_METHOD Table_640 "enumeration table" TAB_VERB "%.0" "" COMPU_TAB_REF Table_640 /end COMPU_METHOD
/begin COMPU_METHOD Table_641 "enumeration table" TAB_VERB "%.0" "" COMPU_TAB_REF Table_641 /end COMPU_METHOD
/begin COMPU_METHOD Table_642 "enumeration table" TAB_VERB "%.0" "" COMPU_TAB_REF Table_642 /end COMPU_METHOD
/begin COMPU_METHOD Table_643 "enumeration table" TAB_VERB "%.0" "" COMPU_TAB_REF Table_643 /end COMPU_METHOD
/begin COMPU_METHOD Table_644 "enumeration table" TAB_VERB "%.0" "" COMPU_TAB_REF Table_644 /end COMPU_METHOD
/begin COMPU_METHOD Table_645 "enumeration table" TAB_VERB "%.0" "" COMPU_TAB_REF Table_645 /end COMPU_METHOD
/begin COMPU_METHOD Table_646 "enumeration table" TAB_VERB "%.0" "" COMPU_TAB_REF Table_646 /end COMPU_METHOD
/begin COMPU_METHOD Table_647 "enumeration table" TAB_VERB "%.0" "" COMPU_TAB_REF Table_647 /end COMPU_METHOD
/begin COMPU_METHOD Table_648 "enumeration table" TAB_VERB "%.0" "" COMPU_TAB_REF Table_648 /end COMPU_METHOD
/begin COMPU_METHOD Table_650 "enumeration table" TAB_VERB "%.0" "" COMPU_TAB_REF Table_650 /end COMPU_METHOD
/begin COMPU_METHOD Table_652 "enumeration table" TAB_VERB "%.0" "" COMPU_TAB_REF Table_652 /end COMPU_METHOD
/begin COMPU_METHOD Table_654 "enumeration table" TAB_VERB "%.0" "" COMPU_TAB_REF Table_654 /end COMPU_METHOD
/begin COMPU_METHOD Table_655 "enumeration table" TAB_VERB "%.0" "" COMPU_TAB_REF Table_655 /end COMPU_METHOD
/begin COMPU_METHOD Table_656 "enumeration table" TAB_VERB "%.0" "" COMPU_TAB_REF Table_656 /end COMPU_METHOD
/begin COMPU_METHOD Table_657 "enumeration table" TAB_VERB "%.0" "" COMPU_TAB_REF Table_657 /end COMPU_METHOD
/begin COMPU_METHOD Table_658 "enumeration table" TAB_VERB "%.0" "" COMPU_TAB_REF Table_658 /end COMPU_METHOD
/begin COMPU_METHOD Table_659 "enumeration table" TAB_VERB "%.0" "" COMPU_TAB_REF Table_659 /end COMPU_METHOD
/begin COMPU_METHOD Table_660 "enumeration table" TAB_VERB "%.0" "" COMPU_TAB_REF Table_660 /end COMPU_METHOD
/begin COMPU_METHOD Table_661 "enumeration table" TAB_VERB "%.0" "" COMPU_TAB_REF Table_661 /end COMPU_METHOD
/begin COMPU_METHOD Table_662 "enumeration table" TAB_VERB "%.0" "" COMPU_TAB_REF Table_662 /end COMPU_METHOD
/begin COMPU_METHOD Table_663 "enumeration table" TAB_VERB "%.0" "" COMPU_TAB_REF Table_663 /end COMPU_METHOD
/begin COMPU_METHOD Table_669 "enumeration table" TAB_VERB "%.0" "" COMPU_TAB_REF Table_669 /end COMPU_METHOD
/begin COMPU_METHOD Table_675 "enumeration table" TAB_VERB "%.0" "" COMPU_TAB_REF Table_675 /end COMPU_METHOD
/begin COMPU_METHOD Table_681 "enumeration table" TAB_VERB "%.0" "" COMPU_TAB_REF Table_681 /end COMPU_METHOD
/begin COMPU_METHOD Table_687 "enumeration table" TAB_VERB "%.0" "" COMPU_TAB_REF Table_687 /end COMPU_METHOD
/begin COMPU_METHOD Table_693 "enumeration table" TAB_VERB "%.0" "" COMPU_TAB_REF Table_693 /end COMPU_METHOD
/begin COMPU_METHOD Table_699 "enumeration table" TAB_VERB "%.0" "" COMPU_TAB_REF Table_699 /end COMPU_METHOD
/begin COMPU_METHOD Table_70 "enumeration table" TAB_VERB "%.0" "" COMPU_TAB_REF Table_70 /end COMPU_METHOD
/begin COMPU_METHOD Table_705 "enumeration table" TAB_VERB "%.0" "" COMPU_TAB_REF Table_705 /end COMPU_METHOD
/begin COMPU_METHOD Table_71 "enumeration table" TAB_VERB "%.0" "" COMPU_TAB_REF Table_71 /end COMPU_METHOD
/begin COMPU_METHOD Table_711 "enumeration table" TAB_VERB "%.0" "" COMPU_TAB_REF Table_711 /end COMPU_METHOD
/begin COMPU_METHOD Table_717 "enumeration table" TAB_VERB "%.0" "" COMPU_TAB_REF Table_717 /end COMPU_METHOD
/begin COMPU_METHOD Table_723 "enumeration table" TAB_VERB "%.0" "" COMPU_TAB_REF Table_723 /end COMPU_METHOD
/begin COMPU_METHOD Table_729 "enumeration table" TAB_VERB "%.0" "" COMPU_TAB_REF Table_729 /end COMPU_METHOD
/begin COMPU_METHOD Table_730 "enumeration table" TAB_VERB "%.0" "" COMPU_TAB_REF Table_730 /end COMPU_METHOD
/begin COMPU_METHOD Table_731 "enumeration table" TAB_VERB "%.0" "" COMPU_TAB_REF Table_731 /end COMPU_METHOD
/begin COMPU_METHOD Table_732 "enumeration table" TAB_VERB "%.0" "" COMPU_TAB_REF Table_732 /end COMPU_METHOD
/begin COMPU_METHOD Table_733 "enumeration table" TAB_VERB "%.0" "" COMPU_TAB_REF Table_733 /end COMPU_METHOD
/begin COMPU_METHOD Table_734 "enumeration table" TAB_VERB "%.0" "" COMPU_TAB_REF Table_734 /end COMPU_METHOD
/begin COMPU_METHOD Table_735 "enumeration table" TAB_VERB "%.0" "" COMPU_TAB_REF Table_735 /end COMPU_METHOD
/begin COMPU_METHOD Table_736 "enumeration table" TAB_VERB "%.0" "" COMPU_TAB_REF Table_736 /end COMPU_METHOD
/begin COMPU_METHOD Table_737 "enumeration table" TAB_VERB "%.0" "" COMPU_TAB_REF Table_737 /end COMPU_METHOD
/begin COMPU_METHOD Table_750 "enumeration table" TAB_VERB "%.0" "" COMPU_TAB_REF Table_750 /end COMPU_METHOD
/begin COMPU_METHOD Table_763 "enumeration table" TAB_VERB "%.0" "" COMPU_TAB_REF Table_763 /end COMPU_METHOD
/begin COMPU_METHOD Table_764 "enumeration table" TAB_VERB "%.0" "" COMPU_TAB_REF Table_764 /end COMPU_METHOD
/begin COMPU_METHOD Table_765 "enumeration table" TAB_VERB "%.0" "" COMPU_TAB_REF Table_765 /end COMPU_METHOD
/begin COMPU_METHOD Table_767 "enumeration table" TAB_VERB "%.0" "" COMPU_TAB_REF Table_767 /end COMPU_METHOD
/begin COMPU_METHOD Table_769 "enumeration table" TAB_VERB "%.0" "" COMPU_TAB_REF Table_769 /end COMPU_METHOD
/begin COMPU_METHOD Table_770 "enumeration table" TAB_VERB "%.0" "" COMPU_TAB_REF Table_770 /end COMPU_METHOD
/begin COMPU_METHOD Table_771 "enumeration table" TAB_VERB "%.0" "" COMPU_TAB_REF Table_771 /end COMPU_METHOD
/begin COMPU_METHOD Table_772 "enumeration table" TAB_VERB "%.0" "" COMPU_TAB_REF Table_772 /end COMPU_METHOD
/begin COMPU_METHOD Table_773 "enumeration table" TAB_VERB "%.0" "" COMPU_TAB_REF Table_773 /end COMPU_METHOD
/begin COMPU_METHOD Table_861 "enumeration table" TAB_VERB "%.0" "" COMPU_TAB_REF Table_861 /end COMPU_METHOD
/begin COMPU_METHOD Table_862 "enumeration table" TAB_VERB "%.0" "" COMPU_TAB_REF Table_862 /end COMPU_METHOD
/begin COMPU_METHOD Table_865 "enumeration table" TAB_VERB "%.0" "" COMPU_TAB_REF Table_865 /end COMPU_METHOD
/begin COMPU_METHOD Table_866 "enumeration table" TAB_VERB "%.0" "" COMPU_TAB_REF Table_866 /end COMPU_METHOD
/begin COMPU_METHOD Table_867 "enumeration table" TAB_VERB "%.0" "" COMPU_TAB_REF Table_867 /end COMPU_METHOD
/begin COMPU_METHOD Table_868 "enumeration table" TAB_VERB "%.0" "" COMPU_TAB_REF Table_868 /end COMPU_METHOD
/begin COMPU_METHOD Table_869 "enumeration table" TAB_VERB "%.0" "" COMPU_TAB_REF Table_869 /end COMPU_METHOD
/begin COMPU_METHOD Table_870 "enumeration table" TAB_VERB "%.0" "" COMPU_TAB_REF Table_870 /end COMPU_METHOD
/begin COMPU_METHOD Table_871 "enumeration table" TAB_VERB "%.0" "" COMPU_TAB_REF Table_871 /end COMPU_METHOD
/begin COMPU_METHOD Table_872 "enumeration table" TAB_VERB "%.0" "" COMPU_TAB_REF Table_872 /end COMPU_METHOD
/begin COMPU_METHOD Table_873 "enumeration table" TAB_VERB "%.0" "" COMPU_TAB_REF Table_873 /end COMPU_METHOD
/begin COMPU_METHOD Table_874 "enumeration table" TAB_VERB "%.0" "" COMPU_TAB_REF Table_874 /end COMPU_METHOD
/begin COMPU_METHOD Table_875 "enumeration table" TAB_VERB "%.0" "" COMPU_TAB_REF Table_875 /end COMPU_METHOD
/begin COMPU_METHOD Table_876 "enumeration table" TAB_VERB "%.0" "" COMPU_TAB_REF Table_876 /end COMPU_METHOD
/begin COMPU_METHOD Table_949 "enumeration table" TAB_VERB "%.0" "" COMPU_TAB_REF Table_949 /end COMPU_METHOD
/begin COMPU_METHOD Table_950 "enumeration table" TAB_VERB "%.0" "" COMPU_TAB_REF Table_950 /end COMPU_METHOD
/begin COMPU_METHOD Table_951 "enumeration table" TAB_VERB "%.0" "" COMPU_TAB_REF Table_951 /end COMPU_METHOD
/begin COMPU_METHOD Table_952 "enumeration table" TAB_VERB "%.0" "" COMPU_TAB_REF Table_952 /end COMPU_METHOD
/begin COMPU_METHOD Table_953 "enumeration table" TAB_VERB "%.0" "" COMPU_TAB_REF Table_953 /end COMPU_METHOD
/begin COMPU_METHOD Table_954 "enumeration table" TAB_VERB "%.0" "" COMPU_TAB_REF Table_954 /end COMPU_METHOD
/begin COMPU_METHOD Table_955 "enumeration table" TAB_VERB "%.0" "" COMPU_TAB_REF Table_955 /end COMPU_METHOD
/begin COMPU_METHOD Table_956 "enumeration table" TAB_VERB "%.0" "" COMPU_TAB_REF Table_956 /end COMPU_METHOD
/begin COMPU_METHOD Table_957 "enumeration table" TAB_VERB "%.0" "" COMPU_TAB_REF Table_957 /end COMPU_METHOD
/begin COMPU_METHOD Table_958 "enumeration table" TAB_VERB "%.0" "" COMPU_TAB_REF Table_958 /end COMPU_METHOD
/begin COMPU_METHOD Table_959 "enumeration table" TAB_VERB "%.0" "" COMPU_TAB_REF Table_959 /end COMPU_METHOD
/begin COMPU_METHOD Table_960 "enumeration table" TAB_VERB "%.0" "" COMPU_TAB_REF Table_960 /end COMPU_METHOD
/begin COMPU_METHOD Table_961 "enumeration table" TAB_VERB "%.0" "" COMPU_TAB_REF Table_961 /end COMPU_METHOD
/begin COMPU_METHOD Table_962 "enumeration table" TAB_VERB "%.0" "" COMPU_TAB_REF Table_962 /end COMPU_METHOD
/begin COMPU_METHOD Table_963 "enumeration table" TAB_VERB "%.0" "" COMPU_TAB_REF Table_963 /end COMPU_METHOD
/begin COMPU_METHOD Table_964 "enumeration table" TAB_VERB "%.0" "" COMPU_TAB_REF Table_964 /end COMPU_METHOD
/begin COMPU_METHOD Table_965 "enumeration table" TAB_VERB "%.0" "" COMPU_TAB_REF Table_965 /end COMPU_METHOD
/begin COMPU_METHOD Table_966 "enumeration table" TAB_VERB "%.0" "" COMPU_TAB_REF Table_966 /end COMPU_METHOD
/begin COMPU_METHOD Table_967 "enumeration table" TAB_VERB "%.0" "" COMPU_TAB_REF Table_967 /end COMPU_METHOD
/begin COMPU_METHOD Table_968 "enumeration table" TAB_VERB "%.0" "" COMPU_TAB_REF Table_968 /end COMPU_METHOD
/begin COMPU_METHOD Table_977 "enumeration table" TAB_VERB "%.0" "" COMPU_TAB_REF Table_977 /end COMPU_METHOD
/begin COMPU_METHOD Table_978 "enumeration table" TAB_VERB "%.0" "" COMPU_TAB_REF Table_978 /end COMPU_METHOD
/begin COMPU_METHOD Table_979 "enumeration table" TAB_VERB "%.0" "" COMPU_TAB_REF Table_979 /end COMPU_METHOD
/begin COMPU_METHOD Table_980 "enumeration table" TAB_VERB "%.0" "" COMPU_TAB_REF Table_980 /end COMPU_METHOD
/begin COMPU_METHOD Table_981 "enumeration table" TAB_VERB "%.0" "" COMPU_TAB_REF Table_981 /end COMPU_METHOD
/begin COMPU_METHOD Table_983 "enumeration table" TAB_VERB "%.0" "" COMPU_TAB_REF Table_983 /end COMPU_METHOD
/begin COMPU_METHOD Table_984 "enumeration table" TAB_VERB "%.0" "" COMPU_TAB_REF Table_984 /end COMPU_METHOD
/begin COMPU_METHOD Table_985 "enumeration table" TAB_VERB "%.0" "" COMPU_TAB_REF Table_985 /end COMPU_METHOD
/begin COMPU_METHOD Table_986 "enumeration table" TAB_VERB "%.0" "" COMPU_TAB_REF Table_986 /end COMPU_METHOD
/begin COMPU_METHOD Table_991 "enumeration table" TAB_VERB "%.0" "" COMPU_TAB_REF Table_991 /end COMPU_METHOD
/begin COMPU_METHOD Table_992 "enumeration table" TAB_VERB "%.0" "" COMPU_TAB_REF Table_992 /end COMPU_METHOD
/begin COMPU_METHOD TargetLaneReaction "enumeration table" TAB_VERB "%.0" "" COMPU_TAB_REF TargetLaneReaction /end COMPU_METHOD
/begin COMPU_METHOD TargetObjectLossType "enumeration table" TAB_VERB "%.0" "" COMPU_TAB_REF TargetObjectLossType /end COMPU_METHOD
/begin COMPU_METHOD TargetObjectType "enumeration table" TAB_VERB "%.0" "" COMPU_TAB_REF TargetObjectType /end COMPU_METHOD
/begin COMPU_METHOD TargetSelectionStrategy "enumeration table" TAB_VERB "%.0" "" COMPU_TAB_REF TargetSelectionStrategy /end COMPU_METHOD
/begin COMPU_METHOD TimbaObjectIndex "enumeration table" TAB_VERB "%.0" "" COMPU_TAB_REF TimbaObjectIndex /end COMPU_METHOD
/begin COMPU_METHOD TimeSpecifications "enumeration table" TAB_VERB "%.0" "" COMPU_TAB_REF TimeSpecifications /end COMPU_METHOD
/begin COMPU_METHOD TimeStampProcMethodSelection "enumeration table" TAB_VERB "%.0" "" COMPU_TAB_REF TimeStampProcMethodSelection /end COMPU_METHOD
/begin COMPU_METHOD TimeValidity "enumeration table" TAB_VERB "%.0" "" COMPU_TAB_REF TimeValidity /end COMPU_METHOD
/begin COMPU_METHOD TrackState "enumeration table" TAB_VERB "%.0" "" COMPU_TAB_REF TrackState /end COMPU_METHOD
/begin COMPU_METHOD TrackState_Copy1 "enumeration table" TAB_VERB "%.0" "" COMPU_TAB_REF TrackState_Copy1 /end COMPU_METHOD
/begin COMPU_METHOD TrafficDirection "enumeration table" TAB_VERB "%.0" "" COMPU_TAB_REF TrafficDirection /end COMPU_METHOD
/begin COMPU_METHOD TrafficHandedness "enumeration table" TAB_VERB "%.0" "" COMPU_TAB_REF TrafficHandedness /end COMPU_METHOD
/begin COMPU_METHOD TrafficInfoClass "enumeration table" TAB_VERB "%.0" "" COMPU_TAB_REF TrafficInfoClass /end COMPU_METHOD
/begin COMPU_METHOD TrafficInfoType "enumeration table" TAB_VERB "%.0" "" COMPU_TAB_REF TrafficInfoType /end COMPU_METHOD
/begin COMPU_METHOD TrafficJamLevel "enumeration table" TAB_VERB "%.0" "" COMPU_TAB_REF TrafficJamLevel /end COMPU_METHOD
/begin COMPU_METHOD TrafficLightState "enumeration table" TAB_VERB "%.0" "" COMPU_TAB_REF TrafficLightState /end COMPU_METHOD
/begin COMPU_METHOD TrafficRuleCancelationType "enumeration table" TAB_VERB "%.0" "" COMPU_TAB_REF TrafficRuleCancelationType /end COMPU_METHOD
/begin COMPU_METHOD TrafficSignAndSituation "enumeration table" TAB_VERB "%.0" "" COMPU_TAB_REF TrafficSignAndSituation /end COMPU_METHOD
/begin COMPU_METHOD TrafficSignType "enumeration table" TAB_VERB "%.0" "" COMPU_TAB_REF TrafficSignType /end COMPU_METHOD
/begin COMPU_METHOD TrafficSignValidityConditions "enumeration table" TAB_VERB "%.0" "" COMPU_TAB_REF TrafficSignValidityConditions /end COMPU_METHOD
/begin COMPU_METHOD TrafficSituationInfoType "enumeration table" TAB_VERB "%.0" "" COMPU_TAB_REF TrafficSituationInfoType /end COMPU_METHOD
/begin COMPU_METHOD TrafficZoneInfo "enumeration table" TAB_VERB "%.0" "" COMPU_TAB_REF TrafficZoneInfo /end COMPU_METHOD
/begin COMPU_METHOD TruckSpeedLimitCurrentValidity "enumeration table" TAB_VERB "%.0" "" COMPU_TAB_REF TruckSpeedLimitCurrentValidity /end COMPU_METHOD
/begin COMPU_METHOD TruckSpeedLimitType "enumeration table" TAB_VERB "%.0" "" COMPU_TAB_REF TruckSpeedLimitType /end COMPU_METHOD
/begin COMPU_METHOD TurnState "enumeration table" TAB_VERB "%.0" "" COMPU_TAB_REF TurnState /end COMPU_METHOD
/begin COMPU_METHOD Type "enumeration table" TAB_VERB "%.0" "" COMPU_TAB_REF Type /end COMPU_METHOD
/begin COMPU_METHOD TypeId "enumeration table" TAB_VERB "%.0" "" COMPU_TAB_REF TypeId /end COMPU_METHOD
/begin COMPU_METHOD TypeId_Copy1 "enumeration table" TAB_VERB "%.0" "" COMPU_TAB_REF TypeId_Copy1 /end COMPU_METHOD
/begin COMPU_METHOD TypeLaneModelSolution "enumeration table" TAB_VERB "%.0" "" COMPU_TAB_REF TypeLaneModelSolution /end COMPU_METHOD
/begin COMPU_METHOD Type_Copy1 "enumeration table" TAB_VERB "%.0" "" COMPU_TAB_REF Type_Copy1 /end COMPU_METHOD
/begin COMPU_METHOD Type_Copy2 "enumeration table" TAB_VERB "%.0" "" COMPU_TAB_REF Type_Copy2 /end COMPU_METHOD
/begin COMPU_METHOD Unit "enumeration table" TAB_VERB "%.0" "" COMPU_TAB_REF Unit /end COMPU_METHOD
/begin COMPU_METHOD VX1000.sys.upTimeS.CONVERSION.DIFF_UNIT "@@@@RuleName created by CANape" RAT_FUNC "%3.1" "Seconds" COEFFS 0 1 0 0 0 1 /end COMPU_METHOD
/begin COMPU_METHOD VX113x.mon.bmTemperature.CONVERSION "@@@@RuleName created by CANape" RAT_FUNC "%3.1" "Celsius" COEFFS 0 128 0 0 0 1 /end COMPU_METHOD
/begin COMPU_METHOD VX14xx.mon.nenc.traceBufferOutMax.CONVERSION "@@@@RuleName created by CANape" RAT_FUNC "%3.1" "" COEFFS 0 0.125 0 0 0 1 /end COMPU_METHOD
/begin COMPU_METHOD VX14xx.mon.pod.temperature.CONVERSION "@@@@RuleName created by CANape" RAT_FUNC "%3.1" "" COEFFS 0 1 0 0 0 1 /end COMPU_METHOD
/begin COMPU_METHOD Value "enumeration table" TAB_VERB "%.0" "" COMPU_TAB_REF Value /end COMPU_METHOD
/begin COMPU_METHOD Value_Copy1 "enumeration table" TAB_VERB "%.0" "" COMPU_TAB_REF Value_Copy1 /end COMPU_METHOD
/begin COMPU_METHOD Value_Copy10 "enumeration table" TAB_VERB "%.0" "" COMPU_TAB_REF Value_Copy10 /end COMPU_METHOD
/begin COMPU_METHOD Value_Copy11 "enumeration table" TAB_VERB "%.0" "" COMPU_TAB_REF Value_Copy11 /end COMPU_METHOD
/begin COMPU_METHOD Value_Copy12 "enumeration table" TAB_VERB "%.0" "" COMPU_TAB_REF Value_Copy12 /end COMPU_METHOD
/begin COMPU_METHOD Value_Copy13 "enumeration table" TAB_VERB "%.0" "" COMPU_TAB_REF Value_Copy13 /end COMPU_METHOD
/begin COMPU_METHOD Value_Copy14 "enumeration table" TAB_VERB "%.0" "" COMPU_TAB_REF Value_Copy14 /end COMPU_METHOD
/begin COMPU_METHOD Value_Copy15 "enumeration table" TAB_VERB "%.0" "" COMPU_TAB_REF Value_Copy15 /end COMPU_METHOD
/begin COMPU_METHOD Value_Copy16 "enumeration table" TAB_VERB "%.0" "" COMPU_TAB_REF Value_Copy16 /end COMPU_METHOD
/begin COMPU_METHOD Value_Copy17 "enumeration table" TAB_VERB "%.0" "" COMPU_TAB_REF Value_Copy17 /end COMPU_METHOD
/begin COMPU_METHOD Value_Copy2 "enumeration table" TAB_VERB "%.0" "" COMPU_TAB_REF Value_Copy2 /end COMPU_METHOD
/begin COMPU_METHOD Value_Copy3 "enumeration table" TAB_VERB "%.0" "" COMPU_TAB_REF Value_Copy3 /end COMPU_METHOD
/begin COMPU_METHOD Value_Copy4 "enumeration table" TAB_VERB "%.0" "" COMPU_TAB_REF Value_Copy4 /end COMPU_METHOD
/begin COMPU_METHOD Value_Copy5 "enumeration table" TAB_VERB "%.0" "" COMPU_TAB_REF Value_Copy5 /end COMPU_METHOD
/begin COMPU_METHOD Value_Copy6 "enumeration table" TAB_VERB "%.0" "" COMPU_TAB_REF Value_Copy6 /end COMPU_METHOD
/begin COMPU_METHOD Value_Copy7 "enumeration table" TAB_VERB "%.0" "" COMPU_TAB_REF Value_Copy7 /end COMPU_METHOD
/begin COMPU_METHOD Value_Copy8 "enumeration table" TAB_VERB "%.0" "" COMPU_TAB_REF Value_Copy8 /end COMPU_METHOD
/begin COMPU_METHOD Value_Copy9 "enumeration table" TAB_VERB "%.0" "" COMPU_TAB_REF Value_Copy9 /end COMPU_METHOD
/begin COMPU_METHOD Variant "enumeration table" TAB_VERB "%.0" "" COMPU_TAB_REF Variant /end COMPU_METHOD
/begin COMPU_METHOD VehicleMovementDirection "enumeration table" TAB_VERB "%.0" "" COMPU_TAB_REF VehicleMovementDirection /end COMPU_METHOD
/begin COMPU_METHOD VehicleSpecifications "enumeration table" TAB_VERB "%.0" "" COMPU_TAB_REF VehicleSpecifications /end COMPU_METHOD
/begin COMPU_METHOD VehicleType "enumeration table" TAB_VERB "%.0" "" COMPU_TAB_REF VehicleType /end COMPU_METHOD
/begin COMPU_METHOD VideoCalibrationState "enumeration table" TAB_VERB "%.0" "" COMPU_TAB_REF VideoCalibrationState /end COMPU_METHOD
/begin COMPU_METHOD VideoLane "enumeration table" TAB_VERB "%.0" "" COMPU_TAB_REF VideoLane /end COMPU_METHOD
/begin COMPU_METHOD VideoMainRoadSignType "enumeration table" TAB_VERB "%.0" "" COMPU_TAB_REF VideoMainRoadSignType /end COMPU_METHOD
/begin COMPU_METHOD VideoRoadSignEmbeddedInfo "enumeration table" TAB_VERB "%.0" "" COMPU_TAB_REF VideoRoadSignEmbeddedInfo /end COMPU_METHOD
/begin COMPU_METHOD VideoRoadSignUnit "enumeration table" TAB_VERB "%.0" "" COMPU_TAB_REF VideoRoadSignUnit /end COMPU_METHOD
/begin COMPU_METHOD VideoSensorState "enumeration table" TAB_VERB "%.0" "" COMPU_TAB_REF VideoSensorState /end COMPU_METHOD
/begin COMPU_METHOD VideoStatusState "enumeration table" TAB_VERB "%.0" "" COMPU_TAB_REF VideoStatusState /end COMPU_METHOD
/begin COMPU_METHOD VideoSupplementaryRoadSignType "enumeration table" TAB_VERB "%.0" "" COMPU_TAB_REF VideoSupplementaryRoadSignType /end COMPU_METHOD
/begin COMPU_METHOD VmcMotionType "enumeration table" TAB_VERB "%.0" "" COMPU_TAB_REF VmcMotionType /end COMPU_METHOD
/begin COMPU_METHOD WdwStates "enumeration table" TAB_VERB "%.0" "" COMPU_TAB_REF WdwStates /end COMPU_METHOD
/begin COMPU_METHOD WeatherRestriction "enumeration table" TAB_VERB "%.0" "" COMPU_TAB_REF WeatherRestriction /end COMPU_METHOD
/begin COMPU_METHOD WeatherRestriction_Copy1 "enumeration table" TAB_VERB "%.0" "" COMPU_TAB_REF WeatherRestriction_Copy1 /end COMPU_METHOD
/begin COMPU_METHOD WiperStatus "enumeration table" TAB_VERB "%.0" "" COMPU_TAB_REF WiperStatus /end COMPU_METHOD
/begin COMPU_METHOD YAW_RATE_OFFSET_EXTERNAL_STATES "enumeration table" TAB_VERB "%.0" "" COMPU_TAB_REF YAW_RATE_OFFSET_EXTERNAL_STATES /end COMPU_METHOD
/begin COMPU_METHOD YAW_RATE_OFFSET_INDICATOR_STATES "enumeration table" TAB_VERB "%.0" "" COMPU_TAB_REF YAW_RATE_OFFSET_INDICATOR_STATES /end COMPU_METHOD
/begin COMPU_METHOD YawRateStabilizationAvailability "enumeration table" TAB_VERB "%.0" "" COMPU_TAB_REF YawRateStabilizationAvailability /end COMPU_METHOD
/begin COMPU_METHOD YawRateStateMachineExternalInfo "enumeration table" TAB_VERB "%.0" "" COMPU_TAB_REF YawRateStateMachineExternalInfo /end COMPU_METHOD
/begin COMPU_METHOD YawRateStateMachineInternalInfo "enumeration table" TAB_VERB "%.0" "" COMPU_TAB_REF YawRateStateMachineInternalInfo /end COMPU_METHOD
/begin COMPU_METHOD driverHandsOnSteeringWheelCapacitive "enumeration table" TAB_VERB "%.0" "" COMPU_TAB_REF driverHandsOnSteeringWheelCapacitive /end COMPU_METHOD
/begin COMPU_METHOD driverHandsOnSteeringWheelTorque "enumeration table" TAB_VERB "%.0" "" COMPU_TAB_REF driverHandsOnSteeringWheelTorque /end COMPU_METHOD
/begin COMPU_METHOD driverIntendedSteeringDirection "enumeration table" TAB_VERB "%.0" "" COMPU_TAB_REF driverIntendedSteeringDirection /end COMPU_METHOD
/begin COMPU_METHOD drivingGearSelection "enumeration table" TAB_VERB "%.0" "" COMPU_TAB_REF drivingGearSelection /end COMPU_METHOD
/begin COMPU_METHOD eAdcUnitInCommand "enumeration table" TAB_VERB "%.0" "" COMPU_TAB_REF eAdcUnitInCommand /end COMPU_METHOD
/begin COMPU_METHOD eLimiterStates "enumeration table" TAB_VERB "%.0" "" COMPU_TAB_REF eLimiterStates /end COMPU_METHOD
/begin COMPU_METHOD eUnitInCommand "enumeration table" TAB_VERB "%.0" "" COMPU_TAB_REF eUnitInCommand /end COMPU_METHOD
/begin COMPU_METHOD ecy_hsm_Csai_KeyIdTag "enumeration table" TAB_VERB "%.0" "" COMPU_TAB_REF ecy_hsm_Csai_KeyIdTag /end COMPU_METHOD
/begin COMPU_METHOD rbHsmPrepare_AccessState_en "enumeration table" TAB_VERB "%.0" "" COMPU_TAB_REF rbHsmPrepare_AccessState_en /end COMPU_METHOD
/begin COMPU_METHOD rbMcu_LastResetType_en "enumeration table" TAB_VERB "%.0" "" COMPU_TAB_REF rbMcu_LastResetType_en /end COMPU_METHOD
/begin COMPU_METHOD rbMonReact_EventState "enumeration table" TAB_VERB "%.0" "" COMPU_TAB_REF rbMonReact_EventState /end COMPU_METHOD
/begin COMPU_METHOD rbMonReact_State_en "enumeration table" TAB_VERB "%.0" "" COMPU_TAB_REF rbMonReact_State_en /end COMPU_METHOD
/begin COMPU_METHOD rbNetCom_State_e "enumeration table" TAB_VERB "%.0" "" COMPU_TAB_REF rbNetCom_State_e /end COMPU_METHOD
/begin COMPU_METHOD rbPFlashIntegrity_CrcStatus_en "enumeration table" TAB_VERB "%.0" "" COMPU_TAB_REF rbPFlashIntegrity_CrcStatus_en /end COMPU_METHOD
/begin COMPU_METHOD rbPdm_EDevelopmentError "enumeration table" TAB_VERB "%.0" "" COMPU_TAB_REF rbPdm_EDevelopmentError /end COMPU_METHOD
/begin COMPU_METHOD rbPdm_EJobStatus "enumeration table" TAB_VERB "%.0" "" COMPU_TAB_REF rbPdm_EJobStatus /end COMPU_METHOD
/begin COMPU_METHOD rbPdm_ERequestType "enumeration table" TAB_VERB "%.0" "" COMPU_TAB_REF rbPdm_ERequestType /end COMPU_METHOD
/begin COMPU_METHOD rbSftMon_CoreClkList_en "enumeration table" TAB_VERB "%.0" "" COMPU_TAB_REF rbSftMon_CoreClkList_en /end COMPU_METHOD
/begin COMPU_METHOD rbSftMon_StackStatus_en "enumeration table" TAB_VERB "%.0" "" COMPU_TAB_REF rbSftMon_StackStatus_en /end COMPU_METHOD
/begin COMPU_METHOD rbSysLog_InvalidateStatus_en "enumeration table" TAB_VERB "%.0" "" COMPU_TAB_REF rbSysLog_InvalidateStatus_en /end COMPU_METHOD
/begin COMPU_METHOD rcy_hsm_Csai_JobPriorityTag "enumeration table" TAB_VERB "%.0" "" COMPU_TAB_REF rcy_hsm_Csai_JobPriorityTag /end COMPU_METHOD
/begin COMPU_METHOD rcy_hsm_Csai_SecAcc_NonceCtrl "enumeration table" TAB_VERB "%.0" "" COMPU_TAB_REF rcy_hsm_Csai_SecAcc_NonceCtrl /end COMPU_METHOD
/begin COMPU_METHOD validLineState "enumeration table" TAB_VERB "%.0" "" COMPU_TAB_REF validLineState /end COMPU_METHOD
/begin COMPU_VTAB DirectionIndicatorStatus "enumeration table" TAB_VERB 4 0 "neutral" 1 "left" 2 "right" 3 "bothActive" /end COMPU_VTAB
/begin COMPU_VTAB LcState "enumeration table" TAB_VERB 7 0 "INVALID" 1 "INIT" 2 "SHUTDOWN" 3 "PASSIVE" 4 "DEGRADED" 5 "FULL_PERFORMANCE" 6 "REINIT" /end COMPU_VTAB
/begin COMPU_VTAB RoadsideBarrierType "enumeration table" TAB_VERB 7 0 "NOT_AVAILABLE" 1 "TURF" 2 "GUARDRAIL" 3 "WALL" 4 "CURB" 5 "CONES" 6 "PARKED_VEHICLES" /end COMPU_VTAB
/begin COMPU_VTAB RoadsideBoundaryCategory "enumeration table" TAB_VERB 5 0 "INVALID_EDGE" 1 "LEFT_ELEVATED_EDGE" 2 "RIGHT_ELEVATED_EDGE" 3 "LEFT_ROADEDGE" 4 "RIGHT_ROADEDGE" /end COMPU_VTAB
/begin COMPU_VTAB RoundaboutStates "enumeration table" TAB_VERB 5 0 "notInRoundabout" 1 "approachingRoundaboutBySign" 2 "approachingRoundaboutByMap" 3 "inRoundaboutBySign" 4 "inRoundaboutByMap" /end COMPU_VTAB
/begin COMPU_VTAB RuleProtection "enumeration table" TAB_VERB 2 0 "none" 1 "turn" /end COMPU_VTAB
/begin COMPU_VTAB RuleSource "enumeration table" TAB_VERB 6 0 "RS_UNKNOWN" 1 "RS_SINGLE_MAP" 2 "RS_SINGLE_ROAD_SIGN" 3 "RS_ONLY_MAP" 4 "RS_ONLY_ROAD_SIGN" 5 "RS_MERGED" /end COMPU_VTAB
/begin COMPU_VTAB RuleTypeGroup "enumeration table" TAB_VERB 10 0 "RTG_UNDEFINED" 1 "RTG_SPEED_LIMIT" 2 "RTG_NO_PASSING" 3 "RTG_PAY_ATTENTION" 4 "RTG_NO_ENTRY" 5 "RTG_RIGHT_OF_WAY_AND_YIELDING" 6 "RTG_ALLOWED_DIRECTION" 7 "RTG_NO_PARKING" 8 "RTG_ORDER" 9 "RTG_ALL" /end COMPU_VTAB
/begin COMPU_VTAB SLSDisplayStatus "enumeration table" TAB_VERB 3 0 "notSet" 1 "active" 2 "inActive" /end COMPU_VTAB
/begin COMPU_VTAB SLSOverSpeedOffsetUnit "enumeration table" TAB_VERB 2 0 "kph" 1 "mph" /end COMPU_VTAB
/begin COMPU_VTAB SLSSpeedLimitChangeNotificationStatus "enumeration table" TAB_VERB 2 0 "notActive" 1 "active" /end COMPU_VTAB
/begin COMPU_VTAB SLWFWarningMode "enumeration table" TAB_VERB 5 0 "none" 1 "visualOnly" 2 "visualAcousticCascaded" 3 "visualHapticCascaded" 4 "hapticOnly" /end COMPU_VTAB
/begin COMPU_VTAB SegmentModelType "enumeration table" TAB_VERB 4 0 "CLOTHOID" 1 "CIRCLE" 2 "LINE" 255 "UNKNOWN" /end COMPU_VTAB
/begin COMPU_VTAB SensorConfirmationLevel "enumeration table" TAB_VERB 5 0 "noConfirmation" 1 "unstableConfirmationLostInNearRange" 2 "unstableConfirmation" 3 "stableConfirmationLostInNearRange" 4 "stableConfirmation" /end COMPU_VTAB
/begin COMPU_VTAB SeparationFromOtpResult "enumeration table" TAB_VERB 4 0 "Insufficient" 1 "SufficientBecauseOfNoOtp" 2 "SufficientBecauseOfBarrier" 3 "SufficientBecauseOfLateralDistance" /end COMPU_VTAB
/begin COMPU_VTAB ServiceId "enumeration table" TAB_VERB 23 0 "HV" 1 "ENV_MODEL" 2 "ENV_MODEL2" 3 "BC" 4 "BC2" 5 "BS" 6 "BS2" 7 "RPM_EXECUTION" 8 "LONG_TARGET" 9 "ACF" 10 "REF_LAT" 11 "TRP_LAT" 12 "TRC_LAT" 13 "STEERING_ANGLE" 14 "STEERING_TORQUE" 15 "MCAM_LONG" 16 "EXTERNAL" 17 "SSU" 18 "LONG_OUTPUTPROC" 19 "BA" 20 "LOCA" 21 "TOTAL_NUMBER" 65535 "NOT_DEFINED" /end COMPU_VTAB
/begin COMPU_VTAB SetSpeedInteractionType "enumeration table" TAB_VERB 4 0 "NoEvent" 1 "Increase" 2 "Decrease" 3 "SetToValue" /end COMPU_VTAB
/begin COMPU_VTAB ShapeType "enumeration table" TAB_VERB 14 0 "unknown" 1 "round" 2 "arrowStraight" 3 "arrowLeftStraight" 4 "arrowRightStraight" 5 "arrowLeft" 6 "arrowRight" 7 "arrowLeftRight" 8 "arrowDown" 9 "counter" 10 "uTurn" 11 "pedestrian" 12 "bicycle" 13 "bus" /end COMPU_VTAB
/begin COMPU_VTAB ShapeType_Copy1 "enumeration table" TAB_VERB 11 0 "unknown" 1 "round" 2 "arrowStraight" 3 "arrowLeftStraight" 4 "arrowRightStraight" 5 "arrowLeft" 6 "arrowRight" 7 "arrowLeftRight" 8 "arrowDown" 9 "counter" 10 "uTurn" /end COMPU_VTAB
/begin COMPU_VTAB ShortUserNotificationRequest "enumeration table" TAB_VERB 2 0 "noRequest" 1 "requestActive" /end COMPU_VTAB
/begin COMPU_VTAB Side "enumeration table" TAB_VERB 2 0 "left" 1 "right" /end COMPU_VTAB
/begin COMPU_VTAB Side_Copy1 "enumeration table" TAB_VERB 4 0 "Undefined" 1 "Left" 2 "Right" 3 "Both" /end COMPU_VTAB
/begin COMPU_VTAB SignLocation "enumeration table" TAB_VERB 8 0 "UNKNOWN" 1 "RIGHT_OF_ROAD" 2 "LEFT_OF_ROAD" 3 "ABOVE_ROAD" 4 "ON_ROAD_SURFACE" 5 "NOT_PHISICAL_SIGN" 6 "END_OF_STRETCH_OF_ROAD" 7 "NOT_APPLICABLE" /end COMPU_VTAB
/begin COMPU_VTAB SignState "enumeration table" TAB_VERB 3 0 "none" 1 "newlyDetected" 2 "frozen" /end COMPU_VTAB
/begin COMPU_VTAB SlotMode "enumeration table" TAB_VERB 5 0 "normal" 1 "highlighted" 2 "grayedOut" 3 "blinking" 4 "pulsing" /end COMPU_VTAB
/begin COMPU_VTAB SlsSlwfActiveWarningType "enumeration table" TAB_VERB 8 0 "none" 1 "visual" 2 "acoustic" 3 "visualAcoustic" 4 "haptic" 5 "visualHaptic" 6 "acousticHaptic" 7 "visualAcousticHaptic" /end COMPU_VTAB
/begin COMPU_VTAB SlsStates "enumeration table" TAB_VERB 9 0 "disabledOff" 1 "disabledInit" 2 "disabledCountryNotSupported" 3 "disabledUserDeactivation" 4 "failureSystemError" 5 "failureCommunicationError" 6 "passive" 7 "activeSpeedLimitInformation" 8 "activeWarning" /end COMPU_VTAB
/begin COMPU_VTAB SlwfMode "enumeration table" TAB_VERB 9 0 "off" 1 "visualOnly" 2 "cascadedAcoustic" 3 "cascadedHaptic" 4 "cascadedAcousticHaptic" 5 "hapticOnly" 5 "lastValid" 6 "reserved1" 7 "reserved2" /end COMPU_VTAB
/begin COMPU_VTAB SmStateId "enumeration table" TAB_VERB 6 0 "startup_ending" 1 "bad" 2 "badConnection" 3 "reinit" 4 "reinit_ending" 5 "normalOperation" /end COMPU_VTAB
/begin COMPU_VTAB SmoothType4dSet "enumeration table" TAB_VERB 2 0 "None" 1 "EsaNlaObj" /end COMPU_VTAB
/begin COMPU_VTAB SpeedProfileIndex "enumeration table" TAB_VERB 3 0 "idxLowSpeed" 1 "idxMidSpeed" 2 "idxHighSpeed" /end COMPU_VTAB
/begin COMPU_VTAB SpeedUnit "enumeration table" TAB_VERB 3 0 "kiloMeterPerHour" 1 "milesPerHour" 2 "unknownUnit" /end COMPU_VTAB
/begin COMPU_VTAB SpeedUpFunction "enumeration table" TAB_VERB 9 0 "None" 1 "CutOut" 2 "Overtake" 3 "LaneChangeSupport" 4 "iBoost" 5 "LaneChangeLeft" 6 "LaneChangeRight" 7 "OtaLeft" 8 "OtaRight" /end COMPU_VTAB
/begin COMPU_VTAB SsmPhase "enumeration table" TAB_VERB 3 0 "invalid" 1 "valid" 2 "debouncing" /end COMPU_VTAB
/begin COMPU_VTAB StartLaneReaction "enumeration table" TAB_VERB 3 0 "None" 1 "Predictive" 2 "Confident" /end COMPU_VTAB
/begin COMPU_VTAB Static2DMotionGoal "enumeration table" TAB_VERB 5 0 "stayLaterallyWithinYellowStaticCorridor" 1 "stayInParallelWithYellowStaticCorridor" 2 "keepLeft" 3 "keepRight" 4 "follow" /end COMPU_VTAB
/begin COMPU_VTAB Static2DMotionGoal_v0 "enumeration table" TAB_VERB 4 0 "stayLaterallyWithinYellowStaticCorridor" 1 "stayInParallelWithYellowStaticCorridor" 2 "keepLeft" 3 "keepRight" /end COMPU_VTAB
/begin COMPU_VTAB StationaryHoldMode "enumeration table" TAB_VERB 3 0 "normal" 1 "secure" 2 "secure_lock" /end COMPU_VTAB
/begin COMPU_VTAB StatusIndicator "enumeration table" TAB_VERB 3 0 "noExtrapolation" 1 "extrapolation" 2 "invalid" /end COMPU_VTAB
/begin COMPU_VTAB StreetClassDetectionStates "enumeration table" TAB_VERB 6 0 "undefined" 1 "notDetected" 2 "detectedWithUnknownType" 3 "motorway" 4 "expressway" 5 "normal" /end COMPU_VTAB
/begin COMPU_VTAB SupplementarySign "enumeration table" TAB_VERB 32 0 "additionalNoDisplay" 1 "additionalCar" 2 "additionalLorry" 3 "additionalTrailer" 4 "additionalCaravan" 5 "additionalBus" 6 "additionalExceptAgricultural" 7 "additionalMotorCycle" 8 "additionalWetRoad" 9 "additionalFog" 10 "additionalRain" 11 "additionalSnow" 12 "additionalTime" 13 "additionalSection" 14 "additionalDistance" 15 "additionalWeight" 16 "additionalExitLeft" 17 "additionalExitRight" 18 "additionalPriorityTurn" 19 "additionalText" 20 "additionalGenericSign" 21 "additionalHump" 22 "additionalZone" 23 "additionalAccident" 24 "additionalTrafficJam" 25 "additionalOilTrail" 26 "additionalGravel" 27 "additionalDirt" 28 "additionalTowing" 29 "additionalSchool" 30 "additionalNight" 31 "additionalEnd" /end COMPU_VTAB
/begin COMPU_VTAB SuppressionReason "enumeration table" TAB_VERB 3 0 "notSuppressed" 1 "pedestrianTl" 2 "blinkingTl" /end COMPU_VTAB
/begin COMPU_VTAB SuppressionValue "enumeration table" TAB_VERB 9 0 "noSuppression" 1 "time" 2 "time_unknown" 4 "weather" 8 "weather_unknown" 16 "shortMapSl" 32 "lowConfidence" 64 "roundabout" 128 "exit" /end COMPU_VTAB
/begin COMPU_VTAB SystemStatus "enumeration table" TAB_VERB 4 0 "off" 1 "notAvailable" 2 "available" 3 "active" /end COMPU_VTAB
/begin COMPU_VTAB Table_0 "enumeration table" TAB_VERB 17 0 "MCU_ESR0_RESET" 1 "MCU_ESR1_RESET" 2 "MCU_SMU_RESET" 3 "MCU_SW_RESET" 4 "MCU_STM0_RESET" 5 "MCU_STM1_RESET" 6 "MCU_STM2_RESET" 7 "MCU_STM3_RESET" 8 "MCU_STM4_RESET" 9 "MCU_STM5_RESET" 10 "MCU_CB0_RESET" 11 "MCU_CB1_RESET" 12 "MCU_CB3_RESET" 13 "MCU_STBYR_RESET" 14 "MCU_WARM_POWER_ON_RESET" 15 "MCU_POWER_ON_RESET" 16 "MCU_RESET_UNDEFINED" /end COMPU_VTAB
/begin COMPU_VTAB Table_1043 "enumeration table" TAB_VERB 3 0 "CANIF_PRV_FULL_E" 1 "CANIF_PRV_BASIC_RANGE_E" 2 "CANIF_PRV_BASIC_LIST_E" /end COMPU_VTAB
/begin COMPU_VTAB Table_1236 "enumeration table" TAB_VERB 4 0 "CANTSYN_CRC_IGNORED" 1 "CANTSYN_CRC_NOT_VALIDATED" 2 "CANTSYN_CRC_OPTIONAL" 3 "CANTSYN_CRC_VALIDATED" /end COMPU_VTAB
/begin COMPU_VTAB Table_1237 "enumeration table" TAB_VERB 3 0 "DCM_DSLD_NO_COM_MODE" 1 "DCM_DSLD_SILENT_COM_MODE" 2 "DCM_DSLD_FULL_COM_MODE" /end COMPU_VTAB
/begin COMPU_VTAB Table_1238 "enumeration table" TAB_VERB 3 0 "DCM_NO_BOOT" 1 "DCM_OEM_BOOT" 2 "DCM_SYS_BOOT" /end COMPU_VTAB
/begin COMPU_VTAB Table_1242 "enumeration table" TAB_VERB 2 0 "USE_ASYNCH_CLIENT_SERVER" 1 "USE_ASYNCH_FNC" /end COMPU_VTAB
/begin COMPU_VTAB Table_1244 "enumeration table" TAB_VERB 4 0 "DCM_ROUTINE_IDLE" 1 "DCM_ROUTINE_STOP" 2 "DCM_ROUTINE_STARTED" 3 "DCM_ROUTINE_STOP_PENDING" /end COMPU_VTAB
/begin COMPU_VTAB Table_1246 "enumeration table" TAB_VERB 4 0 "DCM_RESET_NO_BOOT" 1 "DCM_RESET_OEM_BOOT" 2 "DCM_RESET_SYS_BOOT" 3 "DCM_RESET_DRIVE_TO_DRIVE" /end COMPU_VTAB
/begin COMPU_VTAB Table_1252 "enumeration table" TAB_VERB 6 0 "MEMIF_JOB_OK" 1 "MEMIF_JOB_FAILED" 2 "MEMIF_JOB_PENDING" 3 "MEMIF_JOB_CANCELED" 4 "MEMIF_BLOCK_INCONSISTENT" 5 "MEMIF_BLOCK_INVALID" /end COMPU_VTAB
/begin COMPU_VTAB Table_1256 "enumeration table" TAB_VERB 2 0 "Fls_Rb_FlsDevice" 1 "Fls_Rb_nrFlsDevice" /end COMPU_VTAB
/begin COMPU_VTAB Table_1257 "enumeration table" TAB_VERB 2 0 "FEE_PRV_LOAD_IDLE_E" 1 "FEE_PRV_LOAD_BUSY_E" /end COMPU_VTAB
/begin COMPU_VTAB Table_1258 "enumeration table" TAB_VERB 6 0 "FEE_PRV_MEDIUM_WRITE_IDLE_E" 1 "FEE_PRV_MEDIUM_WRITE_BLANKCHECK_E" 2 "FEE_PRV_MEDIUM_WRITE_COPYDATA_E" 3 "FEE_PRV_MEDIUM_WRITE_PROGRAM_E" 4 "FEE_PRV_MEDIUM_WRITE_COMPARE_E" 5 "FEE_PRV_MEDIUM_WRITE_FINAL_E" /end COMPU_VTAB
/begin COMPU_VTAB Table_1260 "enumeration table" TAB_VERB 4 0 "FEE_PRV_MEDIUM_COPY_IDLE_E" 1 "FEE_PRV_MEDIUM_COPY_READ_E" 2 "FEE_PRV_MEDIUM_COPY_WRITE_E" 3 "FEE_PRV_MEDIUM_COPY_FINAL_E" /end COMPU_VTAB
/begin COMPU_VTAB Table_1261 "enumeration table" TAB_VERB 5 0 "FEE_PRV_MEDIUM_SEQ_WRITE_BLNKCHK_COPY_COMP_E" 1 "FEE_PRV_MEDIUM_SEQ_WRITE_BLNKCHK_COMP_E" 2 "FEE_PRV_MEDIUM_SEQ_WRITE_COPY_COMP_E" 3 "FEE_PRV_MEDIUM_SEQ_WRITE_COMP_E" 4 "FEE_PRV_MEDIUM_SEQ_WRITE_ONLY_E" /end COMPU_VTAB
/begin COMPU_VTAB Table_1263 "enumeration table" TAB_VERB 4 0 "FEE_PRV_MEDIUM_COMPAREFLS2FLS_IDLE_E" 1 "FEE_PRV_MEDIUM_COMPAREFLS2FLS_READ_E" 2 "FEE_PRV_MEDIUM_COMPAREFLS2FLS_COMPARE_E" 3 "FEE_PRV_MEDIUM_COMPAREFLS2FLS_FINAL_E" /end COMPU_VTAB
/begin COMPU_VTAB Table_1265 "enumeration table" TAB_VERB 5 0 "FEE_PRV_PROC_DRIVERSTATE_UNINIT_E" 1 "FEE_PRV_PROC_DRIVERSTATE_INIT_E" 2 "FEE_PRV_PROC_DRIVERSTATE_BACKGROUND_E" 3 "FEE_PRV_PROC_DRIVERSTATE_IDLE_E" 4 "FEE_PRV_PROC_DRIVERSTATE_EXT_JOB_E" /end COMPU_VTAB
/begin COMPU_VTAB Table_1266 "enumeration table" TAB_VERB 2 0 "MEMIF_MODE_SLOW" 1 "MEMIF_MODE_FAST" /end COMPU_VTAB
/begin COMPU_VTAB Table_1267 "enumeration table" TAB_VERB 3 0 "FEE_PRV_PROC_BACKGROUNDSTATE_DISABLED" 1 "FEE_PRV_PROC_BACKGROUNDSTATE_ENABLED_ACTIVE" 2 "FEE_PRV_PROC_BACKGROUNDSTATE_ENABLED_SLEEPING" /end COMPU_VTAB
/begin COMPU_VTAB Table_1268 "enumeration table" TAB_VERB 9 0 "FEE_RB_IDLE_E" 1 "FEE_RB_WRITE_MODE_E" 2 "FEE_RB_READ_MODE_E" 3 "FEE_RB_INVALIDATE_MODE_E" 4 "FEE_RB_MAINTAIN_MODE_E" 5 "FEE_RB_SOFT_SECTOR_REORG_MODE_E" 6 "FEE_RB_HARD_SECTOR_REORG_MODE_E" 7 "FEE_RB_SECTOR_ERASE_E" 8 "FEE_RB_STOPMODE_E" /end COMPU_VTAB
/begin COMPU_VTAB Table_1270 "enumeration table" TAB_VERB 4 0 "FEE_FS10" 1 "FEE_FS1X" 2 "FEE_FS2" 3 "FEE_FS3" /end COMPU_VTAB
/begin COMPU_VTAB Table_1272 "enumeration table" TAB_VERB 6 0 "FLS_RB_NO_ORDER_E" 1 "FLS_RB_READ_ORDER_E" 2 "FLS_RB_WRITE_ORDER_E" 3 "FLS_RB_ERASE_ORDER_E" 4 "FLS_RB_COMPARE_ORDER_E" 5 "FLS_RB_BLANK_CHECK_ORDER_E" /end COMPU_VTAB
/begin COMPU_VTAB Table_1274 "enumeration table" TAB_VERB 5 0 "FLS_RB_UNINIT" 1 "FLS_RB_DEEP" 2 "FLS_RB_IDLE" 3 "FLS_RB_BUSY" 4 "FLS_RB_BUSY_INTERNAL" /end COMPU_VTAB
/begin COMPU_VTAB Table_1276 "enumeration table" TAB_VERB 4 0 "Fls_RB_FlsUser_Fls_Fee" 1 "Fls_Rb_nrFlsUser" 254 "Fls_Rb_idErrorAdr" 255 "Fls_Rb_idErrorLen" /end COMPU_VTAB
/begin COMPU_VTAB Table_1277 "enumeration table" TAB_VERB 8 0 "FLS_RB_ST_SUSPEND_NONE_E" 1 "FLS_RB_ST_SUSPEND_REQUESTED_E" 2 "FLS_RB_ST_SUSPEND_DONE_E" 3 "FLS_RB_ST_SUSPEND_NOT_NECESSARY_E" 4 "FLS_RB_ST_RESUME_REQUESTED_E" 5 "FLS_RB_ST_RESUME_DONE_E" 16 "FLS_RB_ST_SUSPEND_ACC_EXEC_ORDERS_E" 17 "FLS_RB_ST_SUSPEND_DONE_EXEC_ORDERS_E" /end COMPU_VTAB
/begin COMPU_VTAB Table_1285 "enumeration table" TAB_VERB 3 0 "STBM_NVM_NO_STORAGE" 1 "STBM_NVM_STORAGE_AT_SHUTDOWN" 2 "STBM_NVM_NOT_CONFIGURED" /end COMPU_VTAB
/begin COMPU_VTAB Table_1286 "enumeration table" TAB_VERB 3 0 "STBM_MASTER" 1 "STBM_SLAVE" 2 "STBM_GATEWAY" /end COMPU_VTAB
/begin COMPU_VTAB Table_1287 "enumeration table" TAB_VERB 5 0 "OS" 1 "ETHTSYN" 2 "GPT" 3 "EXTERNAL_COUNTER" 4 "STBMLOCALTIMEHARDWARE_NOT_CONFIGURED" /end COMPU_VTAB
/begin COMPU_VTAB Table_1288 "enumeration table" TAB_VERB 4 0 "XCP_TIMESTAMP_TYPE_NO_TIME_STAMP" 1 "XCP_TIMESTAMP_TYPE_ONE_BYTE" 2 "XCP_TIMESTAMP_TYPE_TWO_BYTE" 4 "XCP_TIMESTAMP_TYPE_FOUR_BYTE" /end COMPU_VTAB
/begin COMPU_VTAB Table_1290 "enumeration table" TAB_VERB 3 0 "XCP_DAQ_NO_OVERLOAD_INDICATION" 1 "XCP_DAQ_OVERLOAD_INDICATION_PID" 2 "XCP_DAQ_OVERLOAD_INDICATION_EVENT" /end COMPU_VTAB
/begin COMPU_VTAB Table_1291 "enumeration table" TAB_VERB 6 0 "XCP_ODT_OPTIMIZATION_OM_DEFAULT" 1 "XCP_ODT_OPTIMIZATION_OM_ODT_TYPE_16" 2 "XCP_ODT_OPTIMIZATION_OM_ODT_TYPE_32" 3 "XCP_ODT_OPTIMIZATION_OM_ODT_TYPE_64" 4 "XCP_ODT_OPTIMIZATION_OM_ODT_TYPE_ALIGNMENT" 5 "XCP_ODT_OPTIMIZATION_OM_MAX_ENTRY_SIZE" /end COMPU_VTAB
/begin COMPU_VTAB Table_1292 "enumeration table" TAB_VERB 4 0 "XCP_CONSISTENCY_ODT" 1 "XCP_CONSISTENCY_DAQ" 2 "XCP_CONSISTENCY_EVENT" 3 "XCP_CONSISTENCY_NONE" /end COMPU_VTAB
/begin COMPU_VTAB Table_1293 "enumeration table" TAB_VERB 3 0 "XCP_RAMSECTION_INVALID" 1 "XCP_RAMSECTION_PD" 2 "XCP_RAMSECTION_ED" /end COMPU_VTAB
/begin COMPU_VTAB Table_1294 "enumeration table" TAB_VERB 2 0 "NvM_STATE_IDLE" 1 "NvM_STATE_WRITE_IN_PROGRESS" /end COMPU_VTAB
/begin COMPU_VTAB Table_1295 "enumeration table" TAB_VERB 7 0 "DSP_RDTC_SFUNINIT" 1 "DSP_RDTC_SFINIT" 2 "DSP_RDTC_SFCALCNUMDTC" 3 "DSP_RDTC_GETFFSIZE" 4 "DSP_RDTC_UPDATEDISABLED" 5 "DSP_RDTC_GETDTCSTATUS" 6 "DSP_RDTC_SFFILLRESP" /end COMPU_VTAB
/begin COMPU_VTAB Table_1296 "enumeration table" TAB_VERB 8 0 "DCM_RDTC_SUBFUNCTION_INITIAL" 1 "DCM_RDTC_SUBFUNCTION_STATUSOFDTC" 2 "DCM_RDTC_SUBFUNCTION_DISABLERECORDUPDATE" 3 "DCM_RDTC_SUBFUNCTION_SELECTRECORDSDATA" 4 "DCM_RDTC_SUBFUNCTION_GETRECORDSDATASIZE" 5 "DCM_RDTC_SUBFUNCTION_REPORTDTCRECORDS" 6 "DCM_RDTC_SUBFUNCTION_ENABLERECORDUPDATE" 7 "DCM_RDTC_SUBFUNCTION_REENABLERECORDUPDATE" /end COMPU_VTAB
/begin COMPU_VTAB Table_199 "enumeration table" TAB_VERB 7 0 "NvM_Prv_JobResult_Succeeded_e" 1 "NvM_Prv_JobResult_Pending_e" 2 "NvM_Prv_JobResult_Failed_e" 3 "NvM_Prv_JobResult_BlockInconsistent_e" 4 "NvM_Prv_JobResult_BlockInvalidated_e" 5 "NvM_Prv_JobResult_Skipped_e" 6 "NvM_Prv_JobResult_Succeeded_MemIfSkipped_e" /end COMPU_VTAB
/begin COMPU_VTAB Table_2 "enumeration table" TAB_VERB 8 0 "RBBIST_NOERROR" 1 "RBBIST_MBIST_SERR_E" 2 "RBBIST_MBIST_CERR_E" 4 "RBBIST_MBIST_UCERR_E" 8 "RBBIST_MBIST_MERR_E" 16 "RBBIST_MONBIST_SMUERR_E" 32 "RBBIST_MONBIST_PMSERR_E" 48 "RBBIST_MONBIST_SMUERR_AND_PMSERR_E" /end COMPU_VTAB
/begin COMPU_VTAB Table_201 "enumeration table" TAB_VERB 18 0 "NvM_Prv_idJob_Idle_e" 1 "NvM_Prv_idJob_Read_e" 2 "NvM_Prv_idJob_Write_e" 3 "NvM_Prv_idJob_Erase_e" 4 "NvM_Prv_idJob_Restore_e" 5 "NvM_Prv_idJob_Maintain_e" 6 "NvM_Prv_idJob_Validate_e" 7 "NvM_Prv_idJob_Invalidate_e" 8 "NvM_Prv_idJob_ReadIdConfigForReadAll_e" 9 "NvM_Prv_idJob_InvalidateForFirstInitAll_e" 10 "NvM_Prv_idJob_RestoreForImplicitRecovery_e" 11 "NvM_Prv_idJob_InvalidateForRemoveNonResistant_e" 12 "NvM_Prv_idJob_RecalcRamBlkCrc_e" 13 "NvM_Prv_idJob_WriteAll_e" 14 "NvM_Prv_idJob_ReadAllExtPreparation_e" 15 "NvM_Prv_idJob_Suspend_e" 16 "NvM_Prv_idJob_Invalid_e" 17 "NvM_Prv_idJob_Count_e" /end COMPU_VTAB
/begin COMPU_VTAB Table_202 "enumeration table" TAB_VERB 42 0 "NvM_Prv_stJob_Idle_e" 1 "NvM_Prv_stJob_DoCrypto_e" 2 "NvM_Prv_stJob_DoMemIf_e" 3 "NvM_Prv_stJob_PollMemIf_e" 4 "NvM_Prv_stJob_DoCrc_e" 5 "NvM_Prv_stJob_Finished_e" 6 "NvM_Prv_stJobWrite_GetUserData_e" 7 "NvM_Prv_stJobWrite_RecalcUserDataCrc_e" 8 "NvM_Prv_stJobWrite_CalcNvBlkCrc_e" 9 "NvM_Prv_stJobWrite_AppendAdminData_e" 10 "NvM_Prv_stJobWrite_InitiateMemIf_e" 11 "NvM_Prv_stJobWrite_CryptoStartGenerationRandom_e" 12 "NvM_Prv_stJobWrite_CryptoPollGenerationRandom_e" 13 "NvM_Prv_stJobWrite_CryptoStartEncryption_e" 14 "NvM_Prv_stJobWrite_CryptoPollEncryption_e" 15 "NvM_Prv_stJobWrite_CryptoStartGenerationSignature_e" 16 "NvM_Prv_stJobWrite_CryptoPollGenerationSignature_e" 17 "NvM_Prv_stJobRead_Start_e" 18 "NvM_Prv_stJobRead_GetUserData_e" 19 "NvM_Prv_stJobRead_CrcCheck_e" 20 "NvM_Prv_stJobRead_InitiateMemIf_e" 21 "NvM_Prv_stJobRead_RecalcUserDataCrc_e" 22 "NvM_Prv_stJobRead_CalcNvBlkCrc_e" 23 "NvM_Prv_stJobRead_ExtractAdminData_e" 24 "NvM_Prv_stJobRead_SetUserData_e" 25 "NvM_Prv_stJobRead_StartImplicitRecovery_e" 26 "NvM_Prv_stJobRead_CryptoStartSignatureVerification_e" 27 "NvM_Prv_stJobRead_CryptoPollSignatureVerification_e" 28 "NvM_Prv_stJobRead_CryptoStartDecryption_e" 29 "NvM_Prv_stJobRead_CryptoPollDecryption_e" 30 "NvM_Prv_stJobRestore_Start_e" 31 "NvM_Prv_stJobRestore_CopyFromRom_e" 32 "NvM_Prv_stJobRestore_ExplicitSync_e" 33 "NvM_Prv_stJobRestore_InitCallback_e" 34 "NvM_Prv_stJobRestore_Crc_e" 35 "NvM_Prv_stJobRestore_StartWrite_e" 36 "NvM_Prv_stJobInvalidate_InitiateMemIf_e" 37 "NvM_Prv_stJobMaintain_InitiateMemIf_e" 38 "NvM_Prv_stJobValidate_Start_e" 39 "NvM_Prv_stRecalcRamBlkCrc_ExplicitSyncWriteToNvM_e" 40 "NvM_Prv_stRecalcRamBlkCrc_Do_e" 41 "NvM_Prv_stJob_Count_e" /end COMPU_VTAB
/begin COMPU_VTAB Table_220 "enumeration table" TAB_VERB 4 0 "NVM_PRV_ACTIVITY_NOT_INIT" 1 "NVM_PRV_ACTIVITY_IDLE" 2 "NVM_PRV_ACTIVITY_BUSY" 3 "NVM_PRV_ACTIVITY_RAM_BLOCK_CRC" /end COMPU_VTAB
/begin COMPU_VTAB Table_231 "enumeration table" TAB_VERB 2 0 "COM_UNINIT" 1 "COM_INIT" /end COMPU_VTAB
/begin COMPU_VTAB Table_232 "enumeration table" TAB_VERB 2 0 "COMM_UNINIT" 1 "COMM_INIT" /end COMPU_VTAB
/begin COMPU_VTAB Table_233 "enumeration table" TAB_VERB 5 0 "COMM_NO_COM_NO_PENDING_REQUEST" 1 "COMM_NO_COM_REQUEST_PENDING" 2 "COMM_FULL_COM_NETWORK_REQUESTED" 3 "COMM_FULL_COM_READY_SLEEP" 4 "COMM_SILENT_COM" /end COMPU_VTAB
/begin COMPU_VTAB Table_239 "enumeration table" TAB_VERB 3 0 "APPLICATION_ACCESSIBLE" 1 "APPLICATION_RESTARTING" 2 "APPLICATION_TERMINATED" /end COMPU_VTAB
/begin COMPU_VTAB Table_246 "enumeration table" TAB_VERB 4 0 "OS_LOCK_NOTHING" 1 "OS_LOCK_ALL" 2 "OS_LOCK_OS" 3 "OS_LOCK_TASKS" /end COMPU_VTAB
/begin COMPU_VTAB Table_254 "enumeration table" TAB_VERB 5 0 "rbDyResetDiag_InitState_e" 1 "rbDyResetDiag_IdentifyState_e" 2 "rbDyResetDiag_NvmWriteState_e" 3 "rbDyResetDiag_NvmStatusState_e" 4 "rbDyResetDiag_IdleState_e" /end COMPU_VTAB
/begin COMPU_VTAB Table_255 "enumeration table" TAB_VERB 13 -1 "rbDyErrHdl_NoId_e" 0 "rbDyErrHdl_NoStatus_e" 10 "rbDyErrHdl_OneTimeReportsBoundary_e" 10 "rbDyErrHdl_SOPT_StatPtrId_e" 11 "rbDyErrHdl_IWDMon_ErrStatusId_e" 12 "rbDyErrHdl_Temp_CfgStatusPtrId_e" 13 "rbDyErrHdl_Temp_StatusPtrId_e" 14 "rbDyErrHdl_CompCheck_BoschFailureStatId_e" 15 "rbDyErrHdl_CompCheck_CustFailureStatId_e" 16 "rbDyErrHdl_CompCheck_HashFailureStatId_e" 17 "rbDyErrHdl_HWSWCheck_FailureStatId_e" 30 "rbDyErrHdl_NumOfCyclicRprts_e" 45054 "rbDyErrHdl_ReportChecked_e" /end COMPU_VTAB
/begin COMPU_VTAB Table_256 "enumeration table" TAB_VERB 6 0 "rbDyErrHdl_NoErrReac_e" 1 "rbDyErrHdl_Master_SMU_e" 2 "rbDyErrHdl_Master_Latent_e" 3 "rbDyErrHdl_Master_IWD_e" 4 "rbDyErrHdl_Master_JumpFBL_e" 5 "rbDyErrHdl_NumOfErrReactions_e" /end COMPU_VTAB
/begin COMPU_VTAB Table_3 "enumeration table" TAB_VERB 3 0 "RBBIST_NOTTESTED_E" 1 "RBBIST_PASSED_E" 2 "RBBIST_FAILED_E" /end COMPU_VTAB
/begin COMPU_VTAB Table_315 "enumeration table" TAB_VERB 3 0 "rbDyIWDMon_Synchronizing_e" 1 "rbDyIWDMon_ReceiveQuery_e" 2 "rbDyIWDMon_Sending_e" /end COMPU_VTAB
/begin COMPU_VTAB Table_316 "enumeration table" TAB_VERB 8 0 "rbDyIWDMon_CorrTimeAndValue1_e" 1 "rbDyIWDMon_CorrTimeAndValue2_e" 2 "rbDyIWDMon_TooEarly_e" 3 "rbDyIWDMon_CorrTimeAndValue3_e" 4 "rbDyIWDMon_TooLate_e" 5 "rbDyIWDMon_CorrTimeAndValue4_e" 6 "rbDyIWDMon_CorrTimeAndValue5_e" 7 "rbDyIWDMon_CorrTimeInCorrValue_e" /end COMPU_VTAB
/begin COMPU_VTAB Table_317 "enumeration table" TAB_VERB 5 0 "RBMONREACT_REACTION_DEM_TXPIN_FSP_SWRST" 1 "RBMONREACT_REACTION_DEM_TXPIN_FSP" 2 "RBMONREACT_REACTION_DEM_TXPIN" 3 "RBMONREACT_REACTION_HW_DIRECTLY" 4 "RBMONREACT_REACTION_NO_REACTION" /end COMPU_VTAB
/begin COMPU_VTAB Table_368 "enumeration table" TAB_VERB 6 0 "RBMPUSRIBUSCONFIG_CORE0_EN" 1 "RBMPUSRIBUSCONFIG_CORE1_EN" 2 "RBMPUSRIBUSCONFIG_CORE2_EN" 3 "RBMPUSRIBUSCONFIG_CORE3_EN" 4 "RBMPUSRIBUSCONFIG_CORE4_EN" 5 "RBMPUSRIBUSCONFIG_CORE5_EN" /end COMPU_VTAB
/begin COMPU_VTAB Table_374 "enumeration table" TAB_VERB 2 0 "BSWM_FULL_COM" 1 "BSWM_NO_COM" /end COMPU_VTAB
/begin COMPU_VTAB Table_375 "enumeration table" TAB_VERB 29 0 "BSWM_MRP_BSW_MODE_NOTIFICATION" 1 "BSWM_MRP_CANSM_IND" 2 "BSWM_MRP_COMM_IND" 3 "BSWM_MRP_COMM_INITIATE_RESET" 4 "BSWM_MRP_COMM_PNC_REQST" 5 "BSWM_MRP_DCM_APPL_UPDATE_IND" 6 "BSWM_MRP_DCM_COM_MODE_REQST" 7 "BSWM_MRP_ECUM_IND" 8 "BSWM_MRP_ECUM_RUN_REQST_IND" 9 "BSWM_MRP_ECUM_WKUP_SOURCE" 10 "BSWM_MRP_ETHIF_PORTFGROUP" 11 "BSWM_MRP_ETHSM_IND" 12 "BSWM_MRP_FRSM_IND" 13 "BSWM_MRP_GENERIC_REQST" 14 "BSWM_MRP_J1939_DCM_BROADCAST_STATS" 15 "BSWM_MRP_J1939_NM_IND" 16 "BSWM_MRP_LINSM_IND" 17 "BSWM_MRP_LINSM_SCHEDULE_IND" 18 "BSWM_MRP_LINTP_MODE_REQST" 19 "BSWM_MRP_NM_CAR_WKUP_IND" 20 "BSWM_MRP_NVM_JOB_MODE_IND" 21 "BSWM_MRP_NVM_REQST" 22 "BSWM_MRP_SD_CLNT_SERV_CURR_STATE" 23 "BSWM_MRP_SD_CNSMD_EVNT_GRP_CURR_STATE" 24 "BSWM_MRP_SD_EVNT_HNDLR_CURR_STATE" 25 "BSWM_MRP_SWC_MODE_NOTIFICATION" 26 "BSWM_MRP_SWC_MODE_REQUEST" 27 "BSWM_MRP_TIMER" 255 "BSWM_MRP_DEFAULT" /end COMPU_VTAB
/begin COMPU_VTAB Table_382 "enumeration table" TAB_VERB 3 0 "BSWM_FALSE" 1 "BSWM_TRUE" 2 "BSWM_UNDEFINED" /end COMPU_VTAB
/begin COMPU_VTAB Table_4 "enumeration table" TAB_VERB 3 0 "RBBIST_LBIST_PASSED_FAKE_E" 1 "RBBIST_LBIST_PASSED_UCB_E" 2 "RBBIST_LBIST_PASSED_HARDCODED_E" /end COMPU_VTAB
/begin COMPU_VTAB Table_414 "enumeration table" TAB_VERB 28 0 "BSWM_ACTIONLIST" 1 "BSWM_ACTION_COMM_ALLOW_COM" 2 "BSWM_ACTION_COMM_MODE_LMTN" 3 "BSWM_ACTION_COMM_MODE_SWITCH" 4 "BSWM_ACTION_DEADLINE_MNT_CTRL" 5 "BSWM_ACTION_ECUM_STATE_SWITCH" 6 "BSWM_ACTION_ECUM_DRIVER_INIT_LIST_BSWM" 7 "BSWM_ACTION_ETHIF_MODESWITCH" 8 "BSWM_ACTION_J1939DCM_STATE_SWITCH" 9 "BSWM_ACTION_J1939RM_STATE_SWITCH" 10 "BSWM_ACTION_LIN_SCHDL_SWITCH" 11 "BSWM_ACTION_NM_CNTRL" 12 "BSWM_ACTION_PDU_GRP_SWITCH" 13 "BSWM_ACTION_PDU_ROUTER_CNTRL" 14 "BSWM_ACTION_RTE_MODE_REQUEST" 15 "BSWM_ACTION_RTE_START" 16 "BSWM_ACTION_RTE_STOP" 17 "BSWM_ACTION_RTE_SWITCH" 18 "BSWM_ACTION_SCHM_SWITCH" 19 "BSWM_ACTION_SD_CLNT_SERV_MODE_REQ" 20 "BSWM_ACTION_SD_CNSMD_EVNT_GRP_MODE_REQ" 21 "BSWM_ACTION_SD_SERVR_SERV_MODE_REQ" 22 "BSWM_ACTION_SWITCH_IPDU_MODE" 23 "BSWM_ACTION_TIMER_CONTROL" 24 "BSWM_ACTION_TRIG_IPDU_SEND" 25 "BSWM_ACTION_USR_CALLOUT" 26 "BSWM_ACTION_RB_SWC_USR_CALLOUT" 27 "BSWM_ACTIONLIST_SIZE" /end COMPU_VTAB
/begin COMPU_VTAB Table_433 "enumeration table" TAB_VERB 2 0 "BSWM_TRIGGER" 1 "BSWM_CONDITION" /end COMPU_VTAB
/begin COMPU_VTAB Table_445 "enumeration table" TAB_VERB 2 0 "BSWM_DEFERRED" 1 "BSWM_IMMEDIATE" /end COMPU_VTAB
/begin COMPU_VTAB Table_457 "enumeration table" TAB_VERB 7 0 "MCAN" 1 "MULTICAN" 2 "DCAN" 3 "AFCAN" 4 "ZYNQCAN" 5 "RSCAN" 6 "FLEXCAN" /end COMPU_VTAB
/begin COMPU_VTAB Table_458 "enumeration table" TAB_VERB 4 0 "CANIF_CS_UNINIT" 1 "CANIF_CS_SLEEP" 2 "CANIF_CS_STARTED" 3 "CANIF_CS_STOPPED" /end COMPU_VTAB
/begin COMPU_VTAB Table_5 "enumeration table" TAB_VERB 97 0 "RBBIST_MEMORY_CPU0DMEM_E" 1 "RBBIST_MEMORY_CPU0DTAG_E" 2 "RBBIST_MEMORY_CPU0PMEM_E" 3 "RBBIST_MEMORY_CPU0PTAG_E" 4 "RBBIST_MEMORY_CPU0DLMUSTBY_E" 5 "RBBIST_MEMORY_CPU1DMEM_E" 6 "RBBIST_MEMORY_CPU1DTAG_E" 7 "RBBIST_MEMORY_CPU1PMEM_E" 8 "RBBIST_MEMORY_CPU1PTAG_E" 9 "RBBIST_MEMORY_CPU1DLMUSTBY_E" 10 "RBBIST_MEMORY_CPU2DMEM_E" 11 "RBBIST_MEMORY_CPU2DTAG_E" 12 "RBBIST_MEMORY_CPU2PMEM_E" 13 "RBBIST_MEMORY_CPU2PTAG_E" 14 "RBBIST_MEMORY_CPU2DLMU_E" 15 "RBBIST_MEMORY_CPU3DMEM_E" 16 "RBBIST_MEMORY_CPU3DTAG_E" 17 "RBBIST_MEMORY_CPU3PMEM_E" 18 "RBBIST_MEMORY_CPU3PTAG_E" 19 "RBBIST_MEMORY_CPU3DLMU_E" 20 "RBBIST_MEMORY_CPU4DMEM_E" 21 "RBBIST_MEMORY_CPU4DTAG_E" 22 "RBBIST_MEMORY_CPU4PMEM_E" 23 "RBBIST_MEMORY_CPU4PTAG_E" 24 "RBBIST_MEMORY_CPU4DLMU_E" 25 "RBBIST_MEMORY_CPU5DMEM_E" 26 "RBBIST_MEMORY_CPU5DTAG_E" 27 "RBBIST_MEMORY_CPU5PMEM_E" 28 "RBBIST_MEMORY_CPU5PTAG_E" 29 "RBBIST_MEMORY_CPU5DLMU_E" 30 "RBBIST_MEMORY_LMU00_E" 31 "RBBIST_MEMORY_LMU10_E" 32 "RBBIST_MEMORY_LMU20_E" 33 "RBBIST_MEMORY_RESERVED0_E" 34 "RBBIST_MEMORY_CPU0DMEM1_E" 35 "RBBIST_MEMORY_CPU1DMEM1_E" 36 "RBBIST_MEMORY_RESERVED1_E" 37 "RBBIST_MEMORY_RESERVED2_E" 38 "RBBIST_MEMORY_DAM0_E" 39 "RBBIST_MEMORY_DAM1_E" 40 "RBBIST_MEMORY_FSIRAM_E" 41 "RBBIST_MEMORY_SADMA_E" 42 "RBBIST_MEMORY_RESERVED4_E" 43 "RBBIST_MEMORY_MCDS_E" 44 "RBBIST_MEMORY_EMEM0_E" 45 "RBBIST_MEMORY_EMEM1_E" 46 "RBBIST_MEMORY_EMEM2_E" 47 "RBBIST_MEMORY_EMEM3_E" 48 "RBBIST_MEMORY_EMEMXTM_E" 49 "RBBIST_MEMORY_SPUBUFFER0_E" 50 "RBBIST_MEMORY_SPUBUFFER1_E" 51 "RBBIST_MEMORY_SPUCONFIG0_E" 52 "RBBIST_MEMORY_SPUCONFIG1_E" 53 "RBBIST_MEMORY_GTMFIFO_E" 54 "RBBIST_MEMORY_GTMMCS0SLOW_E" 55 "RBBIST_MEMORY_GTMMCS0FAST_E" 56 "RBBIST_MEMORY_GTMMCS1SLOW_E" 57 "RBBIST_MEMORY_GTMMCS1FAST_E" 58 "RBBIST_MEMORY_GTMDPLL1A_E" 59 "RBBIST_MEMORY_GTMDPLL1BC_E" 60 "RBBIST_MEMORY_GTMDPLL2_E" 61 "RBBIST_MEMORY_RESERVED5_E" 62 "RBBIST_MEMORY_MCAN10_E" 63 "RBBIST_MEMORY_MCAN20_E" 64 "RBBIST_MEMORY_MCAN21_E" 65 "RBBIST_MEMORY_PSI5_E" 66 "RBBIST_MEMORY_ERAYOBF0_E" 67 "RBBIST_MEMORY_ERAYOBF1_E" 68 "RBBIST_MEMORY_ERAYTBFIBF0_E" 69 "RBBIST_MEMORY_ERAYTBFIBF1_E" 70 "RBBIST_MEMORY_ERAYMBF0_E" 71 "RBBIST_MEMORY_ERAYMBF1_E" 72 "RBBIST_MEMORY_RESERVED6_E" 73 "RBBIST_MEMORY_RESERVED7_E" 74 "RBBIST_MEMORY_RESERVED8_E" 75 "RBBIST_MEMORY_RESERVED9_E" 76 "RBBIST_MEMORY_RESERVED10_E" 77 "RBBIST_MEMORY_SCRXRAM_E" 78 "RBBIST_MEMORY_SCRRAMINT_E" 79 "RBBIST_MEMORY_RESERVED11_E" 80 "RBBIST_MEMORY_RESERVED12_E" 81 "RBBIST_MEMORY_RESERVED13_E" 82 "RBBIST_MEMORY_GIGETHRXRAM_E" 83 "RBBIST_MEMORY_GIGETHTXRAM_E" 84 "RBBIST_MEMORY_SDMMCRAM_E" 85 "RBBIST_MEMORY_HSPDMRAM_E" 86 "RBBIST_MEMORY_RESERVED14_E" 87 "RBBIST_MEMORY_RESERVED15_E" 88 "RBBIST_MEMORY_SPUFFT00_E" 89 "RBBIST_MEMORY_SPUFFT01_E" 90 "RBBIST_MEMORY_SPUFFT10_E" 91 "RBBIST_MEMORY_SPUFFT11_E" 92 "RBBIST_MEMORY_SPUFFT20_E" 93 "RBBIST_MEMORY_SPUFFT21_E" 94 "RBBIST_MEMORY_SPUFFT30_E" 95 "RBBIST_MEMORY_SPUFFT31_E" 96 "RBBIST_MEMORY_MAXSSH_E" /end COMPU_VTAB
/begin COMPU_VTAB Table_523 "enumeration table" TAB_VERB 5 0 "COMM_BUS_TYPE_CAN" 1 "COMM_BUS_TYPE_ETH" 2 "COMM_BUS_TYPE_FR" 3 "COMM_BUS_TYPE_INTERNAL" 4 "COMM_BUS_TYPE_LIN" /end COMPU_VTAB
/begin COMPU_VTAB Table_524 "enumeration table" TAB_VERB 4 0 "FULL" 1 "LIGHT" 2 "NONE" 3 "PASSIVE" /end COMPU_VTAB
/begin COMPU_VTAB Table_540 "enumeration table" TAB_VERB 3 0 "NVM_BLOCK_NATIVE" 1 "NVM_BLOCK_REDUNDANT" 2 "NVM_BLOCK_DATASET" /end COMPU_VTAB
/begin COMPU_VTAB Table_614 "enumeration table" TAB_VERB 2 0 "SPI_CHANNEL_EB" 1 "SPI_CHANNEL_IB" /end COMPU_VTAB
/begin COMPU_VTAB Table_627 "enumeration table" TAB_VERB 3 0 "SPI_RB_SINGLE" 1 "SPI_RB_CHANNEL" 2 "SPI_RB_CONTINUOUS" /end COMPU_VTAB
/begin COMPU_VTAB Table_640 "enumeration table" TAB_VERB 2 0 "Spi_Cfg___DEFAULT_VARIANT___e" 1 "SPI_CFG_NUM_CONFIGS" /end COMPU_VTAB
/begin COMPU_VTAB Table_641 "enumeration table" TAB_VERB 2 0 "READ_START" 1 "READ_STATUS_CHECK" /end COMPU_VTAB
/begin COMPU_VTAB Table_642 "enumeration table" TAB_VERB 4 0 "READTRAPINFO_STATE_SIZE_CHECK_e" 1 "READTRAPINFO_STATE_TRAP_READ_e" 2 "READTRAPINFO_STATE_TRAP_CHECK_e" 3 "READTRAPINFO_STATE_FAILURE_e" /end COMPU_VTAB
/begin COMPU_VTAB Table_643 "enumeration table" TAB_VERB 3 0 "VIN_WRITE_START" 1 "VIN_WRITE_STATUS_CHECK" 2 "VIN_WRITE_INIT_STATE" /end COMPU_VTAB
/begin COMPU_VTAB Table_644 "enumeration table" TAB_VERB 3 0 "F1A1_WRITE_START" 1 "F1A1_WRITE_STATUS_CHECK" 2 "F1A1_WRITE_INIT_STATE" /end COMPU_VTAB
/begin COMPU_VTAB Table_645 "enumeration table" TAB_VERB 3 0 "XCP_DISABLE_WRITE_START" 1 "XCP_DISABLE_WRITE_STATUS_CHECK" 2 "XCP_DISABLE_WRITE_INIT_STATE" /end COMPU_VTAB
/begin COMPU_VTAB Table_646 "enumeration table" TAB_VERB 2 1 "NvM_STATE_IDLE" 2 "NvM_STATE_WRITE_IN_PROGRESS" /end COMPU_VTAB
/begin COMPU_VTAB Table_647 "enumeration table" TAB_VERB 10 0 "rbDia_LifeCycleManagementPreconitionSessionInit_e" 1 "rbDia_LifeCycleManagementPreconitionSessionCheckLifeCycle_e" 2 "rbDia_LifeCycleManagementPreconitionSessionCheckLifeCyclePending_e" 3 "rbDia_LifeCycleManagementPreconitionSessionCheckReadLcPowerOnCtr_e" 4 "rbDia_LifeCycleManagementPreconitionSessionCheckReadLcPowerOnCtrPending_e" 5 "rbDia_LifeCycleManagementPreconitionSessionClosedPending_e" 6 "rbDia_LifeCycleManagementPreconitionSessionClosed_e" 7 "rbDia_LifeCycleManagementPreconitionSessionError_e" 8 "rbDia_LifeCycleManagementPreconitionSessionSuccessful_e" 9 "rbDia_LifeCycleManagementPreconitionSessionFailed_e" /end COMPU_VTAB
/begin COMPU_VTAB Table_648 "enumeration table" TAB_VERB 4 0 "E2E_P01_DATAID_BOTH" 1 "E2E_P01_DATAID_ALT" 2 "E2E_P01_DATAID_LOW" 3 "E2E_P01_DATAID_NIBBLE" /end COMPU_VTAB
/begin COMPU_VTAB Table_650 "enumeration table" TAB_VERB 6 0 "E2E_P05STATUS_OK" 1 "E2E_P05STATUS_NONEWDATA" 7 "E2E_P05STATUS_ERROR" 8 "E2E_P05STATUS_REPEATED" 32 "E2E_P05STATUS_OKSOMELOST" 64 "E2E_P05STATUS_WRONGSEQUENCE" /end COMPU_VTAB
/begin COMPU_VTAB Table_652 "enumeration table" TAB_VERB 4 0 "IDLE" 1 "DATA_UPDATE" 2 "TRANSMIT_DATA" 3 "TRANSMIT_IN_PROGRESS" /end COMPU_VTAB
/begin COMPU_VTAB Table_654 "enumeration table" TAB_VERB 8 0 "E2E_P01STATUS_OK" 1 "E2E_P01STATUS_NONEWDATA" 2 "E2E_P01STATUS_WRONGCRC" 3 "E2E_P01STATUS_SYNC" 4 "E2E_P01STATUS_INITIAL" 5 "E2E_P01STATUS_REPEATED" 6 "E2E_P01STATUS_OKSOMELOST" 7 "E2E_P01STATUS_WRONGSEQUENCE" /end COMPU_VTAB
/begin COMPU_VTAB Table_655 "enumeration table" TAB_VERB 3 0 "RBMEMSTACK_SETECU_IDLE" 1 "RBMEMSTACK_SETECU_PENDING" 2 "RBMEMSTACK_SETECU_DONE" /end COMPU_VTAB
/begin COMPU_VTAB Table_656 "enumeration table" TAB_VERB 3 0 "RBADC_UNINIT" 1 "RBADC_RUN" 2 "RBADC_ERROR" /end COMPU_VTAB
/begin COMPU_VTAB Table_657 "enumeration table" TAB_VERB 4 0 "RBSFTMON_CLOCKPLAUSIBILITY_FIRST_TX_E" 1 "RBSFTMON_CLOCKPLAUSIBILITY_MEASURE_SEND_E" 2 "RBSFTMON_CLOCKPLAUSIBILITY_WAITFORINT_E" 3 "RBSFTMON_CLOCKPLAUSIBILITY_IDLE_E" /end COMPU_VTAB
/begin COMPU_VTAB Table_658 "enumeration table" TAB_VERB 5 0 "RBSFTMON_CLOCKPLAUSIBILITY_NOERROR_E" 1 "RBSFTMON_CLOCKPLAUSIBILITY_MISSINGINTERROR_E" 2 "RBSFTMON_CLOCKPLAUSIBILITY_OUTOFRANGE_UPPERBOUND_E" 3 "RBSFTMON_CLOCKPLAUSIBILITY_OUTOFRANGE_LOWERBOUND_E" 4 "RBSFTMON_CLOCKPLAUSIBILITY_TRANSMITERROR_E" /end COMPU_VTAB
/begin COMPU_VTAB Table_659 "enumeration table" TAB_VERB 3 0 "RBSFTMON_CORECLK_CLKMON_NOT_ENABLED_E" 1 "RBSFTMON_CORECLK_ALARMNOTSET_E" 2 "RBSFTMON_CORECLK_ALARMNOTCLEARED_E" /end COMPU_VTAB
/begin COMPU_VTAB Table_660 "enumeration table" TAB_VERB 3 0 "rbNetCom_NotInit_e" 1 "rbNetCom_InitDone_e" 2 "rbNetCom_MultiInit_e" /end COMPU_VTAB
/begin COMPU_VTAB Table_661 "enumeration table" TAB_VERB 3 0 "rbNetScheduler_NotInit_e" 1 "rbNetScheduler_InitDone_e" 2 "rbNetScheduler_MultiInit_e" /end COMPU_VTAB
/begin COMPU_VTAB Table_662 "enumeration table" TAB_VERB 3 0 "rbNetXcp_NotInit_e" 1 "rbNetXcp_InitDone_e" 2 "rbNetXcp_MultiInit_e" /end COMPU_VTAB
/begin COMPU_VTAB Table_663 "enumeration table" TAB_VERB 2 0 "CANIF_NO_NOTIFICATION" 1 "CANIF_TX_RX_NOTIFICATION" /end COMPU_VTAB
/begin COMPU_VTAB Table_669 "enumeration table" TAB_VERB 4 1 "CANSM_TIMER_INIT" 2 "CANSM_TIMER_RUNNING" 3 "CANSM_TIMER_ELAPSED" 4 "CANSM_TIMER_CANCELLED" /end COMPU_VTAB
/begin COMPU_VTAB Table_675 "enumeration table" TAB_VERB 10 0 "CANSM_BSM_S_NOCOM" 1 "CANSM_BSM_S_SILENTCOM" 2 "CANSM_BSM_S_FULLCOM" 3 "CANSM_BSM_S_NOT_INITIALIZED" 4 "CANSM_BSM_S_PRE_NOCOM" 5 "CANSM_BSM_WUVALIDATION" 6 "CANSM_BSM_S_PRE_FULLCOM" 7 "CANSM_BSM_S_SET_BAUDRATE" 8 "CANSM_BSM_S_SILENTCOM_BOR" 9 "CANSM_BSM_S_TX_TIMEOUT_EXCEPTION" /end COMPU_VTAB
/begin COMPU_VTAB Table_681 "enumeration table" TAB_VERB 7 0 "CANSM_BOR_IDLE" 1 "CANSM_S_BUS_OFF_CHECK" 2 "CANSM_S_NO_BUS_OFF" 3 "CANSM_S_BUS_OFF_RECOVERY_L1" 4 "CANSM_S_RESTART_CC" 5 "CANSM_S_RESTART_CC_WAIT" 6 "CANSM_S_BUS_OFF_RECOVERY_L2" /end COMPU_VTAB
/begin COMPU_VTAB Table_687 "enumeration table" TAB_VERB 4 0 "CANSM_CANTRCV_DEFAULT" 1 "CANSM_CANTRCV_NORMAL" 2 "CANSM_CANTRCV_SLEEP" 3 "CANSM_CANTRCV_STANDBY" /end COMPU_VTAB
/begin COMPU_VTAB Table_693 "enumeration table" TAB_VERB 23 0 "CANSM_DEFAULT" 1 "CANSM_S_CC_STOPPED" 2 "CANSM_S_PN_CC_STOPPED" 3 "CANSM_S_CC_STOPPED_WAIT" 4 "CANSM_S_PN_CC_STOPPED_WAIT" 5 "CANSM_S_CC_SLEEP" 6 "CANSM_S_PN_CC_SLEEP" 7 "CANSM_S_CC_SLEEP_WAIT" 8 "CANSM_S_PN_CC_SLEEP_WAIT" 9 "CANSM_S_TRCV_NORMAL" 10 "CANSM_S_PN_TRCV_NORMAL" 11 "CANSM_S_TRCV_NORMAL_WAIT" 12 "CANSM_S_PN_TRCV_NORMAL_WAIT" 13 "CANSM_S_TRCV_STANDBY" 14 "CANSM_S_PN_TRCV_STANDBY" 15 "CANSM_S_TRCV_STANDBY_WAIT" 16 "CANSM_S_PN_TRCV_STANDBY_WAIT" 17 "CANSM_S_PN_CLEAR_WUF" 18 "CANSM_S_PN_CLEAR_WUF_WAIT" 19 "CANSM_S_CHECK_WFLAG_IN_CC_SLEEP" 20 "CANSM_S_CHECK_WFLAG_IN_CC_SLEEP_WAIT" 21 "CANSM_S_CHECK_WFLAG_IN_NOT_CC_SLEEP" 22 "CANSM_S_CHECK_WFLAG_IN_NOT_CC_SLEEP_WAIT" /end COMPU_VTAB
/begin COMPU_VTAB Table_699 "enumeration table" TAB_VERB 7 0 "CANSM_PRE_FULLCOM_DEFAULT" 1 "CANSM_PRE_FULLCOM_S_TRCV_NORMAL" 2 "CANSM_PRE_FULLCOM_S_TRCV_NORMAL_WAIT" 3 "CANSM_PRE_FULLCOM_S_CC_STOPPED" 4 "CANSM_PRE_FULLCOM_S_CC_STOPPED_WAIT" 5 "CANSM_PRE_FULLCOM_S_CC_STARTED" 6 "CANSM_PRE_FULLCOM_S_CC_STARTED_WAIT" /end COMPU_VTAB
/begin COMPU_VTAB Table_70 "enumeration table" TAB_VERB 2 0 "RBMPUSRIBUSCONFIG_PASS_E" 1 "RBMPUSRIBUSCONFIG_FAIL_E" /end COMPU_VTAB
/begin COMPU_VTAB Table_705 "enumeration table" TAB_VERB 7 0 "CANSM_WAKEUP_VALIDATION_DEFAULT" 1 "CANSM_WAKEUP_VALIDATION_S_TRCV_NORMAL" 2 "CANSM_WAKEUP_VALIDATION_S_TRCV_NORMAL_WAIT" 3 "CANSM_WAKEUP_VALIDATION_S_CC_STOPPED" 4 "CANSM_WAKEUP_VALIDATION_S_CC_STOPPED_WAIT" 5 "CANSM_WAKEUP_VALIDATION_S_CC_STARTED" 6 "CANSM_WAKEUP_VALIDATION_S_CC_STARTED_WAIT" /end COMPU_VTAB
/begin COMPU_VTAB Table_71 "enumeration table" TAB_VERB 3 0 "RBA_DMA_IDLE" 1 "RBA_DMA_READY" 2 "RBA_DMA_BUSY" /end COMPU_VTAB
/begin COMPU_VTAB Table_711 "enumeration table" TAB_VERB 5 0 "CANSM_TxTimeoutException_DEFAULT" 1 "CANSM_TxTimeoutException_S_CC_STOPPED" 2 "CANSM_TxTimeoutException_S_CC_STOPPED_WAIT" 3 "CANSM_TxTimeoutException_S_CC_STARTED" 4 "CANSM_TxTimeoutException_S_CC_STARTED_WAIT" /end COMPU_VTAB
/begin COMPU_VTAB Table_717 "enumeration table" TAB_VERB 4 0 "CANSM_ControllerState_UNINIT" 1 "CANSM_ControllerState_STOPPED" 2 "CANSM_ControllerState_STARTED" 3 "CANSM_ControllerState_SLEEP" /end COMPU_VTAB
/begin COMPU_VTAB Table_723 "enumeration table" TAB_VERB 3 0 "CANSM_BOR_CONTROLLER_STOPPED_REQUEST" 1 "CANSM_BOR_CONTROLLER_STOPPED_WAIT" 2 "CANSM_BOR_CONTROLLER_STOPPED_REQUEST_COMPLETED" /end COMPU_VTAB
/begin COMPU_VTAB Table_729 "enumeration table" TAB_VERB 5 0 "XCP_STATE_DISCONNECTED" 1 "XCP_STATE_DISCONNECTING" 2 "XCP_STATE_CONNECTED" 3 "XCP_STATE_RESUME" 240 "XCP_STATE_DISABLED" /end COMPU_VTAB
/begin COMPU_VTAB Table_730 "enumeration table" TAB_VERB 4 1 "XCP_IDENTIFICATION_FIELD_TYPE_ABSOLUTE" 2 "XCP_IDENTIFICATION_FIELD_TYPE_RELATIVE_BYTE" 3 "XCP_IDENTIFICATION_FIELD_TYPE_RELATIVE_WORD" 4 "XCP_IDENTIFICATION_FIELD_TYPE_RELATIVE_WORD_ALIGNED" /end COMPU_VTAB
/begin COMPU_VTAB Table_731 "enumeration table" TAB_VERB 11 0 "XCP_DAQ_STATE_NO_DAQ" 1 "XCP_DAQ_STATE_FREE_DAQ" 2 "XCP_DAQ_STATE_ALLOC_DAQ" 3 "XCP_DAQ_STATE_ALLOC_ODT" 4 "XCP_DAQ_STATE_ALLOC_ODT_ENTRY" 5 "XCP_DAQ_STATE_WRITE_DAQ" 6 "XCP_DAQ_STATE_PREPARE_START" 7 "XCP_DAQ_STATE_SHIFTING" 8 "XCP_DAQ_STATE_STOP_REQUESTED" 9 "XCP_DAQ_STATE_READY_TO_RUN" 10 "XCP_DAQ_STATE_RUNNING" /end COMPU_VTAB
/begin COMPU_VTAB Table_732 "enumeration table" TAB_VERB 24 0 "XCP_ERR_CMD_SYNCH" 16 "XCP_ERR_CMD_BUSY" 17 "XCP_ERR_DAQ_ACTIVE" 18 "XCP_ERR_PGM_ACTIVE" 32 "XCP_ERR_CMD_UNKNOWN" 33 "XCP_ERR_CMD_SYNTAX" 34 "XCP_ERR_OUT_OF_RANGE" 35 "XCP_ERR_WRITE_PROTECTED" 36 "XCP_ERR_ACCESS_DENIED" 37 "XCP_ERR_ACCESS_LOCKED" 38 "XCP_ERR_PAGE_NOT_VALID" 39 "XCP_ERR_MODE_NOT_VALID" 40 "XCP_ERR_SEGMENT_NOT_VALID" 41 "XCP_ERR_SEQUENCE" 42 "XCP_ERR_DAQ_CONFIG" 48 "XCP_ERR_MEMORY_OVERFLOW" 49 "XCP_ERR_GENERIC" 50 "XCP_ERR_VERIFY" 51 "XCP_ERR_RES_TEMP_NOT_ACCESS" 52 "XCP_ERR_SUBCMD_UNKNOWN" 252 "XCP_REPEAT_COMMAND" 253 "XCP_NO_ACCESS_HIDE" 254 "XCP_NO_RESPONSE" 255 "XCP_NO_ERROR" /end COMPU_VTAB
/begin COMPU_VTAB Table_733 "enumeration table" TAB_VERB 7 0 "XCP_BG_IDLE" 1 "XCP_BG_CHKSUM" 2 "XCP_BG_MEM_WRITE" 3 "XCP_BG_REPEAT_CMD" 4 "XCP_BG_DO_DISCONNECT" 5 "XCP_BG_CANCEL_REQ" 6 "XCP_BG_START_STOP_SYNC_DAQ" /end COMPU_VTAB
/begin COMPU_VTAB Table_734 "enumeration table" TAB_VERB 2 0 "DCM_DSLD_POS_RESPONSE" 1 "DCM_DSLD_NEG_RESPONSE" /end COMPU_VTAB
/begin COMPU_VTAB Table_735 "enumeration table" TAB_VERB 2 0 "DCM_COMM_ACTIVE" 1 "DCM_COMM_NOT_ACTIVE" /end COMPU_VTAB
/begin COMPU_VTAB Table_736 "enumeration table" TAB_VERB 5 0 "DSD_IDLE" 1 "DSD_VERIFY_DIAGNOSTIC_DATA" 2 "DSD_CALL_SERVICE" 3 "DSD_WAITFORTXCONF" 4 "DSD_SENDTXCONF_APPL" /end COMPU_VTAB
/begin COMPU_VTAB Table_737 "enumeration table" TAB_VERB 4 0 "SPI_JOB_OK" 1 "SPI_JOB_PENDING" 2 "SPI_JOB_FAILED" 3 "SPI_JOB_QUEUED" /end COMPU_VTAB
/begin COMPU_VTAB Table_750 "enumeration table" TAB_VERB 4 0 "SPI_SEQ_OK" 1 "SPI_SEQ_PENDING" 2 "SPI_SEQ_FAILED" 3 "SPI_SEQ_CANCELED" /end COMPU_VTAB
/begin COMPU_VTAB Table_763 "enumeration table" TAB_VERB 6 0 "SPI_PRV_HWUNIT_UNINIT" 1 "SPI_PRV_HWUNIT_IDLE" 2 "SPI_PRV_HWUNIT_TRY_BLOCK_SYNC" 3 "SPI_PRV_HWUNIT_BLOCKED_SYNC" 4 "SPI_PRV_HWUNIT_BUSY_SYNC" 5 "SPI_PRV_HWUNIT_BUSY_ASYNC" /end COMPU_VTAB
/begin COMPU_VTAB Table_764 "enumeration table" TAB_VERB 2 0 "SPI_RB_LO_POLLING_MODE" 1 "SPI_RB_LO_INTERRUPT_MODE" /end COMPU_VTAB
/begin COMPU_VTAB Table_765 "enumeration table" TAB_VERB 3 0 "SPI_RB_LO_UNINIT" 1 "SPI_RB_LO_IDLE" 2 "SPI_RB_LO_BUSY" /end COMPU_VTAB
/begin COMPU_VTAB Table_767 "enumeration table" TAB_VERB 17 0 "RBA_DMA_DECREMENT_ADDR_BY_1_X_DATAWIDTH" 1 "RBA_DMA_DECREMENT_ADDR_BY_2_X_DATAWIDTH" 2 "RBA_DMA_DECREMENT_ADDR_BY_4_X_DATAWIDTH" 3 "RBA_DMA_DECREMENT_ADDR_BY_8_X_DATAWIDTH" 4 "RBA_DMA_DECREMENT_ADDR_BY_16_X_DATAWIDTH" 5 "RBA_DMA_DECREMENT_ADDR_BY_32_X_DATAWIDTH" 6 "RBA_DMA_DECREMENT_ADDR_BY_64_X_DATAWIDTH" 7 "RBA_DMA_DECREMENT_ADDR_BY_128_X_DATAWIDTH" 8 "RBA_DMA_INCREMENT_ADDR_BY_1_X_DATAWIDTH" 9 "RBA_DMA_INCREMENT_ADDR_BY_2_X_DATAWIDTH" 10 "RBA_DMA_INCREMENT_ADDR_BY_4_X_DATAWIDTH" 11 "RBA_DMA_INCREMENT_ADDR_BY_8_X_DATAWIDTH" 12 "RBA_DMA_INCREMENT_ADDR_BY_16_X_DATAWIDTH" 13 "RBA_DMA_INCREMENT_ADDR_BY_32_X_DATAWIDTH" 14 "RBA_DMA_INCREMENT_ADDR_BY_64_X_DATAWIDTH" 15 "RBA_DMA_INCREMENT_ADDR_BY_128_X_DATAWIDTH" 16 "RBA_DMA_NO_MODIFICATION_OF_ADDRESS" /end COMPU_VTAB
/begin COMPU_VTAB Table_769 "enumeration table" TAB_VERB 8 0 "RBA_DMA_TFR_HAS_1_DMA_MOVE" 1 "RBA_DMA_TFR_HAS_2_DMA_MOVES" 2 "RBA_DMA_TFR_HAS_4_DMA_MOVES" 3 "RBA_DMA_TFR_HAS_8_DMA_MOVES" 4 "RBA_DMA_TFR_HAS_16_DMA_MOVES" 5 "RBA_DMA_TFR_HAS_3_DMA_MOVES" 6 "RBA_DMA_TFR_HAS_5_DMA_MOVES" 7 "RBA_DMA_TFR_HAS_9_DMA_MOVES" /end COMPU_VTAB
/begin COMPU_VTAB Table_770 "enumeration table" TAB_VERB 6 0 "RBA_DMA_MOVE_HAS_8_BIT_DATA" 1 "RBA_DMA_MOVE_HAS_16_BIT_DATA" 2 "RBA_DMA_MOVE_HAS_32_BIT_DATA" 3 "RBA_DMA_MOVE_HAS_64_BIT_DATA" 4 "RBA_DMA_MOVE_HAS_128_BIT_DATA" 5 "RBA_DMA_MOVE_HAS_256_BIT_DATA" /end COMPU_VTAB
/begin COMPU_VTAB Table_771 "enumeration table" TAB_VERB 6 0 "RBA_DMA_SW_TRIG_COMPLETE_TRANSACTION" 1 "RBA_DMA_SW_TRIG_SINGLE_TRANSFER" 2 "RBA_DMA_HW_TRIG_COMPLETE_TRANSACTION" 3 "RBA_DMA_HW_TRIG_SINGLE_TRANSFER" 4 "RBA_DMA_HW_TRIG_CONTINUOUS_SINGLE_TRANSFER" 5 "RBA_DMA_HW_TRIG_CONTINUOUS_COMPLETE_TRANSACTION" /end COMPU_VTAB
/begin COMPU_VTAB Table_772 "enumeration table" TAB_VERB 4 0 "RBA_DMA_NO_INT_BUT_FLAG_FOR_COMPLETE_TRANSACTION" 1 "RBA_DMA_NO_INT_BUT_FLAG_FOR_EACH_TRANSFER" 2 "RBA_DMA_INT_TRIG_AND_FLAG_FOR_COMPLETE_TRANSACTION" 3 "RBA_DMA_INT_TRIG_AND_FLAG_FOR_EACH_TRANSFER" /end COMPU_VTAB
/begin COMPU_VTAB Table_773 "enumeration table" TAB_VERB 5 0 "RBA_DMA_NO_LINKEDLIST" 12 "RBA_DMA_LINKEDLIST" 13 "RBA_DMA_ACCUMULATED_LINKEDLIST" 14 "RBA_DMA_SAFE_LINKEDLIST" 15 "RBA_DMA_CONDITIONAL_LINKEDLIST" /end COMPU_VTAB
/begin COMPU_VTAB Table_861 "enumeration table" TAB_VERB 2 0 "ADC_UNINIT" 1 "ADC_INIT" /end COMPU_VTAB
/begin COMPU_VTAB Table_862 "enumeration table" TAB_VERB 4 0 "ADC_IDLE" 1 "ADC_BUSY" 2 "ADC_COMPLETED" 3 "ADC_STREAM_COMPLETED" /end COMPU_VTAB
/begin COMPU_VTAB Table_865 "enumeration table" TAB_VERB 3 0 "PDUR_UNINIT" 1 "PDUR_REDUCED" 2 "PDUR_ONLINE" /end COMPU_VTAB
/begin COMPU_VTAB Table_866 "enumeration table" TAB_VERB 5 1 "DCM_DSP_DSC_INIT" 2 "DCM_DSP_DSC_WAIT" 3 "DCM_DSP_DSC_CHECK_PERMISSION" 4 "DCM_DSP_DSC_SEND_RESP" 5 "DCM_DSP_DSC_ERROR" /end COMPU_VTAB
/begin COMPU_VTAB Table_867 "enumeration table" TAB_VERB 3 1 "DCM_RC_IDLE" 2 "DCM_RC_PENDING" 3 "DCM_RC_CANCEL" /end COMPU_VTAB
/begin COMPU_VTAB Table_868 "enumeration table" TAB_VERB 7 0 "DCM_RDBI_IDLE" 1 "DCM_RDBI_NEG_RESP" 2 "DCM_RDBI_PROCESS_NEW_DID" 3 "DCM_RDBI_CHECK_READACCESS" 4 "DCM_RDBI_CHECK_CONDITIONS" 5 "DCM_RDBI_GET_LENGTH" 6 "DCM_RDBI_GET_DATA" /end COMPU_VTAB
/begin COMPU_VTAB Table_869 "enumeration table" TAB_VERB 4 0 "DCM_LENCALC_STATUS_INIT" 1 "DCM_LENCALC_STATUS_GETINDEX" 2 "DCM_LENCALC_STATUS_GETLENGTH" 3 "DCM_LENCALC_STATUS_GETSUPPORT" /end COMPU_VTAB
/begin COMPU_VTAB Table_870 "enumeration table" TAB_VERB 3 0 "DCM_GETDATA_STATUS_INIT" 1 "DCM_GETDATA_STATUS_GETLENGTH" 2 "DCM_GETDATA_STATUS_GETDATA" /end COMPU_VTAB
/begin COMPU_VTAB Table_871 "enumeration table" TAB_VERB 5 0 "DCM_SUPPORT_OK" 1 "DCM_SUPPORT_SESSION_VIOLATED" 2 "DCM_SUPPORT_SECURITY_VIOLATED" 3 "DCM_SUPPORT_CONDITION_VIOLATED" 4 "DCM_SUPPORT_CONDITION_PENDING" /end COMPU_VTAB
/begin COMPU_VTAB Table_872 "enumeration table" TAB_VERB 2 0 "Fee_Rb_DeviceName" 1 "Fee_Rb_Device_Max" /end COMPU_VTAB
/begin COMPU_VTAB Table_873 "enumeration table" TAB_VERB 5 0 "RBA_FEEFS2_PRV_READ_IDLE_E" 1 "RBA_FEEFS2_PRV_READ_INIT_E" 2 "RBA_FEEFS2_PRV_READ_GETLATEST_E" 3 "RBA_FEEFS2_PRV_READ_READING_E" 4 "RBA_FEEFS2_PRV_READ_FINAL_E" /end COMPU_VTAB
/begin COMPU_VTAB Table_874 "enumeration table" TAB_VERB 11 0 "RBA_FEEFS2_PRV_WRITE_IDLE_E" 1 "RBA_FEEFS2_PRV_WRITE_INIT_E" 2 "RBA_FEEFS2_PRV_WRITE_CALCCRCINRAM_E" 3 "RBA_FEEFS2_PRV_WRITE_GETLATEST_E" 4 "RBA_FEEFS2_PRV_WRITE_COMPARE_E" 5 "RBA_FEEFS2_PRV_WRITE_MALLOCDAT_E" 6 "RBA_FEEFS2_PRV_WRITE_MALLOCFAT_E" 7 "RBA_FEEFS2_PRV_WRITE_DATWRITE_E" 8 "RBA_FEEFS2_PRV_WRITE_VERIFY_E" 9 "RBA_FEEFS2_PRV_WRITE_FATWRITE_E" 10 "RBA_FEEFS2_PRV_WRITE_FINAL_E" /end COMPU_VTAB
/begin COMPU_VTAB Table_875 "enumeration table" TAB_VERB 6 0 "RBA_FEEFS2_PRV_INVALIDATEBLOCK_IDLE_E" 1 "RBA_FEEFS2_PRV_INVALIDATEBLOCK_INIT_E" 2 "RBA_FEEFS2_PRV_INVALIDATEBLOCK_GETLATEST_E" 3 "RBA_FEEFS2_PRV_INVALIDATEBLOCK_MALLOCFAT_E" 4 "RBA_FEEFS2_PRV_INVALIDATEBLOCK_FATWRITE_E" 5 "RBA_FEEFS2_PRV_INVALIDATEBLOCK_FINAL_E" /end COMPU_VTAB
/begin COMPU_VTAB Table_876 "enumeration table" TAB_VERB 6 0 "MEMIF_RB_MIGRATION_RESULT_INIT_E" 1 "MEMIF_RB_MIGRATION_RESULT_NOT_NECESSARY_E" 2 "MEMIF_RB_MIGRATION_RESULT_TO_SMALLER_SIZE_E" 3 "MEMIF_RB_MIGRATION_RESULT_TO_BIGGER_SIZE_E" 4 "MEMIF_RB_MIGRATION_RESULT_NOT_DONE_E" 5 "MEMIF_RB_MIGRATION_RESULT_DEACTIVATED_E" /end COMPU_VTAB
/begin COMPU_VTAB Table_949 "enumeration table" TAB_VERB 8 0 "FEE_PRV_JOBTYPE_NONE_E" 1 "FEE_PRV_JOBTYPE_READ_E" 2 "FEE_PRV_JOBTYPE_WRITE_E" 3 "FEE_PRV_JOBTYPE_INVALIDATE_E" 4 "FEE_PRV_JOBTYPE_BLOCKMAINTENANCE_E" 5 "FEE_PRV_JOBTYPE_TRIGGERREORG_E" 6 "FEE_PRV_JOBTYPE_ENTER_STOP_MODE_E" 7 "FEE_PRV_JOBTYPE_MAX_E" /end COMPU_VTAB
/begin COMPU_VTAB Table_950 "enumeration table" TAB_VERB 4 0 "RBA_FEEFS2_PRV_BACKGROUND_IDLE_E" 1 "RBA_FEEFS2_PRV_BACKGROUND_ERASE_E" 2 "RBA_FEEFS2_PRV_BACKGROUND_SOFTREORG_E" 3 "RBA_FEEFS2_PRV_BACKGROUND_WRITEPERSISTENTDATA_E" /end COMPU_VTAB
/begin COMPU_VTAB Table_951 "enumeration table" TAB_VERB 11 0 "DCM_BOOT_IDLE" 1 "DCM_BOOT_PROCESS_RESET" 2 "DCM_BOOT_SENDFORCEDRESPPEND" 3 "DCM_BOOT_WAIT" 4 "DCM_BOOT_STORE_WARMREQ" 5 "DCM_BOOT_STORE_WARMINIT" 6 "DCM_BOOT_STORE_WARMRESP" 7 "DCM_BOOT_ERROR" 8 "DCM_BOOT_WAIT_FOR_RESET" 9 "DCM_BOOT_PERFORM_RESET" 10 "DCM_BOOT_PREPARE_RESET" /end COMPU_VTAB
/begin COMPU_VTAB Table_952 "enumeration table" TAB_VERB 5 1 "DCM_ECURESET_IDLE" 2 "DCM_ECURESET_REQPERMISSION" 3 "DCM_ECURESET_WAIT" 4 "DCM_ECURESET_SENDRESPONSE" 5 "DCM_ECURESET_ERROR" /end COMPU_VTAB
/begin COMPU_VTAB Table_953 "enumeration table" TAB_VERB 5 0 "RBA_FEEFS2_PRV_ALLOC_ERASE_INIT_E" 1 "RBA_FEEFS2_PRV_ALLOC_ERASE_RDY4ERASE_E" 2 "RBA_FEEFS2_PRV_ALLOC_ERASE_FATPREPARE_E" 3 "RBA_FEEFS2_PRV_ALLOC_ERASE_DAT_E" 4 "RBA_FEEFS2_PRV_ALLOC_ERASE_FINAL_E" /end COMPU_VTAB
/begin COMPU_VTAB Table_954 "enumeration table" TAB_VERB 8 0 "RBA_FEEFS2_PRV_ALLOC_MALLOCFAT_IDLE_E" 1 "RBA_FEEFS2_PRV_ALLOC_MALLOCFAT_INIT_E" 2 "RBA_FEEFS2_PRV_ALLOC_MALLOCFAT_GETERASED_E" 3 "RBA_FEEFS2_PRV_ALLOC_MALLOCFAT_SETFATPREPARE_E" 4 "RBA_FEEFS2_PRV_ALLOC_MALLOCFAT_MIGRATE_E" 5 "RBA_FEEFS2_PRV_ALLOC_MALLOCFAT_SETFATACTIVE_E" 6 "RBA_FEEFS2_PRV_ALLOC_MALLOCFAT_SETRDY4ERASE_E" 7 "RBA_FEEFS2_PRV_ALLOC_MALLOCFAT_FINAL_E" /end COMPU_VTAB
/begin COMPU_VTAB Table_955 "enumeration table" TAB_VERB 11 0 "RBA_FEEFS2_PRV_ALLOC_MALLOCDAT_IDLE_E" 1 "RBA_FEEFS2_PRV_ALLOC_MALLOCDAT_INIT_E" 2 "RBA_FEEFS2_PRV_ALLOC_MALLOCDAT_MALLOCFAT_E" 3 "RBA_FEEFS2_PRV_ALLOC_MALLOCDAT_CREATEERASED_E" 4 "RBA_FEEFS2_PRV_ALLOC_MALLOCDAT_CREATEDAT_E" 5 "RBA_FEEFS2_PRV_ALLOC_MALLOCDAT_GETNEXTBLOCK_E" 6 "RBA_FEEFS2_PRV_ALLOC_MALLOCDAT_DATWRITE_E" 7 "RBA_FEEFS2_PRV_ALLOC_MALLOCDAT_FATWRITE_E" 8 "RBA_FEEFS2_PRV_ALLOC_MALLOCDAT_FINALIZEFAT_E" 9 "RBA_FEEFS2_PRV_ALLOC_MALLOCDAT_UNLINKDAT_E" 10 "RBA_FEEFS2_PRV_ALLOC_MALLOCDAT_FINAL_E" /end COMPU_VTAB
/begin COMPU_VTAB Table_956 "enumeration table" TAB_VERB 4 0 "RBA_FEEFS2_PRV_DAT_WRAP_IDLE_E" 1 "RBA_FEEFS2_PRV_DAT_WRAP_INIT_E" 2 "RBA_FEEFS2_PRV_DAT_WRAP_ACT_E" 3 "RBA_FEEFS2_PRV_DAT_WRAP_FINAL_E" /end COMPU_VTAB
/begin COMPU_VTAB Table_957 "enumeration table" TAB_VERB 5 0 "RBA_FEEFS2_PRV_DAT_FUNC_READ_E" 1 "RBA_FEEFS2_PRV_DAT_FUNC_WRITE_E" 2 "RBA_FEEFS2_PRV_DAT_FUNC_COMPARE_E" 3 "RBA_FEEFS2_PRV_DAT_FUNC_BLANKCHECK_E" 4 "RBA_FEEFS2_PRV_DAT_FUNC_CRC_E" /end COMPU_VTAB
/begin COMPU_VTAB Table_958 "enumeration table" TAB_VERB 7 0 "RBA_FEEFS2_PRV_DAT_WRITE_IDLE_E" 1 "RBA_FEEFS2_PRV_DAT_WRITE_INIT_E" 2 "RBA_FEEFS2_PRV_DAT_WRITE_WRITING_E" 3 "RBA_FEEFS2_PRV_DAT_WRITE_SAFEDATA_E" 4 "RBA_FEEFS2_PRV_DAT_WRITE_SETWLDFC_E" 5 "RBA_FEEFS2_PRV_DAT_WRITE_FINDEOD_E" 6 "RBA_FEEFS2_PRV_DAT_WRITE_FINAL_E" /end COMPU_VTAB
/begin COMPU_VTAB Table_959 "enumeration table" TAB_VERB 5 0 "RBA_FEEFS2_PRV_DAT_COPY_IDLE_E" 1 "RBA_FEEFS2_PRV_DAT_COPY_INIT_E" 2 "RBA_FEEFS2_PRV_DAT_COPY_READ_E" 3 "RBA_FEEFS2_PRV_DAT_COPY_WRITE_E" 4 "RBA_FEEFS2_PRV_DAT_COPY_FINAL_E" /end COMPU_VTAB
/begin COMPU_VTAB Table_960 "enumeration table" TAB_VERB 3 0 "RBA_FEEFS2_PRV_DAT_UNLINKSECTOR_IDLE_E" 1 "RBA_FEEFS2_PRV_DAT_UNLINKSECTOR_INIT_E" 2 "RBA_FEEFS2_PRV_DAT_UNLINKSECTOR_BUSY_E" /end COMPU_VTAB
/begin COMPU_VTAB Table_961 "enumeration table" TAB_VERB 3 0 "RBA_FEEFS2_PRV_FAT_CACHEMODE_UNDEF_E" 1 "RBA_FEEFS2_PRV_FAT_CACHEMODE_GETLATESTBYID_E" 2 "RBA_FEEFS2_PRV_FAT_CACHEMODE_GETLATESTBYADR_E" /end COMPU_VTAB
/begin COMPU_VTAB Table_962 "enumeration table" TAB_VERB 5 0 "RBA_FEEFS2_PRV_FAT_ENTRY2FLS_IDLE_E" 1 "RBA_FEEFS2_PRV_FAT_ENTRY2FLS_INIT_E" 2 "RBA_FEEFS2_PRV_FAT_ENTRY2FLS_WRITE_E" 3 "RBA_FEEFS2_PRV_FAT_ENTRY2FLS_WLERR_E" 4 "RBA_FEEFS2_PRV_FAT_ENTRY2FLS_FINAL_E" /end COMPU_VTAB
/begin COMPU_VTAB Table_963 "enumeration table" TAB_VERB 2 0 "RBA_FEEFS2_PRV_FAT_CACHEBUILD_IDLE_E" 1 "RBA_FEEFS2_PRV_FAT_CACHEBUILD_BUSY_E" /end COMPU_VTAB
/begin COMPU_VTAB Table_964 "enumeration table" TAB_VERB 6 0 "RBA_FEEFS2_PRV_FAT_GETLATESTBYID_IDLE_E" 1 "RBA_FEEFS2_PRV_FAT_GETLATESTBYID_INIT_E" 2 "RBA_FEEFS2_PRV_FAT_GETLATESTBYID_CACHEBUILD_E" 3 "RBA_FEEFS2_PRV_FAT_GETLATESTBYID_SCAN_E" 4 "RBA_FEEFS2_PRV_FAT_GETLATESTBYID_VERIFY_E" 5 "RBA_FEEFS2_PRV_FAT_GETLATESTBYID_FINAL_E" /end COMPU_VTAB
/begin COMPU_VTAB Table_965 "enumeration table" TAB_VERB 7 0 "RBA_FEEFS2_PRV_FAT_GETLATESTBYADR_IDLE_E" 1 "RBA_FEEFS2_PRV_FAT_GETLATESTBYADR_INIT_E" 2 "RBA_FEEFS2_PRV_FAT_GETLATESTBYADR_FILLCACHE_E" 3 "RBA_FEEFS2_PRV_FAT_GETLATESTBYADR_FILTERCACHE_E" 4 "RBA_FEEFS2_PRV_FAT_GETLATESTBYADR_VERIFY_E" 5 "RBA_FEEFS2_PRV_FAT_GETLATESTBYADR_CACHEBUILD_E" 6 "RBA_FEEFS2_PRV_FAT_GETLATESTBYADR_FINAL_E" /end COMPU_VTAB
/begin COMPU_VTAB Table_966 "enumeration table" TAB_VERB 4 0 "RBA_FEEFS2_PRV_FAT_FATWRITE_IDLE_E" 1 "RBA_FEEFS2_PRV_FAT_FATWRITE_INIT_E" 2 "RBA_FEEFS2_PRV_FAT_FATWRITE_WRITE_E" 3 "RBA_FEEFS2_PRV_FAT_FATWRITE_FINAL_E" /end COMPU_VTAB
/begin COMPU_VTAB Table_967 "enumeration table" TAB_VERB 6 0 "RBA_FEEFS2_PRV_FAT_MIGRATE_IDLE_E" 1 "RBA_FEEFS2_PRV_FAT_MIGRATE_INIT_E" 2 "RBA_FEEFS2_PRV_FAT_MIGRATE_GETBLOCK_E" 3 "RBA_FEEFS2_PRV_FAT_MIGRATE_WRITE_E" 4 "RBA_FEEFS2_PRV_FAT_MIGRATE_CACHEBUILD_E" 5 "RBA_FEEFS2_PRV_FAT_MIGRATE_FINAL_E" /end COMPU_VTAB
/begin COMPU_VTAB Table_968 "enumeration table" TAB_VERB 5 0 "RBA_FEEFS2_PRV_FAT_FINALIZE_IDLE_E" 1 "RBA_FEEFS2_PRV_FAT_FINALIZE_INIT_E" 2 "RBA_FEEFS2_PRV_FAT_FINALIZE_BLANKCHECK_E" 3 "RBA_FEEFS2_PRV_FAT_FINALIZE_SHREDDER_E" 4 "RBA_FEEFS2_PRV_FAT_FINALIZE_FINAL_E" /end COMPU_VTAB
/begin COMPU_VTAB Table_977 "enumeration table" TAB_VERB 3 0 "RBA_FEEFS2_PRV_SECTOR_WRITEMARKER_IDLE_E" 1 "RBA_FEEFS2_PRV_SECTOR_WRITEMARKER_INIT_E" 2 "RBA_FEEFS2_PRV_SECTOR_WRITEMARKER_WRITING_E" /end COMPU_VTAB
/begin COMPU_VTAB Table_978 "enumeration table" TAB_VERB 3 0 "RBA_FEEFS2_PRV_SECTOR_SETSTATE_IDLE_E" 1 "RBA_FEEFS2_PRV_SECTOR_SETSTATE_INIT_E" 2 "RBA_FEEFS2_PRV_SECTOR_SETSTATE_WRITING_E" /end COMPU_VTAB
/begin COMPU_VTAB Table_979 "enumeration table" TAB_VERB 7 0 "RBA_FEEFS2_PRV_SECTOR_STATE_UNDEF_E" 1 "RBA_FEEFS2_PRV_SECTOR_STATE_ERASED_E" 2 "RBA_FEEFS2_PRV_SECTOR_STATE_FATPREPARE_E" 3 "RBA_FEEFS2_PRV_SECTOR_STATE_FATACTIVE_E" 4 "RBA_FEEFS2_PRV_SECTOR_STATE_DAT_E" 5 "RBA_FEEFS2_PRV_SECTOR_STATE_RDY4ERASE_E" 6 "RBA_FEEFS2_PRV_SECTOR_STATE_END_E" /end COMPU_VTAB
/begin COMPU_VTAB Table_980 "enumeration table" TAB_VERB 7 0 "RBA_FEEFS2_PRV_SECTOR_ERASE_IDLE_E" 1 "RBA_FEEFS2_PRV_SECTOR_ERASE_INIT_E" 2 "RBA_FEEFS2_PRV_SECTOR_ERASE_PROGRAMERASESTARTMKRSLOT_E" 3 "RBA_FEEFS2_PRV_SECTOR_ERASE_OVERPROGRAMMARKER_E" 4 "RBA_FEEFS2_PRV_SECTOR_ERASE_ERASING_E" 5 "RBA_FEEFS2_PRV_SECTOR_ERASE_SETSTATE_E" 6 "RBA_FEEFS2_PRV_SECTOR_ERASE_FINAL_E" /end COMPU_VTAB
/begin COMPU_VTAB Table_981 "enumeration table" TAB_VERB 3 0 "RBA_FEEFS2_PRV_SECTOR_SETWLDFC_IDLE_E" 1 "RBA_FEEFS2_PRV_SECTOR_SETWLDFC_INIT_E" 2 "RBA_FEEFS2_PRV_SECTOR_SETWLDFC_WRITING_E" /end COMPU_VTAB
/begin COMPU_VTAB Table_983 "enumeration table" TAB_VERB 16 0 "rbDia_CryptoAlgoSessionInit_e" 1 "rbDia_CryptoAlgoSessionFcPending_e" 2 "rbDia_CryptoAlgoSessionOpen_e" 3 "rbDia_CryptoAlgoSessionBusy_e" 4 "rbDia_CryptoAlgoSessionClosed_e" 5 "rbDia_CryptoAlgoSessionClosedPending_e" 6 "rbDia_CryptoAlgoSessionError_e" 7 "rbDia_CryptoAlgoSessionCheckLifeCycle_e" 8 "rbDia_CryptoAlgoSessionCheckLifeCyclePending_e" 9 "rbDia_CryptoAlgoSessionCheckReadLCPowerOnCtr_e" 10 "rbDia_CryptoAlgoSessionCheckReadLCPowerOnCtrPending_e" 11 "rbDia_CryptoAlgoSessionGetChallenge_e" 12 "rbDia_CryptoAlgoSessionVerifyResponse_e" 13 "rbDia_CryptoAlgoSessionVerifyResponsePending_e" 14 "rbDia_CryptoAlgoSessionTransferResponse_e" 15 "rbDia_CryptoAlgoSessionIdle_e" /end COMPU_VTAB
/begin COMPU_VTAB Table_984 "enumeration table" TAB_VERB 10 0 "rbDia_LifeCycleManagementSwitchSessionIdle_e" 1 "rbDia_LifeCycleManagementSwitchSessionStart_e" 2 "rbDia_LifeCycleManagementSwitchSessionSetLifeCycle_e" 3 "rbDia_LifeCycleManagementSwitchSessionSetLifeCyclePending_e" 4 "rbDia_LifeCycleManagementSwitchSessionClosedPending_e" 5 "rbDia_LifeCycleManagementSwitchSessionClosed_e" 6 "rbDia_LifeCycleManagementSwitchSessionError_e" 7 "rbDia_LifeCycleManagementSwitchSessionBusyRepeat_e" 8 "rbDia_LifeCycleManagementSwitchSessionSuccessful_e" 9 "rbDia_LifeCycleManagementSwitchSessionFailed_e" /end COMPU_VTAB
/begin COMPU_VTAB Table_985 "enumeration table" TAB_VERB 2 0 "ADC_CONV_MODE_ONESHOT" 1 "ADC_CONV_MODE_CONTINUOUS" /end COMPU_VTAB
/begin COMPU_VTAB Table_986 "enumeration table" TAB_VERB 32 0 "FADCI_IS_AT_MAX_FREQ" 1 "FADCI_IS_FADC_BY_2" 2 "FADCI_IS_FADC_BY_3" 3 "FADCI_IS_FADC_BY_4" 4 "FADCI_IS_FADC_BY_5" 5 "FADCI_IS_FADC_BY_6" 6 "FADCI_IS_FADC_BY_7" 7 "FADCI_IS_FADC_BY_8" 8 "FADCI_IS_FADC_BY_9" 9 "FADCI_IS_FADC_BY_10" 10 "FADCI_IS_FADC_BY_11" 11 "FADCI_IS_FADC_BY_12" 12 "FADCI_IS_FADC_BY_13" 13 "FADCI_IS_FADC_BY_14" 14 "FADCI_IS_FADC_BY_15" 15 "FADCI_IS_FADC_BY_16" 16 "FADCI_IS_FADC_BY_17" 17 "FADCI_IS_FADC_BY_18" 18 "FADCI_IS_FADC_BY_19" 19 "FADCI_IS_FADC_BY_20" 20 "FADCI_IS_FADC_BY_21" 21 "FADCI_IS_FADC_BY_22" 22 "FADCI_IS_FADC_BY_23" 23 "FADCI_IS_FADC_BY_24" 24 "FADCI_IS_FADC_BY_25" 25 "FADCI_IS_FADC_BY_26" 26 "FADCI_IS_FADC_BY_27" 27 "FADCI_IS_FADC_BY_28" 28 "FADCI_IS_FADC_BY_29" 29 "FADCI_IS_FADC_BY_30" 30 "FADCI_IS_FADC_BY_31" 31 "FADCI_IS_FADC_BY_32" /end COMPU_VTAB
/begin COMPU_VTAB Table_991 "enumeration table" TAB_VERB 4 0 "STANDARD_CAN" 1 "STANDARD_FD_CAN" 2 "EXTENDED_CAN" 3 "EXTENDED_FD_CAN" /end COMPU_VTAB
/begin COMPU_VTAB Table_992 "enumeration table" TAB_VERB 11 0 "CANIF_NO_UL" 1 "CAN_NM" 2 "CAN_TP" 3 "CAN_TSYN" 4 "J1939NM" 5 "J1939TP" 6 "PDUR" 7 "XCP" 8 "CDD" 9 "USER" 10 "MAX_USER_TYPE" /end COMPU_VTAB
/begin COMPU_VTAB TargetLaneReaction "enumeration table" TAB_VERB 5 0 "None" 1 "LimitedToStartLane" 2 "Full" 3 "WsosPass" 4 "WsosFollow" /end COMPU_VTAB
/begin COMPU_VTAB TargetObjectLossType "enumeration table" TAB_VERB 4 0 "noLoss" 1 "lossInFollowUp" 2 "lossInStandStill" 3 "lossInCloseRange" /end COMPU_VTAB
/begin COMPU_VTAB TargetObjectType "enumeration table" TAB_VERB 6 0 "unknown" 1 "ego" 2 "left" 3 "right" 4 "egoLane" 5 "egoTrack" /end COMPU_VTAB
/begin COMPU_VTAB TargetSelectionStrategy "enumeration table" TAB_VERB 6 0 "tiplLaneKeeping" 1 "imbaFollowPrecedingObject" 2 "tiplLaneChangeToTheLeft" 3 "tiplLaneChangeToTheRight" 4 "tiplLaneChangeLongLatLeft" 5 "tiplLaneChangeLongLatRight" /end COMPU_VTAB
/begin COMPU_VTAB TimbaObjectIndex "enumeration table" TAB_VERB 11 0 "targetObject" 1 "closestTipl" 2 "subClosestCentral" 3 "closestLeft" 4 "subClosestLeft" 5 "closestRight" 6 "subClosestRight" 7 "closestOncomingLeft" 8 "closestOncomingRight" 9 "closestImba" 10 "TimbaObjectIndex_MAX" /end COMPU_VTAB
/begin COMPU_VTAB TimeSpecifications "enumeration table" TAB_VERB 4 0 "NOT_TIME_DEPENDENT" 1 "APPLIES_NOW" 2 "NOT_APPLIES_NOW" 3 "UNKNOWN" /end COMPU_VTAB
/begin COMPU_VTAB TimeStampProcMethodSelection "enumeration table" TAB_VERB 4 1 "compensateWithLatencyTime" 2 "timeStampBelowLatencyAfterOverflow" 3 "initialTimeStampBelowLatency" 4 "invalidTimeStamp" /end COMPU_VTAB
/begin COMPU_VTAB TimeValidity "enumeration table" TAB_VERB 5 0 "Undefined" 1 "Valid" 2 "ReverseMoving" 3 "NegativeTime" 4 "InfinityTime" /end COMPU_VTAB
/begin COMPU_VTAB TrackState "enumeration table" TAB_VERB 3 0 "invalid" 1 "updated" 2 "tracked" /end COMPU_VTAB
/begin COMPU_VTAB TrackState_Copy1 "enumeration table" TAB_VERB 3 0 "updated" 1 "visibleTracked" 2 "tracked" /end COMPU_VTAB
/begin COMPU_VTAB TrafficDirection "enumeration table" TAB_VERB 3 0 "undefined" 1 "left" 2 "right" /end COMPU_VTAB
/begin COMPU_VTAB TrafficHandedness "enumeration table" TAB_VERB 2 0 "right" 1 "left" /end COMPU_VTAB
/begin COMPU_VTAB TrafficInfoClass "enumeration table" TAB_VERB 6 0 "unknown" 1 "fromRoadSign" 2 "defaultSpeedLimit" 3 "trafficContext" 4 "fromMapData" 5 "all" /end COMPU_VTAB
/begin COMPU_VTAB TrafficInfoType "enumeration table" TAB_VERB 80 0 "invalid" 100 "speedLimit" 101 "speedAdvice" 102 "speedMinimum" 200 "noPassing" 300 "payAttentionDanger" 301 "payAttentionCurveLeft" 302 "payAttentionCurveRight" 303 "payAttentionDoubleCurveLeft" 304 "payAttentionDoubleCurveRight" 305 "payAttentionTrain" 306 "payAttentionJam" 307 "payAttentionRoadWorks" 308 "payAttentionSlopeDown" 309 "payAttentionSlopeUp" 310 "payAttentionConstriction" 311 "payAttentionConstrictionLeft" 312 "payAttentionConstrictionRight" 313 "payAttentionPedestrians" 314 "payAttentionKids" 315 "payAttentionBikes" 316 "payAttentionSkidding" 317 "payAttentionRoundabout" 318 "payAttentionWildAnimal" 319 "payAttentionCattle" 320 "payAttentionFrogs" 321 "payAttentionBus" 322 "payAttentionWind" 323 "payAttentionSnow" 324 "payAttentionPedestrianCrossing" 325 "payAttentionHump" 326 "payAttentionRock" 327 "payAttentionLowTree" 328 "payAttentionGravel" 329 "payAttentionTwoWay" 330 "payAttentionLights" 331 "payAttentionPlane" 332 "payAttentionRider" 333 "payAttentionDrawbridge" 334 "payAttentionPier" 335 "payAttentionJunction" 336 "payAttentionCrashRisk" 337 "payAttentionAccident" 338 "payAttentionSmoke" 339 "payAttentionOilTrail" 340 "payAttentionDirtyRoad" 341 "payAttentionRoadDamage" 342 "payAttentionRuts" 343 "payAttentionSoftShoulder" 344 "payAttentionCustoms" 345 "payAttentionDeadEnd" 346 "payAttentionPollution" 347 "payAttentionPriorityJunction" 400 "noEntry" 401 "noEntryOneWay" 500 "rightOfWay" 501 "rightOfWayNextCrossing" 502 "giveRightOfWayNextCrossing" 503 "yieldToRightNextCrossing" 504 "yieldToLeftNextCrossing" 505 "stopAndYield" 600 "directionOnlyStraight" 601 "directionOnlyRight" 602 "directionOnlyLeft" 603 "directionOnlyStraightOrLeft" 604 "directionOnlyStraightOrRight" 605 "directionOnlyLeftOrRight" 606 "noReverseTurn" 607 "noLeftTurn" 608 "noRightTurn" 700 "noParking" 701 "noStopping" 702 "noStoppingOnShoulder" 800 "orderKeepDistance" 801 "orderZebraCrossing" 802 "orderUmweltZone" 803 "orderTurnLightsOn" 804 "orderTurnLightsOff" 805 "orderOneWayStreet" 805 "last" /end COMPU_VTAB
/begin COMPU_VTAB TrafficJamLevel "enumeration table" TAB_VERB 5 0 "none" 1 "neutral" 2 "slowMoving" 3 "trafficJam" 4 "trafficJamHighway" /end COMPU_VTAB
/begin COMPU_VTAB TrafficLightState "enumeration table" TAB_VERB 7 0 "unknown" 1 "red" 2 "yellow" 3 "green" 4 "yellowAfterGreen" 5 "yellowBlinking" 6 "turnedOff" /end COMPU_VTAB
/begin COMPU_VTAB TrafficRuleCancelationType "enumeration table" TAB_VERB 7 0 "CT_NONE" 1 "CT_ALL" 2 "CT_SPEED_LIMIT" 3 "CT_SPEED_ADVICE" 4 "CT_SPEED_MINIMUM" 5 "CT_NO_PASSING" 6 "CT_RIGHT_OF_WAY" /end COMPU_VTAB
/begin COMPU_VTAB TrafficSignAndSituation "enumeration table" TAB_VERB 80 0 "DANGER" 1 "PASS_LEFT_OR_RIGHT_SIDE" 2 "PASS_LEFT_SIDE" 3 "PASS_RIGHT_SIDE" 4 "DOMESTIC_ANIMALS_CROSSING" 5 "WILD_ANIMALS_CROSSING" 6 "ROAD_WORKS" 7 "RESIDENTIAL_AREA" 8 "END_OF_RESIDENTIAL_AREA" 9 "RIGHT_BEND" 10 "LEFT_BEND" 13 "DOUBLE_BEND_RIGHT_FIRST" 14 "DOUBLE_BEND_LEFT_FIRST" 17 "CURVY_ROAD" 20 "OVERTAKING_BY_GOODS_VEHICLES_PROHIBITED" 21 "END_OF_PROHIBITION_ON_OVERTAKING_FOR_GOODS_VEHICLES" 22 "DANGEROUS_INTERSECTION" 24 "TUNNEL" 25 "FERRY_TERMINAL" 26 "NARROW_BRIDGE" 28 "HUMPBACK_BRIDGE" 29 "RIVER_BANK" 30 "RIVER_BANK_LEFT" 31 "LIGHT_SIGNALS" 32 "GIVE_WAY_OR_YIELD_B" 33 "STOP" 34 "PRIORITY_ROAD" 35 "INTERSECTION" 36 "INTERSECTION_WITH_MINOR_ROAD" 37 "INTERSECTION_WITH_PRIORITY_TO_THE_RIGHT" 38 "DIRECTION_TO_THE_RIGHT" 39 "DIRECTION_TO_THE_LEFT" 40 "CARRIAGEWAY_NARROWS" 41 "CARRIAGEWAY_NARROWS_RIGHT" 42 "CARRIAGEWAY_NARROWS_LEFT" 43 "LANE_MERGE_LEFT" 44 "LANE_MERGE_RIGHT" 45 "LANE_MERGE_CENTER" 46 "OVERTAKING_PROHIBITED" 47 "END_OF_PROHIBITION_ON_OVERTAKING" 50 "PEDESTRIANS" 51 "PEDESTRIAN_CROSSING" 52 "CHILDREN" 53 "SCHOOL_ZONE" 54 "CYCLISTS" 55 "TWO_WAY_TRAFFIC" 56 "RAILWAY_CROSSING_WITH_GATES" 57 "RAILWAY_CROSSING_WITHOUT_GATES" 58 "RAILWAY_CROSSING" 59 "TRAMWAY" 60 "FALLING_ROCKS" 61 "FALLING_ROCKS_LEFT" 62 "FALLING_ROCKS_RIGHT" 63 "STEEP_DROP_LEFT" 64 "STEEP_DROP_RIGHT" 65 "VARIABLE_SIGN_MECHANIC_ELEMENTS" 66 "SLIPPERY_ROAD" 67 "STEEP_ASCENT" 68 "STEEP_DESCENT" 69 "UNEVEN_ROAD" 70 "HUMP" 71 "DIP" 72 "ROAD_FLOODS" 73 "ICY_ROAD" 74 "SIDE_WINDS" 75 "TRAFFIC_CONGESTION" 76 "HIGH_ACCIDENT_AREA" 77 "BEGINNING_OF_BUILT_UP_AREA" 79 "END_OF_ALL_PROHIBITIONS" 80 "VARIABLE_SIGN_LIGHT_ELEMENTS" 81 "PRIORITY_OVER_ONCOMING_TRAFFIC" 82 "PRIORITY_FOR_ONCOMING_TRAFFIC" 83 "END_OF_BUILT_UP_AREA" 87 "SPEED_LIMIT" 88 "END_OF_SPEED_LIMIT" 251 "RAILROAD_CROSSING" 252 "ZEBRA_CROSSING" 253 "SPEED_BUMP" 254 "TRAFFIC_LIGHT" 255 "INVALID" /end COMPU_VTAB
/begin COMPU_VTAB TrafficSignType "enumeration table" TAB_VERB 2 0 "unknown" 1 "stopSign" /end COMPU_VTAB
/begin COMPU_VTAB TrafficSignValidityConditions "enumeration table" TAB_VERB 16 0 "ALWAYS_VALID" 1 "OTHER_CONDITIONS_FOR_ALL_VEHICLES" 2 "OTHER_CONDITIONS_FOR_THIS_VEHICLE" 3 "OTHER_CONDITIONS_FOR_OTHER_VEHICLES" 4 "OTHER_CONDITIONS_FOR_NO_VEHICLES" 5 "INVALID_SIGN" 6 "VALID_IF_SNOW" 7 "VALID_IF_FOG" 8 "VALID_IF_RAIN" 9 "VALID_BY_DAY" 10 "VALID_BY_NIGHT" 11 "VALID_DEPENDING_ON_TURN_DIRECTION" 12 "VALIDITY_UNKNOWN" 13 "VALIDITY_RESERVED_1" 14 "VALIDITY_RESERVED_2" 15 "CONDITION_DEPENDENCY_UNKNOWN" /end COMPU_VTAB
/begin COMPU_VTAB TrafficSituationInfoType "enumeration table" TAB_VERB 26 0 "unknown" 1 "pedestrianCrossingAhead" 2 "endOfAllRestriction" 3 "endOfSpeedLimit" 4 "endOfNoOvertaking" 5 "mandatoryDirectionForward" 6 "mandatoryDirectionSharpLeft" 7 "mandatoryDirectionSharpRight" 8 "mandatoryDirectionForwardOrSharpLeft" 9 "mandatoryDirectionForwardOrSharpRight" 10 "mandatoryDirectionSharpLeftOrRight" 11 "mandatoryDirectionAllDirectionExceptBack" 12 "mandatoryDirectionPassOnLeft" 13 "mandatoryDirectionPassOnRight" 14 "mandatoryDirectionPassOnLeftOrRight" 15 "roundabout" 16 "roadWork" 17 "pedestrianRoad" 18 "endOfPedestrianRoad" 19 "bikeRoad" 20 "endOfBikeRoad" 21 "pedestrianAndBikeRoad" 22 "endOfPedestrianAndBikeRoad" 23 "pedestrianAndBikeRoadSeparated" 24 "endOfPedestrianAndBikeRoadSeparated" 25 "endOfSchoolZone" /end COMPU_VTAB
/begin COMPU_VTAB TrafficZoneInfo "enumeration table" TAB_VERB 6 0 "noZone" 1 "speedLimitZone" 2 "calmZone" 3 "pedestrianZone" 4 "bikeZone" 5 "pedestrianAndBikeZone" /end COMPU_VTAB
/begin COMPU_VTAB TruckSpeedLimitCurrentValidity "enumeration table" TAB_VERB 4 0 "speedLimitIsNotValidAtThisMoment" 1 "speedLimitIsValidAtThisMoment" 2 "speedLimitValidityIsUnkownAtThisMoment" 3 "infoNotAvailable" /end COMPU_VTAB
/begin COMPU_VTAB TruckSpeedLimitType "enumeration table" TAB_VERB 4 0 "explicitLegalSpeedLimitByRoadSign" 1 "implicitLegalSpeedLimitByRoadType" 2 "maximumSpeedLimitNotRegardingExplicity" 3 "unknownOrNA" /end COMPU_VTAB
/begin COMPU_VTAB TurnState "enumeration table" TAB_VERB 3 0 "notTurning" 1 "turningDrivingSide" 2 "turningOncomingSide" /end COMPU_VTAB
/begin COMPU_VTAB Type "enumeration table" TAB_VERB 3 0 "invalid" 1 "partialReaction" 2 "fullReaction" /end COMPU_VTAB
/begin COMPU_VTAB TypeId "enumeration table" TAB_VERB 3 0 "invalid" 1 "trafficParticipant" 2 "platoon" /end COMPU_VTAB
/begin COMPU_VTAB TypeId_Copy1 "enumeration table" TAB_VERB 5 0 "unknown" 1 "objectImba" 2 "egoVehicle" 3 "trajectory" 4 "polyline" /end COMPU_VTAB
/begin COMPU_VTAB TypeLaneModelSolution "enumeration table" TAB_VERB 2 0 "TiplSolution" 1 "VideoSolution" /end COMPU_VTAB
/begin COMPU_VTAB Type_Copy1 "enumeration table" TAB_VERB 6 1 "Ok" 1 "OK" 2 "Error" 2 "ERROR" 3 "Imprecise" 3 "IMPRECISE" /end COMPU_VTAB
/begin COMPU_VTAB Type_Copy2 "enumeration table" TAB_VERB 15 0 "Unknown" 1 "StopLine" 2 "ZebraCrossing" 3 "ArrowForward" 4 "ArrowLeft" 5 "ArrowRight" 6 "ArrowStraightLeft" 7 "ArrowStraightRight" 8 "ArrowTurningPointLeft" 9 "ArrowTurningPointRight" 10 "Arrow45DegLeft" 11 "Arrow45DegRight" 12 "VirtualStopArea" 13 "VirtualBrakingArea" 14 "VirtualStopSign" /end COMPU_VTAB
/begin COMPU_VTAB Unit "enumeration table" TAB_VERB 3 0 "UNIT_UNKNOWN" 1 "UNIT_KMH" 2 "UNIT_MPH" /end COMPU_VTAB
/begin COMPU_VTAB Value "enumeration table" TAB_VERB 6 0 "none" 1 "warning" 2 "driverCorrecting" 3 "assisting" 4 "autonomous" 5 "information" /end COMPU_VTAB
/begin COMPU_VTAB Value_Copy1 "enumeration table" TAB_VERB 5 0 "undefined" 1 "tipl" 2 "imba" 3 "cfm" 4 "tixl" /end COMPU_VTAB
/begin COMPU_VTAB Value_Copy10 "enumeration table" TAB_VERB 4 0 "unknown" 1 "contextFromRoadSign" 2 "contextFromMapData" 3 "contextFromExternalSource" /end COMPU_VTAB
/begin COMPU_VTAB Value_Copy11 "enumeration table" TAB_VERB 3 0 "normal" 1 "eco" 2 "dynamic" /end COMPU_VTAB
/begin COMPU_VTAB Value_Copy12 "enumeration table" TAB_VERB 3 0 "off" 1 "cruiseControl" 2 "adaptiveCruiseControl" /end COMPU_VTAB
/begin COMPU_VTAB Value_Copy13 "enumeration table" TAB_VERB 14 0 "laneKeeping0" 1 "laneKeeping1" 2 "laneKeeping2" 3 "laneChangeOutOfBoundsLeft0" 4 "laneChange0OutOfBoundsLeft" 5 "laneChange01" 6 "laneChange10" 7 "laneChange12" 8 "laneChange21" 9 "laneChange2OutOfBoundsRight" 10 "laneChangeOutOfBoundsRight2" 11 "outOfBoundsLeft" 12 "outOfBoundsRight" 13 "unknown" /end COMPU_VTAB
/begin COMPU_VTAB Value_Copy14 "enumeration table" TAB_VERB 4 0 "none" 1 "left" 2 "right" 3 "reset" /end COMPU_VTAB
/begin COMPU_VTAB Value_Copy15 "enumeration table" TAB_VERB 3 0 "left" 1 "off" 2 "right" /end COMPU_VTAB
/begin COMPU_VTAB Value_Copy16 "enumeration table" TAB_VERB 5 0 "borderLane0" 1 "borderLane01" 2 "borderLane12" 3 "borderLane2" 4 "borderLaneUnassigned" /end COMPU_VTAB
/begin COMPU_VTAB Value_Copy17 "enumeration table" TAB_VERB 3 0 "none" 1 "fast" 2 "soft" /end COMPU_VTAB
/begin COMPU_VTAB Value_Copy2 "enumeration table" TAB_VERB 20 0 "undefined" 1 "laneDriving" 2 "forwardCollisionWarning" 3 "emergencyBrake" 4 "partialBrake" 5 "immediateBrake" 6 "emergencyBrakeAssist" 20 "laneChangeLeft" 21 "laneChangeRight" 22 "laneDepartureWarning" 23 "returnToLane" 24 "laneChangeWarningLeft" 25 "laneChangeWarningRight" 30 "rearCrossTrafficWarning" 31 "doorOpeningWarning" 32 "frontCrossTrafficInfo" 33 "preCrashRearWarning" 40 "frontSafetyDistanceInformation" 50 "emergencySteering" 60 "mois" /end COMPU_VTAB
/begin COMPU_VTAB Value_Copy3 "enumeration table" TAB_VERB 43 0 "defaultTrait" 1 "vulnerableRoadUser" 2 "farsideTurnLeft" 3 "farsideTurnRight" 4 "collisionMitigation" 5 "stopping" 6 "oncoming" 7 "pedestrian" 8 "laneMarking" 9 "horizontalEdge" 10 "verticalEdge" 11 "brakeJerk" 12 "limitedBrake" 13 "highSpeedBrake" 14 "defaultTrait2" 15 "defaultTrait3" 16 "blindSpotDetection" 17 "laneChangeAssist" 18 "blindSpotTrailerTow" 19 "rearCrossingTrafficLeft" 20 "rearCrossingTrafficRight" 21 "handsFree" 22 "overtaking" 23 "brakePrefill" 24 "steeringWheelVibration" 25 "acousticWarning" 26 "visualWarning" 27 "frontCrossingTraffic" 28 "emergencyBrakeAssist" 29 "brakeJerkVehicle" 30 "brakeJerkVulnerableRoadUser" 31 "preFillVehicle" 32 "preFillVulnerableRoadUser" 33 "customerTrait0" 34 "customerTrait1" 35 "customerTrait2" 36 "customerTrait3" 37 "customerTrait4" 38 "customerTrait5" 39 "customerTrait6" 40 "customerTrait7" 41 "customerTrait8" 42 "customerTrait9" /end COMPU_VTAB
/begin COMPU_VTAB Value_Copy4 "enumeration table" TAB_VERB 4 0 "laneLeft" 1 "laneMiddle" 2 "laneRight" 255 "invalid" /end COMPU_VTAB
/begin COMPU_VTAB Value_Copy5 "enumeration table" TAB_VERB 11 0 "none" 1 "unknown" 2 "junction" 3 "cancelAllSign" 4 "cancelSpecificSign" 5 "newTrafficContext" 6 "newRule" 7 "explicitRange" 8 "other" 9 "cancelSpecificSignWithDifferentValidity" 10 "turn" /end COMPU_VTAB
/begin COMPU_VTAB Value_Copy6 "enumeration table" TAB_VERB 9 0 "rearLast" 1 "rear2" 2 "rear1" 3 "front1" 4 "front2" 5 "front3" 6 "front4" 7 "frontLast" 255 "invalid" /end COMPU_VTAB
/begin COMPU_VTAB Value_Copy7 "enumeration table" TAB_VERB 9 0 "none" 1 "unknown" 2 "junction" 3 "cancelAllSign" 4 "cancelSpecificSign" 5 "newTrafficContext" 6 "newRule" 7 "explicitRange" 8 "other" /end COMPU_VTAB
/begin COMPU_VTAB Value_Copy8 "enumeration table" TAB_VERB 5 0 "RC_UNKNOWN" 1 "RC_FROM_ROAD_SIGN" 2 "RC_DEFAULT_SPEED_LIMIT" 3 "RC_TRAFFIC_CONTEXT" 4 "RC_FROM_MAP_DATA" /end COMPU_VTAB
/begin COMPU_VTAB Value_Copy9 "enumeration table" TAB_VERB 77 0 "TRT_INVALID" 100 "TRT_SPEED_LIMIT" 101 "TRT_SPEED_ADVICE" 102 "TRT_SPEED_MINIMUM" 200 "TRT_NO_PASSING" 300 "TRT_PAY_ATTENTION_DANGER" 301 "TRT_PAY_ATTENTION_CURVE_LEFT" 302 "TRT_PAY_ATTENTION_CURVE_RIGHT" 303 "TRT_PAY_ATTENTION_DOUBLE_CURVE_LEFT" 304 "TRT_PAY_ATTENTION_DOUBLE_CURVE_RIGHT" 305 "TRT_PAY_ATTENTION_TRAIN" 306 "TRT_PAY_ATTENTION_JAM" 307 "TRT_PAY_ATTENTION_ROAD_WORKS" 308 "TRT_PAY_ATTENTION_SLOPE_DOWN" 309 "TRT_PAY_ATTENTION_SLOPE_UP" 310 "TRT_PAY_ATTENTION_CONSTRICTION" 311 "TRT_PAY_ATTENTION_CONSTRICTION_LEFT" 312 "TRT_PAY_ATTENTION_CONSTRICTION_RIGHT" 313 "TRT_PAY_ATTENTION_PEDESTRIANS" 314 "TRT_PAY_ATTENTION_KIDS" 315 "TRT_PAY_ATTENTION_BIKES" 316 "TRT_PAY_ATTENTION_SKIDDING" 317 "TRT_PAY_ATTENTION_ROUNDABOUT" 318 "TRT_PAY_ATTENTION_WILD_ANIMAL" 319 "TRT_PAY_ATTENTION_CATTLE" 320 "TRT_PAY_ATTENTION_FROGS" 321 "TRT_PAY_ATTENTION_BUS" 322 "TRT_PAY_ATTENTION_WIND" 323 "TRT_PAY_ATTENTION_SNOW" 324 "TRT_PAY_ATTENTION_PEDESTRIAN_CROSSING" 325 "TRT_PAY_ATTENTION_HUMP" 326 "TRT_PAY_ATTENTION_ROCK" 327 "TRT_PAY_ATTENTION_LOW_TREE" 328 "TRT_PAY_ATTENTION_GRAVEL" 329 "TRT_PAY_ATTENTION_TWO_WAY" 330 "TRT_PAY_ATTENTION_LIGHTS" 331 "TRT_PAY_ATTENTION_PLANE" 332 "TRT_PAY_ATTENTION_RIDER" 333 "TRT_PAY_ATTENTION_DRAWBRIDGE" 334 "TRT_PAY_ATTENTION_PIER" 335 "TRT_PAY_ATTENTION_JUNCTION" 336 "TRT_PAY_ATTENTION_CRASH_RISK" 337 "TRT_PAY_ATTENTION_ACCIDENT" 338 "TRT_PAY_ATTENTION_SMOKE" 339 "TRT_PAY_ATTENTION_OIL_TRAIL" 340 "TRT_PAY_ATTENTION_DIRTY_ROAD" 341 "TRT_PAY_ATTENTION_ROAD_DAMAGE" 342 "TRT_PAY_ATTENTION_RUTS" 343 "TRT_PAY_ATTENTION_SOFT_SHOULDER" 344 "TRT_PAY_ATTENTION_CUSTOMS" 345 "TRT_PAY_ATTENTION_DEAD_END" 346 "TRT_PAY_ATTENTION_POLLUTION" 347 "TRT_PAY_ATTENTION_PRIORITY_JUNCTION" 400 "TRT_NO_ENTRY" 401 "TRT_NO_ENTRY_ONE_WAY" 500 "TRT_RIGHT_OF_WAY" 501 "TRT_RIGHT_OF_WAY_NEXT_CROSSING" 502 "TRT_GIVE_RIGHT_OF_WAY_NEXT_CROSSING" 503 "TRT_YIELD_TO_RIGHT_NEXT_CROSSING" 504 "TRT_YIELD_TO_LEFT_NEXT_CROSSING" 505 "TRT_STOP_AND_YIELD" 600 "TRT_DIRECTION_ONLY_STRAIGHT" 601 "TRT_DIRECTION_ONLY_RIGHT" 602 "TRT_DIRECTION_ONLY_LEFT" 603 "TRT_DIRECTION_ONLY_STRAIGHT_OR_LEFT" 604 "TRT_DIRECTION_ONLY_STRAIGHT_OR_RIGHT" 605 "TRT_DIRECTION_ONLY_LEFT_OR_RIGHT" 606 "TRT_NO_UTURN" 700 "TRT_NO_PARKING" 701 "TRT_NO_STOPPING" 702 "TRT_NO_STOPPING_ON_SHOULDER" 800 "TRT_ORDER_KEEP_DISTANCE" 801 "TRT_ORDER_ZEBRA_CROSSING" 802 "TRT_ORDER_UMWELT_ZONE" 803 "TRT_ORDER_TURN_LIGHTS_ON" 804 "TRT_ORDER_TURN_LIGHTS_OFF" 805 "TRT_ORDER_ONE_WAY_STREET" /end COMPU_VTAB
/begin COMPU_VTAB Variant "enumeration table" TAB_VERB 5 0 "LineMarking" 1 "RoadEdge" 2 "ConstructionElement" 3 "Virtual" 4 "Fused" /end COMPU_VTAB
/begin COMPU_VTAB VehicleMovementDirection "enumeration table" TAB_VERB 3 0 "forward" 1 "backward" 2 "undefined" /end COMPU_VTAB
/begin COMPU_VTAB VehicleSpecifications "enumeration table" TAB_VERB 4 0 "NOT_VEHICLE_SPECIFIC" 1 "APPLIES_TO_EGO_VEHICLE" 2 "DOES_NOT_APPLY_TO_EGO_VEHICLE" 3 "UNKNOWN" /end COMPU_VTAB
/begin COMPU_VTAB VehicleType "enumeration table" TAB_VERB 12 0 "none" 1 "pedestrian" 2 "bike" 4 "motorBike" 8 "passengerCar" 16 "passengerCarWithTrailer" 32 "passengerCarWithCaravan" 64 "bus" 128 "tractor" 256 "truck" 512 "truckWithTrailer" 1024 "tram" /end COMPU_VTAB
/begin COMPU_VTAB VideoCalibrationState "enumeration table" TAB_VERB 9 0 "fullyCalibrated" 1 "notCalibrated" 2 "yawNotCalibrated" 3 "pitchNotCalibrated" 4 "rollNotCalibrated" 5 "reserved5" 6 "reserved6" 7 "reserved7" 255 "outOfRange" /end COMPU_VTAB
/begin COMPU_VTAB VideoLane "enumeration table" TAB_VERB 5 0 "init" 1 "leftLane" 2 "egoLane" 3 "rightLane" 255 "unknownLane" /end COMPU_VTAB
/begin COMPU_VTAB VideoMainRoadSignType "enumeration table" TAB_VERB 422 0 "UNKNOWN" 1 "SL5" 2 "SL10" 3 "SL15" 4 "SL20" 5 "SL25" 6 "SL30" 7 "SL35" 8 "SL40" 9 "SL45" 10 "SL50" 11 "SL55" 12 "SL60" 13 "SL65" 14 "SL70" 15 "SL75" 16 "SL80" 17 "SL85" 18 "SL90" 19 "SL95" 20 "SL100" 21 "SL105" 22 "SL110" 23 "SL115" 24 "SL120" 25 "SL125" 26 "SL130" 27 "SL135" 28 "SL140" 29 "SL145" 30 "SL150" 31 "SL155" 32 "SL160" 33 "OP" 34 "OL" 35 "ESL" 36 "EOP" 37 "EOL" 38 "EA" 39 "VSL5" 40 "VSL10" 41 "VSL15" 42 "VSL20" 43 "VSL25" 44 "VSL30" 45 "VSL35" 46 "VSL40" 47 "VSL45" 48 "VSL50" 49 "VSL55" 50 "VSL60" 51 "VSL65" 52 "VSL70" 53 "VSL75" 54 "VSL80" 55 "VSL85" 56 "VSL90" 57 "VSL95" 58 "VSL100" 59 "VSL105" 60 "VSL110" 61 "VSL115" 62 "VSL120" 63 "VSL125" 64 "VSL130" 65 "VSL135" 66 "VSL140" 67 "VSL145" 68 "VSL150" 69 "VSL155" 70 "VSL160" 71 "VOP" 72 "VOL" 73 "VESL" 74 "VEOP" 75 "VEOL" 76 "VEA" 77 "NOENTRY" 78 "NOALL" 79 "NOCAR" 80 "NOLORRY" 81 "NOHAZMAT" 82 "NOBIKE" 83 "NOPED" 84 "NOCARBIKE" 85 "NOTWOWAY" 86 "WEIGHT" 87 "HEIGHT" 88 "WIDTH" 89 "LENGTH" 90 "PRIOCROSS" 91 "GIVEWAY" 92 "PRIOCROSSYIELDTORIGHT" 93 "WARNDANGER" 94 "WARNCURVEL" 95 "WARNCURVER" 96 "WARNDCURVEL" 97 "WARNDCURVER" 98 "WARNTRAIN" 99 "WARNJAM" 100 "WARNANIMAL_DEPRECATED" 101 "WARNRWORKS" 102 "WARNSLOPED" 103 "WARNSLOPEU" 104 "PRIOSTREET" 105 "EPRIOSTREET" 106 "STOP" 107 "ASL" 108 "EASL" 109 "MSL" 110 "EMSL" 111 "MLC" 112 "WBDIAGL" 113 "WBDIAGR" 114 "WBROUND" 115 "NOLTURN" 116 "NORTURN" 117 "NOUTURN" 118 "NOPARK" 119 "NOSTOP" 120 "SMOG" 121 "UMWELT" 122 "EUMWELT" 123 "DOUANE" 124 "FWAY" 125 "EFWAY" 126 "HWAY" 127 "EHWAY" 128 "NORIDER" 129 "WARNCONST" 130 "WARNCONSTL" 131 "WARNCONSTR" 132 "WARNPED" 133 "WARNKIDS" 134 "WARNBIKE" 135 "WARNSKID" 136 "ZEBRA" 137 "ONEWAYS" 138 "ONEWAYU" 139 "SLOWDOWN" 140 "NOCARRIAGE" 141 "NOLORRYTRAILER" 142 "NOBUS" 143 "NOTRACTOR" 144 "LORRYDIST" 145 "CARDIST" 146 "WARNROUND" 147 "WARNWILDANIMAL" 148 "WARNCATTLE" 149 "WARNFROG" 150 "WARNBUS" 151 "WARNWIND" 152 "WARNSNOW" 153 "WARNPCROSS" 154 "WARNHUMP" 155 "WARNROCK" 156 "WARNLOWTREE" 157 "WARNGRAVEL" 158 "WARNTWOWAY" 159 "WARNLIGHTS" 160 "WARNPLANE" 161 "VNOENTRY" 162 "VNOALL" 163 "VNOCAR" 164 "VNOLORRY" 165 "VNOCARBIKE" 166 "VWEIGHT" 167 "VHEIGHT" 168 "VWIDTH" 169 "VLENGTH" 170 "VWARNDANGER" 171 "VWARNJAM" 172 "VWARNRWORKS" 173 "VWARNSKID" 174 "VASL" 175 "VEASL" 176 "VNOLORRYTRAILER" 177 "VNOBUS" 178 "VLORRYDIST" 179 "VCARDIST" 180 "VWARNSNOW" 181 "VWARNHUMP" 182 "VWARNGRAVEL" 183 "CALM" 184 "ECALM" 185 "TWN" 186 "ETWN" 187 "DEADEND" 188 "AXLEWEIGHT" 189 "WARNRIDER" 190 "WARNDRAWBRIDGE" 191 "WARNPIER" 192 "TRINATURE" 193 "VWARNCONST" 194 "VWARNCONSTL" 195 "VWARNCONSTR" 196 "VWARNCURVEL" 197 "VWARNCURVER" 198 "VWARNDCURVEL" 199 "VWARNDCURVER" 200 "VWARNLIGHTS" 201 "WBBENTLEFT" 202 "WBBENTLEFTRIGHT" 203 "WBBENTRIGHT" 204 "WBDIAGLR" 205 "WBLEFT" 206 "WBRIGHT" 207 "WBUP" 208 "WBUPLEFT" 209 "WBUPRIGHT" 210 "WBHAZWATER" 211 "NOHAZWATER" 212 "SCHOOL" 213 "ESCHOOL" 214 "HAZMAT" 215 "EMERGENCYBAY" 216 "ENDOFLANEL" 217 "ENDOFLANER" 218 "ENOPARK" 219 "EONEWAY" 220 "EPARK" 221 "ETOLL" 222 "NOPARKL" 223 "NOPARKLR" 224 "NOPARKR" 225 "NOSTOPL" 226 "NOSTOPLR" 227 "NOSTOPR" 228 "NOTURNONRED" 229 "ONEWAYL" 230 "ONEWAYR" 231 "PARK" 232 "PRIOCROSSL" 233 "PRIOCROSSR" 234 "TOLL" 235 "TUNNEL" 236 "TWOWAY" 237 "WARNCROSS" 238 "WARNCROSSL" 239 "WARNCROSSLR" 240 "WARNCROSSR" 241 "WARNCROSSRL" 242 "WARNCROSST" 243 "WARNGIVEWAYAHEAD" 244 "WARNSLAHEAD" 245 "WARNSTOPAHEAD" 246 "WBBUS" 247 "WRONGWAY" 248 "HAZWATER" 249 "GIVEWAYROUND" 250 "WARNWINDINGL" 251 "WARNWINDINGR" 252 "WARNHAIRPINL" 253 "WARNHAIRPINR" 254 "WARNPEDBIKE" 255 "WARNCROSSY" 256 "WARNBRANCHL" 257 "WARNBRANCHR" 258 "WARNAXLEWEIGHT" 259 "WARNWEIGHT" 260 "WARNHEIGHT" 261 "WARNLENGTH" 262 "WARNWIDTH" 263 "WARNBLACKSPOT" 264 "WARNMERGEL" 265 "WARNMERGER" 266 "WARNTUNNEL" 267 "WARNTRACTOR" 268 "WARNRWORKSVEHICLE" 269 "WARNNARROWBRIDGE" 270 "WARNFLAGGER" 271 "LANES" 272 "LANESHIFTL" 273 "LANESHIFTR" 274 "NEWLANEL" 275 "NEWLANER" 276 "RIGHTTURNONRED" 277 "BORDERLIMIT" 278 "EMBEDDEDRAIN" 279 "VWARNWEIGHT" 280 "VWARNHEIGHT" 281 "VWARNLENGTH" 282 "VWARNWIDTH" 283 "VENDOFLANEL" 284 "VENDOFLANER" 285 "VLANES" 286 "VLANESHIFTL" 287 "VLANESHIFTR" 288 "VNEWLANEL" 289 "VNEWLANER" 290 "NOUP" 291 "VOFF" 292 "ASL5" 293 "ASL10" 294 "ASL15" 295 "ASL20" 296 "ASL25" 297 "ASL30" 298 "ASL35" 299 "ASL40" 300 "ASL45" 301 "ASL50" 302 "ASL55" 303 "ASL60" 304 "ASL65" 305 "ASL70" 306 "ASL75" 307 "ASL80" 308 "ASL85" 309 "ASL90" 310 "ASL95" 311 "ASL100" 312 "ASL105" 313 "ASL110" 314 "ASL115" 315 "ASL120" 316 "ASL125" 317 "ASL130" 318 "ASL135" 319 "ASL140" 320 "ASL145" 321 "ASL150" 322 "ASL155" 323 "ASL160" 324 "VASL5" 325 "VASL10" 326 "VASL15" 327 "VASL20" 328 "VASL25" 329 "VASL30" 330 "VASL35" 331 "VASL40" 332 "VASL45" 333 "VASL50" 334 "VASL55" 335 "VASL60" 336 "VASL65" 337 "VASL70" 338 "VASL75" 339 "VASL80" 340 "VASL85" 341 "VASL90" 342 "VASL95" 343 "VASL100" 344 "VASL105" 345 "VASL110" 346 "VASL115" 347 "VASL120" 348 "VASL125" 349 "VASL130" 350 "VASL135" 351 "VASL140" 352 "VASL145" 353 "VASL150" 354 "VASL155" 355 "VASL160" 356 "WARNTRAINGATED" 357 "KEEPRIGHTCAR" 358 "ASLCURVE5" 359 "ASLCURVE10" 360 "ASLCURVE15" 361 "ASLCURVE20" 362 "ASLCURVE25" 363 "ASLCURVE30" 364 "ASLCURVE35" 365 "ASLCURVE40" 366 "ASLCURVE45" 367 "ASLCURVE50" 368 "ASLCURVE55" 369 "ASLCURVE60" 370 "ASLCURVE65" 371 "ASLCURVE70" 372 "ASLCURVE75" 373 "ASLCURVE80" 374 "ASLCURVE85" 375 "ASLCURVE90" 376 "ASLCURVE95" 377 "ASLCURVE100" 378 "ASLCURVE105" 379 "ASLCURVE110" 380 "ASLCURVE115" 381 "ASLCURVE120" 382 "ASLCURVE125" 383 "ASLCURVE130" 384 "ASLCURVE135" 385 "ASLCURVE140" 386 "ASLCURVE145" 387 "ASLCURVE150" 388 "ASLCURVE155" 389 "ASLCURVE160" 390 "KIDS" 391 "EKIDS" 392 "BIKEROAD" 393 "EBIKEROAD" 394 "PEDSTREET" 395 "EPEDSTREET" 396 "PEDBIKESTREET" 397 "EPEDBIKESTREET" 398 "EWARNKIDS" 399 "CALM20" 400 "CALM30" 401 "ECALM20" 402 "ECALM30" 403 "FWAYGREEN" 404 "TWN40" 405 "TWN50" 406 "TWN60" 407 "TWN70" 408 "ETWN40" 409 "ETWN50" 410 "ETWN60" 411 "ETWN70" 412 "WBBIKE" 413 "EWBBIKE" 414 "WBPED" 415 "EWBPED" 416 "WBPEDBIKESEP" 417 "EWBPEDBIKESEP" 418 "WBPEDBIKESHARED" 419 "EWBPEDBIKESHARED" 420 "EFWAYGREEN" 421 "NumberValidMainSignTypes" /end COMPU_VTAB
/begin COMPU_VTAB VideoRoadSignEmbeddedInfo "enumeration table" TAB_VERB 10 0 "unknown" 1 "notEmbedded" 2 "embeddedBorderLimit" 3 "embeddedMultiLane" 4 "embeddedRain" 5 "embeddedVehicleType" 6 "embeddedPlate" 7 "embeddedErrorValue" 8 "embeddedVehicleSticker" 9 "embeddedValueCount" /end COMPU_VTAB
/begin COMPU_VTAB VideoRoadSignUnit "enumeration table" TAB_VERB 6 0 "unknown" 1 "meter" 2 "kilometer" 3 "foot" 4 "yard" 5 "mile" /end COMPU_VTAB
/begin COMPU_VTAB VideoSensorState "enumeration table" TAB_VERB 9 0 "off" 1 "on" 2 "reduced" 3 "hwError" 4 "swError" 5 "fidActive" 6 "reserved6" 7 "reserved7" 255 "outOfRange" /end COMPU_VTAB
/begin COMPU_VTAB VideoStatusState "enumeration table" TAB_VERB 11 0 "cameraOperational" 1 "cameraInitialization" 2 "cameraLimited" 3 "cameraTempBlind" 4 "cameraBlocked" 5 "cameraError" 6 "cameraCalibration" 7 "cameraDecalibrated" 8 "cameraShutdown" 9 "cameraSleep" 255 "outOfRange" /end COMPU_VTAB
/begin COMPU_VTAB VideoSupplementaryRoadSignType "enumeration table" TAB_VERB 143 0 "UNKNOWN" 1 "ADDCAR" 2 "ADDLORRY" 3 "ADDTRAILER" 4 "ADDCARAVAN" 5 "ADDBUS" 6 "ADDTRACTOR" 7 "ADDMCYCLE" 8 "ADDLORRYBUSTRAILER_DEPRECATED" 9 "ADDLORRYBUS_DEPRECATED" 10 "ADDHAZMAT" 11 "ADDTANK" 12 "ADDTRAM" 13 "ADDWET" 14 "ADDFOG" 15 "ADDRAIN" 16 "ADDSNOW" 17 "ADDTIME" 18 "ADDSECTION" 19 "ADDDISTANCE" 20 "ADDWEIGHT" 21 "ADDEXITL" 22 "ADDEXITR" 23 "ADDLANES" 24 "ADDRADAR" 25 "ADDRAPPEL" 26 "ADDPRIOTURN" 27 "ADDLORRY_EXCEPT" 28 "ADDTRACTOR_OVER" 29 "ADDTEXT" 30 "ADDSIGN" 31 "ADDRAINSNOW" 32 "ADDHUMP" 33 "VADDLORRYBUSTRAILER_DEPRECATED" 34 "VADDLORRYBUS_DEPRECATED" 35 "VADDLORRYTRAILER_DEPRECATED" 36 "ADDLORRYTRAILER_DEPRECATED" 37 "ADDCAMPER" 38 "ADDZONE" 39 "ADDCRASHRISK" 40 "ADDACCIDENT" 41 "ADDJAM" 42 "ADDSMOKE" 43 "ADDOILTRAIL" 44 "ADDGRAVEL" 45 "ADDDIRT" 46 "ADDRWORKSEXIT" 47 "ADDROADDAMAGE" 48 "ADDRWORKSENTRY" 49 "ADDLOWTREE" 50 "ADDRWORKSACCESS" 51 "ADDRUTS" 52 "ADDSOFTSHOULDERCAR" 53 "ADDSOFTSHOULDERLORRY" 54 "VADDSIGN" 55 "VADDCAR" 56 "VADDLORRY" 57 "VADDTRAILER" 58 "VADDCARAVAN" 59 "VADDBUS" 60 "VADDWET" 61 "VADDFOG" 62 "VADDRAIN" 63 "VADDSNOW" 64 "VADDRAINSNOW" 65 "VADDTEXT" 66 "VADDSECTION" 67 "VADDDISTANCE" 68 "VADDWEIGHT" 69 "VADDZONE" 70 "VADDCRASHRISK" 71 "VADDACCIDENT" 72 "VADDJAM" 73 "VADDOILTRAIL" 74 "VADDGRAVEL" 75 "VADDDIRT" 76 "VADDROADDAMAGE" 77 "VADDRUTS" 78 "ADDNOSTOPSHOULDER" 79 "ADDTOWING" 80 "ADDSCHOOL" 81 "ADDNIGHT" 82 "ADDEND" 83 "ADDBEGINS" 84 "ADDWITHIN" 85 "ADDDISTANCEBARS" 86 "ADDMINIMUM" 87 "ADDADVICE" 88 "ADDACCESS" 89 "ADDALLWAY" 90 "ADDBUS_EXCEPT" 91 "ADDEXCEPTDELIVERY" 92 "ADDEXCEPTLOCAL" 93 "ADDFROG" 94 "ADDPRIOTURNL" 95 "ADDPRIOTURNR" 96 "ADDSTART" 97 "ADDSTOPIN" 98 "ADDEXIT" 99 "ADDHAZWATER" 100 "ADDDAY" 101 "ADDSL" 102 "ADDLORRYTRAILER" 103 "ADDLORRYSEMI" 104 "VADDLORRYTRAILER" 105 "VADDLORRYSEMI" 106 "ADDSLOW" 107 "ADDSL5" 108 "ADDSL10" 109 "ADDSL15" 110 "ADDSL20" 111 "ADDSL25" 112 "ADDSL30" 113 "ADDSL35" 114 "ADDSL40" 115 "ADDSL45" 116 "ADDSL50" 117 "ADDSL55" 118 "ADDSL60" 119 "ADDSL65" 120 "ADDSL70" 121 "ADDSL75" 122 "ADDSL80" 123 "ADDSL85" 124 "ADDSL90" 125 "ADDSL95" 126 "ADDSL100" 127 "ADDSL105" 128 "ADDSL110" 129 "ADDSL115" 130 "ADDSL120" 131 "ADDSL125" 132 "ADDSL130" 133 "ADDSL135" 134 "ADDSL140" 135 "ADDSL145" 136 "ADDSL150" 137 "ADDSL155" 138 "ADDSL160" 139 "ADDBIKEROAD" 140 "ADDLORRYTRAILER_EXCEPT" 141 "ADDLORRYSEMI_EXCEPT" 142 "NumberValidSupplementarySignTypes" /end COMPU_VTAB
/begin COMPU_VTAB VmcMotionType "enumeration table" TAB_VERB 3 0 "none" 1 "comfort" 2 "emergency" /end COMPU_VTAB
/begin COMPU_VTAB WdwStates "enumeration table" TAB_VERB 8 0 "disabledOff" 1 "disabledInit" 2 "disabledCountryNotSupported" 3 "disabledUserDeactivation" 4 "failureSystemError" 5 "failureCommunicationError" 6 "passive" 7 "active" /end COMPU_VTAB
/begin COMPU_VTAB WeatherRestriction "enumeration table" TAB_VERB 6 0 "none" 1 "snow" 2 "rain" 4 "fog" 8 "night" 16 "smog" /end COMPU_VTAB
/begin COMPU_VTAB WeatherRestriction_Copy1 "enumeration table" TAB_VERB 8 0 "noWeatherRestriction" 1 "validOnlyIfSnowing" 2 "validOnlyInCaseOfFog" 3 "validOnlyIfRaining" 4 "reserved_4" 5 "reserved_5" 6 "unknwonWeatherRestriction" 7 "weatherRestrictionNotAvailable" /end COMPU_VTAB
/begin COMPU_VTAB WiperStatus "enumeration table" TAB_VERB 4 0 "off" 1 "slow" 2 "medium" 3 "fast" /end COMPU_VTAB
/begin COMPU_VTAB YAW_RATE_OFFSET_EXTERNAL_STATES "enumeration table" TAB_VERB 2 0 "UNAVAILABLE" 1 "AVAILABLE" /end COMPU_VTAB
/begin COMPU_VTAB YAW_RATE_OFFSET_INDICATOR_STATES "enumeration table" TAB_VERB 6 0 "INITIAL" 1 "DEFAULT_PERSISTENT_DATA" 2 "LAST_IGNITION_PERSISTENT_DATA" 3 "CROSS_MODEL_ALIGNED" 4 "YAW_RATE_INPUT_NOT_AVAILABLE_LONG" 5 "STANDSTILL_ALIGNED" /end COMPU_VTAB
/begin COMPU_VTAB YawRateStabilizationAvailability "enumeration table" TAB_VERB 3 0 "notInitialized" 1 "fault" 2 "full" /end COMPU_VTAB
/begin COMPU_VTAB YawRateStateMachineExternalInfo "enumeration table" TAB_VERB 2 0 "unavailable" 1 "available" /end COMPU_VTAB
/begin COMPU_VTAB YawRateStateMachineInternalInfo "enumeration table" TAB_VERB 6 0 "initial" 1 "defaultPersistentData" 2 "lastIgnitionPersistentData" 3 "crossModelAligned" 4 "yawRateInputNotAvailableLong" 5 "standstillAligned" /end COMPU_VTAB
/begin COMPU_VTAB driverHandsOnSteeringWheelCapacitive "enumeration table" TAB_VERB 3 0 "unknown" 1 "offWheel" 2 "onWheel" /end COMPU_VTAB
/begin COMPU_VTAB driverHandsOnSteeringWheelTorque "enumeration table" TAB_VERB 2 0 "notDetected" 1 "onWheel" /end COMPU_VTAB
/begin COMPU_VTAB driverIntendedSteeringDirection "enumeration table" TAB_VERB 3 0 "none" 1 "toLeft" 2 "toRight" /end COMPU_VTAB
/begin COMPU_VTAB drivingGearSelection "enumeration table" TAB_VERB 4 0 "parking" 1 "reverse" 2 "neutral" 3 "forward" /end COMPU_VTAB
/begin COMPU_VTAB eAdcUnitInCommand "enumeration table" TAB_VERB 2 0 "none" 1 "foc" /end COMPU_VTAB
/begin COMPU_VTAB eLimiterStates "enumeration table" TAB_VERB 9 0 "off" 1 "passive" 2 "active" 3 "override" 4 "reversibleFailure" 5 "irreversibleFailure" 6 "adcActive" 7 "adcOverride" 8 "numStates" /end COMPU_VTAB
/begin COMPU_VTAB eUnitInCommand "enumeration table" TAB_VERB 6 0 "none" 1 "ssc" 2 "foc" 3 "csc" 4 "cra" 5 "psc" /end COMPU_VTAB
/begin COMPU_VTAB ecy_hsm_Csai_KeyIdTag "enumeration table" TAB_VERB 35 0 "ecy_hsm_CSAI_KEYID_AES_KEY_start" 0 "ecy_hsm_CSAI_KEYID_AES_KEY_DYNAMIC_CFG_CRYPTO_AES128_KEY_DYNAMIC_0_BASE_0" 1 "ecy_hsm_CSAI_KEYID_AES_KEY_DYNAMIC_CFG_CRYPTO_AES128_KEY_DYNAMIC_0_INST_1" 2 "ecy_hsm_CSAI_KEYID_AES_KEY_end" 256 "ecy_hsm_CSAI_KEYID_RSA_KEY_start" 256 "ecy_hsm_CSAI_KEYID_RSA_KEY_STATIC_CFG_RSA2048_KEY_PUB_STATIC_0" 257 "ecy_hsm_CSAI_KEYID_RSA_KEY_end" 512 "ecy_hsm_CSAI_KEYID_ECC_KEY_start" 513 "ecy_hsm_CSAI_KEYID_ECC_KEY_end" 768 "ecy_hsm_CSAI_KEYID_CERT_start" 768 "ecy_hsm_CSAI_KEYID_CERT_STATIC_CFG_CERT_0_CVC_RSA2048__RBPKI_PRJ" 769 "ecy_hsm_CSAI_KEYID_CERT_STATIC_CFG_CERT_1_CVC_RSA2048__RBPKI_RESERVED" 770 "ecy_hsm_CSAI_KEYID_CERT_end" 1024 "ecy_hsm_CSAI_KEYID_OID_start" 1024 "ecy_hsm_CSAI_KEYID_OID_STATIC_CFG_OID_0_CVC_RSA2048__RBPKI_PRJ" 1025 "ecy_hsm_CSAI_KEYID_OID_STATIC_CFG_OID_1_CVC_RSA2048__RBPKI_RESERVED" 1026 "ecy_hsm_CSAI_KEYID_OID_end" 1280 "ecy_hsm_CSAI_KEYID_SECRET_DATA_start" 1280 "ecy_hsm_CSAI_KEYID_SECRET_DATA_DYNAMIC_CFG_SECRET_DATA_0_2B__RBPLATFORM_LCPONCTR" 1281 "ecy_hsm_CSAI_KEYID_SECRET_DATA_DYNAMIC_CFG_SECRET_DATA_1_2B__RESERVED" 1282 "ecy_hsm_CSAI_KEYID_SECRET_DATA_end" 1536 "ecy_hsm_CSAI_KEYID_INT_DATA_start" 1536 "ecy_hsm_CSAI_KEYID_INT_DATA_STATIC_CFG_INT_DATA_0" 1537 "ecy_hsm_CSAI_KEYID_INT_DATA_DYNAMIC_CFG_INT_DATA_TRUSTED_BOOT_REF" 1538 "ecy_hsm_CSAI_KEYID_INT_DATA_DYNAMIC_CFG_LIFE_CYCLE_STATE" 1539 "ecy_hsm_CSAI_KEYID_INT_DATA_DYNAMIC_CFG_PASSWORDS" 1540 "ecy_hsm_CSAI_KEYID_INT_DATA_DYNAMIC_CFG_SERIALNUMBER" 1541 "ecy_hsm_CSAI_KEYID_INT_DATA_DYNAMIC_CFG_HSM_UPDATE_PASSWORD" 1542 "ecy_hsm_CSAI_KEYID_INT_DATA_STATIC_CFG_HSM_SUSPEND_TIME" 1543 "ecy_hsm_CSAI_KEYID_INT_DATA_DYNAMIC_CFG_SECACC_NONCE" 1544 "ecy_hsm_CSAI_KEYID_INT_DATA_STATIC_CFG_SECURE_DEBUG_NONCE_CNTRL" 1545 "ecy_hsm_CSAI_KEYID_INT_DATA_STATIC_CFG_SECURE_DEBUG_USE_CASE" 1546 "ecy_hsm_CSAI_KEYID_INT_DATA_STATIC_CFG_SECURE_DEBUG_CHALLENGE_LEN" 1547 "ecy_hsm_CSAI_KEYID_INT_DATA_end" 2147483647 "ecy_hsm_CSAI_SHE_KEYID_RESERVED" /end COMPU_VTAB
/begin COMPU_VTAB rbHsmPrepare_AccessState_en "enumeration table" TAB_VERB 5 0 "rbHsmPrepare_NotStarted_e" 1 "rbHsmPrepare_AccessPending_e" 2 "rbHsmPrepare_AccessFailed_e" 3 "rbHsmPrepare_AccessStateOK_e" 4 "rbHsmPrepare_PreInitDone_e" /end COMPU_VTAB
/begin COMPU_VTAB rbMcu_LastResetType_en "enumeration table" TAB_VERB 6 0 "RBMCU_COLD_PORST_E" 1 "RBMCU_WARM_PORST_E" 2 "RBMCU_COLD_WARM_PORST_E" 3 "RBMCU_SYSTEM_SW_E" 4 "RBMCU_SYSTEM_SMU_E" 5 "RBMCU_INVALID_RESET_E" /end COMPU_VTAB
/begin COMPU_VTAB rbMonReact_EventState "enumeration table" TAB_VERB 3 0 "rbMonReact_EventStateFailed_e" 1 "rbMonReact_EventStatePassed_e" 2 "rbMonReact_Prv_EventStateInit_e" /end COMPU_VTAB
/begin COMPU_VTAB rbMonReact_State_en "enumeration table" TAB_VERB 5 0 "RBMONREACT_UNINIT" 1 "RBMONREACT_INIT" 2 "RBMONREACT_RUN" 3 "RBMONREACT_SAFE" 4 "RBMONREACT_ERRORSAFE" /end COMPU_VTAB
/begin COMPU_VTAB rbNetCom_State_e "enumeration table" TAB_VERB 6 0 "rbNetCom_ErrorInvalid_e" 1 "rbNetCom_Valid_e" 2 "rbNetCom_OutOfRange_e" 3 "rbNetCom_NoSpecialValue_e" 4 "rbNetCom_Received_e" 5 "rbNetCom_InRange_e" /end COMPU_VTAB
/begin COMPU_VTAB rbPFlashIntegrity_CrcStatus_en "enumeration table" TAB_VERB 6 0 "RBPFLSINTY_NOTSTARTED" 1 "RBPFLSINTY_INITFAILED" 2 "RBPFLSINTY_CALCINPROGRESS" 3 "RBPFLSINTY_CALCCOMPLETED" 4 "RBPFLSINTY_EVALCOMPLETEDPASSED" 5 "RBPFLSINTY_EVALCOMPLETEDFAILED" /end COMPU_VTAB
/begin COMPU_VTAB rbPdm_EDevelopmentError "enumeration table" TAB_VERB 6 0 "NoError_e" 1 "WriteError_e" 2 "ReadError_e" 3 "StatusError_e" 4 "RamBlockMissingError_e" 5 "InvalidBlockIdArgumentError_e" /end COMPU_VTAB
/begin COMPU_VTAB rbPdm_EJobStatus "enumeration table" TAB_VERB 16 0 "JobStatusInit_e" 1 "JobWriteAccepted_e" 2 "JobWriteRejected_e" 3 "JobWriteRetriggerOnGoing_e" 4 "JobWriteCompleted_e" 5 "JobWriteFailed_e" 6 "JobReadCompleted_e" 7 "JobReadFailed_e" 8 "JobRestoreAccepted_e" 9 "JobRestoreRejected_e" 10 "JobRestoreCompleted_e" 11 "JobRestoreFailed_e" 12 "JobInvalidateAccepted_e" 13 "JobInvalidateRejected_e" 14 "JobInvalidateCompleted_e" 15 "JobInvalidateFailed_e" /end COMPU_VTAB
/begin COMPU_VTAB rbPdm_ERequestType "enumeration table" TAB_VERB 6 0 "RequestNone_e" 1 "RequestWrite_e" 2 "RequestWriteImmediate_e" 3 "RequestRead_e" 4 "RequestInvalidate_e" 5 "RequestRestore_e" /end COMPU_VTAB
/begin COMPU_VTAB rbSftMon_CoreClkList_en "enumeration table" TAB_VERB 5 0 "RBSFTMON_CORECLK_SYSTEMFPLL0_E" 1 "RBSFTMON_CORECLK_PHASEFPLL1_E" 2 "RBSFTMON_CORECLK_PHASEFPLL2_E" 3 "RBSFTMON_CORECLK_EXTENDEDSPB_E" 4 "RBSFTMON_CORECLK_BACKUP_E" /end COMPU_VTAB
/begin COMPU_VTAB rbSftMon_StackStatus_en "enumeration table" TAB_VERB 3 0 "RBSFTMON_STACKSTATUS_NOT_TESTED_E" 1 "RBSFTMON_STACKSTATUS_PASS_E" 2 "RBSFTMON_STACKSTATUS_FAIL_E" /end COMPU_VTAB
/begin COMPU_VTAB rbSysLog_InvalidateStatus_en "enumeration table" TAB_VERB 5 0 "RBSYSLOG_INVALIDATE_NOT_REQUESTED_EN" 1 "RBSYSLOG_INVALIDATE_SUCCESSFUL_EN" 2 "RBSYSLOG_INVALIDATE_JOB_REQUEST_FAILED_EN" 3 "RBSYSLOG_INVALIDATE_JOB_FAILED_EN" 4 "RBSYSLOG_INVALIDATE_TIMEOUT_EN" /end COMPU_VTAB
/begin COMPU_VTAB rcy_hsm_Csai_JobPriorityTag "enumeration table" TAB_VERB 7 0 "ecy_hsm_CSAI_PRIO_BACKGROUND" 1 "ecy_hsm_CSAI_PRIO_LOW" 2 "ecy_hsm_CSAI_PRIO_MEDIUM" 3 "ecy_hsm_CSAI_PRIO_HIGH" 3 "ecy_hsm_CSAI_PRIO_SAFETY" 5 "ecy_hsm_CSAI_PRIO_UNCHANGED" 2147483647 "ecy_hsm_CSAI_JOBPRIORITY_RESERVED" /end COMPU_VTAB
/begin COMPU_VTAB rcy_hsm_Csai_SecAcc_NonceCtrl "enumeration table" TAB_VERB 8 1 "ecy_hsm_CSAI_NONCE_ZERO" 2 "ecy_hsm_CSAI_NONCE_RND" 3 "ecy_hsm_CSAI_NONCE_RND_STORE_DFLASH" 4 "ecy_hsm_CSAI_NONCE_FROM_DFLASH" 5 "ecy_hsm_CSAI_NONCE_DEVICE_ID" 6 "ecy_hsm_CSAI_NONCE_HASHED_DEVICE_ID" 7 "ecy_hsm_CSAI_NONCE_NUMTYPES" 2147483647 "ecy_hsm_CSAI_NONCE_RESERVED" /end COMPU_VTAB
/begin COMPU_VTAB validLineState "enumeration table" TAB_VERB 4 0 "invalid" 1 "noValidLines" 2 "oneValidLine" 3 "twoValidLines" /end COMPU_VTAB
/begin RECORD_LAYOUT SSV__FLOAT32_IEEE_S AXIS_PTS_X 1 FLOAT32_IEEE INDEX_INCR DIRECT ALIGNMENT_FLOAT64_IEEE 8 ALIGNMENT_INT64 8 /end RECORD_LAYOUT
/begin RECORD_LAYOUT SSV__FLOAT64_IEEE_S AXIS_PTS_X 1 FLOAT64_IEEE INDEX_INCR DIRECT ALIGNMENT_FLOAT64_IEEE 8 ALIGNMENT_INT64 8 /end RECORD_LAYOUT
/begin RECORD_LAYOUT SSV__SBYTE_S AXIS_PTS_X 1 SBYTE INDEX_INCR DIRECT ALIGNMENT_FLOAT64_IEEE 8 ALIGNMENT_INT64 8 /end RECORD_LAYOUT
/begin RECORD_LAYOUT SSV__SLONG_S AXIS_PTS_X 1 SLONG INDEX_INCR DIRECT ALIGNMENT_FLOAT64_IEEE 8 ALIGNMENT_INT64 8 /end RECORD_LAYOUT
/begin RECORD_LAYOUT SSV__SWORD_S AXIS_PTS_X 1 SWORD INDEX_INCR DIRECT ALIGNMENT_FLOAT64_IEEE 8 ALIGNMENT_INT64 8 /end RECORD_LAYOUT
/begin RECORD_LAYOUT SSV__UBYTE_S AXIS_PTS_X 1 UBYTE INDEX_INCR DIRECT ALIGNMENT_FLOAT64_IEEE 8 ALIGNMENT_INT64 8 /end RECORD_LAYOUT
/begin RECORD_LAYOUT SSV__ULONG_S AXIS_PTS_X 1 ULONG INDEX_INCR DIRECT ALIGNMENT_FLOAT64_IEEE 8 ALIGNMENT_INT64 8 /end RECORD_LAYOUT
/begin RECORD_LAYOUT SSV__UWORD_S AXIS_PTS_X 1 UWORD INDEX_INCR DIRECT ALIGNMENT_FLOAT64_IEEE 8 ALIGNMENT_INT64 8 /end RECORD_LAYOUT
/begin RECORD_LAYOUT __FLOAT32_IEEE_S FNC_VALUES 1 FLOAT32_IEEE COLUMN_DIR DIRECT ALIGNMENT_FLOAT64_IEEE 8 ALIGNMENT_INT64 8 /end RECORD_LAYOUT
/begin RECORD_LAYOUT __FLOAT32_IEEE_Z FNC_VALUES 1 FLOAT32_IEEE ROW_DIR DIRECT ALIGNMENT_FLOAT64_IEEE 8 ALIGNMENT_INT64 8 /end RECORD_LAYOUT
/begin RECORD_LAYOUT __FLOAT64_IEEE_S FNC_VALUES 1 FLOAT64_IEEE COLUMN_DIR DIRECT ALIGNMENT_FLOAT64_IEEE 8 ALIGNMENT_INT64 8 /end RECORD_LAYOUT
/begin RECORD_LAYOUT __FLOAT64_IEEE_Z FNC_VALUES 1 FLOAT64_IEEE ROW_DIR DIRECT ALIGNMENT_FLOAT64_IEEE 8 ALIGNMENT_INT64 8 /end RECORD_LAYOUT
/begin RECORD_LAYOUT __Float32_Axis AXIS_PTS_X 1 FLOAT32_IEEE INDEX_INCR DIRECT ALIGNMENT_FLOAT64_IEEE 8 ALIGNMENT_INT64 8 /end RECORD_LAYOUT
/begin RECORD_LAYOUT __Float32_Value FNC_VALUES 1 FLOAT32_IEEE ROW_DIR DIRECT ALIGNMENT_FLOAT64_IEEE 8 ALIGNMENT_INT64 8 /end RECORD_LAYOUT
/begin RECORD_LAYOUT __Float32_Value_Map FNC_VALUES 1 FLOAT32_IEEE COLUMN_DIR DIRECT ALIGNMENT_FLOAT64_IEEE 8 ALIGNMENT_INT64 8 /end RECORD_LAYOUT
/begin RECORD_LAYOUT __SBYTE_S FNC_VALUES 1 SBYTE COLUMN_DIR DIRECT ALIGNMENT_FLOAT64_IEEE 8 ALIGNMENT_INT64 8 /end RECORD_LAYOUT
/begin RECORD_LAYOUT __SBYTE_Z FNC_VALUES 1 SBYTE ROW_DIR DIRECT ALIGNMENT_FLOAT64_IEEE 8 ALIGNMENT_INT64 8 /end RECORD_LAYOUT
/begin RECORD_LAYOUT __SByte_Value FNC_VALUES 1 SBYTE ROW_DIR DIRECT ALIGNMENT_FLOAT64_IEEE 8 ALIGNMENT_INT64 8 /end RECORD_LAYOUT
/begin RECORD_LAYOUT __SLONG_S FNC_VALUES 1 SLONG COLUMN_DIR DIRECT ALIGNMENT_FLOAT64_IEEE 8 ALIGNMENT_INT64 8 /end RECORD_LAYOUT
/begin RECORD_LAYOUT __SLONG_Z FNC_VALUES 1 SLONG ROW_DIR DIRECT ALIGNMENT_FLOAT64_IEEE 8 ALIGNMENT_INT64 8 /end RECORD_LAYOUT
/begin RECORD_LAYOUT __SLong_Value FNC_VALUES 1 SLONG ROW_DIR DIRECT ALIGNMENT_FLOAT64_IEEE 8 ALIGNMENT_INT64 8 /end RECORD_LAYOUT
/begin RECORD_LAYOUT __SWORD_S FNC_VALUES 1 SWORD COLUMN_DIR DIRECT ALIGNMENT_FLOAT64_IEEE 8 ALIGNMENT_INT64 8 /end RECORD_LAYOUT
/begin RECORD_LAYOUT __SWORD_Z FNC_VALUES 1 SWORD ROW_DIR DIRECT ALIGNMENT_FLOAT64_IEEE 8 ALIGNMENT_INT64 8 /end RECORD_LAYOUT
/begin RECORD_LAYOUT __UBYTE_S FNC_VALUES 1 UBYTE COLUMN_DIR DIRECT ALIGNMENT_FLOAT64_IEEE 8 ALIGNMENT_INT64 8 /end RECORD_LAYOUT
/begin RECORD_LAYOUT __ULONG_S FNC_VALUES 1 ULONG COLUMN_DIR DIRECT ALIGNMENT_FLOAT64_IEEE 8 ALIGNMENT_INT64 8 /end RECORD_LAYOUT
/begin RECORD_LAYOUT __ULONG_Z FNC_VALUES 1 ULONG ROW_DIR DIRECT ALIGNMENT_FLOAT64_IEEE 8 ALIGNMENT_INT64 8 /end RECORD_LAYOUT
/begin RECORD_LAYOUT __ULong_Value FNC_VALUES 1 ULONG ROW_DIR DIRECT ALIGNMENT_FLOAT64_IEEE 8 ALIGNMENT_INT64 8 /end RECORD_LAYOUT
/begin RECORD_LAYOUT __UWORD_S FNC_VALUES 1 UWORD COLUMN_DIR DIRECT ALIGNMENT_FLOAT64_IEEE 8 ALIGNMENT_INT64 8 /end RECORD_LAYOUT
/begin RECORD_LAYOUT __UWORD_Z FNC_VALUES 1 UWORD ROW_DIR DIRECT ALIGNMENT_FLOAT64_IEEE 8 ALIGNMENT_INT64 8 /end RECORD_LAYOUT
/begin RECORD_LAYOUT __UWord_Value FNC_VALUES 1 UWORD ROW_DIR DIRECT ALIGNMENT_FLOAT64_IEEE 8 ALIGNMENT_INT64 8 /end RECORD_LAYOUT
/end MODULE
/end PROJECT
