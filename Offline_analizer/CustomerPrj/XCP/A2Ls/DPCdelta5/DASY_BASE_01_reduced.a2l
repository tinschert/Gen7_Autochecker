/* generated by ASAP2 Modifier - ASAP2 Tool-Set Version 18.0.10 */
ASAP2_VERSION 1 71
/begin PROJECT jlr_my20_base ""
/begin MODULE CPP ""
/begin MOD_PAR "" ADDR_EPK 0x80301114 EPK "$ SW built by jenkins on par-aurix-4287-fx475-c420x-468gg at 2024/11/21 23:25:59 $" /end MOD_PAR
/begin MOD_COMMON "" ALIGNMENT_BYTE 1 ALIGNMENT_WORD 2 ALIGNMENT_LONG 4 ALIGNMENT_FLOAT16_IEEE 2 ALIGNMENT_FLOAT32_IEEE 4 ALIGNMENT_FLOAT64_IEEE 4 ALIGNMENT_INT64 4 /end MOD_COMMON
/begin IF_DATA XCP
 /begin PROTOCOL_LAYER 0x0100 0x09C4 0xC8 0x00 0x00 0x00 0x00 0x00 0xFA 0xFA BYTE_ORDER_MSB_LAST ADDRESS_GRANULARITY_BYTE OPTIONAL_CMD PROGRAM_PREPARE OPTIONAL_CMD PROGRAM_RESET OPTIONAL_CMD PROGRAM OPTIONAL_CMD PROGRAM_CLEAR OPTIONAL_CMD PROGRAM_START OPTIONAL_CMD ALLOC_ODT_ENTRY OPTIONAL_CMD ALLOC_ODT OPTIONAL_CMD ALLOC_DAQ OPTIONAL_CMD FREE_DAQ OPTIONAL_CMD GET_DAQ_EVENT_INFO OPTIONAL_CMD GET_DAQ_RESOLUTION_INFO OPTIONAL_CMD GET_DAQ_PROCESSOR_INFO OPTIONAL_CMD GET_DAQ_CLOCK OPTIONAL_CMD START_STOP_SYNCH OPTIONAL_CMD START_STOP_DAQ_LIST OPTIONAL_CMD GET_DAQ_LIST_MODE OPTIONAL_CMD SET_DAQ_LIST_MODE OPTIONAL_CMD WRITE_DAQ OPTIONAL_CMD SET_DAQ_PTR OPTIONAL_CMD CLEAR_DAQ_LIST OPTIONAL_CMD SHORT_DOWNLOAD OPTIONAL_CMD DOWNLOAD_MAX OPTIONAL_CMD DOWNLOAD OPTIONAL_CMD SHORT_UPLOAD OPTIONAL_CMD UPLOAD OPTIONAL_CMD SET_MTA OPTIONAL_CMD GET_COMM_MODE_INFO /end PROTOCOL_LAYER
 /begin DAQ DYNAMIC 0x00 0x18 0x00 OPTIMISATION_TYPE_DEFAULT ADDRESS_EXTENSION_FREE IDENTIFICATION_FIELD_TYPE_RELATIVE_BYTE GRANULARITY_ODT_ENTRY_SIZE_DAQ_BYTE 0xF8 OVERLOAD_INDICATION_PID /begin STIM GRANULARITY_ODT_ENTRY_SIZE_STIM_BYTE 0xF8 /end STIM /begin TIMESTAMP_SUPPORTED 0x01 SIZE_DWORD UNIT_10NS /end TIMESTAMP_SUPPORTED /begin EVENT "core0_t10" "core0_t10" 0x01 DAQ 0xFF 0x0A 0x06 0x00 /end EVENT /begin EVENT "core0_t20" "core0_t20" 0x02 DAQ 0xFF 0x14 0x06 0x00 /end EVENT /begin EVENT "core0_t100" "core0_t10" 0x03 DAQ 0xFF 0x64 0x06 0x00 /end EVENT /begin EVENT "core0_bg" "core0_bg" 0x04 DAQ 0xFF 0x32 0x06 0x00 /end EVENT /begin EVENT "core1_t10" "core1_t10" 0x05 DAQ 0xFF 0x0A 0x06 0x00 /end EVENT /begin EVENT "core1_t20" "core1_t20" 0x06 DAQ 0xFF 0x14 0x06 0x00 /end EVENT /begin EVENT "core1_t100" "core1_t10" 0x07 DAQ 0xFF 0x64 0x06 0x00 /end EVENT /begin EVENT "core1_bg" "core1_bg" 0x08 DAQ 0xFF 0x64 0x06 0x00 /end EVENT /begin EVENT "core2_t10" "core2_t10" 0x09 DAQ 0xFF 0x0A 0x06 0x00 /end EVENT /begin EVENT "core2_t20" "core2_t20" 0x0A DAQ 0xFF 0x14 0x06 0x00 /end EVENT /begin EVENT "core2_t100" "core2_t10" 0x0B DAQ 0xFF 0x64 0x06 0x00 /end EVENT /begin EVENT "core2_bg" "core2_bg" 0x0C DAQ 0xFF 0x32 0x06 0x00 /end EVENT /begin EVENT "core3_t10" "core3_t10" 0x0D DAQ 0xFF 0x01 0x07 0x00 /end EVENT /begin EVENT "core3_t20" "core3_t20" 0x0E DAQ 0xFF 0x02 0x07 0x00 /end EVENT /begin EVENT "core3_t100" "core3_t10" 0x0F DAQ 0xFF 0x01 0x08 0x00 /end EVENT /begin EVENT "core3_bg" "core3_bg" 0x10 DAQ 0xFF 0x05 0x07 0x00 /end EVENT /begin EVENT "core4_t10" "core4_t10" 0x11 DAQ 0xFF 0x01 0x07 0x00 /end EVENT /begin EVENT "core4_t20" "core4_t20" 0x12 DAQ 0xFF 0x02 0x07 0x00 /end EVENT /begin EVENT "core4_t100" "core4_t10" 0x13 DAQ 0xFF 0x01 0x08 0x00 /end EVENT /begin EVENT "core4_bg" "core4_bg" 0x14 DAQ 0xFF 0x05 0x07 0x00 /end EVENT /begin EVENT "core5_t10" "core5_t10" 0x15 DAQ 0xFF 0x01 0x07 0x00 /end EVENT /begin EVENT "core5_t20" "core5_t20" 0x16 DAQ 0xFF 0x02 0x07 0x00 /end EVENT /begin EVENT "core5_t100" "core5_t10" 0x17 DAQ 0xFF 0x01 0x08 0x00 /end EVENT /begin EVENT "core5_bg" "core5_bg" 0x18 DAQ 0xFF 0x05 0x07 0x00 /end EVENT /begin EVENT "mE4029F2B" "mE4029F2B" 0x60 DAQ 0xFF 0x01 0x07 0x00 /end EVENT /begin EVENT "m70BEDAAD" "m70BEDAAD" 0x61 DAQ 0xFF 0x01 0x07 0x00 /end EVENT /begin EVENT "m03387546" "m03387546" 0x62 DAQ 0xFF 0x01 0x07 0x00 /end EVENT /begin EVENT "m2A67BA24" "m2A67BA24" 0x63 DAQ 0xFF 0x01 0x07 0x00 /end EVENT /begin EVENT "m65FE4522" "m65FE4522" 0x64 DAQ 0xFF 0x01 0x07 0x00 /end EVENT /begin EVENT "m4BF866C4" "m4BF866C4" 0x65 DAQ 0xFF 0x01 0x07 0x00 /end EVENT /begin EVENT "m5C5DFE49" "m5C5DFE49" 0x66 DAQ 0xFF 0x01 0x07 0x00 /end EVENT /begin EVENT "mD6DFB073" "mD6DFB073" 0x67 DAQ 0xFF 0x01 0x07 0x00 /end EVENT /begin EVENT "mE0F31A38" "mE0F31A38" 0x68 DAQ 0xFF 0x01 0x07 0x00 /end EVENT /begin EVENT "m8D04813C" "m8D04813C" 0x69 DAQ 0xFF 0x01 0x07 0x00 /end EVENT /begin EVENT "m2A29F383" "m2A29F383" 0x6A DAQ 0xFF 0x01 0x07 0x00 /end EVENT /begin EVENT "m3D9ED35F" "m3D9ED35F" 0x6B DAQ 0xFF 0x01 0x07 0x00 /end EVENT /begin EVENT "m3EDD7443" "m3EDD7443" 0x6C DAQ 0xFF 0x01 0x07 0x00 /end EVENT /begin EVENT "mD3273491" "mD3273491" 0x6D DAQ 0xFF 0x01 0x07 0x00 /end EVENT /begin EVENT "m75A16AA2" "m75A16AA2" 0x6E DAQ 0xFF 0x01 0x07 0x00 /end EVENT /begin EVENT "mD07F7238" "mD07F7238" 0x6F DAQ 0xFF 0x01 0x07 0x00 /end EVENT /begin EVENT "m2B7308EA" "m2B7308EA" 0x70 DAQ 0xFF 0x01 0x07 0x00 /end EVENT /begin EVENT "m172310C5" "m172310C5" 0x71 DAQ 0xFF 0x01 0x07 0x00 /end EVENT /begin EVENT "mCC218A12" "mCC218A12" 0x72 DAQ 0xFF 0x01 0x07 0x00 /end EVENT /begin EVENT "m836A8DA6" "m836A8DA6" 0x73 DAQ 0xFF 0x01 0x07 0x00 /end EVENT /begin EVENT "mE0321FEF" "mE0321FEF" 0x74 DAQ 0xFF 0x01 0x07 0x00 /end EVENT /begin EVENT "m48532691" "m48532691" 0x75 DAQ 0xFF 0x01 0x07 0x00 /end EVENT /begin EVENT "m40789FB2" "m40789FB2" 0x76 DAQ 0xFF 0x01 0x07 0x00 /end EVENT /begin EVENT "m6151123C" "m6151123C" 0x77 DAQ 0xFF 0x01 0x07 0x00 /end EVENT /begin EVENT "m6D302C8C" "m6D302C8C" 0x78 DAQ 0xFF 0x01 0x07 0x00 /end EVENT /begin EVENT "m0B2462B8" "m0B2462B8" 0x79 DAQ 0xFF 0x01 0x07 0x00 /end EVENT /begin EVENT "m75B61C0A" "m75B61C0A" 0x7A DAQ 0xFF 0x01 0x07 0x00 /end EVENT /begin EVENT "mB42E081B" "mB42E081B" 0x7B DAQ 0xFF 0x01 0x07 0x00 /end EVENT /begin EVENT "m5F02D6B7" "m5F02D6B7" 0x7C DAQ 0xFF 0x01 0x07 0x00 /end EVENT /begin EVENT "m8DE2D5EF" "m8DE2D5EF" 0x7D DAQ 0xFF 0x01 0x07 0x00 /end EVENT /begin EVENT "mD24807A4" "mD24807A4" 0x7E DAQ 0xFF 0x01 0x07 0x00 /end EVENT /begin EVENT "mB38B253F" "mB38B253F" 0x7F DAQ 0xFF 0x01 0x07 0x00 /end EVENT /begin EVENT "mF6CC185E" "mF6CC185E" 0x80 DAQ 0xFF 0x01 0x07 0x00 /end EVENT /begin EVENT "m6314FA1E" "m6314FA1E" 0x81 DAQ 0xFF 0x01 0x07 0x00 /end EVENT /begin EVENT "m19B438EF" "m19B438EF" 0x82 DAQ 0xFF 0x01 0x07 0x00 /end EVENT /begin EVENT "m4B876289" "m4B876289" 0x83 DAQ 0xFF 0x01 0x07 0x00 /end EVENT /begin EVENT "m02018FD3" "m02018FD3" 0x84 DAQ 0xFF 0x01 0x07 0x00 /end EVENT /begin EVENT "m51B893B4" "m51B893B4" 0x85 DAQ 0xFF 0x01 0x07 0x00 /end EVENT /begin EVENT "mE109D0C6" "mE109D0C6" 0x86 DAQ 0xFF 0x01 0x07 0x00 /end EVENT /begin EVENT "mEA0B778A" "mEA0B778A" 0x87 DAQ 0xFF 0x01 0x07 0x00 /end EVENT /begin EVENT "m2529E72F" "m2529E72F" 0x88 DAQ 0xFF 0x01 0x07 0x00 /end EVENT /begin EVENT "mE208A9DF" "mE208A9DF" 0x89 DAQ 0xFF 0x01 0x07 0x00 /end EVENT /begin EVENT "mCCDE771B" "mCCDE771B" 0x8A DAQ 0xFF 0x01 0x07 0x00 /end EVENT /begin EVENT "m52452F75" "m52452F75" 0x8B DAQ 0xFF 0x01 0x07 0x00 /end EVENT /begin EVENT "m00C89390" "m00C89390" 0x8C DAQ 0xFF 0x01 0x07 0x00 /end EVENT /begin EVENT "m5B30E0EC" "m5B30E0EC" 0x8D DAQ 0xFF 0x01 0x07 0x00 /end EVENT /begin EVENT "mD4FEA742" "mD4FEA742" 0x8E DAQ 0xFF 0x01 0x07 0x00 /end EVENT /begin EVENT "m6971EE33" "m6971EE33" 0x8F DAQ 0xFF 0x01 0x07 0x00 /end EVENT /begin EVENT "mF4236A7C" "mF4236A7C" 0x90 DAQ 0xFF 0x01 0x07 0x00 /end EVENT /begin EVENT "m169D989B" "m169D989B" 0x91 DAQ 0xFF 0x01 0x07 0x00 /end EVENT /begin EVENT "mE2D4D7CC" "mE2D4D7CC" 0x92 DAQ 0xFF 0x01 0x07 0x00 /end EVENT /begin EVENT "m36D6CAF4" "m36D6CAF4" 0x93 DAQ 0xFF 0x01 0x07 0x00 /end EVENT /begin EVENT "m8721A188" "m8721A188" 0x94 DAQ 0xFF 0x01 0x07 0x00 /end EVENT /begin EVENT "m74793D25" "m74793D25" 0x95 DAQ 0xFF 0x01 0x07 0x00 /end EVENT /begin EVENT "m54AAE2D2" "m54AAE2D2" 0x96 DAQ 0xFF 0x01 0x07 0x00 /end EVENT /begin EVENT "m44150998" "m44150998" 0x97 DAQ 0xFF 0x01 0x07 0x00 /end EVENT /begin EVENT "mC37BEA6B" "mC37BEA6B" 0x98 DAQ 0xFF 0x01 0x07 0x00 /end EVENT /begin EVENT "m7FC38E8C" "m7FC38E8C" 0x99 DAQ 0xFF 0x01 0x07 0x00 /end EVENT /begin EVENT "mE6EAC0BB" "mE6EAC0BB" 0x9A DAQ 0xFF 0x01 0x07 0x00 /end EVENT /begin EVENT "mF1BBE94A" "mF1BBE94A" 0x9B DAQ 0xFF 0x01 0x07 0x00 /end EVENT /begin EVENT "mC4AD6325" "mC4AD6325" 0x9C DAQ 0xFF 0x01 0x07 0x00 /end EVENT /begin EVENT "m5CC13641" "m5CC13641" 0x9D DAQ 0xFF 0x01 0x07 0x00 /end EVENT /begin EVENT "mF632389D" "mF632389D" 0x9E DAQ 0xFF 0x01 0x07 0x00 /end EVENT /begin EVENT "m7896344C" "m7896344C" 0x9F DAQ 0xFF 0x01 0x07 0x00 /end EVENT /begin EVENT "mEE42867E" "mEE42867E" 0xA0 DAQ 0xFF 0x01 0x07 0x00 /end EVENT /begin EVENT "m8BE7C754" "m8BE7C754" 0xA1 DAQ 0xFF 0x01 0x07 0x00 /end EVENT /begin EVENT "mC4CC89CB" "mC4CC89CB" 0xA2 DAQ 0xFF 0x01 0x07 0x00 /end EVENT /begin EVENT "mD95C1093" "mD95C1093" 0xA3 DAQ 0xFF 0x01 0x07 0x00 /end EVENT /begin EVENT "m8188E012" "m8188E012" 0xA4 DAQ 0xFF 0x01 0x07 0x00 /end EVENT /begin EVENT "mC7DA7622" "mC7DA7622" 0xA5 DAQ 0xFF 0x01 0x07 0x00 /end EVENT /begin EVENT "mE8669EED" "mE8669EED" 0xA6 DAQ 0xFF 0x01 0x07 0x00 /end EVENT /begin EVENT "m09329641" "m09329641" 0xA7 DAQ 0xFF 0x01 0x07 0x00 /end EVENT /begin EVENT "m06F98A9B" "m06F98A9B" 0xA8 DAQ 0xFF 0x01 0x07 0x00 /end EVENT /begin EVENT "m7E05614E" "m7E05614E" 0xA9 DAQ 0xFF 0x01 0x07 0x00 /end EVENT /begin EVENT "mB8101AB9" "mB8101AB9" 0xAA DAQ 0xFF 0x01 0x07 0x00 /end EVENT /begin EVENT "m12332BF5" "m12332BF5" 0xAB DAQ 0xFF 0x01 0x07 0x00 /end EVENT /begin EVENT "m392C484C" "m392C484C" 0xAC DAQ 0xFF 0x01 0x07 0x00 /end EVENT /begin EVENT "m848A8F95" "m848A8F95" 0xAD DAQ 0xFF 0x01 0x07 0x00 /end EVENT /begin EVENT "m3C835C2B" "m3C835C2B" 0xAE DAQ 0xFF 0x01 0x07 0x00 /end EVENT /begin EVENT "m3811D3F4" "m3811D3F4" 0xAF DAQ 0xFF 0x01 0x07 0x00 /end EVENT /begin EVENT "m9ED6D216" "m9ED6D216" 0xB0 DAQ 0xFF 0x01 0x07 0x00 /end EVENT /begin EVENT "m08CC2D2D" "m08CC2D2D" 0xB1 DAQ 0xFF 0x01 0x07 0x00 /end EVENT /begin EVENT "mAF0D9F32" "mAF0D9F32" 0xB2 DAQ 0xFF 0x01 0x07 0x00 /end EVENT /begin EVENT "mDFE0C184" "mDFE0C184" 0xB3 DAQ 0xFF 0x01 0x07 0x00 /end EVENT /begin EVENT "m6113BC85" "m6113BC85" 0xB4 DAQ 0xFF 0x01 0x07 0x00 /end EVENT /begin EVENT "m5B94D338" "m5B94D338" 0xB5 DAQ 0xFF 0x01 0x07 0x00 /end EVENT /begin EVENT "mDFDD3AD5" "mDFDD3AD5" 0xB6 DAQ 0xFF 0x01 0x07 0x00 /end EVENT /begin EVENT "m24199710" "m24199710" 0xB7 DAQ 0xFF 0x01 0x07 0x00 /end EVENT /begin EVENT "m0414D557" "m0414D557" 0xB8 DAQ 0xFF 0x01 0x07 0x00 /end EVENT /begin EVENT "mC82DE476" "mC82DE476" 0xB9 DAQ 0xFF 0x01 0x07 0x00 /end EVENT /begin EVENT "mE6A8F011" "mE6A8F011" 0xBA DAQ 0xFF 0x01 0x07 0x00 /end EVENT /begin EVENT "mA9DC8893" "mA9DC8893" 0xBB DAQ 0xFF 0x01 0x07 0x00 /end EVENT /begin EVENT "m33C063AB" "m33C063AB" 0xBC DAQ 0xFF 0x01 0x07 0x00 /end EVENT /begin EVENT "mE1BEAD6E" "mE1BEAD6E" 0xBD DAQ 0xFF 0x01 0x07 0x00 /end EVENT /begin EVENT "m54F6BBC4" "m54F6BBC4" 0xBE DAQ 0xFF 0x01 0x07 0x00 /end EVENT /begin EVENT "mFC5F793A" "mFC5F793A" 0xBF DAQ 0xFF 0x01 0x07 0x00 /end EVENT /begin EVENT "mC6D95B54" "mC6D95B54" 0xC0 DAQ 0xFF 0x01 0x07 0x00 /end EVENT /begin EVENT "mC565C863" "mC565C863" 0xC1 DAQ 0xFF 0x01 0x07 0x00 /end EVENT /begin EVENT "m7179D09A" "m7179D09A" 0xC2 DAQ 0xFF 0x01 0x07 0x00 /end EVENT /begin EVENT "mEB450666" "mEB450666" 0xC3 DAQ 0xFF 0x01 0x07 0x00 /end EVENT /begin EVENT "m61257D31" "m61257D31" 0xC4 DAQ 0xFF 0x01 0x07 0x00 /end EVENT /begin EVENT "mF3BC289D" "mF3BC289D" 0xC5 DAQ 0xFF 0x01 0x07 0x00 /end EVENT /begin EVENT "mFCC44EA8" "mFCC44EA8" 0xC6 DAQ 0xFF 0x01 0x07 0x00 /end EVENT /begin EVENT "mEDDE5D59" "mEDDE5D59" 0xC7 DAQ 0xFF 0x01 0x07 0x00 /end EVENT /begin EVENT "m5361C2DF" "m5361C2DF" 0xC8 DAQ 0xFF 0x01 0x07 0x00 /end EVENT /begin EVENT "mF2BC9B45" "mF2BC9B45" 0xC9 DAQ 0xFF 0x01 0x07 0x00 /end EVENT /begin EVENT "m96B8F8FB" "m96B8F8FB" 0xCA DAQ 0xFF 0x01 0x07 0x00 /end EVENT /begin EVENT "m53D5E515" "m53D5E515" 0xCB DAQ 0xFF 0x01 0x07 0x00 /end EVENT /begin EVENT "m7A8CF7FF" "m7A8CF7FF" 0xCC DAQ 0xFF 0x01 0x07 0x00 /end EVENT /begin EVENT "m5AC46730" "m5AC46730" 0xCD DAQ 0xFF 0x01 0x07 0x00 /end EVENT /begin EVENT "m66D06668" "m66D06668" 0xCE DAQ 0xFF 0x01 0x07 0x00 /end EVENT /begin EVENT "mE9087761" "mE9087761" 0xCF DAQ 0xFF 0x01 0x07 0x00 /end EVENT /begin EVENT "m3560D369" "m3560D369" 0xD0 DAQ 0xFF 0x01 0x07 0x00 /end EVENT /begin EVENT "m5C40F8A1" "m5C40F8A1" 0xD1 DAQ 0xFF 0x01 0x07 0x00 /end EVENT /begin EVENT "m85AD4CE0" "m85AD4CE0" 0xD2 DAQ 0xFF 0x01 0x07 0x00 /end EVENT /begin EVENT "mBDBBCDD0" "mBDBBCDD0" 0xD3 DAQ 0xFF 0x01 0x07 0x00 /end EVENT /begin EVENT "mF6086F6F" "mF6086F6F" 0xD4 DAQ 0xFF 0x01 0x07 0x00 /end EVENT /begin EVENT "m65BDCC00" "m65BDCC00" 0xD5 DAQ 0xFF 0x01 0x07 0x00 /end EVENT /begin EVENT "m4416C666" "m4416C666" 0xD6 DAQ 0xFF 0x01 0x07 0x00 /end EVENT /begin EVENT "mA5838F33" "mA5838F33" 0xD7 DAQ 0xFF 0x01 0x07 0x00 /end EVENT /begin EVENT "m6E47103C" "m6E47103C" 0xD8 DAQ 0xFF 0x01 0x07 0x00 /end EVENT /begin EVENT "m63D7CBB2" "m63D7CBB2" 0xD9 DAQ 0xFF 0x01 0x07 0x00 /end EVENT /begin EVENT "m126B2864" "m126B2864" 0xDA DAQ 0xFF 0x01 0x07 0x00 /end EVENT /begin EVENT "m82532E9C" "m82532E9C" 0xDB DAQ 0xFF 0x01 0x07 0x00 /end EVENT /begin EVENT "mA67C4AEE" "mA67C4AEE" 0xDC DAQ 0xFF 0x01 0x07 0x00 /end EVENT /begin EVENT "mEAE04E35" "mEAE04E35" 0xDD DAQ 0xFF 0x01 0x07 0x00 /end EVENT /begin EVENT "m3E8F7CDC" "m3E8F7CDC" 0xDE DAQ 0xFF 0x01 0x07 0x00 /end EVENT /begin EVENT "mD4F3BD9C" "mD4F3BD9C" 0xDF DAQ 0xFF 0x01 0x07 0x00 /end EVENT /begin EVENT "mDD2854F0" "mDD2854F0" 0xE0 DAQ 0xFF 0x01 0x07 0x00 /end EVENT /begin EVENT "mC51CE417" "mC51CE417" 0xE1 DAQ 0xFF 0x01 0x07 0x00 /end EVENT /begin EVENT "m42CE439F" "m42CE439F" 0xE2 DAQ 0xFF 0x01 0x07 0x00 /end EVENT /begin EVENT "mD2F99AA4" "mD2F99AA4" 0xE3 DAQ 0xFF 0x01 0x07 0x00 /end EVENT /begin EVENT "m119E79D1" "m119E79D1" 0xE4 DAQ 0xFF 0x01 0x07 0x00 /end EVENT /begin EVENT "m88C2462A" "m88C2462A" 0xE5 DAQ 0xFF 0x01 0x07 0x00 /end EVENT /begin EVENT "m3C57F67B" "m3C57F67B" 0xE6 DAQ 0xFF 0x01 0x07 0x00 /end EVENT /begin EVENT "m60806075" "m60806075" 0xE7 DAQ 0xFF 0x01 0x07 0x00 /end EVENT /begin EVENT "m645EAE66" "m645EAE66" 0xE8 DAQ 0xFF 0x01 0x07 0x00 /end EVENT /begin EVENT "m87AD3F00" "m87AD3F00" 0xE9 DAQ 0xFF 0x01 0x07 0x00 /end EVENT /begin EVENT "mC9EA4C78" "mC9EA4C78" 0xEA DAQ 0xFF 0x01 0x07 0x00 /end EVENT /begin EVENT "mD177BD67" "mD177BD67" 0xEB DAQ 0xFF 0x01 0x07 0x00 /end EVENT /begin EVENT "m4BD69FFB" "m4BD69FFB" 0xEC DAQ 0xFF 0x01 0x07 0x00 /end EVENT /begin EVENT "m944AFDC6" "m944AFDC6" 0xED DAQ 0xFF 0x01 0x07 0x00 /end EVENT /begin EVENT "mC9AA777D" "mC9AA777D" 0xEE DAQ 0xFF 0x01 0x07 0x00 /end EVENT /begin EVENT "m496328A6" "m496328A6" 0xEF DAQ 0xFF 0x01 0x07 0x00 /end EVENT /begin EVENT "mE6295B24" "mE6295B24" 0xF0 DAQ 0xFF 0x01 0x07 0x00 /end EVENT /begin EVENT "mC963B22B" "mC963B22B" 0xF1 DAQ 0xFF 0x01 0x07 0x00 /end EVENT /begin EVENT "mF56939BC" "mF56939BC" 0xF2 DAQ 0xFF 0x01 0x07 0x00 /end EVENT /begin EVENT "m85F0B096" "m85F0B096" 0xF3 DAQ 0xFF 0x01 0x07 0x00 /end EVENT /begin EVENT "m2D0FE7FF" "m2D0FE7FF" 0xF4 DAQ 0xFF 0x01 0x07 0x00 /end EVENT /begin EVENT "mE5598696" "mE5598696" 0xF5 DAQ 0xFF 0x01 0x07 0x00 /end EVENT /begin EVENT "mB3E1B4DE" "mB3E1B4DE" 0xF6 DAQ 0xFF 0x01 0x07 0x00 /end EVENT /begin EVENT "m866622E4" "m866622E4" 0xF7 DAQ 0xFF 0x01 0x07 0x00 /end EVENT /begin EVENT "m989473B3" "m989473B3" 0xF8 DAQ 0xFF 0x01 0x07 0x00 /end EVENT /begin EVENT "m1C91E65A" "m1C91E65A" 0xF9 DAQ 0xFF 0x01 0x07 0x00 /end EVENT /begin EVENT "m4B02AF13" "m4B02AF13" 0xFA DAQ 0xFF 0x01 0x07 0x00 /end EVENT /begin EVENT "m45B92363" "m45B92363" 0xFB DAQ 0xFF 0x01 0x07 0x00 /end EVENT /begin EVENT "m3FEE3B55" "m3FEE3B55" 0xFC DAQ 0xFF 0x01 0x07 0x00 /end EVENT /begin EVENT "m11F974E1" "m11F974E1" 0xFD DAQ 0xFF 0x01 0x07 0x00 /end EVENT /begin EVENT "mF16BB08A" "mF16BB08A" 0xFE DAQ 0xFF 0x01 0x07 0x00 /end EVENT /begin EVENT "mD69E898D" "mD69E898D" 0xFF DAQ 0xFF 0x01 0x07 0x00 /end EVENT /begin EVENT "m3D816A44" "m3D816A44" 0x100 DAQ 0xFF 0x01 0x07 0x00 /end EVENT /begin EVENT "m0CAFC287" "m0CAFC287" 0x101 DAQ 0xFF 0x01 0x07 0x00 /end EVENT /begin EVENT "m8D2D4E79" "m8D2D4E79" 0x102 DAQ 0xFF 0x01 0x07 0x00 /end EVENT /begin EVENT "m869CFE0F" "m869CFE0F" 0x103 DAQ 0xFF 0x01 0x07 0x00 /end EVENT /begin EVENT "m7CAE2CC9" "m7CAE2CC9" 0x104 DAQ 0xFF 0x01 0x07 0x00 /end EVENT /begin EVENT "mE8FC5716" "mE8FC5716" 0x105 DAQ 0xFF 0x01 0x07 0x00 /end EVENT /begin EVENT "m2122DC38" "m2122DC38" 0x106 DAQ 0xFF 0x01 0x07 0x00 /end EVENT /begin EVENT "mCA90F930" "mCA90F930" 0x107 DAQ 0xFF 0x01 0x07 0x00 /end EVENT /begin EVENT "m5DF41B25" "m5DF41B25" 0x108 DAQ 0xFF 0x01 0x07 0x00 /end EVENT /begin EVENT "mC015B399" "mC015B399" 0x109 DAQ 0xFF 0x01 0x07 0x00 /end EVENT /begin EVENT "mBE82C046" "mBE82C046" 0x10A DAQ 0xFF 0x01 0x07 0x00 /end EVENT /begin EVENT "m64D3C122" "m64D3C122" 0x10B DAQ 0xFF 0x01 0x07 0x00 /end EVENT /begin EVENT "m342CF370" "m342CF370" 0x10C DAQ 0xFF 0x01 0x07 0x00 /end EVENT /begin EVENT "m56BA8788" "m56BA8788" 0x10D DAQ 0xFF 0x01 0x07 0x00 /end EVENT /begin EVENT "m8C2D8D4B" "m8C2D8D4B" 0x10E DAQ 0xFF 0x01 0x07 0x00 /end EVENT /begin EVENT "m5D1D9AB7" "m5D1D9AB7" 0x10F DAQ 0xFF 0x01 0x07 0x00 /end EVENT /begin EVENT "m86C305AD" "m86C305AD" 0x110 DAQ 0xFF 0x01 0x07 0x00 /end EVENT /begin EVENT "m72760766" "m72760766" 0x111 DAQ 0xFF 0x01 0x07 0x00 /end EVENT /begin EVENT "m2B987656" "m2B987656" 0x112 DAQ 0xFF 0x01 0x07 0x00 /end EVENT /begin EVENT "m79CF4B5C" "m79CF4B5C" 0x113 DAQ 0xFF 0x01 0x07 0x00 /end EVENT /begin EVENT "m0B787352" "m0B787352" 0x114 DAQ 0xFF 0x01 0x07 0x00 /end EVENT /begin EVENT "mD225C6C1" "mD225C6C1" 0x115 DAQ 0xFF 0x01 0x07 0x00 /end EVENT /begin EVENT "m3FFC0ED4" "m3FFC0ED4" 0x116 DAQ 0xFF 0x01 0x07 0x00 /end EVENT /begin EVENT "m710A7800" "m710A7800" 0x117 DAQ 0xFF 0x01 0x07 0x00 /end EVENT /begin EVENT "m7C47122F" "m7C47122F" 0x118 DAQ 0xFF 0x01 0x07 0x00 /end EVENT /begin EVENT "mC1BDC313" "mC1BDC313" 0x119 DAQ 0xFF 0x01 0x07 0x00 /end EVENT /begin EVENT "m21D839FE" "m21D839FE" 0x11A DAQ 0xFF 0x01 0x07 0x00 /end EVENT /begin EVENT "m03770C27" "m03770C27" 0x11B DAQ 0xFF 0x01 0x07 0x00 /end EVENT /begin EVENT "m97B53199" "m97B53199" 0x11C DAQ 0xFF 0x01 0x07 0x00 /end EVENT /begin EVENT "mFD97D8CD" "mFD97D8CD" 0x11D DAQ 0xFF 0x01 0x07 0x00 /end EVENT /begin EVENT "mE0E1DBB4" "mE0E1DBB4" 0x11E DAQ 0xFF 0x01 0x07 0x00 /end EVENT /begin EVENT "m6CF04904" "m6CF04904" 0x11F DAQ 0xFF 0x01 0x07 0x00 /end EVENT /begin EVENT "m69B7E64C" "m69B7E64C" 0x120 DAQ 0xFF 0x01 0x07 0x00 /end EVENT /begin EVENT "mCDCB9C6E" "mCDCB9C6E" 0x121 DAQ 0xFF 0x01 0x07 0x00 /end EVENT /begin EVENT "m1F5767C1" "m1F5767C1" 0x122 DAQ 0xFF 0x01 0x07 0x00 /end EVENT /begin EVENT "mB4C7EE23" "mB4C7EE23" 0x123 DAQ 0xFF 0x01 0x07 0x00 /end EVENT /end DAQ
 /begin PAG 0x00 /end PAG
 /begin PGM PGM_MODE_ABSOLUTE 0xB0 0x00 /begin SECTOR "" 0x00 0x00 0x01000000 0x00 0x00 0x00 /end SECTOR /end PGM
 /begin XCP_ON_TCP_IP 0x0100 0x15B3 ADDRESS "192.168.51.2" /end XCP_ON_TCP_IP
/end IF_DATA
/begin CHARACTERISTIC BUILD_COMMIT_ID "" ASCII 0x803011AA __UBYTE_Z 0 NO_COMPU_METHOD 0 255 READ_ONLY NUMBER 48 /end CHARACTERISTIC
/begin CHARACTERISTIC BUILD_REPOSITORY "" ASCII 0x80301096 __UBYTE_Z 0 NO_COMPU_METHOD 0 255 READ_ONLY NUMBER 96 /end CHARACTERISTIC
/begin CHARACTERISTIC BUILD_SW_VERSION "" ASCII 0x80300000 __UBYTE_Z 0 NO_COMPU_METHOD 0 255 READ_ONLY NUMBER 150 /end CHARACTERISTIC
/begin CHARACTERISTIC FctParam.AebCommon._m_trigger._m_update "" VALUE 0x30008D3C __UByte_Value 0 NO_COMPU_METHOD 0 255 ECU_ADDRESS_EXTENSION 0x10 /end CHARACTERISTIC
/begin CHARACTERISTIC FctParam.AebCommon.aebEncodingBypass " 0: Bypass as false, 1: Bypass as true, 255: read from encoding structure" VALUE 0x30008E0D __UByte_Value 0 NO_COMPU_METHOD 0 255 ECU_ADDRESS_EXTENSION 0x10 /end CHARACTERISTIC
/begin CHARACTERISTIC FctParam.AebCommon.aebHMISwitchBypass " 0: Bypass as false, 1: Bypass as true, 255: read from vehicle bus" VALUE 0x30008E0E __UByte_Value 0 NO_COMPU_METHOD 0 255 ECU_ADDRESS_EXTENSION 0x10 /end CHARACTERISTIC
/begin CHARACTERISTIC FctParam.AebCommon.fcwHMISwitchBypass " 0: Bypass as false, 1: Bypass as true, 255: read from vehicle bus" VALUE 0x30008E10 __UByte_Value 0 NO_COMPU_METHOD 0 255 ECU_ADDRESS_EXTENSION 0x10 /end CHARACTERISTIC
/begin CHARACTERISTIC FctParam.AlcLane._m_trigger._m_update "" VALUE 0x300094B4 __UByte_Value 0 NO_COMPU_METHOD 0 255 ECU_ADDRESS_EXTENSION 0x10 /end CHARACTERISTIC
/begin CHARACTERISTIC FctParam.AlcLane.bypassRoadTypePermittedCond " bypass parameter for RoadTypePermission Condition Switch for ALC Road Type Permitted Condition: 0: Condition not fulfilled, 1: Condition fulfilled, 255: Condition dynamically set" VALUE 0x30009673 __UByte_Value 0 NO_COMPU_METHOD 0 255 ECU_ADDRESS_EXTENSION 0x10 /end CHARACTERISTIC
/begin CHARACTERISTIC FctParam.Est._m_trigger._m_update "" VALUE 0x30009B80 __UByte_Value 0 NO_COMPU_METHOD 0 255 ECU_ADDRESS_EXTENSION 0x10 /end CHARACTERISTIC
/begin CHARACTERISTIC FctParam.Est.paramFittedEst " EST fitted (0: not fitted, 1: EST Base, 2: EST Enhanced)" VALUE 0x30009C92 __UByte_Value 0 NO_COMPU_METHOD 0 255 ECU_ADDRESS_EXTENSION 0x10 /end CHARACTERISTIC
/begin MEASUREMENT _StbM_GlobalTimeTupleArray_ast._0_._timeBaseStatus "" UBYTE NO_COMPU_METHOD 0 0 0 255 BYTE_ORDER MSB_LAST ECU_ADDRESS 0x70026214 ECU_ADDRESS_EXTENSION 0x1 /end MEASUREMENT
/begin MEASUREMENT _g_PL_AD_fw_OneDrivingSW_dsm_StateManagement_SscRunnable_SscRunnable_m_daCoreStateNotification_out_local.m_daCoreState "" ULONG NO_COMPU_METHOD 0 0 0 4294967295 BYTE_ORDER MSB_LAST ECU_ADDRESS 0xB0035D48 ECU_ADDRESS_EXTENSION 0x8 /end MEASUREMENT
/begin MEASUREMENT _g_PL_AD_fw_OneDrivingSW_fct_fct_mainproc_ods_fct_ods_fct_mainproc_RunnableMainProc.m_mainProcBusinessLogic.m_mainProcCustomerController.m_hf.m_conditionDmsDriverPresent.m_isConditionFulfilled "" UBYTE NO_COMPU_METHOD 0 0 0 255 BYTE_ORDER MSB_LAST ECU_ADDRESS 0xB0090D94 ECU_ADDRESS_EXTENSION 0x2 /end MEASUREMENT
/begin MEASUREMENT _g_PL_AD_fw_OneDrivingSW_fct_fct_mainproc_ods_fct_ods_fct_mainproc_RunnableMainProc.m_mainProcBusinessLogic.m_mainProcCustomerController.m_hf.m_conditionGeofencingApc.m_isConditionFulfilled "" UBYTE NO_COMPU_METHOD 0 0 0 255 BYTE_ORDER MSB_LAST ECU_ADDRESS 0xB0090E0C ECU_ADDRESS_EXTENSION 0x2 /end MEASUREMENT
/begin MEASUREMENT _g_PL_AD_fw_OneDrivingSW_fct_fct_mainproc_ods_fct_ods_fct_mainproc_RunnableMainProc.m_mainProcBusinessLogic.m_mainProcCustomerController.m_hf.m_conditionHandsOff.m_isConditionFulfilled "" UBYTE NO_COMPU_METHOD 0 0 0 255 BYTE_ORDER MSB_LAST ECU_ADDRESS 0xB0090D7C ECU_ADDRESS_EXTENSION 0x2 /end MEASUREMENT
/begin MEASUREMENT _g_PL_AD_fw_OneDrivingSW_fct_fct_mainproc_ods_fct_ods_fct_mainproc_RunnableMainProc.m_portFunctionStates.m_states.m_accState "" UBYTE AccStates 0 0 0 255 BYTE_ORDER MSB_LAST ECU_ADDRESS 0xB008D098 ECU_ADDRESS_EXTENSION 0x2 /end MEASUREMENT
/begin MEASUREMENT _g_PL_AD_fw_OneDrivingSW_fct_fct_mainproc_ods_fct_ods_fct_mainproc_RunnableMainProc.m_portFunctionStates.m_states.m_alcDriverCancellation "" UBYTE AlcSubStateDriverCancellation 0 0 0 255 BYTE_ORDER MSB_LAST ECU_ADDRESS 0xB008D0A3 ECU_ADDRESS_EXTENSION 0x2 /end MEASUREMENT
/begin MEASUREMENT _g_PL_AD_fw_OneDrivingSW_fct_fct_mainproc_ods_fct_ods_fct_mainproc_RunnableMainProc.m_portFunctionStates.m_states.m_alcPrevState "" UBYTE AlcStates 0 0 0 255 BYTE_ORDER MSB_LAST ECU_ADDRESS 0xB008D0A2 ECU_ADDRESS_EXTENSION 0x2 /end MEASUREMENT
/begin MEASUREMENT _g_PL_AD_fw_OneDrivingSW_fct_fct_mainproc_ods_fct_ods_fct_mainproc_RunnableMainProc.m_portFunctionStates.m_states.m_alcState "" UBYTE AlcStates 0 0 0 255 BYTE_ORDER MSB_LAST ECU_ADDRESS 0xB008D0A1 ECU_ADDRESS_EXTENSION 0x2 /end MEASUREMENT
/begin MEASUREMENT _g_PL_AD_fw_OneDrivingSW_fct_fct_mainproc_ods_fct_ods_fct_mainproc_RunnableMainProc.m_portFunctionStates.m_states.m_elkOcvState "" UBYTE LssStates 0 0 0 255 BYTE_ORDER MSB_LAST ECU_ADDRESS 0xB008D09C ECU_ADDRESS_EXTENSION 0x2 /end MEASUREMENT
/begin MEASUREMENT _g_PL_AD_fw_OneDrivingSW_fct_fct_mainproc_ods_fct_ods_fct_mainproc_RunnableMainProc.m_portFunctionStates.m_states.m_elkOtState "" UBYTE LssStates 0 0 0 255 BYTE_ORDER MSB_LAST ECU_ADDRESS 0xB008D09D ECU_ADDRESS_EXTENSION 0x2 /end MEASUREMENT
/begin MEASUREMENT _g_PL_AD_fw_OneDrivingSW_fct_fct_mainproc_ods_fct_ods_fct_mainproc_RunnableMainProc.m_portFunctionStates.m_states.m_elkPedState "" UBYTE LssStates 0 0 0 255 BYTE_ORDER MSB_LAST ECU_ADDRESS 0xB008D09F ECU_ADDRESS_EXTENSION 0x2 /end MEASUREMENT
/begin MEASUREMENT _g_PL_AD_fw_OneDrivingSW_fct_fct_mainproc_ods_fct_ods_fct_mainproc_RunnableMainProc.m_portFunctionStates.m_states.m_elkReHState "" UBYTE LssStates 0 0 0 255 BYTE_ORDER MSB_LAST ECU_ADDRESS 0xB008D09B ECU_ADDRESS_EXTENSION 0x2 /end MEASUREMENT
/begin MEASUREMENT _g_PL_AD_fw_OneDrivingSW_fct_fct_mainproc_ods_fct_ods_fct_mainproc_RunnableMainProc.m_portFunctionStates.m_states.m_elkReVState "" UBYTE LssStates 0 0 0 255 BYTE_ORDER MSB_LAST ECU_ADDRESS 0xB008D0A0 ECU_ADDRESS_EXTENSION 0x2 /end MEASUREMENT
/begin MEASUREMENT _g_PL_AD_fw_OneDrivingSW_fct_fct_mainproc_ods_fct_ods_fct_mainproc_RunnableMainProc.m_portFunctionStates.m_states.m_estPrevState "" UBYTE EstStates 0 0 0 255 BYTE_ORDER MSB_LAST ECU_ADDRESS 0xB008D0A6 ECU_ADDRESS_EXTENSION 0x2 /end MEASUREMENT
/begin MEASUREMENT _g_PL_AD_fw_OneDrivingSW_fct_fct_mainproc_ods_fct_ods_fct_mainproc_RunnableMainProc.m_portFunctionStates.m_states.m_estState "" UBYTE EstStates 0 0 0 255 BYTE_ORDER MSB_LAST ECU_ADDRESS 0xB008D0A5 ECU_ADDRESS_EXTENSION 0x2 /end MEASUREMENT
/begin MEASUREMENT _g_PL_AD_fw_OneDrivingSW_fct_fct_mainproc_ods_fct_ods_fct_mainproc_RunnableMainProc.m_portFunctionStates.m_states.m_hfState "" UBYTE HfStates 0 0 0 255 BYTE_ORDER MSB_LAST ECU_ADDRESS 0xB008D0A7 ECU_ADDRESS_EXTENSION 0x2 /end MEASUREMENT
/begin MEASUREMENT _g_PL_AD_fw_OneDrivingSW_fct_fct_mainproc_ods_fct_ods_fct_mainproc_RunnableMainProc.m_portFunctionStates.m_states.m_ldwState "" UBYTE LssStates 0 0 0 255 BYTE_ORDER MSB_LAST ECU_ADDRESS 0xB008D09E ECU_ADDRESS_EXTENSION 0x2 /end MEASUREMENT
/begin MEASUREMENT _g_PL_AD_fw_OneDrivingSW_fct_fct_mainproc_ods_fct_ods_fct_mainproc_RunnableMainProc.m_portFunctionStates.m_states.m_lkaState "" UBYTE LssStates 0 0 0 255 BYTE_ORDER MSB_LAST ECU_ADDRESS 0xB008D09A ECU_ADDRESS_EXTENSION 0x2 /end MEASUREMENT
/begin MEASUREMENT _g_PL_AD_fw_OneDrivingSW_fct_fct_mainproc_ods_fct_ods_fct_mainproc_RunnableMainProc.m_portFunctionStates.m_states.m_lksState "" UBYTE LssStates 0 0 0 255 BYTE_ORDER MSB_LAST ECU_ADDRESS 0xB008D0A4 ECU_ADDRESS_EXTENSION 0x2 /end MEASUREMENT
/begin MEASUREMENT _g_PL_AD_fw_OneDrivingSW_fct_fct_mainproc_ods_fct_ods_fct_mainproc_RunnableMainProc_m_portMainProcInternalData_out_local.m_lssProcessorSignals.m_rollingInterventionWarning.m_interventionCounter "" UWORD NO_COMPU_METHOD 0 0 0 65535 BYTE_ORDER MSB_LAST ECU_ADDRESS 0xB0033218 ECU_ADDRESS_EXTENSION 0x8 /end MEASUREMENT
/begin COMPU_METHOD ASILRating "enumeration table" TAB_VERB "%.0" "" COMPU_TAB_REF ASILRating /end COMPU_METHOD
/begin COMPU_METHOD AbdMainStates "enumeration table" TAB_VERB "%.0" "" COMPU_TAB_REF AbdMainStates /end COMPU_METHOD
/begin COMPU_METHOD AbsStatus "enumeration table" TAB_VERB "%.0" "" COMPU_TAB_REF AbsStatus /end COMPU_METHOD
/begin COMPU_METHOD AccPlusBehavior "enumeration table" TAB_VERB "%.0" "" COMPU_TAB_REF AccPlusBehavior /end COMPU_METHOD
/begin COMPU_METHOD AccStateMachineInteractionType "enumeration table" TAB_VERB "%.0" "" COMPU_TAB_REF AccStateMachineInteractionType /end COMPU_METHOD
/begin COMPU_METHOD AccStates "enumeration table" TAB_VERB "%.0" "" COMPU_TAB_REF AccStates /end COMPU_METHOD
/begin COMPU_METHOD AcceleratorOverrideStrategy "enumeration table" TAB_VERB "%.0" "" COMPU_TAB_REF AcceleratorOverrideStrategy /end COMPU_METHOD
/begin COMPU_METHOD Accuracy "enumeration table" TAB_VERB "%.0" "" COMPU_TAB_REF Accuracy /end COMPU_METHOD
/begin COMPU_METHOD Action "enumeration table" TAB_VERB "%.0" "" COMPU_TAB_REF Action /end COMPU_METHOD
/begin COMPU_METHOD ActivationRequest "enumeration table" TAB_VERB "%.0" "" COMPU_TAB_REF ActivationRequest /end COMPU_METHOD
/begin COMPU_METHOD ActiveGapSearchVersion "enumeration table" TAB_VERB "%.0" "" COMPU_TAB_REF ActiveGapSearchVersion /end COMPU_METHOD
/begin COMPU_METHOD ActuationConstraint "enumeration table" TAB_VERB "%.0" "" COMPU_TAB_REF ActuationConstraint /end COMPU_METHOD
/begin COMPU_METHOD AdasisMapProvider "enumeration table" TAB_VERB "%.0" "" COMPU_TAB_REF AdasisMapProvider /end COMPU_METHOD
/begin COMPU_METHOD AdditionalDistanceInfo "enumeration table" TAB_VERB "%.0" "" COMPU_TAB_REF AdditionalDistanceInfo /end COMPU_METHOD
/begin COMPU_METHOD AlcAbortReason "enumeration table" TAB_VERB "%.0" "" COMPU_TAB_REF AlcAbortReason /end COMPU_METHOD
/begin COMPU_METHOD AlcHmiState "enumeration table" TAB_VERB "%.0" "" COMPU_TAB_REF AlcHmiState /end COMPU_METHOD
/begin COMPU_METHOD AlcStates "enumeration table" TAB_VERB "%.0" "" COMPU_TAB_REF AlcStates /end COMPU_METHOD
/begin COMPU_METHOD AlcSubStateDriverCancellation "enumeration table" TAB_VERB "%.0" "" COMPU_TAB_REF AlcSubStateDriverCancellation /end COMPU_METHOD
/begin COMPU_METHOD ArbitrationStates "enumeration table" TAB_VERB "%.0" "" COMPU_TAB_REF ArbitrationStates /end COMPU_METHOD
/begin COMPU_METHOD AudioType "enumeration table" TAB_VERB "%.0" "" COMPU_TAB_REF AudioType /end COMPU_METHOD
/begin COMPU_METHOD AvailableConfigurations "enumeration table" TAB_VERB "%.0" "" COMPU_TAB_REF AvailableConfigurations /end COMPU_METHOD
/begin COMPU_METHOD AveragingWeightType "enumeration table" TAB_VERB "%.0" "" COMPU_TAB_REF AveragingWeightType /end COMPU_METHOD
/begin COMPU_METHOD BdaMode "enumeration table" TAB_VERB "%.0" "" COMPU_TAB_REF BdaMode /end COMPU_METHOD
/begin COMPU_METHOD BdcMainStates "enumeration table" TAB_VERB "%.0" "" COMPU_TAB_REF BdcMainStates /end COMPU_METHOD
/begin COMPU_METHOD BdcStateConstants "enumeration table" TAB_VERB "%.0" "" COMPU_TAB_REF BdcStateConstants /end COMPU_METHOD
/begin COMPU_METHOD BdcStateOfdStandstillCv "enumeration table" TAB_VERB "%.0" "" COMPU_TAB_REF BdcStateOfdStandstillCv /end COMPU_METHOD
/begin COMPU_METHOD BdcTargets "enumeration table" TAB_VERB "%.0" "" COMPU_TAB_REF BdcTargets /end COMPU_METHOD
/begin COMPU_METHOD BehaviorExecutionRecommendation "enumeration table" TAB_VERB "%.0" "" COMPU_TAB_REF BehaviorExecutionRecommendation /end COMPU_METHOD
/begin COMPU_METHOD BehaviorIdsAlc "enumeration table" TAB_VERB "%.0" "" COMPU_TAB_REF BehaviorIdsAlc /end COMPU_METHOD
/begin COMPU_METHOD BehaviorRelatedBorderStatus "enumeration table" TAB_VERB "%.0" "" COMPU_TAB_REF BehaviorRelatedBorderStatus /end COMPU_METHOD
/begin COMPU_METHOD BehaviorRelatedObjectStatus "enumeration table" TAB_VERB "%.0" "" COMPU_TAB_REF BehaviorRelatedObjectStatus /end COMPU_METHOD
/begin COMPU_METHOD BehaviorStrategy "enumeration table" TAB_VERB "%.0" "" COMPU_TAB_REF BehaviorStrategy /end COMPU_METHOD
/begin COMPU_METHOD Behaviour "enumeration table" TAB_VERB "%.0" "" COMPU_TAB_REF Behaviour /end COMPU_METHOD
/begin COMPU_METHOD BehaviourRequestAlc "enumeration table" TAB_VERB "%.0" "" COMPU_TAB_REF BehaviourRequestAlc /end COMPU_METHOD
/begin COMPU_METHOD BorderState "enumeration table" TAB_VERB "%.0" "" COMPU_TAB_REF BorderState /end COMPU_METHOD
/begin COMPU_METHOD BoundarySource "enumeration table" TAB_VERB "%.0" "" COMPU_TAB_REF BoundarySource /end COMPU_METHOD
/begin COMPU_METHOD BoundaryType "enumeration table" TAB_VERB "%.0" "" COMPU_TAB_REF BoundaryType /end COMPU_METHOD
/begin COMPU_METHOD BoundaryType_Copy1 "enumeration table" TAB_VERB "%.0" "" COMPU_TAB_REF BoundaryType_Copy1 /end COMPU_METHOD
/begin COMPU_METHOD BoundaryType_Copy2 "enumeration table" TAB_VERB "%.0" "" COMPU_TAB_REF BoundaryType_Copy2 /end COMPU_METHOD
/begin COMPU_METHOD BufferClearingState "enumeration table" TAB_VERB "%.0" "" COMPU_TAB_REF BufferClearingState /end COMPU_METHOD
/begin COMPU_METHOD BuiltUpAreaType "enumeration table" TAB_VERB "%.0" "" COMPU_TAB_REF BuiltUpAreaType /end COMPU_METHOD
/begin COMPU_METHOD ButtonStatus "enumeration table" TAB_VERB "%.0" "" COMPU_TAB_REF ButtonStatus /end COMPU_METHOD
/begin COMPU_METHOD C_PLM "enumeration table" TAB_VERB "%.0" "" COMPU_TAB_REF C_PLM /end COMPU_METHOD
/begin COMPU_METHOD CalculatorResult "enumeration table" TAB_VERB "%.0" "" COMPU_TAB_REF CalculatorResult /end COMPU_METHOD
/begin COMPU_METHOD CascadedStates "enumeration table" TAB_VERB "%.0" "" COMPU_TAB_REF CascadedStates /end COMPU_METHOD
/begin COMPU_METHOD Category "enumeration table" TAB_VERB "%.0" "" COMPU_TAB_REF Category /end COMPU_METHOD
/begin COMPU_METHOD ChosenGap "enumeration table" TAB_VERB "%.0" "" COMPU_TAB_REF ChosenGap /end COMPU_METHOD
/begin COMPU_METHOD ColdPathType "enumeration table" TAB_VERB "%.0" "" COMPU_TAB_REF ColdPathType /end COMPU_METHOD
/begin COMPU_METHOD Color "enumeration table" TAB_VERB "%.0" "" COMPU_TAB_REF Color /end COMPU_METHOD
/begin COMPU_METHOD Color_Copy1 "enumeration table" TAB_VERB "%.0" "" COMPU_TAB_REF Color_Copy1 /end COMPU_METHOD
/begin COMPU_METHOD ConditionBypassParameter "enumeration table" TAB_VERB "%.0" "" COMPU_TAB_REF ConditionBypassParameter /end COMPU_METHOD
/begin COMPU_METHOD ConflictingSituationType "enumeration table" TAB_VERB "%.0" "" COMPU_TAB_REF ConflictingSituationType /end COMPU_METHOD
/begin COMPU_METHOD ConnectionType "enumeration table" TAB_VERB "%.0" "" COMPU_TAB_REF ConnectionType /end COMPU_METHOD
/begin COMPU_METHOD ContextOriginType "enumeration table" TAB_VERB "%.0" "" COMPU_TAB_REF ContextOriginType /end COMPU_METHOD
/begin COMPU_METHOD ContributingType "enumeration table" TAB_VERB "%.0" "" COMPU_TAB_REF ContributingType /end COMPU_METHOD
/begin COMPU_METHOD ControlStrategy "enumeration table" TAB_VERB "%.0" "" COMPU_TAB_REF ControlStrategy /end COMPU_METHOD
/begin COMPU_METHOD ControlStrategyType "enumeration table" TAB_VERB "%.0" "" COMPU_TAB_REF ControlStrategyType /end COMPU_METHOD
/begin COMPU_METHOD CountryAndRegion "enumeration table" TAB_VERB "%.0" "" COMPU_TAB_REF CountryAndRegion /end COMPU_METHOD
/begin COMPU_METHOD CountryCode "enumeration table" TAB_VERB "%.0" "" COMPU_TAB_REF CountryCode /end COMPU_METHOD
/begin COMPU_METHOD CruiseControlModeInput "enumeration table" TAB_VERB "%.0" "" COMPU_TAB_REF CruiseControlModeInput /end COMPU_METHOD
/begin COMPU_METHOD CruiseMode "enumeration table" TAB_VERB "%.0" "" COMPU_TAB_REF CruiseMode /end COMPU_METHOD
/begin COMPU_METHOD CscRoundAboutState "enumeration table" TAB_VERB "%.0" "" COMPU_TAB_REF CscRoundAboutState /end COMPU_METHOD
/begin COMPU_METHOD CurrentLane "enumeration table" TAB_VERB "%.0" "" COMPU_TAB_REF CurrentLane /end COMPU_METHOD
/begin COMPU_METHOD CurrentLane_Copy1 "enumeration table" TAB_VERB "%.0" "" COMPU_TAB_REF CurrentLane_Copy1 /end COMPU_METHOD
/begin COMPU_METHOD CurrentLane_Copy2 "enumeration table" TAB_VERB "%.0" "" COMPU_TAB_REF CurrentLane_Copy2 /end COMPU_METHOD
/begin COMPU_METHOD DImmSubWinner "enumeration table" TAB_VERB "%.0" "" COMPU_TAB_REF DImmSubWinner /end COMPU_METHOD
/begin COMPU_METHOD DefinedTargetMotionGoal_v0 "enumeration table" TAB_VERB "%.0" "" COMPU_TAB_REF DefinedTargetMotionGoal_v0 /end COMPU_METHOD
/begin COMPU_METHOD DinMainStates "enumeration table" TAB_VERB "%.0" "" COMPU_TAB_REF DinMainStates /end COMPU_METHOD
/begin COMPU_METHOD DirectionIndicator "enumeration table" TAB_VERB "%.0" "" COMPU_TAB_REF DirectionIndicator /end COMPU_METHOD
/begin COMPU_METHOD DisplaySpeedUnit "enumeration table" TAB_VERB "%.0" "" COMPU_TAB_REF DisplaySpeedUnit /end COMPU_METHOD
/begin COMPU_METHOD DoorStatus "enumeration table" TAB_VERB "%.0" "" COMPU_TAB_REF DoorStatus /end COMPU_METHOD
/begin COMPU_METHOD Drivability "enumeration table" TAB_VERB "%.0" "" COMPU_TAB_REF Drivability /end COMPU_METHOD
/begin COMPU_METHOD DriveMode "enumeration table" TAB_VERB "%.0" "" COMPU_TAB_REF DriveMode /end COMPU_METHOD
/begin COMPU_METHOD DriveMode_Copy1 "enumeration table" TAB_VERB "%.0" "" COMPU_TAB_REF DriveMode_Copy1 /end COMPU_METHOD
/begin COMPU_METHOD DriveOffMode "enumeration table" TAB_VERB "%.0" "" COMPU_TAB_REF DriveOffMode /end COMPU_METHOD
/begin COMPU_METHOD DriveRestrictionMode "enumeration table" TAB_VERB "%.0" "" COMPU_TAB_REF DriveRestrictionMode /end COMPU_METHOD
/begin COMPU_METHOD DriverDrowsinessLevel "enumeration table" TAB_VERB "%.0" "" COMPU_TAB_REF DriverDrowsinessLevel /end COMPU_METHOD
/begin COMPU_METHOD DriverGazingSide "enumeration table" TAB_VERB "%.0" "" COMPU_TAB_REF DriverGazingSide /end COMPU_METHOD
/begin COMPU_METHOD DriverModelDmsStatus "enumeration table" TAB_VERB "%.0" "" COMPU_TAB_REF DriverModelDmsStatus /end COMPU_METHOD
/begin COMPU_METHOD DriverModelDriverAttention "enumeration table" TAB_VERB "%.0" "" COMPU_TAB_REF DriverModelDriverAttention /end COMPU_METHOD
/begin COMPU_METHOD DriverModelDriverDrowsinessLevel "enumeration table" TAB_VERB "%.0" "" COMPU_TAB_REF DriverModelDriverDrowsinessLevel /end COMPU_METHOD
/begin COMPU_METHOD DriverModelDriverPresence "enumeration table" TAB_VERB "%.0" "" COMPU_TAB_REF DriverModelDriverPresence /end COMPU_METHOD
/begin COMPU_METHOD DriverModelDriverSpoofing "enumeration table" TAB_VERB "%.0" "" COMPU_TAB_REF DriverModelDriverSpoofing /end COMPU_METHOD
/begin COMPU_METHOD DriverModelLaneChangeIntentionSide "enumeration table" TAB_VERB "%.0" "" COMPU_TAB_REF DriverModelLaneChangeIntentionSide /end COMPU_METHOD
/begin COMPU_METHOD DriverMonitoringSystemStatus "enumeration table" TAB_VERB "%.0" "" COMPU_TAB_REF DriverMonitoringSystemStatus /end COMPU_METHOD
/begin COMPU_METHOD DriverOvertakeIntentionState "enumeration table" TAB_VERB "%.0" "" COMPU_TAB_REF DriverOvertakeIntentionState /end COMPU_METHOD
/begin COMPU_METHOD DriverPresence "enumeration table" TAB_VERB "%.0" "" COMPU_TAB_REF DriverPresence /end COMPU_METHOD
/begin COMPU_METHOD DriverSpoofing "enumeration table" TAB_VERB "%.0" "" COMPU_TAB_REF DriverSpoofing /end COMPU_METHOD
/begin COMPU_METHOD DrivingDirection "enumeration table" TAB_VERB "%.0" "" COMPU_TAB_REF DrivingDirection /end COMPU_METHOD
/begin COMPU_METHOD DrivingDirection_Copy1 "enumeration table" TAB_VERB "%.0" "" COMPU_TAB_REF DrivingDirection_Copy1 /end COMPU_METHOD
/begin COMPU_METHOD DrivingDirection_Copy2 "enumeration table" TAB_VERB "%.0" "" COMPU_TAB_REF DrivingDirection_Copy2 /end COMPU_METHOD
/begin COMPU_METHOD DrivingSense "enumeration table" TAB_VERB "%.0" "" COMPU_TAB_REF DrivingSense /end COMPU_METHOD
/begin COMPU_METHOD DrivingSide "enumeration table" TAB_VERB "%.0" "" COMPU_TAB_REF DrivingSide /end COMPU_METHOD
/begin COMPU_METHOD DrivingSide_Copy1 "enumeration table" TAB_VERB "%.0" "" COMPU_TAB_REF DrivingSide_Copy1 /end COMPU_METHOD
/begin COMPU_METHOD DsmPhase "enumeration table" TAB_VERB "%.0" "" COMPU_TAB_REF DsmPhase /end COMPU_METHOD
/begin COMPU_METHOD Dynamic1DMotionGoal "enumeration table" TAB_VERB "%.0" "" COMPU_TAB_REF Dynamic1DMotionGoal /end COMPU_METHOD
/begin COMPU_METHOD Dynamic1DMotionGoal_v0 "enumeration table" TAB_VERB "%.0" "" COMPU_TAB_REF Dynamic1DMotionGoal_v0 /end COMPU_METHOD
/begin COMPU_METHOD Dynamic2DMotionGoal_v0 "enumeration table" TAB_VERB "%.0" "" COMPU_TAB_REF Dynamic2DMotionGoal_v0 /end COMPU_METHOD
/begin COMPU_METHOD EAccMode "" TAB_VERB "%6.3" "" COMPU_TAB_REF CT_EAccMode /end COMPU_METHOD
/begin COMPU_METHOD EAccStandStillActivationMode "" TAB_VERB "%6.3" "" COMPU_TAB_REF CT_EAccStandStillActivationMode /end COMPU_METHOD
/begin COMPU_METHOD EColor "enumeration table" TAB_VERB "%.0" "" COMPU_TAB_REF EColor /end COMPU_METHOD
/begin COMPU_METHOD ECsaMode "" TAB_VERB "%6.3" "" COMPU_TAB_REF CT_ECsaMode /end COMPU_METHOD
/begin COMPU_METHOD EDefaultState "enumeration table" TAB_VERB "%.0" "" COMPU_TAB_REF EDefaultState /end COMPU_METHOD
/begin COMPU_METHOD EDriveMode "" TAB_VERB "%6.3" "" COMPU_TAB_REF CT_EDriveMode /end COMPU_METHOD
/begin COMPU_METHOD EDriveTrainConfig "" TAB_VERB "%6.3" "" COMPU_TAB_REF CT_EDriveTrainConfig /end COMPU_METHOD
/begin COMPU_METHOD EFrictionProfileMode "" TAB_VERB "%6.3" "" COMPU_TAB_REF CT_EFrictionProfileMode /end COMPU_METHOD
/begin COMPU_METHOD EMainState "enumeration table" TAB_VERB "%.0" "" COMPU_TAB_REF EMainState /end COMPU_METHOD
/begin COMPU_METHOD EManagerDatasetStatus "enumeration table" TAB_VERB "%.0" "" COMPU_TAB_REF EManagerDatasetStatus /end COMPU_METHOD
/begin COMPU_METHOD EReferenceVelocityConfig "" TAB_VERB "%6.3" "" COMPU_TAB_REF CT_EReferenceVelocityConfig /end COMPU_METHOD
/begin COMPU_METHOD ESacEpsPfArchType "" TAB_VERB "%6.3" "" COMPU_TAB_REF CT_ESacEpsPfArchType /end COMPU_METHOD
/begin COMPU_METHOD ESetSpeedRoundingStrategy "" TAB_VERB "%6.3" "" COMPU_TAB_REF CT_ESetSpeedRoundingStrategy /end COMPU_METHOD
/begin COMPU_METHOD ESlaMode "" TAB_VERB "%6.3" "" COMPU_TAB_REF CT_ESlaMode /end COMPU_METHOD
/begin COMPU_METHOD ESpeedProfileMode "" TAB_VERB "%6.3" "" COMPU_TAB_REF CT_ESpeedProfileMode /end COMPU_METHOD
/begin COMPU_METHOD ESteeringAngleCalibrationType "" TAB_VERB "%6.3" "" COMPU_TAB_REF CT_ESteeringAngleCalibrationType /end COMPU_METHOD
/begin COMPU_METHOD ESteeringTorqueCalibrationType "" TAB_VERB "%6.3" "" COMPU_TAB_REF CT_ESteeringTorqueCalibrationType /end COMPU_METHOD
/begin COMPU_METHOD ETimeGapProcessesingStrategy "" TAB_VERB "%6.3" "" COMPU_TAB_REF CT_ETimeGapProcessesingStrategy /end COMPU_METHOD
/begin COMPU_METHOD ETrigger "enumeration table" TAB_VERB "%.0" "" COMPU_TAB_REF ETrigger /end COMPU_METHOD
/begin COMPU_METHOD EType "enumeration table" TAB_VERB "%.0" "" COMPU_TAB_REF EType /end COMPU_METHOD
/begin COMPU_METHOD EVariantIdx "enumeration table" TAB_VERB "%.0" "" COMPU_TAB_REF EVariantIdx /end COMPU_METHOD
/begin COMPU_METHOD EVariantIdx_Copy1 "enumeration table" TAB_VERB "%.0" "" COMPU_TAB_REF EVariantIdx_Copy1 /end COMPU_METHOD
/begin COMPU_METHOD EffectiveSpeedLimitTypeAndCondition "enumeration table" TAB_VERB "%.0" "" COMPU_TAB_REF EffectiveSpeedLimitTypeAndCondition /end COMPU_METHOD
/begin COMPU_METHOD EffectiveSpeedLimitTypeUsed "enumeration table" TAB_VERB "%.0" "" COMPU_TAB_REF EffectiveSpeedLimitTypeUsed /end COMPU_METHOD
/begin COMPU_METHOD EgoLaneChangeDirection "enumeration table" TAB_VERB "%.0" "" COMPU_TAB_REF EgoLaneChangeDirection /end COMPU_METHOD
/begin COMPU_METHOD EgoLaneChangePossibility "enumeration table" TAB_VERB "%.0" "" COMPU_TAB_REF EgoLaneChangePossibility /end COMPU_METHOD
/begin COMPU_METHOD EgoLaneChangeSituation "enumeration table" TAB_VERB "%.0" "" COMPU_TAB_REF EgoLaneChangeSituation /end COMPU_METHOD
/begin COMPU_METHOD EgoLaneChangeState "enumeration table" TAB_VERB "%.0" "" COMPU_TAB_REF EgoLaneChangeState /end COMPU_METHOD
/begin COMPU_METHOD EmbeddedStatus "enumeration table" TAB_VERB "%.0" "" COMPU_TAB_REF EmbeddedStatus /end COMPU_METHOD
/begin COMPU_METHOD EmsStandstillIndication "enumeration table" TAB_VERB "%.0" "" COMPU_TAB_REF EmsStandstillIndication /end COMPU_METHOD
/begin COMPU_METHOD EmsWheelMovingDirection "enumeration table" TAB_VERB "%.0" "" COMPU_TAB_REF EmsWheelMovingDirection /end COMPU_METHOD
/begin COMPU_METHOD EntryState "enumeration table" TAB_VERB "%.0" "" COMPU_TAB_REF EntryState /end COMPU_METHOD
/begin COMPU_METHOD EraseAllState_ten "enumeration table" TAB_VERB "%.0" "" COMPU_TAB_REF EraseAllState_ten /end COMPU_METHOD
/begin COMPU_METHOD EstConstraintMode "enumeration table" TAB_VERB "%.0" "" COMPU_TAB_REF EstConstraintMode /end COMPU_METHOD
/begin COMPU_METHOD EstStates "enumeration table" TAB_VERB "%.0" "" COMPU_TAB_REF EstStates /end COMPU_METHOD
/begin COMPU_METHOD Etype_Postprocessing_SteeringInterfaceType "" TAB_VERB "%6.3" "" COMPU_TAB_REF CT_Etype_Postprocessing_SteeringInterfaceType /end COMPU_METHOD
/begin COMPU_METHOD EventStatus "enumeration table" TAB_VERB "%.0" "" COMPU_TAB_REF EventStatus /end COMPU_METHOD
/begin COMPU_METHOD EyesOnRoad "enumeration table" TAB_VERB "%.0" "" COMPU_TAB_REF EyesOnRoad /end COMPU_METHOD
/begin COMPU_METHOD FCTRequest "enumeration table" TAB_VERB "%.0" "" COMPU_TAB_REF FCTRequest /end COMPU_METHOD
/begin COMPU_METHOD FadeStrategy "enumeration table" TAB_VERB "%.0" "" COMPU_TAB_REF FadeStrategy /end COMPU_METHOD
/begin COMPU_METHOD FailureClusterStatus "enumeration table" TAB_VERB "%.0" "" COMPU_TAB_REF FailureClusterStatus /end COMPU_METHOD
/begin COMPU_METHOD FctFunctionId "enumeration table" TAB_VERB "%.0" "" COMPU_TAB_REF FctFunctionId /end COMPU_METHOD
/begin COMPU_METHOD FcwSetting "enumeration table" TAB_VERB "%.0" "" COMPU_TAB_REF FcwSetting /end COMPU_METHOD
/begin COMPU_METHOD FilterMode "enumeration table" TAB_VERB "%.0" "" COMPU_TAB_REF FilterMode /end COMPU_METHOD
/begin COMPU_METHOD FocAccSoStates "enumeration table" TAB_VERB "%.0" "" COMPU_TAB_REF FocAccSoStates /end COMPU_METHOD
/begin COMPU_METHOD FocMainStates "enumeration table" TAB_VERB "%.0" "" COMPU_TAB_REF FocMainStates /end COMPU_METHOD
/begin COMPU_METHOD FormOfWay "enumeration table" TAB_VERB "%.0" "" COMPU_TAB_REF FormOfWay /end COMPU_METHOD
/begin COMPU_METHOD FourTruthValue "enumeration table" TAB_VERB "%.0" "" COMPU_TAB_REF FourTruthValue /end COMPU_METHOD
/begin COMPU_METHOD FreespaceClassType "enumeration table" TAB_VERB "%.0" "" COMPU_TAB_REF FreespaceClassType /end COMPU_METHOD
/begin COMPU_METHOD FrictionAccuracy "enumeration table" TAB_VERB "%.0" "" COMPU_TAB_REF FrictionAccuracy /end COMPU_METHOD
/begin COMPU_METHOD FusionUpdateType "enumeration table" TAB_VERB "%.0" "" COMPU_TAB_REF FusionUpdateType /end COMPU_METHOD
/begin COMPU_METHOD GapSearchDirection "enumeration table" TAB_VERB "%.0" "" COMPU_TAB_REF GapSearchDirection /end COMPU_METHOD
/begin COMPU_METHOD GateType "enumeration table" TAB_VERB "%.0" "" COMPU_TAB_REF GateType /end COMPU_METHOD
/begin COMPU_METHOD GeofencingBoundaryType "enumeration table" TAB_VERB "%.0" "" COMPU_TAB_REF GeofencingBoundaryType /end COMPU_METHOD
/begin COMPU_METHOD HSM_FunctionTag "enumeration table" TAB_VERB "%.0" "" COMPU_TAB_REF HSM_FunctionTag /end COMPU_METHOD
/begin COMPU_METHOD HSM_ModeTag "enumeration table" TAB_VERB "%.0" "" COMPU_TAB_REF HSM_ModeTag /end COMPU_METHOD
/begin COMPU_METHOD HSM_PortStatusTag "enumeration table" TAB_VERB "%.0" "" COMPU_TAB_REF HSM_PortStatusTag /end COMPU_METHOD
/begin COMPU_METHOD HV_SERVICE_AVAILABILITY_STATES "enumeration table" TAB_VERB "%.0" "" COMPU_TAB_REF HV_SERVICE_AVAILABILITY_STATES /end COMPU_METHOD
/begin COMPU_METHOD HandsOffDetectionStage "enumeration table" TAB_VERB "%.0" "" COMPU_TAB_REF HandsOffDetectionStage /end COMPU_METHOD
/begin COMPU_METHOD HandsOnDetectionInputData "enumeration table" TAB_VERB "%.0" "" COMPU_TAB_REF HandsOnDetectionInputData /end COMPU_METHOD
/begin COMPU_METHOD HandsOnDetectionSensorType "enumeration table" TAB_VERB "%.0" "" COMPU_TAB_REF HandsOnDetectionSensorType /end COMPU_METHOD
/begin COMPU_METHOD HandsOnDetectionState "enumeration table" TAB_VERB "%.0" "" COMPU_TAB_REF HandsOnDetectionState /end COMPU_METHOD
/begin COMPU_METHOD HapticOnlyStates "enumeration table" TAB_VERB "%.0" "" COMPU_TAB_REF HapticOnlyStates /end COMPU_METHOD
/begin COMPU_METHOD HazardousGoods "enumeration table" TAB_VERB "%.0" "" COMPU_TAB_REF HazardousGoods /end COMPU_METHOD
/begin COMPU_METHOD HfStates "enumeration table" TAB_VERB "%.0" "" COMPU_TAB_REF HfStates /end COMPU_METHOD
/begin COMPU_METHOD HmiAudioNotificationIdEnum "enumeration table" TAB_VERB "%.0" "" COMPU_TAB_REF HmiAudioNotificationIdEnum /end COMPU_METHOD
/begin COMPU_METHOD HmiAuxiliarySymbolEnum "enumeration table" TAB_VERB "%.0" "" COMPU_TAB_REF HmiAuxiliarySymbolEnum /end COMPU_METHOD
/begin COMPU_METHOD HmiDisplayedTextMessageIdEnum "enumeration table" TAB_VERB "%.0" "" COMPU_TAB_REF HmiDisplayedTextMessageIdEnum /end COMPU_METHOD
/begin COMPU_METHOD HmiHandOfTraffic "enumeration table" TAB_VERB "%.0" "" COMPU_TAB_REF HmiHandOfTraffic /end COMPU_METHOD
/begin COMPU_METHOD HmiHwaStatusEnum "enumeration table" TAB_VERB "%.0" "" COMPU_TAB_REF HmiHwaStatusEnum /end COMPU_METHOD
/begin COMPU_METHOD HmiIndicatorLampRequestSide "enumeration table" TAB_VERB "%.0" "" COMPU_TAB_REF HmiIndicatorLampRequestSide /end COMPU_METHOD
/begin COMPU_METHOD HmiLedStateEnum "enumeration table" TAB_VERB "%.0" "" COMPU_TAB_REF HmiLedStateEnum /end COMPU_METHOD
/begin COMPU_METHOD HmiPopupTextMessageEnum "enumeration table" TAB_VERB "%.0" "" COMPU_TAB_REF HmiPopupTextMessageEnum /end COMPU_METHOD
/begin COMPU_METHOD HmiStateMachineError "enumeration table" TAB_VERB "%.0" "" COMPU_TAB_REF HmiStateMachineError /end COMPU_METHOD
/begin COMPU_METHOD HmiSymbolColorLeftEnum "enumeration table" TAB_VERB "%.0" "" COMPU_TAB_REF HmiSymbolColorLeftEnum /end COMPU_METHOD
/begin COMPU_METHOD HmiTurnIndicatorStatusEnum "enumeration table" TAB_VERB "%.0" "" COMPU_TAB_REF HmiTurnIndicatorStatusEnum /end COMPU_METHOD
/begin COMPU_METHOD ImageRelationProvider "enumeration table" TAB_VERB "%.0" "" COMPU_TAB_REF ImageRelationProvider /end COMPU_METHOD
/begin COMPU_METHOD InputDataCheckResult "enumeration table" TAB_VERB "%.0" "" COMPU_TAB_REF InputDataCheckResult /end COMPU_METHOD
/begin COMPU_METHOD InterpolationType "enumeration table" TAB_VERB "%.0" "" COMPU_TAB_REF InterpolationType /end COMPU_METHOD
/begin COMPU_METHOD IntersectionType "enumeration table" TAB_VERB "%.0" "" COMPU_TAB_REF IntersectionType /end COMPU_METHOD
/begin COMPU_METHOD LSACombiSwitchFunctionSel "enumeration table" TAB_VERB "%.0" "" COMPU_TAB_REF LSACombiSwitchFunctionSel /end COMPU_METHOD
/begin COMPU_METHOD LSAManualBeamSel "enumeration table" TAB_VERB "%.0" "" COMPU_TAB_REF LSAManualBeamSel /end COMPU_METHOD
/begin COMPU_METHOD LaneAssociation "enumeration table" TAB_VERB "%.0" "" COMPU_TAB_REF LaneAssociation /end COMPU_METHOD
/begin COMPU_METHOD LaneAssociationReason "enumeration table" TAB_VERB "%.0" "" COMPU_TAB_REF LaneAssociationReason /end COMPU_METHOD
/begin COMPU_METHOD LaneBorderColor "enumeration table" TAB_VERB "%.0" "" COMPU_TAB_REF LaneBorderColor /end COMPU_METHOD
/begin COMPU_METHOD LaneBorderType "enumeration table" TAB_VERB "%.0" "" COMPU_TAB_REF LaneBorderType /end COMPU_METHOD
/begin COMPU_METHOD LaneChangeObjectRelevance "enumeration table" TAB_VERB "%.0" "" COMPU_TAB_REF LaneChangeObjectRelevance /end COMPU_METHOD
/begin COMPU_METHOD LaneConnectionType "enumeration table" TAB_VERB "%.0" "" COMPU_TAB_REF LaneConnectionType /end COMPU_METHOD
/begin COMPU_METHOD LaneDirectionType "enumeration table" TAB_VERB "%.0" "" COMPU_TAB_REF LaneDirectionType /end COMPU_METHOD
/begin COMPU_METHOD LaneId "enumeration table" TAB_VERB "%.0" "" COMPU_TAB_REF LaneId /end COMPU_METHOD
/begin COMPU_METHOD LaneSensitivityButton "enumeration table" TAB_VERB "%.0" "" COMPU_TAB_REF LaneSensitivityButton /end COMPU_METHOD
/begin COMPU_METHOD LaneSensitivityMode "enumeration table" TAB_VERB "%.0" "" COMPU_TAB_REF LaneSensitivityMode /end COMPU_METHOD
/begin COMPU_METHOD LaneSide "enumeration table" TAB_VERB "%.0" "" COMPU_TAB_REF LaneSide /end COMPU_METHOD
/begin COMPU_METHOD LaneType "enumeration table" TAB_VERB "%.0" "" COMPU_TAB_REF LaneType /end COMPU_METHOD
/begin COMPU_METHOD LaneType_Copy1 "enumeration table" TAB_VERB "%.0" "" COMPU_TAB_REF LaneType_Copy1 /end COMPU_METHOD
/begin COMPU_METHOD LaneType_Copy2 "enumeration table" TAB_VERB "%.0" "" COMPU_TAB_REF LaneType_Copy2 /end COMPU_METHOD
/begin COMPU_METHOD LateralDrivingState "enumeration table" TAB_VERB "%.0" "" COMPU_TAB_REF LateralDrivingState /end COMPU_METHOD
/begin COMPU_METHOD LateralIntention "enumeration table" TAB_VERB "%.0" "" COMPU_TAB_REF LateralIntention /end COMPU_METHOD
/begin COMPU_METHOD LcmStateId "enumeration table" TAB_VERB "%.0" "" COMPU_TAB_REF LcmStateId /end COMPU_METHOD
/begin COMPU_METHOD LcrLane "enumeration table" TAB_VERB "%.0" "" COMPU_TAB_REF LcrLane /end COMPU_METHOD
/begin COMPU_METHOD LcrLockoutReason "enumeration table" TAB_VERB "%.0" "" COMPU_TAB_REF LcrLockoutReason /end COMPU_METHOD
/begin COMPU_METHOD LcrState "enumeration table" TAB_VERB "%.0" "" COMPU_TAB_REF LcrState /end COMPU_METHOD
/begin COMPU_METHOD LcrSuppressionReason "enumeration table" TAB_VERB "%.0" "" COMPU_TAB_REF LcrSuppressionReason /end COMPU_METHOD
/begin COMPU_METHOD LcrType "enumeration table" TAB_VERB "%.0" "" COMPU_TAB_REF LcrType /end COMPU_METHOD
/begin COMPU_METHOD LedState "enumeration table" TAB_VERB "%.0" "" COMPU_TAB_REF LedState /end COMPU_METHOD
/begin COMPU_METHOD LightFunctionSelHMI "enumeration table" TAB_VERB "%.0" "" COMPU_TAB_REF LightFunctionSelHMI /end COMPU_METHOD
/begin COMPU_METHOD LightMode "enumeration table" TAB_VERB "%.0" "" COMPU_TAB_REF LightMode /end COMPU_METHOD
/begin COMPU_METHOD LineColor "enumeration table" TAB_VERB "%.0" "" COMPU_TAB_REF LineColor /end COMPU_METHOD
/begin COMPU_METHOD LineMarking "enumeration table" TAB_VERB "%.0" "" COMPU_TAB_REF LineMarking /end COMPU_METHOD
/begin COMPU_METHOD LinePosition "enumeration table" TAB_VERB "%.0" "" COMPU_TAB_REF LinePosition /end COMPU_METHOD
/begin COMPU_METHOD LineSource_v0 "enumeration table" TAB_VERB "%.0" "" COMPU_TAB_REF LineSource_v0 /end COMPU_METHOD
/begin COMPU_METHOD LineType "enumeration table" TAB_VERB "%.0" "" COMPU_TAB_REF LineType /end COMPU_METHOD
/begin COMPU_METHOD LocationRadarSensorState "enumeration table" TAB_VERB "%.0" "" COMPU_TAB_REF LocationRadarSensorState /end COMPU_METHOD
/begin COMPU_METHOD LongitudinalControlSettingState "enumeration table" TAB_VERB "%.0" "" COMPU_TAB_REF LongitudinalControlSettingState /end COMPU_METHOD
/begin COMPU_METHOD LongitudinalPosition "enumeration table" TAB_VERB "%.0" "" COMPU_TAB_REF LongitudinalPosition /end COMPU_METHOD
/begin COMPU_METHOD LssStates "enumeration table" TAB_VERB "%.0" "" COMPU_TAB_REF LssStates /end COMPU_METHOD
/begin COMPU_METHOD MainSign "enumeration table" TAB_VERB "%.0" "" COMPU_TAB_REF MainSign /end COMPU_METHOD
/begin COMPU_METHOD ManualLaneChangeSupportState "enumeration table" TAB_VERB "%.0" "" COMPU_TAB_REF ManualLaneChangeSupportState /end COMPU_METHOD
/begin COMPU_METHOD MapLevel "enumeration table" TAB_VERB "%.0" "" COMPU_TAB_REF MapLevel /end COMPU_METHOD
/begin COMPU_METHOD MapMatchingStatus "enumeration table" TAB_VERB "%.0" "" COMPU_TAB_REF MapMatchingStatus /end COMPU_METHOD
/begin COMPU_METHOD MapStatus "enumeration table" TAB_VERB "%.0" "" COMPU_TAB_REF MapStatus /end COMPU_METHOD
/begin COMPU_METHOD MeasurementStatus "enumeration table" TAB_VERB "%.0" "" COMPU_TAB_REF MeasurementStatus /end COMPU_METHOD
/begin COMPU_METHOD MessageText "enumeration table" TAB_VERB "%.0" "" COMPU_TAB_REF MessageText /end COMPU_METHOD
/begin COMPU_METHOD MessageType "enumeration table" TAB_VERB "%.0" "" COMPU_TAB_REF MessageType /end COMPU_METHOD
/begin COMPU_METHOD MetaState "enumeration table" TAB_VERB "%.0" "" COMPU_TAB_REF MetaState /end COMPU_METHOD
/begin COMPU_METHOD MissingLaneMarkingOnMiddleLaneScenario "enumeration table" TAB_VERB "%.0" "" COMPU_TAB_REF MissingLaneMarkingOnMiddleLaneScenario /end COMPU_METHOD
/begin COMPU_METHOD MixStates "enumeration table" TAB_VERB "%.0" "" COMPU_TAB_REF MixStates /end COMPU_METHOD
/begin COMPU_METHOD MonitoringType "enumeration table" TAB_VERB "%.0" "" COMPU_TAB_REF MonitoringType /end COMPU_METHOD
/begin COMPU_METHOD MotionGoal "enumeration table" TAB_VERB "%.0" "" COMPU_TAB_REF MotionGoal /end COMPU_METHOD
/begin COMPU_METHOD MotionType "enumeration table" TAB_VERB "%.0" "" COMPU_TAB_REF MotionType /end COMPU_METHOD
/begin COMPU_METHOD MutableWarningStates "enumeration table" TAB_VERB "%.0" "" COMPU_TAB_REF MutableWarningStates /end COMPU_METHOD
/begin COMPU_METHOD NeighboringVehicleAugmentedData "enumeration table" TAB_VERB "%.0" "" COMPU_TAB_REF NeighboringVehicleAugmentedData /end COMPU_METHOD
/begin COMPU_METHOD NeighboringVehicleType "enumeration table" TAB_VERB "%.0" "" COMPU_TAB_REF NeighboringVehicleType /end COMPU_METHOD
/begin COMPU_METHOD NonInterpretedAdditionalInfo "enumeration table" TAB_VERB "%.0" "" COMPU_TAB_REF NonInterpretedAdditionalInfo /end COMPU_METHOD
/begin COMPU_METHOD ObjectClassificationType "enumeration table" TAB_VERB "%.0" "" COMPU_TAB_REF ObjectClassificationType /end COMPU_METHOD
/begin COMPU_METHOD ObjectCorridorPosition "enumeration table" TAB_VERB "%.0" "" COMPU_TAB_REF ObjectCorridorPosition /end COMPU_METHOD
/begin COMPU_METHOD ObjectDrivingDirection "enumeration table" TAB_VERB "%.0" "" COMPU_TAB_REF ObjectDrivingDirection /end COMPU_METHOD
/begin COMPU_METHOD ObjectMotionDirection "enumeration table" TAB_VERB "%.0" "" COMPU_TAB_REF ObjectMotionDirection /end COMPU_METHOD
/begin COMPU_METHOD ObjectMovingState "enumeration table" TAB_VERB "%.0" "" COMPU_TAB_REF ObjectMovingState /end COMPU_METHOD
/begin COMPU_METHOD ObjectMovingState_Copy1 "enumeration table" TAB_VERB "%.0" "" COMPU_TAB_REF ObjectMovingState_Copy1 /end COMPU_METHOD
/begin COMPU_METHOD ObjectRadarSensorState "enumeration table" TAB_VERB "%.0" "" COMPU_TAB_REF ObjectRadarSensorState /end COMPU_METHOD
/begin COMPU_METHOD ObjectTrackingState "enumeration table" TAB_VERB "%.0" "" COMPU_TAB_REF ObjectTrackingState /end COMPU_METHOD
/begin COMPU_METHOD ObjectType "enumeration table" TAB_VERB "%.0" "" COMPU_TAB_REF ObjectType /end COMPU_METHOD
/begin COMPU_METHOD Obligation "enumeration table" TAB_VERB "%.0" "" COMPU_TAB_REF Obligation /end COMPU_METHOD
/begin COMPU_METHOD ObstacleBlockingSide "enumeration table" TAB_VERB "%.0" "" COMPU_TAB_REF ObstacleBlockingSide /end COMPU_METHOD
/begin COMPU_METHOD ObstacleSensorIndex "enumeration table" TAB_VERB "%.0" "" COMPU_TAB_REF ObstacleSensorIndex /end COMPU_METHOD
/begin COMPU_METHOD OcclusionState "enumeration table" TAB_VERB "%.0" "" COMPU_TAB_REF OcclusionState /end COMPU_METHOD
/begin COMPU_METHOD OffsetDirection "enumeration table" TAB_VERB "%.0" "" COMPU_TAB_REF OffsetDirection /end COMPU_METHOD
/begin COMPU_METHOD OoseqStrategy "enumeration table" TAB_VERB "%.0" "" COMPU_TAB_REF OoseqStrategy /end COMPU_METHOD
/begin COMPU_METHOD OperatingState "enumeration table" TAB_VERB "%.0" "" COMPU_TAB_REF OperatingState /end COMPU_METHOD
/begin COMPU_METHOD OperatingStateDetailed "enumeration table" TAB_VERB "%.0" "" COMPU_TAB_REF OperatingStateDetailed /end COMPU_METHOD
/begin COMPU_METHOD Os_ScheduleTableStatusType "enumeration table" TAB_VERB "%.0" "" COMPU_TAB_REF Os_ScheduleTableStatusType /end COMPU_METHOD
/begin COMPU_METHOD OtherNonInterpretedInfo "enumeration table" TAB_VERB "%.0" "" COMPU_TAB_REF OtherNonInterpretedInfo /end COMPU_METHOD
/begin COMPU_METHOD OverspeedOffsetUnit "enumeration table" TAB_VERB "%.0" "" COMPU_TAB_REF OverspeedOffsetUnit /end COMPU_METHOD
/begin COMPU_METHOD OverspeedType "enumeration table" TAB_VERB "%.0" "" COMPU_TAB_REF OverspeedType /end COMPU_METHOD
/begin COMPU_METHOD PER_ALGOS_MBF_TYPES "enumeration table" TAB_VERB "%.0" "" COMPU_TAB_REF PER_ALGOS_MBF_TYPES /end COMPU_METHOD
/begin COMPU_METHOD PER_PER_TYPES "enumeration table" TAB_VERB "%.0" "" COMPU_TAB_REF PER_PER_TYPES /end COMPU_METHOD
/begin COMPU_METHOD PER_REFERENCE_POINTS "enumeration table" TAB_VERB "%.0" "" COMPU_TAB_REF PER_REFERENCE_POINTS /end COMPU_METHOD
/begin COMPU_METHOD PathIdClassification "enumeration table" TAB_VERB "%.0" "" COMPU_TAB_REF PathIdClassification /end COMPU_METHOD
/begin COMPU_METHOD PathStartStrategy "enumeration table" TAB_VERB "%.0" "" COMPU_TAB_REF PathStartStrategy /end COMPU_METHOD
/begin COMPU_METHOD PerVideoObjectTypes "enumeration table" TAB_VERB "%.0" "" COMPU_TAB_REF PerVideoObjectTypes /end COMPU_METHOD
/begin COMPU_METHOD Phase "enumeration table" TAB_VERB "%.0" "" COMPU_TAB_REF Phase /end COMPU_METHOD
/begin COMPU_METHOD PlausibilizationResult "enumeration table" TAB_VERB "%.0" "" COMPU_TAB_REF PlausibilizationResult /end COMPU_METHOD
/begin COMPU_METHOD PredictableObjectType "enumeration table" TAB_VERB "%.0" "" COMPU_TAB_REF PredictableObjectType /end COMPU_METHOD
/begin COMPU_METHOD PredictedStateOfMotion "enumeration table" TAB_VERB "%.0" "" COMPU_TAB_REF PredictedStateOfMotion /end COMPU_METHOD
/begin COMPU_METHOD Priority "enumeration table" TAB_VERB "%.0" "" COMPU_TAB_REF Priority /end COMPU_METHOD
/begin COMPU_METHOD PscControlStrategy "enumeration table" TAB_VERB "%.0" "" COMPU_TAB_REF PscControlStrategy /end COMPU_METHOD
/begin COMPU_METHOD RSB_Types "enumeration table" TAB_VERB "%.0" "" COMPU_TAB_REF RSB_Types /end COMPU_METHOD
/begin COMPU_METHOD RbvmiBrakeDiscTemperatureStatus "enumeration table" TAB_VERB "%.0" "" COMPU_TAB_REF RbvmiBrakeDiscTemperatureStatus /end COMPU_METHOD
/begin COMPU_METHOD RbvmiBrakeDiscTemperatureStatusAvailability "enumeration table" TAB_VERB "%.0" "" COMPU_TAB_REF RbvmiBrakeDiscTemperatureStatusAvailability /end COMPU_METHOD
/begin COMPU_METHOD ReactionPatternType "enumeration table" TAB_VERB "%.0" "" COMPU_TAB_REF ReactionPatternType /end COMPU_METHOD
/begin COMPU_METHOD Reason "enumeration table" TAB_VERB "%.0" "" COMPU_TAB_REF Reason /end COMPU_METHOD
/begin COMPU_METHOD ReasonType "enumeration table" TAB_VERB "%.0" "" COMPU_TAB_REF ReasonType /end COMPU_METHOD
/begin COMPU_METHOD ReferenceCorridor "enumeration table" TAB_VERB "%.0" "" COMPU_TAB_REF ReferenceCorridor /end COMPU_METHOD
/begin COMPU_METHOD ReferenceLineMotionGoal_v0 "enumeration table" TAB_VERB "%.0" "" COMPU_TAB_REF ReferenceLineMotionGoal_v0 /end COMPU_METHOD
/begin COMPU_METHOD ReferenceLineState "enumeration table" TAB_VERB "%.0" "" COMPU_TAB_REF ReferenceLineState /end COMPU_METHOD
/begin COMPU_METHOD RegulatingLane "enumeration table" TAB_VERB "%.0" "" COMPU_TAB_REF RegulatingLane /end COMPU_METHOD
/begin COMPU_METHOD RegulatoryElementRelationType "enumeration table" TAB_VERB "%.0" "" COMPU_TAB_REF RegulatoryElementRelationType /end COMPU_METHOD
/begin COMPU_METHOD RelationCalculationStrategy "enumeration table" TAB_VERB "%.0" "" COMPU_TAB_REF RelationCalculationStrategy /end COMPU_METHOD
/begin COMPU_METHOD RelativeLaneRelation "enumeration table" TAB_VERB "%.0" "" COMPU_TAB_REF RelativeLaneRelation /end COMPU_METHOD
/begin COMPU_METHOD Reliability "enumeration table" TAB_VERB "%.0" "" COMPU_TAB_REF Reliability /end COMPU_METHOD
/begin COMPU_METHOD RestrictionType "enumeration table" TAB_VERB "%.0" "" COMPU_TAB_REF RestrictionType /end COMPU_METHOD
/begin COMPU_METHOD RightOfWay "enumeration table" TAB_VERB "%.0" "" COMPU_TAB_REF RightOfWay /end COMPU_METHOD
/begin COMPU_METHOD RightOfWayElementType "enumeration table" TAB_VERB "%.0" "" COMPU_TAB_REF RightOfWayElementType /end COMPU_METHOD
/begin COMPU_METHOD RoadClass "enumeration table" TAB_VERB "%.0" "" COMPU_TAB_REF RoadClass /end COMPU_METHOD
/begin COMPU_METHOD RoadConditionStates "enumeration table" TAB_VERB "%.0" "" COMPU_TAB_REF RoadConditionStates /end COMPU_METHOD
/begin COMPU_METHOD RoadIlluminationReason "enumeration table" TAB_VERB "%.0" "" COMPU_TAB_REF RoadIlluminationReason /end COMPU_METHOD
/begin COMPU_METHOD RoadIlluminationStatus "enumeration table" TAB_VERB "%.0" "" COMPU_TAB_REF RoadIlluminationStatus /end COMPU_METHOD
/begin COMPU_METHOD RoadLineColor "enumeration table" TAB_VERB "%.0" "" COMPU_TAB_REF RoadLineColor /end COMPU_METHOD
/begin COMPU_METHOD RoadLineType "enumeration table" TAB_VERB "%.0" "" COMPU_TAB_REF RoadLineType /end COMPU_METHOD
/begin COMPU_METHOD RoadSignType "enumeration table" TAB_VERB "%.0" "" COMPU_TAB_REF RoadSignType /end COMPU_METHOD
/begin COMPU_METHOD RoadSituationType "enumeration table" TAB_VERB "%.0" "" COMPU_TAB_REF RoadSituationType /end COMPU_METHOD
/begin COMPU_METHOD RoadTopologySituationType "enumeration table" TAB_VERB "%.0" "" COMPU_TAB_REF RoadTopologySituationType /end COMPU_METHOD
/begin COMPU_VTAB ASILRating "enumeration table" TAB_VERB 6 0 "QM" 1 "ASIL_A" 2 "ASIL_B" 3 "ASIL_C" 4 "ASIL_D" 5 "notAvailable" /end COMPU_VTAB
/begin COMPU_VTAB AbdMainStates "enumeration table" TAB_VERB 5 0 "passive_state" 1 "active_state" 2 "brakeonly_state" 3 "standstill_state" 4 "suspend_state" /end COMPU_VTAB
/begin COMPU_VTAB AbsStatus "enumeration table" TAB_VERB 3 0 "available" 1 "active" 2 "not_available" /end COMPU_VTAB
/begin COMPU_VTAB AccPlusBehavior "enumeration table" TAB_VERB 4 0 "NONE" 1 "SLA_REACTION" 2 "CSA_REACTION" 3 "SP_REACTION" /end COMPU_VTAB
/begin COMPU_VTAB AccStateMachineInteractionType "enumeration table" TAB_VERB 4 0 "NoEvent" 1 "ActivationRequest" 2 "DriveOffRequest" 3 "DeactivationRequest" /end COMPU_VTAB
/begin COMPU_VTAB AccStates "enumeration table" TAB_VERB 14 0 "disabledInit" 1 "disabledOff" 2 "failure" 4 "passiveNotAvailable" 5 "passiveAvailable" 6 "activeStandWait" 7 "activeStandActive" 8 "activeDriveOff" 9 "activeActiveControl" 10 "activeSuspend" 11 "fadeout" 12 "fadeoutStandSecure" 13 "fadeoutBom" 14 "numStates" /end COMPU_VTAB
/begin COMPU_VTAB AcceleratorOverrideStrategy "enumeration table" TAB_VERB 2 0 "cooperation" 1 "limitation" /end COMPU_VTAB
/begin COMPU_VTAB Accuracy "enumeration table" TAB_VERB 4 0 "highestAccuracy" 1 "mediumAccuracy" 2 "lowestAccuracy" 3 "unknownAccuracy" /end COMPU_VTAB
/begin COMPU_VTAB Action "enumeration table" TAB_VERB 4 0 "none" 1 "risingEdge" 2 "fallingEdge" 3 "longPress" /end COMPU_VTAB
/begin COMPU_VTAB ActivationRequest "enumeration table" TAB_VERB 4 0 "off" 1 "comfort" 2 "dynamic" 3 "emergency" /end COMPU_VTAB
/begin COMPU_VTAB ActiveGapSearchVersion "enumeration table" TAB_VERB 4 0 "invalid" 1 "absoluteVelocity" 2 "predictionOneTarget" 3 "predictionTwoTargets" /end COMPU_VTAB
/begin COMPU_VTAB ActuationConstraint "enumeration table" TAB_VERB 2 0 "none" 1 "no_propulsion" /end COMPU_VTAB
/begin COMPU_VTAB AdasisMapProvider "enumeration table" TAB_VERB 8 0 "unknown" 1 "NokiaHere_Navteq" 2 "TomTom_TeleAtlas" 3 "Zenrin" 4 "IPC" 5 "NavInfo" 6 "other" 7 "notAvailable" /end COMPU_VTAB
/begin COMPU_VTAB AdditionalDistanceInfo "enumeration table" TAB_VERB 23 0 "addDistance0" 1 "addDistance50" 2 "addDistance100" 3 "addDistance200" 4 "addDistance300" 5 "addDistance400" 6 "addDistance500" 7 "addDistance600" 8 "addDistance700" 9 "addDistance800" 10 "addDistance900" 11 "addDistance1000" 12 "addDistance1100" 13 "addDistance1200" 14 "addDistance1300" 15 "addDistance1400" 16 "addDistance1500" 17 "addDistance1600" 18 "addDistance1700" 19 "addDistance1800" 20 "addDistance1900" 21 "addDistance2000" 22 "addDistanceAbove2000" /end COMPU_VTAB
/begin COMPU_VTAB AlcAbortReason "enumeration table" TAB_VERB 17 0 "none" 1 "alcNotArbitrated" 2 "behaviorSolutionInvalid" 3 "driverOverrideSteeringOppositeDirection" 4 "executionRecommendationInvalid" 5 "indicatorCancelsLaneChange" 6 "laneChangeManoeuvreDurationExceeded" 7 "laneChangeManoeuvreNotStartInDefinedTime" 8 "laneKeepMaxTimerElapsed" 9 "trafficRuleConformityInvalid" 10 "originLaneInvalid" 11 "laneChangeNotFeasible" 12 "laneChangeIndicatorTerminated" 13 "targetLaneInvalid" 14 "timbaSelectionStrategyInvalid" 15 "lksNotActive" 16 "vsminPreventsLaneChange" /end COMPU_VTAB
/begin COMPU_VTAB AlcHmiState "enumeration table" TAB_VERB 12 0 "Off" 1 "Passive" 2 "LaneKeep" 3 "LaneChange" 4 "Abort" 5 "AbortApc" 6 "AbortApcFeasibility" 7 "AbortFailure" 8 "TOR" 9 "Override" 10 "StandbyFailure" 11 "MAX" /end COMPU_VTAB
/begin COMPU_VTAB AlcStates "enumeration table" TAB_VERB 8 0 "off" 1 "passive" 2 "activeOriginLaneKeeping" 3 "activeLaneChangeToLeft" 4 "activeLaneChangeToRight" 5 "fadeout" 6 "failure" 7 "activeTargetLaneKeeping" /end COMPU_VTAB
/begin COMPU_VTAB AlcSubStateDriverCancellation "enumeration table" TAB_VERB 2 0 "normalOperation" 1 "driverCancellation" /end COMPU_VTAB
/begin COMPU_VTAB ArbitrationStates "enumeration table" TAB_VERB 4 0 "off" 1 "noArbitration" 2 "activeControl" 3 "activeSuspend" /end COMPU_VTAB
/begin COMPU_VTAB AudioType "enumeration table" TAB_VERB 4 0 "none" 1 "notification" 2 "warning" 3 "emergencySafeStop" /end COMPU_VTAB
/begin COMPU_VTAB AvailableConfigurations "enumeration table" TAB_VERB 4 0 "PL_1R1V" 1 "PL_5R1V" 2 "PL_1V" 3 "PL_1RC" /end COMPU_VTAB
/begin COMPU_VTAB AveragingWeightType "enumeration table" TAB_VERB 2 0 "ErrorMeasure" 1 "Sigmoid" /end COMPU_VTAB
/begin COMPU_VTAB BdaMode "enumeration table" TAB_VERB 3 0 "lks" 1 "tjaIca" 2 "cruise" /end COMPU_VTAB
/begin COMPU_VTAB BdcMainStates "enumeration table" TAB_VERB 4 0 "passive" 1 "active" 2 "standstill" 3 "suspend" /end COMPU_VTAB
/begin COMPU_VTAB BdcStateConstants "enumeration table" TAB_VERB 4 0 "passive" 1 "calcprofile" 2 "active_Prof" 3 "active_Max" /end COMPU_VTAB
/begin COMPU_VTAB BdcStateOfdStandstillCv "enumeration table" TAB_VERB 4 0 "novalue" 1 "optvalue" 2 "maxvalue" 3 "tolvalue" /end COMPU_VTAB
/begin COMPU_VTAB BdcTargets "enumeration table" TAB_VERB 5 0 "notarget" 1 "lotarget" 2 "potarget" 3 "sotarget" 4 "imtarget" /end COMPU_VTAB
/begin COMPU_VTAB BehaviorExecutionRecommendation "enumeration table" TAB_VERB 4 0 "invalidAndNotRecommended" 1 "validButNotRecommended" 2 "validAndRecommended" 3 "validWithTimestamp" /end COMPU_VTAB
/begin COMPU_VTAB BehaviorIdsAlc "enumeration table" TAB_VERB 2 60 "alcLongLatLeftTipl" 61 "alcLongLatRightTipl" /end COMPU_VTAB
/begin COMPU_VTAB BehaviorRelatedBorderStatus "enumeration table" TAB_VERB 4 0 "invalid" 1 "available" 2 "critical" 3 "regulatedUpon" /end COMPU_VTAB
/begin COMPU_VTAB BehaviorRelatedObjectStatus "enumeration table" TAB_VERB 3 0 "invalid" 1 "available" 2 "regulatedUpon" /end COMPU_VTAB
/begin COMPU_VTAB BehaviorStrategy "enumeration table" TAB_VERB 6 0 "bsUndefined" 1 "bsTipl" 2 "bsImba" 3 "bsCfm" 4 "bsTixl" 10 "bsSit2d" /end COMPU_VTAB
/begin COMPU_VTAB Behaviour "enumeration table" TAB_VERB 2 0 "loopAround" 1 "limitToRange" /end COMPU_VTAB
/begin COMPU_VTAB BehaviourRequestAlc "enumeration table" TAB_VERB 4 0 "noConditionFulfilled" 1 "centeringConditionFulfilled" 2 "leftConditionFulfilled" 3 "rightConditionFulfilled" /end COMPU_VTAB
/begin COMPU_VTAB BorderState "enumeration table" TAB_VERB 4 0 "unknown" 1 "emptyBorder" 2 "behindEgo" 3 "valid" /end COMPU_VTAB
/begin COMPU_VTAB BoundarySource "enumeration table" TAB_VERB 3 0 "Video" 1 "Fused" 2 "Radar" /end COMPU_VTAB
/begin COMPU_VTAB BoundaryType "enumeration table" TAB_VERB 21 0 "Virtual" 1 "Unknown" 2 "Dashed" 3 "Solid" 4 "DashedExcept" 5 "SolidExcept" 6 "RoadEdge" 7 "ConstructionElement" 8 "Curbstone" 9 "TrafficStatic" 10 "UnknownRaised" 11 "RoadEdgeFlat" 12 "RoadEdgeDropped" 13 "RoadEdgeRaised" 14 "TrafficBarrier" 15 "ConstructionBarriers" 16 "TrafficControlDevices" 17 "ParkedVehicles" 18 "UnknownRaisedOverridable" 19 "UnknownRaisedNotOverridable" 20 "UnknownRaisedUnderridable" /end COMPU_VTAB
/begin COMPU_VTAB BoundaryType_Copy1 "enumeration table" TAB_VERB 5 0 "invalid" 1 "solid" 2 "dashed" 3 "roadEdge" 4 "constructionElement" /end COMPU_VTAB
/begin COMPU_VTAB BoundaryType_Copy2 "enumeration table" TAB_VERB 4 0 "undefined" 1 "verticalRoadEdge" 2 "horizontalRoadEdge" 3 "laneBoundary" /end COMPU_VTAB
/begin COMPU_VTAB BufferClearingState "enumeration table" TAB_VERB 3 0 "inactive" 1 "wait" 2 "clear" /end COMPU_VTAB
/begin COMPU_VTAB BuiltUpAreaType "enumeration table" TAB_VERB 8 0 "unknown" 1 "notInTown" 2 "inTown" 3 "calmZone" 4 "speedLimitZone" 5 "pedestrianZone" 6 "bikeZone" 7 "pedestrianAndBikeZone" /end COMPU_VTAB
/begin COMPU_VTAB ButtonStatus "enumeration table" TAB_VERB 3 0 "NotPressed" 1 "Pressed" 2 "NotFitted" /end COMPU_VTAB
/begin COMPU_VTAB CT_EAccMode "" TAB_VERB 2 0 "base" 1 "stopAndGo" /end COMPU_VTAB
/begin COMPU_VTAB CT_EAccStandStillActivationMode "" TAB_VERB 2 0 "singleActivationStrategy" 1 "doubleActivationStrategy" /end COMPU_VTAB
/begin COMPU_VTAB CT_ECsaMode "" TAB_VERB 4 0 "csaOff" 1 "csaEnabled" 2 "csaStandby" 3 "csaFailure" /end COMPU_VTAB
/begin COMPU_VTAB CT_EDriveMode "" TAB_VERB 3 0 "eco" 1 "normal" 2 "dynamic" /end COMPU_VTAB
/begin COMPU_VTAB CT_EDriveTrainConfig "" TAB_VERB 3 0 "fwd" 1 "rwd" 2 "awd" /end COMPU_VTAB
/begin COMPU_VTAB CT_EFrictionProfileMode "" TAB_VERB 4 0 "frictionProfileOff" 1 "frictionProfileEnabled" 2 "frictionProfileStandby" 3 "frictionProfileFailure" /end COMPU_VTAB
/begin COMPU_VTAB CT_EReferenceVelocityConfig "" TAB_VERB 3 0 "none" 1 "radar" 2 "gnss" /end COMPU_VTAB
/begin COMPU_VTAB CT_ESacEpsPfArchType "" TAB_VERB 3 0 "EpsMotorTorqueCoordination" 1 "EpsTbtCoordination" 2 "EpsMotorTorqueCoordinationJlr" /end COMPU_VTAB
/begin COMPU_VTAB CT_ESetSpeedRoundingStrategy "" TAB_VERB 3 0 "roundingDown" 1 "roundingUp" 2 "roundingNearest" /end COMPU_VTAB
/begin COMPU_VTAB CT_ESlaMode "" TAB_VERB 5 0 "slaOff" 1 "slaEnabledAutoAdaptation" 2 "slaEnabledPrompted" 3 "slaStandby" 4 "slaFailure" /end COMPU_VTAB
/begin COMPU_VTAB CT_ESpeedProfileMode "" TAB_VERB 4 0 "speedProfileOff" 1 "speedProfileEnabled" 2 "speedProfileStandby" 3 "speedProfileFailure" /end COMPU_VTAB
/begin COMPU_VTAB CT_ESteeringAngleCalibrationType "" TAB_VERB 3 0 "SteeringAngleCalibrationOff" 1 "SteeringAngleCalibrationAngleOn" 2 "SteeringAngleCalibrationYawRateOn" /end COMPU_VTAB
/begin COMPU_VTAB CT_ESteeringTorqueCalibrationType "" TAB_VERB 2 0 "SteeringTorqueCalibrationOff" 1 "SteeringTorqueCalibrationOn" /end COMPU_VTAB
/begin COMPU_VTAB CT_ETimeGapProcessesingStrategy "" TAB_VERB 2 0 "readTimeGapIndex" 1 "calculateTimeGapIndex" /end COMPU_VTAB
/begin COMPU_VTAB CT_Etype_Postprocessing_SteeringInterfaceType "" TAB_VERB 2 0 "Angle" 1 "Torque" /end COMPU_VTAB
/begin COMPU_VTAB C_PLM "enumeration table" TAB_VERB 7 0 "EGO_COURSE_LANE_MODEL" 1 "EGO_HIST_TRACK_LANE_MODEL" 2 "OBJECT_HIST_TRACK_LANE_MODEL" 3 "STATIC_SENSOR_LANE_MODEL" 4 "NUMBER_OF_PLM_TYPES" 5 "EXTRAPOLATED_MODEL" 255 "INVALID_PLM_TYPE" /end COMPU_VTAB
/begin COMPU_VTAB CalculatorResult "enumeration table" TAB_VERB 38 0 "notCalled" 1 "valid" 2 "reactionNotRequired" 3 "reactionRequired" 4 "reactionFinished" 10 "invalid" 11 "invalidTargetObject" 12 "invalidBehaviorSpec" 13 "parameterSetMissing" 14 "invalidEgoCurrentTrajectory" 15 "egoNotDrivingForward" 16 "invalidTrajectoryConstruction" 17 "wrongReactionPatternType" 18 "noStaticBorder" 19 "gciCreationFailed" 20 "preconditionsFailed" 21 "featureNotSupported" 22 "egoNotDrivingForwardAfterLatency" 23 "staticBordersResampleFailed" 24 "couldNotDetermineObjectTrajectory" 25 "notImplemented" 30 "invalidNormalBrake" 31 "invalidImmediateBrake" 32 "invalidLimitedImmediateBrake" 33 "maxVelocityReductionLimitReached" 34 "situationIsDeescalated" 40 "egoStabilizationCouldNotBeDetermined" 41 "targetStatesNotFound" 42 "steeringTrajectoryWithParallelAlignmentFailed" 43 "parallelAlignmentTrajectoryFailed" 44 "recommendedExecutionTimeInvalid" 45 "collisionAvoidableLongitudinally" 46 "solutionBeyondTimeHorizon" 47 "lambdaForLateralDisplacementNotFound" 50 "staticBordersTooShort" 60 "egoNotYetStabilized" 61 "egoStabilizationTimeBelowThreshold" 62 "egoStabilizedButBehaviorCurrentlyNotExecuted" /end COMPU_VTAB
/begin COMPU_VTAB CascadedStates "enumeration table" TAB_VERB 7 0 "noSpeeding" 1 "visualOnlyInit" 2 "visualOnly" 3 "visualAcoustic" 4 "visualHaptic" 5 "visualAcousticHaptic" 6 "visualCooldown" /end COMPU_VTAB
/begin COMPU_VTAB Category "enumeration table" TAB_VERB 2 0 "staticObligation" 1 "dynamicObligation" /end COMPU_VTAB
/begin COMPU_VTAB ChosenGap "enumeration table" TAB_VERB 4 0 "none" 1 "inFrontOfTarget" 2 "behindTarget" 3 "invalid" /end COMPU_VTAB
/begin COMPU_VTAB ColdPathType "enumeration table" TAB_VERB 4 0 "COLDPATH_INVALID" 1 "COLDPATH_LASTTC" 2 "COLDPATH_EGO" 3 "COLDPATH_VIDEO" /end COMPU_VTAB
/begin COMPU_VTAB Color "enumeration table" TAB_VERB 5 0 "unknown" 1 "red" 2 "green" 3 "yellow" 4 "white" /end COMPU_VTAB
/begin COMPU_VTAB Color_Copy1 "enumeration table" TAB_VERB 4 0 "unknown" 1 "red" 2 "green" 3 "yellow" /end COMPU_VTAB
/begin COMPU_VTAB ConditionBypassParameter "enumeration table" TAB_VERB 3 0 "neverFulfilled" 1 "alwaysFulfilled" 255 "dynamicallyCalculated" /end COMPU_VTAB
/begin COMPU_VTAB ConflictingSituationType "enumeration table" TAB_VERB 18 0 "unknown" 1 "priority" 2 "hasToYield" 3 "yieldSign" 4 "stopSign" 5 "speedBump" 6 "trafficLight" 7 "pedestrianCrossingSign" 8 "pedestrianCrossing" 9 "railwayCrossingSign" 10 "railwayCrossing" 11 "priority_road" 12 "priority_for_oncoming_traffic" 13 "intersection_with_minor_road" 14 "dangerous_intersection" 15 "curve" 16 "hump" 17 "uneven_road" /end COMPU_VTAB
/begin COMPU_VTAB ConnectionType "enumeration table" TAB_VERB 4 0 "CT_UNKNOWN" 1 "CT_SOLID_LINE" 2 "CT_DASHED_LINE" 3 "CT_UNCROSSABLE" /end COMPU_VTAB
/begin COMPU_VTAB ContextOriginType "enumeration table" TAB_VERB 69 0 "twn" 1 "eTwn" 2 "fway" 3 "eFway" 4 "hway" 5 "eHway" 6 "calm" 7 "eCalm" 8 "slZone" 9 "slZoneGreaterEqThanTownDef" 10 "eSlZone" 11 "warnPed" 12 "warnKids" 13 "warnBike" 14 "school" 15 "warnPCross" 16 "zebra" 17 "warnWildAnimal" 18 "warnCurve" 19 "warnCurveL" 20 "warnCurveR" 21 "warnDCurveL" 22 "warnDCurveR" 23 "warnLights" 24 "stop" 25 "giveWay" 26 "pedestrianStreet" 27 "ePedestrianStreet" 28 "bikeRoad" 29 "eBikeRoad" 30 "pedestrianAndBikeStreet" 31 "ePedestrianAndBikeStreet" 32 "SLGreaterEqThanRuralDef" 33 "SLGreaterEqSpeedwayDef" 34 "SLGreaterEqExpresswayDef" 35 "SLSmallerTownDef" 36 "SLSmallerTownDefNav" 37 "prioStreet" 38 "ePrioStreet" 39 "warnConst" 40 "warnConstL" 41 "warnConstR" 42 "warnHump" 43 "prioCross" 44 "prioCrossYieldToRight" 45 "warnCyclist" 46 "warnTrain" 47 "noTractor" 48 "noBike" 49 "wBround" 50 "warnRound" 51 "noBus" 52 "ePark" 53 "noRTurn" 54 "noLTurn" 55 "noUTurn" 56 "noPark" 57 "OL" 58 "eOL" 59 "oneWayL" 60 "oneWayR" 61 "oneWayS" 62 "oneWayU" 63 "noStop" 64 "noStopL" 65 "noStopR" 66 "noStopLR" 67 "unknown" 67 "numElements" /end COMPU_VTAB
/begin COMPU_VTAB ContributingType "enumeration table" TAB_VERB 4 0 "none" 1 "precedingObject" 2 "preprecedingObject" 3 "trafficLightForBraking" /end COMPU_VTAB
/begin COMPU_VTAB ControlStrategy "enumeration table" TAB_VERB 11 0 "none" 1 "brakeToStandstill" 2 "brakePartially" 3 "reactOnExternalObject" 4 "brakePartiallyOnTrafficLight" 5 "brakeOnTrafficLight" 6 "brakePartiallyOnStopSign" 7 "brakeOnStopSign" 8 "controlOnSpeedLimits" 9 "controlOnCurveSpeed" 10 "controlOnSpeedProfile" /end COMPU_VTAB
/begin COMPU_VTAB ControlStrategyType "enumeration table" TAB_VERB 8 0 "unknown" 1 "fullReactionFollowMode" 2 "fullReactionEcf" 3 "partialReactionCutIn" 4 "partialReactionCutOut" 5 "partialReactionEcf" 6 "partialReactionSo" 7 "partialReactionWsos" /end COMPU_VTAB
/begin COMPU_VTAB CountryAndRegion "enumeration table" TAB_VERB 326 0 "unknown" 100 "afghanistan" 200 "alandIslands" 300 "albania" 400 "algeria" 600 "andorra" 700 "angola" 800 "anguilla" 900 "antarctica" 1000 "antiguaandBarbuda" 1100 "argentina" 1200 "armenia" 1300 "aruba" 1400 "australia_general" 1401 "australia_capital_territory" 1402 "australia_christmas_island" 1403 "australia_cocos_island" 1404 "australia_lord_howe_island" 1405 "australia_new_south_wales" 1406 "australia_norfolk_island" 1407 "australia_northern_territory" 1408 "australia_queensland" 1409 "australia_south_australia" 1410 "australia_tasmania" 1411 "australia_victoria" 1412 "australia_western_australia" 1500 "austria" 1600 "azerbaijan" 1700 "bahamas" 1800 "bahrain" 1900 "bangladesh" 2000 "barbados" 2100 "belarus" 2200 "belgium" 2300 "belize" 2400 "benin" 2500 "bermuda" 2600 "bhutan" 2700 "boliviaPlurinationalStateof" 2800 "bonaireSintEustatiusandSaba" 2900 "bosniaandHerzegovina" 3000 "botswana" 3100 "bouvetIsland" 3200 "brazil" 3300 "britishIndianOceanTerritory" 3400 "bruneiDarussalam" 3500 "bulgaria" 3600 "burkinaFaso" 3700 "burundi" 3800 "caboVerde" 3900 "cambodia" 4000 "cameroon" 4100 "canada_general" 4101 "canada_alberta" 4102 "canada_britishColumbia" 4103 "canada_manitoba" 4104 "canada_newBrunswick" 4105 "canada_newfoundlandAndLabrador" 4106 "canada_novaScotia" 4107 "canada_ontario" 4108 "canada_princeEdwardIsland" 4109 "canada_quebec" 4110 "canada_saskatchewan" 4111 "canada_northwestTerritories" 4112 "canada_nunavut" 4113 "canada_yukon" 4200 "caymanIslands" 4300 "centralAfricanRepublic" 4400 "chad" 4500 "chile" 4600 "china" 4900 "colombia" 5000 "comoros" 5100 "congo" 5200 "congoDemocraticRepublicofthe" 5300 "cookIslands" 5400 "costaRica" 5500 "coteDIvoire" 5600 "croatia" 5700 "cuba" 5800 "curacao" 5900 "cyprus" 6000 "czechia" 6100 "denmark" 6200 "djibouti" 6300 "dominica" 6400 "dominicanRepublic" 6500 "ecuador" 6600 "egypt" 6700 "elSalvador" 6800 "equatorialGuinea" 6900 "eritrea" 7000 "estonia" 7100 "ethiopia" 7200 "falklandIslandsMalvinas" 7300 "faroeIslands" 7400 "fiji" 7500 "finland" 7600 "france" 7700 "frenchGuiana" 7800 "frenchPolynesia" 7900 "frenchSouthernTerritories" 8000 "gabon" 8100 "gambia" 8200 "georgia" 8300 "germany" 8400 "ghana" 8500 "gibraltar" 8600 "greece" 8700 "greenland" 8800 "grenada" 8900 "guadeloupe" 9000 "guam" 9100 "guatemala" 9200 "guernsey" 9300 "guinea" 9400 "guineaBissau" 9500 "guyana" 9600 "haiti" 9700 "heardIslandandMcDonaldIslands" 9800 "holySee" 9900 "honduras" 10000 "hongKong" 10100 "hungary" 10200 "iceland" 10300 "india" 10400 "indonesia" 10500 "iranIslamicRepublicOf" 10600 "iraq" 10700 "ireland" 10800 "isleofMan" 10900 "israel" 11000 "italy" 11100 "jamaica" 11200 "japan" 11300 "jersey" 11400 "jordan" 11500 "kazakhstan" 11600 "kenya" 11700 "kiribati" 11800 "koreaDemocraticPeoplesRepublicOf" 11900 "koreaRepublicOf" 12000 "kosovo" 12100 "kuwait" 12200 "kyrgyzstan" 12300 "laoPeoplesDemocraticRepublic" 12400 "latvia" 12500 "lebanon" 12600 "lesotho" 12700 "liberia" 12800 "libya" 12900 "liechtenstein" 13000 "lithuania" 13100 "luxembourg" 13200 "macao" 13300 "northMacedonia" 13400 "madagascar" 13500 "malawi" 13600 "malaysia" 13700 "maldives" 13800 "mali" 13900 "malta" 14000 "marshallIslands" 14100 "martinique" 14200 "mauritania" 14300 "mauritius" 14400 "mayotte" 14500 "mexico" 14600 "micronesiaFederatedStatesOf" 14700 "moldovaRepublicOf" 14800 "monaco" 14900 "mongolia" 15000 "montenegro" 15100 "montserrat" 15200 "morocco" 15300 "mozambique" 15400 "myanmar" 15500 "namibia" 15600 "nauru" 15700 "nepal" 15800 "netherlands" 15900 "newCaledonia" 16000 "newZealand" 16100 "nicaragua" 16200 "niger" 16300 "nigeria" 16400 "niue" 16700 "norway" 16800 "oman" 16900 "pakistan" 17000 "palau" 17100 "palestineStateOf" 17200 "panama" 17300 "papuaNewGuinea" 17400 "paraguay" 17500 "peru" 17600 "philippines" 17700 "pitcairn" 17800 "poland" 17900 "portugal" 18100 "qatar" 18200 "reunion" 18300 "romania" 18400 "russianFederation" 18500 "rwanda" 18600 "saintBarthelemy" 18700 "saintHelenaAscensionAndTristandaCunha" 18800 "saintKittsandNevis" 18900 "saintLucia" 19000 "saintMartinFrenchpart" 19100 "saintPierreandMiquelon" 19200 "saintVincentandtheGrenadines" 19300 "samoa" 19400 "sanMarino" 19500 "saoTomeandPrincipe" 19600 "saudiArabia" 19700 "senegal" 19800 "serbia" 19900 "seychelles" 20000 "sierraLeone" 20100 "singapore" 20200 "sintMaartenDutchpart" 20300 "slovakia" 20400 "slovenia" 20500 "solomonIslands" 20600 "somalia" 20700 "southAfrica" 20800 "southGeorgiaandtheSouthSandwichIslands" 20900 "southSudan" 21000 "spain" 21100 "sriLanka" 21200 "sudan" 21300 "suriname" 21400 "svalbardandJanMayen" 21500 "swaziland" 21600 "sweden" 21700 "switzerland" 21800 "syrianArabRepublic" 21900 "taiwanProvinceOfChina" 22000 "tajikistan" 22100 "tanzaniaUnitedRepublicOf" 22200 "thailand" 22300 "timorLeste" 22400 "togo" 22500 "tokelau" 22600 "tonga" 22700 "trinidadAndTobago" 22800 "tunisia" 22900 "turkiye" 23000 "turkmenistan" 23100 "turksandCaicosIslands" 23200 "tuvalu" 23300 "uganda" 23400 "ukraine" 23500 "unitedArabEmirates" 23600 "unitedKingdomOfGreatBritainandNorthernIreland" 23700 "unitedStatesOfAmerica_general" 23701 "unitedStatesOfAmerica_alabama" 23702 "unitedStatesOfAmerica_alaska" 23703 "unitedStatesOfAmerica_arizona" 23704 "unitedStatesOfAmerica_arkansas" 23705 "unitedStatesOfAmerica_california" 23706 "unitedStatesOfAmerica_colorado" 23707 "unitedStatesOfAmerica_connecticut" 23708 "unitedStatesOfAmerica_delaware" 23709 "unitedStatesOfAmerica_florida" 23710 "unitedStatesOfAmerica_georgia" 23711 "unitedStatesOfAmerica_hawaii" 23712 "unitedStatesOfAmerica_idaho" 23713 "unitedStatesOfAmerica_illinois" 23714 "unitedStatesOfAmerica_indiana" 23715 "unitedStatesOfAmerica_iowa" 23716 "unitedStatesOfAmerica_kansas" 23717 "unitedStatesOfAmerica_kentucky" 23718 "unitedStatesOfAmerica_louisiana" 23719 "unitedStatesOfAmerica_maine" 23720 "unitedStatesOfAmerica_maryland" 23721 "unitedStatesOfAmerica_massachusetts" 23722 "unitedStatesOfAmerica_michigan" 23723 "unitedStatesOfAmerica_minnesota" 23724 "unitedStatesOfAmerica_mississippi" 23725 "unitedStatesOfAmerica_missouri" 23726 "unitedStatesOfAmerica_montana" 23727 "unitedStatesOfAmerica_nebraska" 23728 "unitedStatesOfAmerica_nevada" 23729 "unitedStatesOfAmerica_newHampshire" 23730 "unitedStatesOfAmerica_newJersey" 23731 "unitedStatesOfAmerica_newMexico" 23732 "unitedStatesOfAmerica_newYork" 23733 "unitedStatesOfAmerica_northCarolina" 23734 "unitedStatesOfAmerica_northDakota" 23735 "unitedStatesOfAmerica_ohio" 23736 "unitedStatesOfAmerica_oklahoma" 23737 "unitedStatesOfAmerica_oregon" 23738 "unitedStatesOfAmerica_pennsylvania" 23739 "unitedStatesOfAmerica_rhodeIsland" 23740 "unitedStatesOfAmerica_southCarolina" 23741 "unitedStatesOfAmerica_southDakota" 23742 "unitedStatesOfAmerica_tennessee" 23743 "unitedStatesOfAmerica_texas" 23744 "unitedStatesOfAmerica_utah" 23745 "unitedStatesOfAmerica_vermont" 23746 "unitedStatesOfAmerica_virginia" 23747 "unitedStatesOfAmerica_washington" 23748 "unitedStatesOfAmerica_westVirginia" 23749 "unitedStatesOfAmerica_wisconsin" 23750 "unitedStatesOfAmerica_wyoming" 23751 "unitedStatesOfAmerica_districtOfColumbia" 23752 "unitedStatesOfAmerica_americanSamoa" 23753 "unitedStatesOfAmerica_guam" 23754 "unitedStatesOfAmerica_northernMarianaIslands" 23755 "unitedStatesOfAmerica_puertoRico" 23756 "unitedStatesOfAmerica_minorOutlyingIslands" 23757 "unitedStatesOfAmerica_virginIslands" 23800 "uruguay" 23900 "uzbekistan" 24000 "vanuatu" 24100 "vatican" 24200 "venezuelaBolivarianRepublicOf" 24300 "vietNam" 24400 "virginIslandsBritish" 24600 "wallisandFutuna" 24700 "westernSahara" 24800 "yemen" 24900 "zambia" 25000 "zimbabwe" /end COMPU_VTAB
/begin COMPU_VTAB CountryCode "enumeration table" TAB_VERB 251 0 "unknown" 4 "afghanistan" 8 "albania" 10 "antarctica" 12 "algeria" 16 "americanSamoa" 20 "andorra" 24 "angola" 28 "antiguaAndBarbuda" 31 "azerbaijan" 32 "argentina" 36 "australia" 40 "austria" 44 "bahamas" 48 "bahrain" 50 "bangladesh" 51 "armenia" 52 "barbados" 56 "belgium" 60 "bermuda" 64 "bhutan" 68 "bolivia" 70 "bosniaAndHerzegovina" 72 "botswana" 74 "bouvetIsland" 76 "brazil" 84 "belize" 86 "britishIndianOceanTerritory" 90 "solomonIslands" 92 "virginIslandsBritish" 96 "bruneiDarussalam" 100 "bulgaria" 104 "myanmar" 108 "burundi" 112 "belarus" 116 "cambodia" 120 "cameroon" 124 "canada" 132 "caboVerde" 136 "caymanIslands" 140 "centralAfricanRepublic" 144 "sriLanka" 148 "chad" 152 "chile" 156 "china" 158 "taiwan" 162 "christmasIsland" 166 "cocosKeelingIslands" 170 "colombia" 174 "comoros" 175 "mayotte" 178 "congo" 180 "congoDemocraticRepublic" 184 "cookIslands" 188 "costaRica" 191 "croatia" 192 "cuba" 196 "cyprus" 203 "czechia" 204 "benin" 208 "denmark" 212 "dominica" 214 "dominicanRepublic" 218 "ecuador" 222 "elSalvador" 226 "equatorialGuinea" 231 "ethiopia" 232 "eritrea" 233 "estonia" 234 "faroeIslands" 238 "falklandIslands" 239 "southGeorgia" 242 "fiji" 246 "finland" 248 "alandIslands" 250 "france" 254 "frenchGuiana" 258 "frenchPolynesia" 260 "frenchSouthernTerritories" 262 "djibouti" 266 "gabon" 268 "georgia" 270 "gambia" 275 "palestine" 276 "germany" 288 "ghana" 292 "gibraltar" 296 "kiribati" 300 "greece" 304 "greenland" 308 "grenada" 312 "guadeloupe" 316 "guam" 320 "guatemala" 324 "guinea" 328 "guyana" 332 "haiti" 334 "heardIslandAndMcDonaldIslands" 336 "holySee" 340 "honduras" 344 "hongKong" 348 "hungary" 352 "iceland" 356 "india" 360 "indonesia" 364 "iran" 368 "iraq" 372 "ireland" 376 "israel" 380 "italy" 384 "coteDIvoire" 388 "jamaica" 392 "japan" 398 "kazakhstan" 400 "jordan" 404 "kenya" 408 "koreaNorth" 410 "koreaSouth" 414 "kuwait" 417 "kyrgyzstan" 418 "lao" 422 "lebanon" 426 "lesotho" 428 "latvia" 430 "liberia" 434 "libya" 438 "liechtenstein" 440 "lithuania" 442 "luxembourg" 446 "macao" 450 "madagascar" 454 "malawi" 458 "malaysia" 462 "maldives" 466 "mali" 470 "malta" 474 "martinique" 478 "mauritania" 480 "mauritius" 484 "mexico" 492 "monaco" 496 "mongolia" 498 "moldova" 499 "montenegro" 500 "montserrat" 504 "morocco" 508 "mozambique" 512 "oman" 516 "namibia" 520 "nauru" 524 "nepal" 528 "netherlands" 531 "curacao" 533 "aruba" 534 "sintMaarten" 535 "bonaire" 540 "newCaledonia" 548 "vanuatu" 554 "newZealand" 558 "nicaragua" 562 "niger" 566 "nigeria" 570 "niue" 574 "norfolkIsland" 578 "norway" 580 "northernMarianaIslands" 581 "unitedStatesMinorOutlyingIslands" 583 "micronesia" 584 "marshallIslands" 585 "palau" 586 "pakistan" 591 "panama" 598 "papuaNewGuinea" 600 "paraguay" 604 "peru" 608 "philippines" 612 "pitcairn" 616 "poland" 620 "portugal" 624 "guineaBissau" 626 "timorLeste" 630 "puertoRico" 634 "qatar" 638 "reunion" 642 "romania" 643 "russianFederation" 646 "rwanda" 652 "saintBarthelemy" 654 "saintHelena" 659 "saintKittsAndNevis" 660 "anguilla" 662 "saintLucia" 663 "saintMartin" 666 "saintPierreAndMiquelon" 670 "saintVincentAndtheGrenadines" 674 "sanMarino" 678 "saoTomeAndPrincipe" 682 "saudiArabia" 686 "senegal" 688 "serbia" 690 "seychelles" 694 "sierraLeone" 702 "singapore" 703 "slovakia" 704 "vietNam" 705 "slovenia" 706 "somalia" 710 "southAfrica" 716 "zimbabwe" 724 "spain" 728 "southSudan" 729 "sudan" 732 "westernSahara" 740 "suriname" 744 "svalbardAndJanMayen" 748 "eswatini" 752 "sweden" 756 "switzerland" 760 "syrianArabRepublic" 762 "tajikistan" 764 "thailand" 768 "togo" 772 "tokelau" 776 "tonga" 780 "trinidadAndTobago" 784 "unitedArabEmirates" 788 "tunisia" 792 "turkiye" 795 "turkmenistan" 796 "turksAndCaicosIslands" 798 "tuvalu" 800 "uganda" 804 "ukraine" 807 "northMacedonia" 818 "egypt" 826 "unitedKingdomOfGreatBritainAndNorthernIreland" 831 "guernsey" 832 "jersey" 833 "isleOfMan" 834 "tanzania" 840 "unitedStatesOfAmerica" 850 "virginIslandsUS" 854 "burkinaFaso" 858 "uruguay" 860 "uzbekistan" 862 "venezuela" 876 "wallisAndFutuna" 882 "samoa" 887 "yemen" 894 "zambia" 895 "numberValidCountryIds" /end COMPU_VTAB
/begin COMPU_VTAB CruiseControlModeInput "enumeration table" TAB_VERB 2 0 "ADAPTIVE_CRUISE_CONTROL" 1 "CRUISE_CONTROL" /end COMPU_VTAB
/begin COMPU_VTAB CruiseMode "enumeration table" TAB_VERB 3 0 "NotEnabled" 1 "ACC" 2 "CC" /end COMPU_VTAB
/begin COMPU_VTAB CscRoundAboutState "enumeration table" TAB_VERB 7 0 "no_rbt" 1 "rbt_entry" 2 "rbt_inflection_pt_entry" 3 "rbt_circle" 4 "rbt_inflection_pt_exit" 5 "rbt_exit" 6 "rbt_blocked" /end COMPU_VTAB
/begin COMPU_VTAB CurrentLane "enumeration table" TAB_VERB 8 0 "unknownLane" 1 "emergencyLane" 2 "singleLaneRoad" 3 "leftMostLane" 4 "rightMostLane" 5 "oneOfTheMiddleLanes" 6 "reserved_6" 7 "lanePositionNotAvailable" /end COMPU_VTAB
/begin COMPU_VTAB CurrentLane_Copy1 "enumeration table" TAB_VERB 4 0 "none" 1 "originLane" 2 "targetLane" 3 "invalidLane" /end COMPU_VTAB
/begin COMPU_VTAB CurrentLane_Copy2 "enumeration table" TAB_VERB 4 0 "none" 1 "originLane" 2 "targetLeftLane" 3 "targetRightLane" /end COMPU_VTAB
/begin COMPU_VTAB DImmSubWinner "enumeration table" TAB_VERB 4 0 "none" 1 "TOaccl" 2 "APPos" 3 "CutIn" /end COMPU_VTAB
/begin COMPU_VTAB DefinedTargetMotionGoal_v0 "enumeration table" TAB_VERB 1 0 "doConstantDeceleration" /end COMPU_VTAB
/begin COMPU_VTAB DinMainStates "enumeration table" TAB_VERB 3 0 "passive" 1 "active" 2 "suspend" /end COMPU_VTAB
/begin COMPU_VTAB DirectionIndicator "enumeration table" TAB_VERB 3 0 "off" 1 "on" 255 "error" /end COMPU_VTAB
/begin COMPU_VTAB DisplaySpeedUnit "enumeration table" TAB_VERB 2 0 "kmh" 1 "mph" /end COMPU_VTAB
/begin COMPU_VTAB DoorStatus "enumeration table" TAB_VERB 4 0 "Init" 1 "Closed" 2 "Open" 3 "Error" /end COMPU_VTAB
/begin COMPU_VTAB Drivability "enumeration table" TAB_VERB 3 0 "DRIVABILITY_YES" 1 "DRIVABILITY_NO" 2 "DRIVABILITY_ONLY_EMERGENCY" /end COMPU_VTAB
/begin COMPU_VTAB DriveMode "enumeration table" TAB_VERB 3 0 "ECO" 1 "COMFORT" 2 "DYNAMIC" /end COMPU_VTAB
/begin COMPU_VTAB DriveMode_Copy1 "enumeration table" TAB_VERB 4 0 "normal" 1 "comfort" 2 "eco" 3 "dynamic" /end COMPU_VTAB
/begin COMPU_VTAB DriveOffMode "enumeration table" TAB_VERB 3 0 "notActive" 1 "waitForDriveOff" 2 "driveOffAssumed" /end COMPU_VTAB
/begin COMPU_VTAB DriveRestrictionMode "enumeration table" TAB_VERB 4 0 "regular" 1 "limited" 2 "restrictive" 3 "unavailable" /end COMPU_VTAB
/begin COMPU_VTAB DriverDrowsinessLevel "enumeration table" TAB_VERB 4 0 "unknown" 1 "notFatigue" 2 "fatigue" 3 "highlyFatigue" /end COMPU_VTAB
/begin COMPU_VTAB DriverGazingSide "enumeration table" TAB_VERB 3 0 "unknown" 1 "leftSideGazing" 2 "rightSideGazing" /end COMPU_VTAB
/begin COMPU_VTAB DriverModelDmsStatus "enumeration table" TAB_VERB 3 0 "cameraBlocked" 1 "cameraNotAvailable" 2 "cameraActive" /end COMPU_VTAB
/begin COMPU_VTAB DriverModelDriverAttention "enumeration table" TAB_VERB 4 0 "noValidData" 1 "inattentive" 2 "slightlyInattentive" 3 "attentive" /end COMPU_VTAB
/begin COMPU_VTAB DriverModelDriverDrowsinessLevel "enumeration table" TAB_VERB 4 0 "noValidData" 1 "drowsy" 2 "slightlyDrowsy" 3 "notDrowsy" /end COMPU_VTAB
/begin COMPU_VTAB DriverModelDriverPresence "enumeration table" TAB_VERB 4 0 "noValidData" 1 "notVisible" 2 "notPresent" 3 "present" /end COMPU_VTAB
/begin COMPU_VTAB DriverModelDriverSpoofing "enumeration table" TAB_VERB 3 0 "noValidData" 1 "noMisuseDetected" 2 "misuseDetected" /end COMPU_VTAB
/begin COMPU_VTAB DriverModelLaneChangeIntentionSide "enumeration table" TAB_VERB 3 0 "noValidData" 1 "laneChangeIntentionLeft" 2 "laneChangeIntentionRight" /end COMPU_VTAB
/begin COMPU_VTAB DriverMonitoringSystemStatus "enumeration table" TAB_VERB 5 0 "unknown" 1 "off" 2 "init" 3 "cameraBlocked" 4 "active" /end COMPU_VTAB
/begin COMPU_VTAB DriverOvertakeIntentionState "enumeration table" TAB_VERB 3 0 "NoOvertakeIntention" 1 "OvertakeIntentionGiven" 2 "OvertakeIntentionExpired" /end COMPU_VTAB
/begin COMPU_VTAB DriverPresence "enumeration table" TAB_VERB 3 0 "unknown" 1 "notPresent" 2 "present" /end COMPU_VTAB
/begin COMPU_VTAB DriverSpoofing "enumeration table" TAB_VERB 3 0 "unknown" 1 "notDetected" 2 "detected" /end COMPU_VTAB
/begin COMPU_VTAB DrivingDirection "enumeration table" TAB_VERB 3 0 "unknown" 1 "forward" 2 "oncoming" /end COMPU_VTAB
/begin COMPU_VTAB DrivingDirection_Copy1 "enumeration table" TAB_VERB 3 0 "unknown" 1 "synchronous" 2 "oncoming" /end COMPU_VTAB
/begin COMPU_VTAB DrivingDirection_Copy2 "enumeration table" TAB_VERB 3 0 "DD_UNKNOWN" 1 "DD_EGO_DIRECTION" 2 "DD_ONCOMING" /end COMPU_VTAB
/begin COMPU_VTAB DrivingSense "enumeration table" TAB_VERB 3 0 "Unknown" 1 "Left" 2 "Right" /end COMPU_VTAB
/begin COMPU_VTAB DrivingSide "enumeration table" TAB_VERB 3 0 "UNKNOWN" 1 "LEFT" 2 "RIGHT" /end COMPU_VTAB
/begin COMPU_VTAB DrivingSide_Copy1 "enumeration table" TAB_VERB 3 0 "leftHandTraffic" 1 "rightHandTraffic" 2 "notSet" /end COMPU_VTAB
/begin COMPU_VTAB DsmPhase "enumeration table" TAB_VERB 6 0 "unavailable" 1 "startup" 2 "healing" 3 "degradation" 4 "available" 5 "reset" /end COMPU_VTAB
/begin COMPU_VTAB Dynamic1DMotionGoal "enumeration table" TAB_VERB 2 0 "doTargetBraking" 1 "followNotSupportedByEmg" /end COMPU_VTAB
/begin COMPU_VTAB Dynamic1DMotionGoal_v0 "enumeration table" TAB_VERB 1 0 "doTargetBraking" /end COMPU_VTAB
/begin COMPU_VTAB Dynamic2DMotionGoal_v0 "enumeration table" TAB_VERB 1 0 "evadeLaterallyByKeepingSafetyDistance" /end COMPU_VTAB
/begin COMPU_VTAB EColor "enumeration table" TAB_VERB 5 0 "COLOR_WHITE" 1 "COLOR_YELLOW" 2 "COLOR_RED" 3 "COLOR_BLUE" 7 "COLOR_UNKNOWN" /end COMPU_VTAB
/begin COMPU_VTAB EDefaultState "enumeration table" TAB_VERB 3 0 "init" 1 "normal" 2 "na" /end COMPU_VTAB
/begin COMPU_VTAB EMainState "enumeration table" TAB_VERB 4 0 "init" 1 "normal" 2 "defaults" 3 "error" /end COMPU_VTAB
/begin COMPU_VTAB EManagerDatasetStatus "enumeration table" TAB_VERB 4 0 "notEvaluated" 1 "notAvailable" 2 "incompatible" 3 "valid" /end COMPU_VTAB
/begin COMPU_VTAB ETrigger "enumeration table" TAB_VERB 2 0 "inactive" 1 "active" /end COMPU_VTAB
/begin COMPU_VTAB EType "enumeration table" TAB_VERB 20 0 "TYPE_SOLID_LINE" 1 "TYPE_DASHED_LINE" 2 "TYPE_DOUBLE_DASHED_DASHED" 3 "TYPE_DOUBLE_DASHED_SOLID" 4 "TYPE_DOUBLE_SOLID_DASHED" 5 "TYPE_DOUBLE_SOLID_SOLID" 6 "TYPE_MULTIPLE" 7 "TYPE_MULTIPLE_WARNING" 8 "TYPE_CAR_POOL" 9 "TYPE_ASPHALT_JOINT" 10 "TYPE_BOTTS_DOTS" 11 "TYPE_ROAD_EDGE" 12 "TYPE_GUARDRAIL" 13 "TYPE_CURBSTONE" 14 "TYPE_WALL" 15 "TYPE_TRAFFIC_CONE" 16 "TYPE_DELINEATOR_POST" 17 "TYPE_PARKING_CAR" 18 "TYPE_UNKNOWN_RAISED" 19 "TYPE_UNKOWN" /end COMPU_VTAB
/begin COMPU_VTAB EVariantIdx "enumeration table" TAB_VERB 5 0 "na" 0 "ods_emg_drivemode_comfort_all" 1 "ods_emg_drivemode_dynamic_all" 2 "ods_emg_drivemode_eco_all" 3 "ods_emg_drivemode_normal_all" /end COMPU_VTAB
/begin COMPU_VTAB EVariantIdx_Copy1 "enumeration table" TAB_VERB 3 0 "na" 0 "ods_defender_all" 1 "ods_golf_all" /end COMPU_VTAB
/begin COMPU_VTAB EffectiveSpeedLimitTypeAndCondition "enumeration table" TAB_VERB 15 0 "implicitSpeedLimit" 1 "explicitSpeedLimitBySign" 2 "explicitNightSpeedLimit" 3 "explicitDaySpeedLimit" 4 "explicitTimeDependentSpeedLimit" 5 "explicitRainSpeedLimit" 6 "explicitSnowSpeedLimit" 7 "explicitDistanceSpeedLimit" 8 "explicitFogSpeedLimit" 9 "explicitVehicleSpeedLimit" 10 "explicitTrailerSpeedLimit" 11 "explicitArrowSpeedLimit" 12 "explicitSpeedCameraSpeedLimit" 13 "explicitIntervalVelocitySpeedLimit" 14 "unknown" /end COMPU_VTAB
/begin COMPU_VTAB EffectiveSpeedLimitTypeUsed "enumeration table" TAB_VERB 3 0 "yes" 1 "no" 2 "unknown" /end COMPU_VTAB
/begin COMPU_VTAB EgoLaneChangeDirection "enumeration table" TAB_VERB 3 0 "none" 1 "left" 2 "right" /end COMPU_VTAB
/begin COMPU_VTAB EgoLaneChangePossibility "enumeration table" TAB_VERB 3 0 "unknown" 1 "possible" 2 "notPossible" /end COMPU_VTAB
/begin COMPU_VTAB EgoLaneChangeSituation "enumeration table" TAB_VERB 4 0 "invalid" 1 "slowSpeed" 2 "city" 3 "highway" /end COMPU_VTAB
/begin COMPU_VTAB EgoLaneChangeState "enumeration table" TAB_VERB 6 0 "inactive" 1 "intended" 2 "aborted" 3 "executed" 4 "returnToStartLane" 5 "finished" /end COMPU_VTAB
/begin COMPU_VTAB EmbeddedStatus "enumeration table" TAB_VERB 10 0 "unknown" 1 "notEmbedded" 2 "embeddedBorderSign" 3 "embeddedMultiLaneSign" 4 "embeddedRainSign" 5 "embeddedVehicleTypeSign" 6 "embeddedOtherSign" 7 "errorValue" 8 "embeddedVehicleSticker" 9 "embeddedValueCount" /end COMPU_VTAB
/begin COMPU_VTAB EmsStandstillIndication "enumeration table" TAB_VERB 3 0 "notStandstill" 1 "standstill" 3 "standstillReliable" /end COMPU_VTAB
/begin COMPU_VTAB EmsWheelMovingDirection "enumeration table" TAB_VERB 4 0 "undetermined" 1 "forward" 2 "backward" 3 "wheelStandstill" /end COMPU_VTAB
/begin COMPU_VTAB EntryState "enumeration table" TAB_VERB 3 0 "init" 1 "upToDate" 2 "writing" /end COMPU_VTAB
/begin COMPU_VTAB EraseAllState_ten "enumeration table" TAB_VERB 4 0 "Wait_e" 1 "TriggerWrite_e" 2 "CheckWrite_e" 3 "Sleep_e" /end COMPU_VTAB
/begin COMPU_VTAB EstConstraintMode "enumeration table" TAB_VERB 4 0 "NONE" 1 "LIMIT_MIN" 2 "LIMIT_MAX" 3 "CONST" /end COMPU_VTAB
/begin COMPU_VTAB EstStates "enumeration table" TAB_VERB 12 0 "disabled" 1 "passive" 2 "activeControlFull" 3 "activeControlLowSpeed" 4 "activeControlDegradedMode" 5 "standstill" 6 "fadeout" 7 "failure" 8 "activeSpeedAdaptation" 9 "activeLaneChangeLeft" 10 "activeLaneChangeRight" 11 "activeDeceleration" /end COMPU_VTAB
/begin COMPU_VTAB EventStatus "enumeration table" TAB_VERB 7 0 "noUpdate" 1 "passed" 2 "failed" 3 "prePassed" 4 "preFailed" 5 "freeze" 6 "reset" /end COMPU_VTAB
/begin COMPU_VTAB EyesOnRoad "enumeration table" TAB_VERB 4 0 "unknown" 1 "eyesOnRoad" 2 "eyesOffRoadDrivingTaskRelated" 3 "eyesOffRoadNotDrivingTaskRelated" /end COMPU_VTAB
/begin COMPU_VTAB FCTRequest "enumeration table" TAB_VERB 3 0 "FCTREQ_NO_REQUEST" 1 "FCTREQ_DRIVE_OFF" 2 "FCTREQ_HOLD" /end COMPU_VTAB
/begin COMPU_VTAB FadeStrategy "enumeration table" TAB_VERB 3 0 "immediate" 1 "fast" 2 "soft" /end COMPU_VTAB
/begin COMPU_VTAB FailureClusterStatus "enumeration table" TAB_VERB 2 0 "active" 1 "inactive" /end COMPU_VTAB
/begin COMPU_VTAB FctFunctionId "enumeration table" TAB_VERB 39 0 "invalid" 1 "aebTiplLongLatentInformation" 2 "aebTiplLongPrePrecedingWarning" 3 "aebTiplLongWarningAcoustic" 4 "aebTiplLongWarningHaptic" 5 "aebTiplLongPrefill" 6 "aebTiplLongPartialBrake" 7 "aebTiplLongFullBrake" 8 "aebTiplLongEba" 9 "aebTiplLongEss" 10 "aebTiplLongAes" 11 "aebTiplLongOncomingPrefill" 12 "aebTiplLongOncomingFullBrake" 13 "aebTiplLongOncomingEba" 14 "aebTiplLongOncomingEss" 15 "aebTiplLongOncomingAes" 16 "aebCfmStartPrevention" 17 "aebCfmWarningAcoustic" 18 "aebCfmPrefill" 19 "aebCfmFullBrake" 20 "aebCfmEba" 21 "aebTiplTurnPrefill" 22 "aebTiplTurnFullBrake" 23 "aebTixlWarningAcoustic" 24 "aebTixlPrefill" 25 "aebTixlFullBrake" 26 "aebStandstill" 27 "alc" 28 "est" 29 "hfLong" 30 "hfLongLat" 31 "lksLat" 32 "lssElkReH" 33 "lssElkReV" 34 "lssElkOcv" 35 "lssElkOt" 36 "lssElkPed" 37 "lssLdwLat" 38 "lssLkaLat" /end COMPU_VTAB
/begin COMPU_VTAB FcwSetting "enumeration table" TAB_VERB 8 0 "earlyWarning" 1 "mediumWarning" 2 "lateWarning" 3 "autoTimedWarning" 4 "customerMode0" 5 "customerMode1" 6 "customerMode2" 7 "customerMode3" /end COMPU_VTAB
/begin COMPU_VTAB FilterMode "enumeration table" TAB_VERB 3 0 "None" 1 "Weak" 2 "Strong" /end COMPU_VTAB
/begin COMPU_VTAB FocAccSoStates "enumeration table" TAB_VERB 3 0 "inactive" 1 "partial" 2 "full" /end COMPU_VTAB
/begin COMPU_VTAB FocMainStates "enumeration table" TAB_VERB 4 0 "passive" 1 "active" 2 "suspend" 3 "standstill" /end COMPU_VTAB
/begin COMPU_VTAB FormOfWay "enumeration table" TAB_VERB 18 0 "unknown" 1 "controlledAccessRoad" 2 "multipleCarriageway" 3 "singleCarriageway" 4 "roundaboutCircle" 5 "trafficSquareOrSpecialTrafficFigure" 6 "reserved_6" 7 "reserved_7" 8 "parallelRoadSpecialSlipRoad" 9 "slipRoadOnControlledAccessRoad" 10 "slipRoadOnNormalRoad" 11 "serviceRoadOrFrontageRoad" 12 "entracceOrExitOfParkingArea" 13 "entranceOrExitToService" 14 "pedestrianZone" 15 "slipRoadBetweenControlledAccessRoads" 16 "parkingLot" 17 "infoNotAvailable" /end COMPU_VTAB
/begin COMPU_VTAB FourTruthValue "enumeration table" TAB_VERB 4 0 "no" 1 "yes" 2 "unknown" 3 "infoNotAvailable" /end COMPU_VTAB
/begin COMPU_VTAB FreespaceClassType "enumeration table" TAB_VERB 12 0 "unknownStatic" 1 "unknownDynamic" 2 "dynamicObject" 3 "staticObstacle" 4 "trafficBarrier" 5 "roadEdgeRaised" 6 "roadEdgeFlat" 7 "curb" 8 "constructionBarrier" 9 "hazard" 10 "maximumRange" 11 "numberOfClassTypes" /end COMPU_VTAB
/begin COMPU_VTAB FrictionAccuracy "enumeration table" TAB_VERB 4 0 "highest" 1 "medium" 2 "low" 3 "unknown" /end COMPU_VTAB
/begin COMPU_VTAB FusionUpdateType "enumeration table" TAB_VERB 2 0 "Kalman1DStandard" 1 "Kalman1DWithVarianceAnalysis" /end COMPU_VTAB
/begin COMPU_VTAB GapSearchDirection "enumeration table" TAB_VERB 3 0 "notSearching" 1 "searchingLeft" 2 "searchingRight" /end COMPU_VTAB
/begin COMPU_VTAB GateType "enumeration table" TAB_VERB 3 0 "noGate" 1 "gatePrimary" 2 "gateSecondary" /end COMPU_VTAB
/begin COMPU_VTAB GeofencingBoundaryType "enumeration table" TAB_VERB 21 0 "unknown" 1 "noBoundary" 2 "versionMismatch" 3 "unavailable" 4 "poorLocalization" 5 "outdated" 6 "country" 7 "region" 8 "formOfWay" 9 "intersection" 10 "curvature" 11 "tollBooth" 12 "tunnel" 13 "trafficLight" 14 "laneWidth" 15 "roadSlope" 16 "laneTransition" 17 "laneType" 18 "blacklist" 19 "sideWind" 20 "boundaryTypeQty" /end COMPU_VTAB
/begin COMPU_VTAB HSM_FunctionTag "enumeration table" TAB_VERB 77 0 "HSM_FUNC_NONE" 1 "HSM_FUNC_VERSION" 2 "HSM_FUNC_DIAGNOSTICS" 3 "HSM_FUNC_SESSION_LOGIN" 4 "HSM_FUNC_SESSION_LOGOUT" 5 "HSM_FUNC_SESSION_STATUS" 6 "HSM_FUNC_SESSION_CLOSE" 7 "HSM_FUNC_CANCEL_JOB" 8 "HSM_FUNC_CHECKSUM_START" 9 "HSM_FUNC_CHECKSUM_UPDATE" 10 "HSM_FUNC_CHECKSUM_FINISH" 11 "HSM_FUNC_HASH_START" 12 "HSM_FUNC_HASH_UPDATE" 13 "HSM_FUNC_HASH_FINISH" 14 "HSM_FUNC_SIGN_GENERATE_START" 15 "HSM_FUNC_SIGN_GENERATE_UPDATE" 16 "HSM_FUNC_SIGN_GENERATE_FINISH" 17 "HSM_FUNC_SIGN_VERIFY_START" 18 "HSM_FUNC_SIGN_VERIFY_UPDATE" 19 "HSM_FUNC_SIGN_VERIFY_FINISH" 20 "HSM_FUNC_MAC_GENERATE_START" 21 "HSM_FUNC_MAC_GENERATE_UPDATE" 22 "HSM_FUNC_MAC_GENERATE_FINISH" 23 "HSM_FUNC_MAC_VERIFY_START" 24 "HSM_FUNC_MAC_VERIFY_UPDATE" 25 "HSM_FUNC_MAC_VERIFY_FINISH" 26 "HSM_FUNC_ENCRYPT_START" 27 "HSM_FUNC_ENCRYPT_UPDATE" 28 "HSM_FUNC_ENCRYPT_FINISH" 29 "HSM_FUNC_DECRYPT_START_X" 30 "HSM_FUNC_DECRYPT_UPDATE_X" 31 "HSM_FUNC_DECRYPT_FINISH_X" 32 "HSM_FUNC_AUTH_ENCRYPT_START" 33 "HSM_FUNC_AUTH_UPDATE" 34 "HSM_FUNC_AUTH_ENCRYPT_FINISH" 35 "HSM_FUNC_AUTH_DECRYPT_START_X" 36 "HSM_FUNC_AUTH_DECRYPT_FINISH_X" 37 "HSM_FUNC_ASYM_ENCRYPT" 38 "HSM_FUNC_ASYM_DECRYPT" 39 "HSM_FUNC_RANDOM_GENERATE" 40 "HSM_FUNC_TRUE_RANDOM_GENERATE" 41 "HSM_FUNC_RANDOM_SEED_EXTEND" 42 "HSM_FUNC_SHE_ENCRYPT_ECB" 43 "HSM_FUNC_SHE_DECRYPT_ECB" 44 "HSM_FUNC_SHE_ENCRYPT_CBC" 45 "HSM_FUNC_SHE_DECRYPT_CBC" 46 "HSM_FUNC_SHE_MAC_GENERATE" 47 "HSM_FUNC_SHE_MAC_VERIFY" 48 "HSM_FUNC_SHE_LOAD_KEY" 49 "HSM_FUNC_SHE_LOAD_KEY_EXTENDED" 50 "HSM_FUNC_SHE_LOAD_PLAIN_KEY" 51 "HSM_FUNC_SHE_EXPORT_RAM_KEY" 52 "HSM_FUNC_SHE_GET_ID" 53 "HSM_FUNC_SHE_INIT_RNG" 54 "HSM_FUNC_SHE_EXTEND_SEED" 55 "HSM_FUNC_SHE_RND" 56 "HSM_FUNC_SHE_SECURE_BOOT" 57 "HSM_FUNC_SHE_SECURE_BOOT_FAILURE" 58 "HSM_FUNC_SHE_SECURE_BOOT_OK" 59 "HSM_FUNC_SHE_DEBUG_CHALLENGE" 60 "HSM_FUNC_SHE_DEBUG_AUTHORIZE" 61 "HSM_FUNC_CHECKSUM" 62 "HSM_FUNC_HASH" 63 "HSM_FUNC_MAC_GENERATE" 64 "HSM_FUNC_MAC_VERIFY" 65 "HSM_FUNC_ENCRYPT" 66 "HSM_FUNC_DECRYPT" 67 "HSM_FUNC_AUTH_ENCRYPT" 68 "HSM_FUNC_AUTH_DECRYPT_X" 69 "HSM_FUNC_SIGN_GENERATE" 70 "HSM_FUNC_SIGN_VERIFY" 71 "HSM_FUNC_DATA_READ_ADAPTED2APP" 72 "HSM_FUNC_DATA_WRITE_ADAPTED2APP" 73 "HSM_FUNC_DATA_DELETE_ADAPTED2APP" 74 "HSM_FUNC_BULK_MAC_VERIFY" 75 "HSM_FUNC_BULK_MAC_GENERATE" 2147483647 "HSM_FUNC_RESERVED" /end COMPU_VTAB
/begin COMPU_VTAB HSM_ModeTag "enumeration table" TAB_VERB 8 1 "HSM_MODE_NOT_STARTED" 2 "HSM_MODE_BOOTING" 3 "HSM_MODE_BOOTLOADER" 4 "HSM_MODE_CORE_APP" 5 "HSM_MODE_INVALID" 6 "HSM_MODE_CORE_APP_STOPPED" 7 "HSM_MODE_SUSPENDED" 2147483647 "HSM_MODE_RESERVED" /end COMPU_VTAB
/begin COMPU_VTAB HSM_PortStatusTag "enumeration table" TAB_VERB 5 0 "HSM_STATUS_IDLE" 1 "HSM_STATUS_PENDING" 2 "HSM_STATUS_PROCESSING" 3 "HSM_STATUS_COMPLETE" 2147483647 "HSM_PORTSTATUS_RESERVED" /end COMPU_VTAB
/begin COMPU_VTAB HV_SERVICE_AVAILABILITY_STATES "enumeration table" TAB_VERB 4 0 "UNAVAILABLE" 1 "AVAILABLE" 2 "HEALING" 3 "DEGRADING" /end COMPU_VTAB
/begin COMPU_VTAB HandsOffDetectionStage "enumeration table" TAB_VERB 5 0 "stage0" 1 "stage1" 2 "stage2" 3 "stage3" 255 "stageNone" /end COMPU_VTAB
/begin COMPU_VTAB HandsOnDetectionInputData "enumeration table" TAB_VERB 4 0 "notProvided" 1 "unknown" 2 "noValidContactDetected" 3 "validContactDetected" /end COMPU_VTAB
/begin COMPU_VTAB HandsOnDetectionSensorType "enumeration table" TAB_VERB 3 0 "unknown" 1 "torque" 2 "capacitive" /end COMPU_VTAB
/begin COMPU_VTAB HandsOnDetectionState "enumeration table" TAB_VERB 3 0 "noValidData" 1 "noValidContact" 2 "validContact" /end COMPU_VTAB
/begin COMPU_VTAB HapticOnlyStates "enumeration table" TAB_VERB 6 0 "noSpeeding" 1 "hapticOnlyInit" 2 "hapticOnlyWarning" 3 "visualAcousticWarning" 4 "visualWarning" 5 "warningTerminated" /end COMPU_VTAB
/begin COMPU_VTAB HazardousGoods "enumeration table" TAB_VERB 8 0 "forAllVehicles" 1 "explosiveGoodsOnly" 2 "waterPollutionGoods" 3 "reserved_3" 4 "reserved_4" 5 "reserved_5" 6 "unknown" 7 "notAvailable" /end COMPU_VTAB
/begin COMPU_VTAB HfStates "enumeration table" TAB_VERB 8 0 "off" 10 "standbySystem" 11 "standbyDriver" 20 "active" 21 "takeoverRequest" 22 "handsonRequest" 23 "emergencySafeStop" 40 "failure" /end COMPU_VTAB
/begin COMPU_VTAB HmiAudioNotificationIdEnum "enumeration table" TAB_VERB 6 0 "noSoundNotification" 1 "notification" 2 "warning" 3 "minimalRiskManeuverSafeStop" 4 "handsOffWarningStage3" 5 "lcrAudioNotification" /end COMPU_VTAB
/begin COMPU_VTAB HmiAuxiliarySymbolEnum "enumeration table" TAB_VERB 23 0 "noDisplay" 1 "collisionWarningBlue" 2 "collisionWarningYellow" 3 "collisionWarningOrange" 4 "collisionWarningRed" 5 "latentWarningIcon" 6 "handsOnAnimationTakeOverRequestYellow" 7 "handsOnAnimationTakeOverRequestRed" 8 "elkAuxiliarySymbolLeft" 9 "elkAuxiliarySymbolRight" 10 "roundaboutSymbol" 11 "strongBrakingAreaSymbol" 12 "dynamicAreaPassedSymbol" 13 "stop" 14 "speedBump" 15 "trafficLights" 16 "railwayCrossing" 17 "yield" 18 "friction" 19 "noCloudConnection" 20 "intersectionWithPriorityIssue" 21 "unknownWarning" 22 "pedestrianCrossing" /end COMPU_VTAB
/begin COMPU_VTAB HmiDisplayedTextMessageIdEnum "enumeration table" TAB_VERB 90 0 "noDisplay" 1 "approachingUnreleasedHighwaySection" 2 "unreleasedHighwaySection" 3 "approachingEndOfHighway" 4 "vehicleNotOnHighway" 5 "laneMarkingsNotPresent" 6 "approachingEndOfLane" 7 "endOfLane" 8 "approachingNarrowLane" 9 "laneWidthTooNarrow" 10 "approachingNarrowCurve" 11 "narrowCurve" 12 "approachingTunnel" 13 "tunnel" 14 "approachingTollGate" 15 "tollGates" 16 "approachingHighwayExit" 17 "highwayExit" 18 "pleaseApplyBrakes" 19 "frontVehicleTooClose" 20 "espIntervention" 21 "espSwitchedOff" 22 "sensorBlocked" 23 "reduceSetSpeed" 24 "aboveSpeedRange" 25 "wrongGearSelected" 26 "otherDriverAssistanceFunctionActive" 27 "pleaseFocusOnTheRoad" 28 "driverNotFocusedOnTheRoad" 29 "pleaseTakeABreak" 30 "takeABreak" 31 "cameraUnableToSeeFace" 32 "pleaseFastenSeatbelt" 33 "seatbeltUnfastened" 34 "openVehicleDoor" 35 "pleaseRemainReadyToInterveneAtAllTimes" 36 "driverMustRemainReadyToInterveneAtAllTimes" 37 "pleaseTakeOverVehicleControl" 38 "hwaHandsfreeNotAvailable" 39 "vehicleStoppingTakeOverVehicleControl" 40 "pleasePutYourHandsOnTheWheel" 41 "pleasePutYourHandsOnTheWheelToConductAutomatedLaneChange" 42 "shwaNotAvailable" 43 "shwaHandsfreeNotAvailable" 44 "speedOutOfRangeRemind" 45 "pleaseHoldTheSteer" 46 "welcomeToHwaHandsfree" 47 "driverDeactivation" 48 "hwaReadyToActivate" 49 "hfNotAvailableDueToProhibition" 50 "neighbouringVehicleTooClose" 51 "behaveAccordingToTheIntendedSystemUsage" 52 "roadConditionInsufficient" 53 "videoSensorBlocked" 54 "adjacentLaneObstructedAlcDisallowed" 55 "activationConditionsForAlcNotFulfilled" 56 "alcFailure" 57 "radarSensorDisturbedForwardSafetyNotAvailable" 58 "radarSensorBlockedAccAndFsfNotAvailable" 59 "laneSystemsFailureContactLocalDealer" 60 "safetyAndComfortFeaturesNotAvailPleaseClearWindscreen" 61 "laneDepartureWarningActive" 62 "emergencyLaneKeepingRoadEdgeHorizontalActive" 63 "emergencyLaneKeepingRoadEdgeVerticalActive" 64 "emergencyLaneKeepingOncomingVehicleActive" 65 "emergencyLaneKeepingSolidLineActive" 66 "emergencyLaneKeepingOvertakingVehicleActive" 67 "vehicleStoppingInLaneTakeOverVehicleControl" 68 "vehicleStoppingInNearStandstillTakeOverVehicleControl" 69 "vehicleStoppingInSecuredStandstillTakeOverVehicleControl" 70 "frequentLaneChangeAreaFollowDistanceIncreased" 71 "dynamicAreaPassed" 72 "bdaNotAvailableDueToMissingVideoSensorInformation" 73 "strongBrakingArea" 74 "roundaboutAhead" 75 "laneChangeLeftTakeOverVehicleControl" 76 "laneChangeRightTakeOverVehicleControl" 77 "stop" 78 "speedBump" 79 "trafficLights" 80 "railwayCrossing" 81 "yield" 82 "roundabout" 83 "friction" 84 "noCloudConnection" 85 "intersectionWithPriorityIssue" 86 "unknownWarning" 87 "pedestrianCrossing" 88 "adasInitializing" 89 "accIsInFailureState" /end COMPU_VTAB
/begin COMPU_VTAB HmiHandOfTraffic "enumeration table" TAB_VERB 3 0 "unkown" 1 "left" 2 "right" /end COMPU_VTAB
/begin COMPU_VTAB HmiHwaStatusEnum "enumeration table" TAB_VERB 8 0 "noDisplay" 1 "notAvailable" 2 "available" 3 "active" 4 "longitudinalOverride" 5 "lateralOverride" 6 "error" 7 "reserved" /end COMPU_VTAB
/begin COMPU_VTAB HmiIndicatorLampRequestSide "enumeration table" TAB_VERB 3 0 "noRequest" 1 "leftIndicatorLampOn" 2 "rightIndicatorLampOn" /end COMPU_VTAB
/begin COMPU_VTAB HmiLedStateEnum "enumeration table" TAB_VERB 16 0 "offState" 1 "initState" 2 "passiveState" 3 "readyState" 4 "requestState" 5 "activeControlState" 6 "activePreWarningState" 7 "handsOnRequestState" 8 "takeOverRequestState" 9 "takeOverRequestEmergencyState" 10 "minimalRiskManeuverState" 11 "prohibitionState" 12 "reserved2" 13 "reserved3" 14 "reserved4" 15 "reserved5" /end COMPU_VTAB
/begin COMPU_VTAB HmiPopupTextMessageEnum "enumeration table" TAB_VERB 4 0 "normalNotification" 1 "popupMessageCenter" 2 "popupMessageRight" 3 "popupMessageLeft" /end COMPU_VTAB
/begin COMPU_VTAB HmiStateMachineError "enumeration table" TAB_VERB 5 0 "None" 1 "Register_Exists" 2 "Register_OOB" 3 "Handler_NotRegistered" 4 "Handler_OOB" /end COMPU_VTAB
/begin COMPU_VTAB HmiSymbolColorLeftEnum "enumeration table" TAB_VERB 8 0 "noDisplay" 1 "gray" 2 "white" 3 "green" 4 "yellow" 5 "red" 6 "blue" 7 "redFlashing" /end COMPU_VTAB
/begin COMPU_VTAB HmiTurnIndicatorStatusEnum "enumeration table" TAB_VERB 4 0 "off" 1 "leftTurnIndicatorOn" 2 "rightTurnIndicatorOn" 3 "hazardLightOn" /end COMPU_VTAB
/begin COMPU_VTAB ImageRelationProvider "enumeration table" TAB_VERB 4 0 "none" 1 "objectCorridorRelation" 2 "ibeaRelations" 3 "ibeaRelationsOnFusObjects" /end COMPU_VTAB
/begin COMPU_VTAB InputDataCheckResult "enumeration table" TAB_VERB 3 0 "ok" 1 "atLeastOneRepeatedTimestamp" 2 "cycleTimeOutOfBounds" /end COMPU_VTAB
/begin COMPU_VTAB InterpolationType "enumeration table" TAB_VERB 5 0 "unknown" 1 "spot" 2 "step" 3 "linear" 4 "higherOrder" /end COMPU_VTAB
/begin COMPU_VTAB IntersectionType "enumeration table" TAB_VERB 4 0 "unknown" 1 "ThreeWay" 2 "FourWay" 3 "Y" /end COMPU_VTAB
/begin COMPU_VTAB LSACombiSwitchFunctionSel "enumeration table" TAB_VERB 4 0 "defaultMode" 1 "autoMode" 2 "park" 3 "lowBeam" /end COMPU_VTAB
/begin COMPU_VTAB LSAManualBeamSel "enumeration table" TAB_VERB 3 0 "defaultMode" 1 "passBeam" 2 "highBeam" /end COMPU_VTAB
/begin COMPU_VTAB LaneAssociation "enumeration table" TAB_VERB 11 0 "LeftEgoLine" 1 "RightEgoLine" 2 "LeftNeighborLine" 3 "RightNeighborLine" 4 "LeftFlatRoadEdge" 5 "RightFlatRoadEdge" 6 "LeftRaisedRoadEdge" 7 "RightRaisedRoadEdge" 8 "NotSelectedCandidate" 9 "LeftEgoCourseLine" 10 "RightEgoCourseLine" /end COMPU_VTAB
/begin COMPU_VTAB LaneAssociationReason "enumeration table" TAB_VERB 22 0 "unknown" 1 "standalone" 2 "overheadOneLane" 3 "overheadAllLanes" 4 "overheadFilteredOut" 5 "overheadLateralFilter" 6 "overheadNotProcessed" 7 "gatePassing" 8 "gateNotPassing" 9 "embedded" 10 "embeddedFilteredOut" 11 "exitAddLeft" 12 "exitAddRight" 13 "exitScenarioLeft" 14 "exitScenarioRight" 15 "filteredOutByLateralDistance" 16 "filteredOutConnectingRoad" 17 "mainSignProbBelowTreshold" 18 "sideRoadLeft" 19 "sideRoadRight" 20 "filteredDueToMoreRelevantSign" 21 "numLaneAssociationReason" /end COMPU_VTAB
/begin COMPU_VTAB LaneBorderColor "enumeration table" TAB_VERB 3 0 "white" 1 "yellow" 2 "unknown" /end COMPU_VTAB
/begin COMPU_VTAB LaneBorderType "enumeration table" TAB_VERB 7 0 "virtualLine" 1 "unknown" 2 "dashed" 3 "solid" 4 "horizontalRoadEdge" 5 "verticalRoadEdge" 6 "constructionElement" /end COMPU_VTAB
/begin COMPU_VTAB LaneChangeObjectRelevance "enumeration table" TAB_VERB 6 0 "startLaneInFrontOfEgo" 1 "targetLaneInFrontOfEgo" 2 "targetLaneBehindEgo" 3 "startLaneBehindEgo" 4 "thirdLaneInFrontOfEgo" 5 "thirdLaneBehindEgo" /end COMPU_VTAB
/begin COMPU_VTAB LaneConnectionType "enumeration table" TAB_VERB 3 0 "unknown" 1 "split" 2 "merge" /end COMPU_VTAB
/begin COMPU_VTAB LaneDirectionType "enumeration table" TAB_VERB 10 0 "unknown" 1 "straight" 2 "left" 3 "right" 4 "straightLeft" 5 "straightRight" 6 "uTurnLeft" 7 "uTurnRight" 8 "slightLeft" 9 "slightRight" /end COMPU_VTAB
/begin COMPU_VTAB LaneId "enumeration table" TAB_VERB 8 0 "Ego" 1 "Left" 2 "Right" 3 "Left2nd" 4 "Right2nd" 5 "Left3rd" 6 "Right3rd" 255 "Unknown" /end COMPU_VTAB
/begin COMPU_VTAB LaneSensitivityButton "enumeration table" TAB_VERB 3 0 "low" 1 "medium" 2 "high" /end COMPU_VTAB
/begin COMPU_VTAB LaneSensitivityMode "enumeration table" TAB_VERB 4 0 "low" 1 "medium" 2 "high" 3 "driverDrowsiness" /end COMPU_VTAB
/begin COMPU_VTAB LaneSide "enumeration table" TAB_VERB 4 0 "undefined" 1 "left" 2 "right" 3 "both" /end COMPU_VTAB
/begin COMPU_VTAB LaneType "enumeration table" TAB_VERB 16 0 "virtualShoulderLane" 1 "normalLane" 2 "exitLane" 3 "entryLane" 4 "auxiliaryLane" 5 "emergencyLane" 6 "restrictedLaneNotAllowedToUse" 7 "restrictedLaneAllowedToUse" 8 "highOccupancyVehicleLane" 9 "expressLane" 10 "reversibleLane" 11 "slowLane" 12 "drivableShoulderLane" 13 "turnLaneOrSuicideLane" 14 "reservedValue" 15 "unknownOrNotAvailable" /end COMPU_VTAB
/begin COMPU_VTAB LaneType_Copy1 "enumeration table" TAB_VERB 3 0 "standardLane" 1 "wideningLane" 2 "narrowingLane" /end COMPU_VTAB
/begin COMPU_VTAB LaneType_Copy2 "enumeration table" TAB_VERB 14 0 "unknown" 1 "normalLane" 2 "exitLane" 3 "entryLane" 4 "auxiliaryLane" 5 "emergencyLane" 6 "restrictedLaneNotAllowedToUse" 7 "restrictedLaneAllowedToUse" 8 "highOccupancyVehicleLane" 9 "expressLane" 10 "reversibleLane" 11 "slowLane" 12 "drivableShoulderLane" 13 "turnLaneOrSuicideLane" /end COMPU_VTAB
/begin COMPU_VTAB LateralDrivingState "enumeration table" TAB_VERB 5 0 "standStill" 1 "straightDriving" 2 "dynamicDriving" 3 "hyperDynamicDriving" 4 "postDynamicDriving" /end COMPU_VTAB
/begin COMPU_VTAB LateralIntention "enumeration table" TAB_VERB 4 0 "laneChangeLeft" 1 "laneKeeping" 2 "laneChangeRight" 3 "invalid" /end COMPU_VTAB
/begin COMPU_VTAB LcmStateId "enumeration table" TAB_VERB 4 0 "init" 1 "passive" 2 "performing" 3 "reinit" /end COMPU_VTAB
/begin COMPU_VTAB LcrLane "enumeration table" TAB_VERB 4 0 "none" 1 "stay" 2 "left" 3 "right" /end COMPU_VTAB
/begin COMPU_VTAB LcrLockoutReason "enumeration table" TAB_VERB 3 0 "standard" 1 "lost" 2 "manoeuvre" /end COMPU_VTAB
/begin COMPU_VTAB LcrState "enumeration table" TAB_VERB 4 0 "running" 1 "lockout" 2 "suppression" 3 "minT" /end COMPU_VTAB
/begin COMPU_VTAB LcrSuppressionReason "enumeration table" TAB_VERB 7 0 "none" 1 "states" 2 "criticality" 3 "egoSpeed" 4 "laneType" 5 "laneWidth" 6 "indicator" /end COMPU_VTAB
/begin COMPU_VTAB LcrType "enumeration table" TAB_VERB 9 0 "none" 1 "base" 2 "roar" 3 "star" 4 "rtl" 5 "lilad" 6 "tad" 7 "rtlPremium" 255 "minT" /end COMPU_VTAB
/begin COMPU_VTAB LedState "enumeration table" TAB_VERB 8 0 "off" 1 "notAvailable" 2 "available" 3 "active" 4 "prewarning" 5 "takeoverRequest" 6 "handsonRequest" 7 "emergencySafeStop" /end COMPU_VTAB
/begin COMPU_VTAB LightFunctionSelHMI "enumeration table" TAB_VERB 3 0 "Default" 1 "ON" 2 "OFF" /end COMPU_VTAB
/begin COMPU_VTAB LightMode "enumeration table" TAB_VERB 4 0 "unknown" 1 "continuous" 2 "blinking" 3 "counting" /end COMPU_VTAB
/begin COMPU_VTAB LineColor "enumeration table" TAB_VERB 6 0 "Unknown" 1 "White" 2 "Yellow" 3 "Red" 4 "Blue" 5 "Green" /end COMPU_VTAB
/begin COMPU_VTAB LineMarking "enumeration table" TAB_VERB 8 0 "noLineMarking" 1 "solidLine" 2 "dashedLine" 3 "leftSolidRightDashedInTrafficDirection" 4 "rightSolidLeftDashedInTrafficDirection" 5 "dashedBlocks" 6 "shadedAreaMarking" 7 "unknownOrNotAvailable" /end COMPU_VTAB
/begin COMPU_VTAB LinePosition "enumeration table" TAB_VERB 14 0 "unknown" 1 "left" 2 "right" 3 "leftLeft" 4 "rightRight" 5 "roadedgeLeft" 6 "roadedgeRight" 7 "raisedLeft" 8 "raisedRight" 9 "egotrackLeft" 10 "egotrackRight" 11 "holisticEgoLineCenter" 12 "holisticEgoLineLeft" 13 "holisticEgoLineRight" /end COMPU_VTAB
/begin COMPU_VTAB LineSource_v0 "enumeration table" TAB_VERB 6 0 "undefined" 1 "videoBoundary" 2 "videoHolisticEgoLine" 3 "map" 4 "roadSideBoundaryLocation" 5 "trafficParticipantTrajectory" /end COMPU_VTAB
/begin COMPU_VTAB LineType "enumeration table" TAB_VERB 7 0 "unknown" 1 "measured" 2 "egoTrack" 3 "virtualLine" 4 "vehicleTrack" 5 "roadBoundary" 6 "holisticEgoLine" /end COMPU_VTAB
/begin COMPU_VTAB LocationRadarSensorState "enumeration table" TAB_VERB 9 0 "hwMalfunction" 1 "dspIssues" 2 "communicationErrors" 3 "misalignment" 4 "sensorBlindnessDetected" 5 "sensorDisturbed" 6 "otherIssues" 7 "reserved" 8 "sensorFullyOperational" /end COMPU_VTAB
/begin COMPU_VTAB LongitudinalControlSettingState "enumeration table" TAB_VERB 9 0 "Off" 1 "DesiredDistanceIncreaseContinuously" 2 "DesiredDistanceIncrease" 3 "DesiredDistanceDecrease" 4 "DesiredSpeedIncreaseSmall" 5 "DesiredSpeedIncreaseLarge" 6 "DesiredSpeedDecreaseSmall" 7 "DesiredSpeedDecreaseLarge" 8 "DesiredSpeedSet" /end COMPU_VTAB
/begin COMPU_VTAB LongitudinalPosition "enumeration table" TAB_VERB 7 0 "closestFront" 1 "secondClosestFront" 2 "closestFrontLeft" 3 "closestFrontRight" 4 "secondClosestFrontLeft" 5 "secondClosestFrontRight" 255 "unknown" /end COMPU_VTAB
/begin COMPU_VTAB LssStates "enumeration table" TAB_VERB 6 0 "off" 1 "passive" 2 "available" 3 "active" 4 "failure" 5 "blindness" /end COMPU_VTAB
/begin COMPU_VTAB MainSign "enumeration table" TAB_VERB 174 0 "none" 1 "speedLimit5" 2 "speedLimit10" 3 "speedLimit15" 4 "speedLimit20" 5 "speedLimit25" 6 "speedLimit30" 7 "speedLimit35" 8 "speedLimit40" 9 "speedLimit45" 10 "speedLimit50" 11 "speedLimit55" 12 "speedLimit60" 13 "speedLimit65" 14 "speedLimit70" 15 "speedLimit75" 16 "speedLimit80" 17 "speedLimit85" 18 "speedLimit90" 19 "speedLimit95" 20 "speedLimit100" 21 "speedLimit105" 22 "speedLimit110" 23 "speedLimit115" 24 "speedLimit120" 25 "speedLimit125" 26 "speedLimit130" 27 "speedLimit135" 28 "speedLimit140" 29 "speedLimit145" 30 "speedLimit150" 31 "speedLimit155" 32 "speedLimit160" 33 "speedLimit3" 34 "speedLimit7" 35 "noRestriction" 36 "endOfSpeedLimit5" 37 "endOfSpeedLimit10" 38 "endOfSpeedLimit15" 39 "endOfSpeedLimit20" 40 "endOfSpeedLimit25" 41 "endOfSpeedLimit30" 42 "endOfSpeedLimit35" 43 "endOfSpeedLimit40" 44 "endOfSpeedLimit45" 45 "endOfSpeedLimit50" 46 "endOfSpeedLimit55" 47 "endOfSpeedLimit60" 48 "endOfSpeedLimit65" 49 "endOfSpeedLimit70" 50 "endOfSpeedLimit75" 51 "endOfSpeedLimit80" 52 "endOfSpeedLimit85" 53 "endOfSpeedLimit90" 54 "endOfSpeedLimit95" 55 "endOfSpeedLimit100" 56 "endOfSpeedLimit105" 57 "endOfSpeedLimit110" 58 "endOfSpeedLimit115" 59 "endOfSpeedLimit120" 60 "endOfSpeedLimit125" 61 "endOfSpeedLimit130" 62 "endOfSpeedLimit135" 63 "endOfSpeedLimit140" 64 "endOfSpeedLimit145" 65 "endOfSpeedLimit150" 66 "endOfSpeedLimit155" 67 "endOfSpeedLimit160" 68 "endOfSpeedLimit3" 69 "endOfSpeedLimit7" 70 "advisorySpeedLimit10" 71 "advisorySpeedLimit20" 72 "advisorySpeedLimit30" 73 "advisorySpeedLimit40" 74 "advisorySpeedLimit50" 75 "advisorySpeedLimit60" 76 "advisorySpeedLimit70" 77 "advisorySpeedLimit80" 78 "advisorySpeedLimit90" 79 "advisorySpeedLimit100" 80 "advisorySpeedLimit110" 81 "advisorySpeedLimit120" 82 "advisorySpeedLimit130" 83 "advisorySpeedLimit140" 84 "advisorySpeedLimit150" 85 "advisorySpeedLimit160" 86 "overtakingProhibitionForCarsLeft" 87 "overtakingProhibitionForCarsRight" 88 "overtakingProhibitionForTrucks" 89 "overtakingProhibitionBikes" 90 "endOfOvertakingProhitionForCars" 91 "endOfOvertakingProhibitionForTrucks" 92 "endOfOvertakingProhibitionBikes" 93 "stop" 94 "yield" 95 "giveWayToOncoming" 96 "priorityOverOncoming" 97 "priorityRoad" 98 "endOfPriorityRoad" 99 "noEntryWrongWay" 100 "noEntryForAny" 101 "noEntryForCars" 102 "noEntryForAnyMotorizedVehicle" 103 "noEntryForTrucks" 104 "noEntryForBuses" 105 "noEntryForDangerousGoods" 106 "noEntryForExplosiveGoods" 107 "noEntryForWaterPollutingGoods" 108 "motorway" 109 "expressway" 110 "townEntry" 111 "calmZone" 112 "endOfMotorway" 113 "endOfExpressway" 114 "endOfCalmZone" 115 "townExit" 116 "cycleStreet" 117 "pedestrianZone" 118 "pedestrianBikeSharedZone" 119 "noPark" 120 "parking" 121 "noWait" 122 "noTurnLeft" 123 "noTurnRight" 124 "noUturn" 125 "mandatoryDirectionAhead" 126 "mandatoryDirectionAheadLeft" 127 "mandatoryDirectionAheadRight" 128 "mandatoryDirectionLeft" 129 "mandatoryDirectionRight" 130 "mandatoryDirectionLeftRight" 131 "mandatoryDirectionLeftInRoundabout" 132 "mandatoryDirectionRightInRoundabout" 133 "pedestrianCrossing" 134 "tunnel" 135 "hazardGeneric" 136 "hazardCurveLeft" 137 "hazardCurveRight" 138 "hazardCurvyRoadLeft" 139 "hazardCurvyRoadRight" 140 "hazardPriorityToDrivingSide" 141 "hazardCrossRoadWithMinorRoad" 142 "hazardRoundaboutAhead" 143 "hazardTrafficLightAhead" 144 "hazardTwoWayTraffic" 145 "hazardTrafficQueue" 146 "hazardSteepAscent" 147 "hazardSteepDescent" 148 "hazardPedestrianCrossingAhead" 149 "hazardChildrenOrSchool" 150 "hazardElderlyPeople" 151 "hazardPedestrianOnRoad" 152 "hazardCyclist" 153 "hazardDomesticAnimal" 154 "hazardWildAnimal" 155 "hazardRoadNarrowsOnLeft" 156 "hazardRoadNarrowsOnRight" 157 "hazardRoadNarrowsBoth" 158 "hazardUnevenSurface" 159 "hazardSpeedBump" 160 "hazardSlipperyRoad" 161 "hazardLooseSurface" 162 "hazardSoftRoadShoulder" 163 "hazardIcyRoad" 164 "hazardFog" 165 "hazardFallingRocks" 166 "hazardStrongCrossWinds" 167 "hazardTunnel" 168 "hazardTram" 169 "hazardTrainCrossing" 170 "hazardTrainCrossingWithBarrier" 171 "hazardRoadWorks" 254 "failureSignal" 255 "notOperational" /end COMPU_VTAB
/begin COMPU_VTAB ManualLaneChangeSupportState "enumeration table" TAB_VERB 4 0 "singleLane" 1 "multiLaneFastest" 2 "multiLaneMiddle" 3 "multiLaneSlowest" /end COMPU_VTAB
/begin COMPU_VTAB MapLevel "enumeration table" TAB_VERB 4 0 "SD" 1 "HD" 2 "PREDICTIVE" 3 "UNKNOWN" /end COMPU_VTAB
/begin COMPU_VTAB MapMatchingStatus "enumeration table" TAB_VERB 4 0 "unknown" 1 "success" 2 "fail" 3 "invalid" /end COMPU_VTAB
/begin COMPU_VTAB MapStatus "enumeration table" TAB_VERB 5 0 "off" 1 "active" 2 "errorCan" 3 "errorPlausibility" 4 "invalid" /end COMPU_VTAB
/begin COMPU_VTAB MeasurementStatus "enumeration table" TAB_VERB 2 0 "estimated" 1 "measured" /end COMPU_VTAB
/begin COMPU_VTAB MessageText "enumeration table" TAB_VERB 8 0 "none" 1 "notAvailable" 2 "available" 3 "pleaseFocusOnTheRoad" 4 "reasonType" 5 "pleaseTakeOverVehicleControl" 6 "pleasePutYourHandsOnTheWheel" 7 "vehicleStoppingTakeOverVehicleControl" /end COMPU_VTAB
/begin COMPU_VTAB MessageType "enumeration table" TAB_VERB 4 0 "none" 1 "information" 2 "interventionRequest" 3 "emergencySafeStop" /end COMPU_VTAB
/begin COMPU_VTAB MetaState "enumeration table" TAB_VERB 15 0 "INVALID" 1 "STARTUP" 2 "REINIT" 3 "PASSIVE" 4 "SHUTDOWN" 5 "OOS" 6 "DEGRADED" 7 "FULL_PERFORMANCE" 8 "BADCONNECTION" 9 "LONG_UNAVAILABLE" 10 "LAT_UNAVAILABLE" 11 "LIMITED_PERFORMANCE" 12 "OOS_LAT_RAMP_OUT" 13 "LAT_UNAVAILABLE_RAMP_OUT" 14 "TOTAL_NUMBER" /end COMPU_VTAB
/begin COMPU_VTAB MissingLaneMarkingOnMiddleLaneScenario "enumeration table" TAB_VERB 4 0 "LargeMiddleLaneScenario" 1 "LeftLaneLeftBorderAndEgoLaneRightBorderScenario" 2 "EgoLaneLeftBorderAndRightLaneRightBorderScenario" 255 "NoScenarioRecognized" /end COMPU_VTAB
/begin COMPU_VTAB MixStates "enumeration table" TAB_VERB 2 0 "passive" 1 "active" /end COMPU_VTAB
/begin COMPU_VTAB MonitoringType "enumeration table" TAB_VERB 20 0 "EMPTY" 1 "BASIC_LINE_QUALITY" 2 "CORRIDOR_LANE_CONSISTENCY" 3 "FREESPACE_COLLISION" 4 "HAZARD_COLLISION" 5 "GEO_COORDINATE_JUMP" 6 "HEADING_CONSISTENCY" 7 "LANE_BORDER_DISTANCE" 8 "LANE_BORDER_VELOCITY" 9 "LANE_PRECISE_LOCALIZATION" 10 "LANE_WIDTH" 11 "NEIGHBORING_LANE_CONSISTENCY" 12 "ONCOMING_TRAFFIC" 13 "ROAD_BOUNDARY" 14 "SHAPE_COMPARISON_MAP_VIDEO" 15 "SHAPE_FUSION_MAP" 16 "SHAPE_FUSION_VIDEO" 17 "SHAPE_CONSISTENCY_MAP_POSITION" 18 "TRANSLATION_VECTOR" 19 "VULNERABLE_ROAD_USER" /end COMPU_VTAB
/begin COMPU_VTAB MotionGoal "enumeration table" TAB_VERB 6 0 "none" 1 "byTci" 2 "evade" 3 "alignWithReferenceLine" 4 "followReferenceLine" 5 "invalid" /end COMPU_VTAB
/begin COMPU_VTAB MotionType "enumeration table" TAB_VERB 4 0 "corridorKeeping" 1 "corridorChangingInLeftDirection" 2 "corridorChangingInRightDirection" 255 "unknown" /end COMPU_VTAB
/begin COMPU_VTAB MutableWarningStates "enumeration table" TAB_VERB 5 0 "noWarning" 1 "active" 2 "suspended" 3 "inactive" 4 "expired" /end COMPU_VTAB
/begin COMPU_VTAB NeighboringVehicleAugmentedData "enumeration table" TAB_VERB 8 0 "normalDriving" 1 "selectedAsLeadVehicle" 2 "locatedInEgoBlindSpot" 3 "closeDistanceToEgo" 4 "strongDeceleration" 5 "strongAcceleration" 6 "laneChangeToLeft" 7 "laneChangeToRight" /end COMPU_VTAB
/begin COMPU_VTAB NeighboringVehicleType "enumeration table" TAB_VERB 8 0 "vehicleNotPresent" 1 "passengerCar" 2 "truck" 3 "motorbike" 4 "other" 5 "reserved1" 6 "reserved2" 7 "error" /end COMPU_VTAB
/begin COMPU_VTAB NonInterpretedAdditionalInfo "enumeration table" TAB_VERB 34 0 "notSet" 1 "addAccident" 2 "addAdvice" 3 "addBegins" 4 "addCrashRisk" 5 "addDirt" 6 "addGravel" 7 "addSpeedBump" 8 "addTrafficJam" 9 "addLowTreeBranches" 10 "addNoStopOnShoulder" 11 "addOilTrail" 12 "addPrioTurn" 13 "addSpeedRadar" 14 "addRappel" 15 "addRoadDamage" 16 "addRuts" 17 "addWorksAccess" 18 "addWorkEntry" 19 "addWorkExit" 20 "addSchool" 21 "addSection" 22 "addGeneralSign" 23 "addSmoke" 24 "addSoftShoulderCar" 25 "addSoftShoulderLorry" 26 "addTextual" 27 "addWithin" 28 "addSl" 29 "kidsAddZoneSl" 30 "warnKidsAddSectionSl" 31 "warnKidsAddZoneSl" 32 "addUnknown" 33 "addDistance" /end COMPU_VTAB
/begin COMPU_VTAB ObjectClassificationType "enumeration table" TAB_VERB 7 0 "unspecified" 1 "twoWheeler" 2 "fourPlusWheeler" 3 "pedestrian" 20 "fourPlusWheelerUnknown" 21 "passengerCar" 22 "truck" /end COMPU_VTAB
/begin COMPU_VTAB ObjectCorridorPosition "enumeration table" TAB_VERB 6 0 "unknown" 1 "onLineLeft" 2 "onLineRight" 3 "sideLeft" 4 "sideRight" 5 "inCorridor" /end COMPU_VTAB
/begin COMPU_VTAB ObjectDrivingDirection "enumeration table" TAB_VERB 4 0 "unknown" 1 "synchronous" 2 "oncoming" 3 "crossing" /end COMPU_VTAB
/begin COMPU_VTAB ObjectMotionDirection "enumeration table" TAB_VERB 4 0 "unspecified" 1 "parallel" 2 "oncoming" 3 "oncomingTurn" /end COMPU_VTAB
/begin COMPU_VTAB ObjectMovingState "enumeration table" TAB_VERB 4 0 "unknown" 1 "standing" 2 "moving" 3 "stopped" /end COMPU_VTAB
/begin COMPU_VTAB ObjectMovingState_Copy1 "enumeration table" TAB_VERB 6 0 "unknown" 1 "standing" 2 "moving" 3 "stopped" 4 "oncoming" 5 "stoppedOncoming" /end COMPU_VTAB
/begin COMPU_VTAB ObjectRadarSensorState "enumeration table" TAB_VERB 17 0 "sensorFullyOperational" 1 "hwMalfunction" 2 "dspIssues" 3 "communicationErrors" 4 "misalignment" 5 "sensorBlindnessDetected" 6 "sensorDisturbed" 7 "otherIssues" 8 "degradedByRequest" 9 "reserved1" 10 "reserved2" 11 "reserved3" 12 "reserved4" 13 "reserved5" 14 "reserved6" 15 "invalid" 255 "outOfRange" /end COMPU_VTAB
/begin COMPU_VTAB ObjectTrackingState "enumeration table" TAB_VERB 6 0 "undefined" 1 "newlyAppeared" 2 "tracked" 3 "replacedWithSimilar" 4 "replacedWithDifferent" 5 "newlyDisappeared" /end COMPU_VTAB
/begin COMPU_VTAB ObjectType "enumeration table" TAB_VERB 14 0 "Unknown" 1 "NonObstacle" 2 "UnknownObstacle" 3 "MobileObstacle" 4 "TwoWheelerUnknown" 5 "Pedestrian" 6 "FourWheelerUnknown" 7 "Truck" 8 "Car" 9 "Bicycle" 10 "Motorcycle" 11 "Bus" 12 "Trailer" 13 "RoadSafetyUnit" /end COMPU_VTAB
/begin COMPU_VTAB Obligation "enumeration table" TAB_VERB 5 0 "unknown" 1 "stop" 2 "stopIfSafe" 3 "giveWay" 4 "proceedIfTraversable" /end COMPU_VTAB
/begin COMPU_VTAB ObstacleBlockingSide "enumeration table" TAB_VERB 3 -1 "Right" 0 "Undefined" 1 "Left" /end COMPU_VTAB
/begin COMPU_VTAB ObstacleSensorIndex "enumeration table" TAB_VERB 19 0 "invalidObstacleSensorIndex" 1 "frontCenterLocationRadar" 2 "frontCenterVideo" 3 "fusedFrontObjectSensor" 3 "envModelSensor" 4 "frontLeftCornerObjectRadar" 5 "frontRightCornerObjectRadar" 6 "rearLeftCornerObjectRadar" 7 "rearRightCornerObjectRadar" 8 "trackedVideoObjectSensor" 9 "frontLeftCornerLocationRadar" 10 "frontRightCornerLocationRadar" 11 "rearLeftCornerLocationRadar" 12 "rearRightCornerLocationRadar" 13 "lidarSensor" 14 "frontCenterObjectRadar" 15 "customObstacleSensorIndex1" 16 "customObstacleSensorIndex2" 255 "maxValueInvalidObstacleSensorIndex" /end COMPU_VTAB
/begin COMPU_VTAB OcclusionState "enumeration table" TAB_VERB 3 0 "notOccluded" 1 "occluded" 2 "notChecked" /end COMPU_VTAB
/begin COMPU_VTAB OffsetDirection "enumeration table" TAB_VERB 3 0 "unknown" 1 "left" 2 "right" /end COMPU_VTAB
/begin COMPU_VTAB OoseqStrategy "enumeration table" TAB_VERB 5 0 "USE" 1 "REWRITE" 2 "DISCARD" 3 "IMPLAUSIBLE" 4 "PLAUSIBLE_QM" /end COMPU_VTAB
/begin COMPU_VTAB OperatingState "enumeration table" TAB_VERB 8 0 "off" 1 "init" 2 "operational" 3 "deactivated" 4 "shutdown" 5 "reserved5" 6 "reserved6" 7 "reserved7" /end COMPU_VTAB
/begin COMPU_VTAB OperatingStateDetailed "enumeration table" TAB_VERB 8 0 "notApplicable" 1 "fusionMode" 2 "visionOnlyMode" 3 "mapOnlyMode" 4 "deactivatedByDriver" 5 "deactivatedByCountryNotSupported" 6 "deactivatedByError" 7 "reserved7" /end COMPU_VTAB
/begin COMPU_VTAB Os_ScheduleTableStatusType "enumeration table" TAB_VERB 5 0 "SCHEDULETABLE_STOPPED" 1 "SCHEDULETABLE_NEXT" 2 "SCHEDULETABLE_WAITING" 3 "SCHEDULETABLE_RUNNING" 4 "SCHEDULETABLE_RUNNING_AND_SYNCHRONOUS" /end COMPU_VTAB
/begin COMPU_VTAB OtherNonInterpretedInfo "enumeration table" TAB_VERB 4 0 "notSet" 1 "embeddedExitSl" 2 "spainOneWaySl" 3 "nonExplRoadTypeContext" /end COMPU_VTAB
/begin COMPU_VTAB OverspeedOffsetUnit "enumeration table" TAB_VERB 2 0 "offsetUnitKph" 1 "offsetUnitMph" /end COMPU_VTAB
/begin COMPU_VTAB OverspeedType "enumeration table" TAB_VERB 4 0 "decelerating" 1 "constantSpeed" 2 "accelerating" 3 "numOverspeedTypes" /end COMPU_VTAB
/begin COMPU_VTAB PER_ALGOS_MBF_TYPES "enumeration table" TAB_VERB 5 0 "TYPE_WNJ" 0 "TYPE_MBF_DEFAULT" 1 "TYPE_LA" 2 "TYPE_FH" 3 "TYPE_CT" /end COMPU_VTAB
/begin COMPU_VTAB PER_PER_TYPES "enumeration table" TAB_VERB 6 1 "TYPE_DEP" 2 "TYPE_SEP" 3 "TYPE_REP" 5 "TYPE_ADEP" 6 "TYPE_ASEP" 7 "TYPE_AREP" /end COMPU_VTAB
/begin COMPU_VTAB PER_REFERENCE_POINTS "enumeration table" TAB_VERB 18 0 "REF_POS_FL" 1 "REF_POS_FC" 2 "REF_POS_FR" 3 "REF_POS_FWL" 4 "REF_POS_FWR" 5 "REF_POS_SML" 6 "REF_POS_SMR" 7 "REF_POS_RWL" 8 "REF_POS_RWR" 9 "REF_POS_RL" 10 "REF_POS_RC" 11 "REF_POS_RR" 12 "REF_POS_CENTER" 13 "REF_POS_RWC" 14 "REF_POS_FWC" 15 "REF_POS_INVALID" 16 "REF_POS_NLR" 17 "REF_POS_NFR" /end COMPU_VTAB
/begin COMPU_VTAB PathIdClassification "enumeration table" TAB_VERB 7 0 "unknown" 1 "uncertain" 2 "special" 3 "stubUnknown" 4 "stubMainPath" 5 "invalid" 6 "normal" /end COMPU_VTAB
/begin COMPU_VTAB PathStartStrategy "enumeration table" TAB_VERB 4 0 "off" 1 "init" 2 "reinit" 3 "normal" /end COMPU_VTAB
/begin COMPU_VTAB PerVideoObjectTypes "enumeration table" TAB_VERB 24 0 "unknown" 1 "passableAbove" 2 "passableBelow" 3 "pedestrian" 4 "pedestrianGroup" 5 "bicycle" 6 "ptw" 7 "car" 8 "van" 9 "truck" 10 "barrier" 11 "animal" 12 "reflector" 13 "type13" 14 "type14" 15 "init" 16 "fourPlusWheeler" 17 "twowheeler" 18 "beacon" 19 "post" 20 "cone" 21 "rickshaw" 22 "carSide" 23 "truckSide" /end COMPU_VTAB
/begin COMPU_VTAB Phase "enumeration table" TAB_VERB 6 0 "passive" 1 "jerkToBrakeHold" 2 "brakeHold" 3 "brakeDecrease" 4 "roll" 5 "stopped" /end COMPU_VTAB
/begin COMPU_VTAB PlausibilizationResult "enumeration table" TAB_VERB 3 -1 "notPlausible" 0 "noResult" 1 "ok" /end COMPU_VTAB
/begin COMPU_VTAB PredictableObjectType "enumeration table" TAB_VERB 3 0 "OT_UNKNOWN" 1 "OT_VEHICLE" 2 "OT_VULNERABLE_ROAD_USER" /end COMPU_VTAB
/begin COMPU_VTAB PredictedStateOfMotion "enumeration table" TAB_VERB 4 0 "unspecified" 1 "stationary" 2 "moving" 3 "stopped" /end COMPU_VTAB
/begin COMPU_VTAB Priority "enumeration table" TAB_VERB 4 0 "A" 1 "B" 2 "parallel" 3 "invalid" /end COMPU_VTAB
/begin COMPU_VTAB PscControlStrategy "enumeration table" TAB_VERB 4 0 "controlOnSpeedLimits" 1 "controlOnCurveSpeed" 2 "controlOnSpeedProfile" 3 "none" /end COMPU_VTAB
/begin COMPU_VTAB RSB_Types "enumeration table" TAB_VERB 9 0 "RSB_TYPE_INVALID" 1 "RSB_TYPE_LEFT_ELEVATED" 2 "RSB_TYPE_RIGHT_ELEVATED" 3 "RSB_TYPE_LEFT_ROADEDGE" 4 "RSB_TYPE_RIGHT_ROADEDGE" 5 "RSB_TYPE_LEFT_ELEVATED_VIDEO" 6 "RSB_TYPE_LEFT_ELEVATED_RADAR" 7 "RSB_TYPE_RIGHT_ELEVATED_VIDEO" 8 "RSB_TYPE_RIGHT_ELEVATED_RADAR" /end COMPU_VTAB
/begin COMPU_VTAB RbvmiBrakeDiscTemperatureStatus "enumeration table" TAB_VERB 4 0 "level3" 1 "level2" 2 "level1" 3 "normal" /end COMPU_VTAB
/begin COMPU_VTAB RbvmiBrakeDiscTemperatureStatusAvailability "enumeration table" TAB_VERB 3 0 "notAvailable" 1 "failure" 2 "available" /end COMPU_VTAB
/begin COMPU_VTAB ReactionPatternType "enumeration table" TAB_VERB 7 0 "undefined" 1 "laneDriving" 2 "laneChange" 3 "emergencyAvoidance" 4 "immediateBrake" 5 "returnToLane" 6 "activeWarning" /end COMPU_VTAB
/begin COMPU_VTAB Reason "enumeration table" TAB_VERB 4 0 "Undefined" 1 "UrbanParking" 2 "Truck" 3 "Guardrail" /end COMPU_VTAB
/begin COMPU_VTAB ReasonType "enumeration table" TAB_VERB 43 0 "notApplicable" 1 "higherPrioFunctionActive" 2 "laneMarkingsInsufficient" 3 "egoTooCloseToLaneMarking" 4 "ttcLongTooSmall" 5 "ttcLatTooSmall" 6 "speedLimitViolation" 7 "wrongGear" 8 "doorOpen" 9 "brakePedalPressed" 10 "driverPedalOverride" 11 "driverNotPresentSeatbelt" 12 "driverNotPresentDMS" 13 "driverNotAttentive" 14 "driverDrowsy" 15 "driverSpoofing" 16 "driverConductingMisuse" 17 "espIntervention" 18 "espNotActivated" 19 "egoHeadingAngle" 20 "carMode" 21 "drivingMode" 22 "engineStatus" 23 "accelLong" 24 "accelLat" 25 "epbActive" 26 "failureMinor" 27 "failureNoImminentHazard" 28 "failureMajor" 29 "failureBrakeDefect" 30 "failureHmiDefect" 31 "unreleasedHighwaySection" 32 "endOfHighway" 33 "endOfLane" 34 "narrowLane" 35 "narrowCurve" 36 "constructionZone" 37 "tunnel" 38 "tollGate" 39 "highwayExit" 40 "reducedSensorSight" 41 "roadConditionInsufficient" 42 "lateralButtonPressed" /end COMPU_VTAB
/begin COMPU_VTAB ReferenceCorridor "enumeration table" TAB_VERB 8 0 "unknown" 1 "ego" 2 "left" 3 "right" 4 "egoLane" 5 "egoTrack" 6 "egoVehicleTrack" 7 "road" /end COMPU_VTAB
/begin COMPU_VTAB ReferenceLineMotionGoal_v0 "enumeration table" TAB_VERB 1 0 "follow" /end COMPU_VTAB
/begin COMPU_VTAB ReferenceLineState "enumeration table" TAB_VERB 3 0 "unknown" 1 "notCrossed" 2 "crossed" /end COMPU_VTAB
/begin COMPU_VTAB RegulatingLane "enumeration table" TAB_VERB 3 0 "invalid" 1 "startLane" 2 "targetLane" /end COMPU_VTAB
/begin COMPU_VTAB RegulatoryElementRelationType "enumeration table" TAB_VERB 5 0 "StandardLane" 1 "WideningLane" 2 "CRWoLaneMarking" 3 "RoadEdgeCombination" 4 "NarrowingLane" /end COMPU_VTAB
/begin COMPU_VTAB RelationCalculationStrategy "enumeration table" TAB_VERB 3 0 "discretePolyline" 1 "egoDrivingCorridor" 255 "Invalid" /end COMPU_VTAB
/begin COMPU_VTAB RelativeLaneRelation "enumeration table" TAB_VERB 4 0 "left" 1 "ego" 2 "right" 255 "unknown" /end COMPU_VTAB
/begin COMPU_VTAB Reliability "enumeration table" TAB_VERB 3 0 "invalid" 1 "predicted" 2 "measured" /end COMPU_VTAB
/begin COMPU_VTAB RestrictionType "enumeration table" TAB_VERB 13 0 "unspecified" 1 "genericImageBasedObject" 2 "matchedGenericImageBasedObject" 3 "redTrafficLight" 4 "yellowTrafficLight" 5 "narrowingCorridor" 6 "deltaSpeed" 7 "stopSign" 8 "greenTrafficLight" 9 "yellowBlinkingTrafficLight" 10 "turnedOffTrafficLight" 11 "speedLimitSign" 12 "curvature" /end COMPU_VTAB
/begin COMPU_VTAB RightOfWay "enumeration table" TAB_VERB 4 0 "drivingInHasPriority" 1 "drivingInHasToYield" 2 "unknownRightOfWay" 3 "notAvailable" /end COMPU_VTAB
/begin COMPU_VTAB RightOfWayElementType "enumeration table" TAB_VERB 11 0 "unknown" 1 "yieldSign" 2 "stopSign" 3 "stopLine" 4 "pedestrianCrossing" 5 "pedestrianCrossingSign" 6 "railwayCrossing" 7 "railwayCrossingSign" 8 "hasToYield" 9 "intersectionWithMinorRoad" 10 "dangerousIntersection" /end COMPU_VTAB
/begin COMPU_VTAB RoadClass "enumeration table" TAB_VERB 4 0 "expressway" 1 "speedway" 2 "other" 3 "unknown" /end COMPU_VTAB
/begin COMPU_VTAB RoadConditionStates "enumeration table" TAB_VERB 4 0 "Dry" 1 "Wet" 2 "Snowy" 3 "Invalid" /end COMPU_VTAB
/begin COMPU_VTAB RoadIlluminationReason "enumeration table" TAB_VERB 8 0 "noReason" 1 "no3DPos" 2 "noMotionData" 3 "highDynamicSit" 4 "insufficientNumberOfValidStreetLight" 5 "noStreetLightPassed" 6 "streetLightSuppressed" 7 "verticalSpreadNotFulfilled" /end COMPU_VTAB
/begin COMPU_VTAB RoadIlluminationStatus "enumeration table" TAB_VERB 3 0 "detected" 1 "notDetected" 2 "notAvailable" /end COMPU_VTAB
/begin COMPU_VTAB RoadLineColor "enumeration table" TAB_VERB 5 0 "unknown" 1 "white" 2 "yellow" 3 "red" 4 "blue" /end COMPU_VTAB
/begin COMPU_VTAB RoadLineType "enumeration table" TAB_VERB 9 0 "virtualLine" 1 "unknown" 2 "dashed" 3 "solid" 4 "dashedExcept" 5 "solidExcept" 6 "roadEdge" 7 "constructionElement" 255 "invalidType" /end COMPU_VTAB
/begin COMPU_VTAB RoadSignType "enumeration table" TAB_VERB 429 0 "UNKNOWN" 1 "SL5" 2 "SL10" 3 "SL15" 4 "SL20" 5 "SL25" 6 "SL30" 7 "SL35" 8 "SL40" 9 "SL45" 10 "SL50" 11 "SL55" 12 "SL60" 13 "SL65" 14 "SL70" 15 "SL75" 16 "SL80" 17 "SL85" 18 "SL90" 19 "SL95" 20 "SL100" 21 "SL105" 22 "SL110" 23 "SL115" 24 "SL120" 25 "SL125" 26 "SL130" 27 "SL135" 28 "SL140" 29 "SL145" 30 "SL150" 31 "SL155" 32 "SL160" 33 "OP" 34 "OL" 35 "ESL" 36 "EOP" 37 "EOL" 38 "EA" 77 "ADDCAR" 78 "ADDLORRY" 79 "ADDTRAILER" 80 "ADDCARAVAN" 81 "ADDBUS" 82 "ADDTRACTOR" 83 "ADDMCYCLE" 84 "ADDLORRYBUSTRAILER_DEPRECATED" 85 "ADDLORRYBUS_DEPRECATED" 86 "ADDHAZMAT" 87 "ADDTANK" 88 "ADDTRAM" 89 "ADDWET" 90 "ADDFOG" 91 "ADDRAIN" 92 "ADDSNOW" 93 "ADDTIME" 94 "ADDSECTION" 95 "ADDDISTANCE" 96 "ADDWEIGHT" 97 "ADDEXITL" 98 "ADDEXITR" 99 "ADDLANES" 100 "ADDRADAR" 101 "ADDRAPPEL" 102 "ADDPRIOTURN" 103 "ADDLORRY_EXCEPT" 104 "ADDTRACTOR_OVER" 105 "NOENTRY" 106 "NOALL" 107 "NOCAR" 108 "NOLORRY" 109 "NOHAZMAT" 110 "NOBIKE" 111 "NOPED" 112 "NOCARBIKE" 113 "NOTWOWAY" 114 "WEIGHT" 115 "HEIGHT" 116 "WIDTH" 117 "LENGTH" 118 "PRIOCROSS" 119 "GIVEWAY" 120 "PRIOCROSSYIELDTORIGHT" 121 "WARNDANGER" 122 "WARNCURVEL" 123 "WARNCURVER" 124 "WARNDCURVEL" 125 "WARNDCURVER" 126 "WARNTRAIN" 127 "WARNJAM" 128 "WARNANIMAL_DEPRECATED" 129 "WARNRWORKS" 130 "WARNSLOPED" 131 "WARNSLOPEU" 132 "PRIOSTREET" 133 "EPRIOSTREET" 134 "STOP" 135 "EXIT" 136 "ASL" 137 "EASL" 138 "MSL" 139 "EMSL" 140 "MLC" 141 "WBDIAGL" 142 "WBDIAGR" 143 "WBROUND" 144 "NOLTURN" 145 "NORTURN" 146 "NOUTURN" 147 "NOPARK" 148 "NOSTOP" 149 "SMOG" 150 "UMWELT" 151 "EUMWELT" 152 "DOUANE" 153 "LOGO_LIDL" 154 "LOGO_ESSO" 155 "LOGO_SHELL" 156 "LOGO_VW" 157 "PICT_HOTEL" 158 "PICT_PHONE" 159 "PICT_FOOD" 160 "LAMP" 161 "ADDTEXT" 162 "REJECTION" 163 "ADDSIGN" 164 "FWAY" 165 "EFWAY" 166 "HWAY" 167 "EHWAY" 168 "NORIDER" 169 "ADDRAINSNOW" 170 "ADDHUMP" 171 "WARNCONST" 172 "WARNCONSTL" 173 "WARNCONSTR" 174 "WARNPED" 175 "WARNKIDS" 176 "WARNBIKE" 177 "WARNSKID" 178 "ZEBRA" 179 "ONEWAYS" 180 "ONEWAYU" 184 "ADDLORRYTRAILER_DEPRECATED" 185 "SLOWDOWN" 186 "NOCARRIAGE" 187 "NOLORRYTRAILER" 188 "NOBUS" 189 "NOTRACTOR" 190 "LORRYDIST" 191 "CARDIST" 192 "WARNROUND" 193 "WARNWILDANIMAL" 194 "WARNCATTLE" 195 "WARNFROG" 196 "WARNBUS" 197 "WARNWIND" 198 "WARNSNOW" 199 "WARNPCROSS" 200 "WARNHUMP" 201 "WARNROCK" 202 "WARNLOWTREE" 203 "WARNGRAVEL" 204 "WARNTWOWAY" 205 "WARNLIGHTS" 206 "WARNPLANE" 207 "ADDCAMPER" 208 "ADDZONE" 209 "ADDCRASHRISK" 210 "ADDACCIDENT" 211 "ADDJAM" 212 "ADDSMOKE" 213 "ADDOILTRAIL" 214 "ADDGRAVEL" 215 "ADDDIRT" 216 "ADDRWORKSEXIT" 217 "ADDROADDAMAGE" 218 "ADDRWORKSENTRY" 219 "ADDLOWTREE" 220 "ADDRWORKSACCESS" 221 "ADDRUTS" 222 "ADDSOFTSHOULDERCAR" 223 "ADDSOFTSHOULDERLORRY" 270 "CALM" 271 "ECALM" 272 "TWN" 273 "ETWN" 274 "DEADEND" 275 "AXLEWEIGHT" 276 "WARNRIDER" 277 "WARNDRAWBRIDGE" 278 "WARNPIER" 279 "TRINATURE" 288 "WBBENTLEFT" 289 "WBBENTLEFTRIGHT" 290 "WBBENTRIGHT" 291 "WBDIAGLR" 292 "WBLEFT" 293 "WBRIGHT" 294 "WBUP" 295 "WBUPLEFT" 296 "WBUPRIGHT" 297 "ADDNOSTOPSHOULDER" 298 "ADDTOWING" 299 "ADDSCHOOL" 300 "ADDNIGHT" 301 "ADDEND" 302 "ADDBEGINS" 303 "ADDWITHIN" 304 "WBHAZWATER" 305 "NOHAZWATER" 306 "ADDDISTANCEBARS" 307 "ADDMINIMUM" 308 "ADDADVICE" 309 "SCHOOL" 310 "ESCHOOL" 311 "HAZMAT" 312 "WARNCURVE" 313 "WARNRIVERBANK" 314 "WARNRIVERBANKL" 315 "WARNDIP" 316 "WARNCYCLIST" 317 "WARNINTERSECTION" 318 "WARNDANGERINT" 319 "WARNINTWITHMINOR" 320 "WARNTRAM" 321 "PRIOFORONCOMINGTRAFFIC" 322 "PRIOOVERONCOMINGTRAFFIC" 323 "PASSRIGHT" 324 "PASSLEFTORRIGHT" 325 "PASSLEFT" 326 "TUNNEL" 327 "LANEMERGER" 328 "LANEMERGEL" 329 "LANEMERGEC" 330 "WARNBRIDGE" 331 "FERRYTERMINAL" 332 "WARNICYROAD" 333 "WARNSTEEPDROPR" 334 "WARNSTEEPDROPL" 335 "WARNROADFLOODS" 336 "WARNACCIDENT" 337 "SL" 338 "ADDACCESS" 339 "ADDALLWAY" 340 "ADDBUS_EXCEPT" 341 "ADDEXCEPTDELIVERY" 342 "ADDEXCEPTLOCAL" 343 "ADDFROG" 344 "ADDPRIOTURNL" 345 "ADDPRIOTURNR" 346 "ADDSTART" 347 "ADDSTOPIN" 348 "EMERGENCYBAY" 349 "ENDOFLANEL" 350 "ENDOFLANER" 351 "ENOPARK" 352 "EONEWAY" 353 "EPARK" 354 "ETOLL" 355 "NOPARKL" 356 "NOPARKLR" 357 "NOPARKR" 358 "NOSTOPL" 359 "NOSTOPLR" 360 "NOSTOPR" 361 "NOTURNONRED" 362 "ONEWAYL" 363 "ONEWAYR" 364 "PARK" 365 "PRIOCROSSL" 366 "PRIOCROSSR" 367 "TOLL" 368 "TWOWAY" 369 "WARNCROSS" 370 "WARNCROSSL" 371 "WARNCROSSLR" 372 "WARNCROSSR" 373 "WARNCROSSRL" 374 "WARNCROSST" 375 "WARNGIVEWAYAHEAD" 376 "WARNSLAHEAD" 377 "WARNSTOPAHEAD" 378 "WBBUS" 379 "WRONGWAY" 380 "ADDEXIT" 381 "HAZWATER" 382 "GIVEWAYROUND" 383 "WARNWINDINGL" 384 "WARNWINDINGR" 385 "WARNHAIRPINL" 386 "WARNHAIRPINR" 387 "WARNPEDBIKE" 388 "WARNCROSSY" 389 "WARNBRANCHL" 390 "WARNBRANCHR" 391 "WARNAXLEWEIGHT" 392 "WARNWEIGHT" 393 "WARNHEIGHT" 394 "WARNLENGTH" 395 "WARNWIDTH" 396 "WARNBLACKSPOT" 397 "WARNMERGEL" 398 "WARNMERGER" 399 "WARNTUNNEL" 400 "WARNTRACTOR" 401 "WARNRWORKSVEHICLE" 402 "WARNNARROWBRIDGE" 403 "WARNFLAGGER" 404 "LANES" 405 "LANESHIFTL" 406 "LANESHIFTR" 407 "NEWLANEL" 408 "NEWLANER" 409 "RIGHTTURNONRED" 410 "BORDERLIMIT" 411 "EMBEDDEDRAIN" 412 "ADDHAZWATER" 413 "ADDDAY" 414 "ADDSL" 426 "NOUP" 428 "ASL5" 429 "ASL10" 430 "ASL15" 431 "ASL20" 432 "ASL25" 433 "ASL30" 434 "ASL35" 435 "ASL40" 436 "ASL45" 437 "ASL50" 438 "ASL55" 439 "ASL60" 440 "ASL65" 441 "ASL70" 442 "ASL75" 443 "ASL80" 444 "ASL85" 445 "ASL90" 446 "ASL95" 447 "ASL100" 448 "ASL105" 449 "ASL110" 450 "ASL115" 451 "ASL120" 452 "ASL125" 453 "ASL130" 454 "ASL135" 455 "ASL140" 456 "ASL145" 457 "ASL150" 458 "ASL155" 459 "ASL160" 492 "WARNTRAINGATED" 493 "ADDLORRYTRAILER" 494 "ADDLORRYSEMI" 497 "KEEPRIGHTCAR" 498 "ASLCURVE5" 499 "ASLCURVE10" 500 "ASLCURVE15" 501 "ASLCURVE20" 502 "ASLCURVE25" 503 "ASLCURVE30" 504 "ASLCURVE35" 505 "ASLCURVE40" 506 "ASLCURVE45" 507 "ASLCURVE50" 508 "ASLCURVE55" 509 "ASLCURVE60" 510 "ASLCURVE65" 511 "ASLCURVE70" 512 "ASLCURVE75" 513 "ASLCURVE80" 514 "ASLCURVE85" 515 "ASLCURVE90" 516 "ASLCURVE95" 517 "ASLCURVE100" 518 "ASLCURVE105" 519 "ASLCURVE110" 520 "ASLCURVE115" 521 "ASLCURVE120" 522 "ASLCURVE125" 523 "ASLCURVE130" 524 "ASLCURVE135" 525 "ASLCURVE140" 526 "ASLCURVE145" 527 "ASLCURVE150" 528 "ASLCURVE155" 529 "ASLCURVE160" 530 "ADDSLOW" 531 "KIDS" 532 "EKIDS" 533 "BIKEROAD" 534 "EBIKEROAD" 535 "PEDSTREET" 536 "EPEDSTREET" 537 "PEDBIKESTREET" 538 "EPEDBIKESTREET" 539 "EWARNKIDS" 572 "CALM20" 573 "CALM30" 574 "ECALM20" 575 "ECALM30" 576 "FWAYGREEN" 577 "TWN40" 578 "TWN50" 579 "TWN60" 580 "TWN70" 581 "ETWN40" 582 "ETWN50" 583 "ETWN60" 584 "ETWN70" 585 "WBBIKE" 586 "EWBBIKE" 587 "WBPED" 588 "EWBPED" 589 "WBPEDBIKESEP" 590 "EWBPEDBIKESEP" 591 "WBPEDBIKESHARED" 592 "EWBPEDBIKESHARED" 593 "ADDBIKEROAD" 594 "ADDLANES_DEPRECATED" 595 "ADDPRIOTURN_DEPRECATED" 596 "ADDMINIMUM_DEPRECATED" 597 "OFF" 598 "EFWAYGREEN" 599 "ADDLORRYTRAILER_EXCEPT" 600 "ADDLORRYSEMI_EXCEPT" 601 "COUNT" /end COMPU_VTAB
/begin COMPU_VTAB RoadSituationType "enumeration table" TAB_VERB 11 0 "unknown" 1 "intersection" 2 "exitZone" 3 "enterZone" 4 "roundabout" 5 "constructionZone" 6 "turnToNewRoad" 7 "tunnel" 8 "tollStation" 9 "laneSplit" 10 "laneMerge" /end COMPU_VTAB
/begin COMPU_VTAB RoadTopologySituationType "enumeration table" TAB_VERB 11 0 "Highway" 1 "HighwayExit" 2 "CountryRoadWoLaneMarking" 3 "Crossing" 4 "HighwayExitLeft" 5 "ValidSituation" 6 "NoSituation" 7 "EndOfLaneTowardsLeft" 8 "EndOfLaneTowardsRight" 100 "FallbackMode" 255 "Unknown" /end COMPU_VTAB
/begin RECORD_LAYOUT __UBYTE_Z FNC_VALUES 1 UBYTE ROW_DIR DIRECT ALIGNMENT_FLOAT64_IEEE 8 ALIGNMENT_INT64 8 /end RECORD_LAYOUT
/begin RECORD_LAYOUT __UByte_Value FNC_VALUES 1 UBYTE ROW_DIR DIRECT ALIGNMENT_FLOAT64_IEEE 8 ALIGNMENT_INT64 8 /end RECORD_LAYOUT
/begin GROUP Aurix "Measurements when using Infineon Aurix"
 /begin REF_MEASUREMENT VX14xx.mon.aurix.aurora.rxFreqKHz VX14xx.mon.aurix.dapFreqkHz VX14xx.mon.aurix.errorMsgCnt VX14xx.mon.aurix.lastAddrBeforeEcuOverrun VX14xx.mon.aurix.retransmitCnt /end REF_MEASUREMENT
/end GROUP
/begin GROUP Nexus "Measurements when using Nexus AUX Trace Interface of PowerPC MCUs"
 /begin REF_MEASUREMENT VX14xx.mon.nexus.aurora.rxFreqKHz VX14xx.mon.nexus.aux.freqKHz VX14xx.mon.nexus.ecuOverrunCnt VX14xx.mon.nexus.ecuStallCnt VX14xx.mon.nexus.lastAddrBeforeEcuOverrun /end REF_MEASUREMENT
/end GROUP
/begin GROUP RH850 "Measurements when using Renesas RH850 Data Trace"
 /begin REF_MEASUREMENT VX14xx.mon.rh850.aud.audFifoMax VX14xx.mon.rh850.aurora.rxFreqKHz VX14xx.mon.rh850.ecuOverrunCnt VX14xx.mon.rh850.lastAddrBeforeEcuOverrun VX14xx.mon.rh850.lastErrorMsgInfo /end REF_MEASUREMENT
/end GROUP
/begin GROUP RIF "Measurements when using the Radar RAW Data Interface" /begin REF_MEASUREMENT VX14xx.mon.rif1.crcErrorCnt /end REF_MEASUREMENT /end GROUP
/begin GROUP RTPDMM "Measurements when using the TI TMS570 RTP/DMM Data Trace Interface"
 /begin REF_MEASUREMENT VX14xx.mon.rtpdmm.dmmFreqKHz VX14xx.mon.rtpdmm.dmmStopCnt VX14xx.mon.rtpdmm.rtpFreqKHz VX14xx.mon.rtpdmm.rtpStopCnt /end REF_MEASUREMENT
/end GROUP
/begin GROUP VX1000 "" ROOT /begin SUB_GROUP VX1060 VX113x VX14xx sys /end SUB_GROUP /end GROUP
/begin GROUP VX1060 "VX1060 Base Module internal Measurements"
 /begin REF_MEASUREMENT VX106x.mon.monEvtCntDword VX106x.mon.serial.niosDapErrorCounter VX106x.mon.serial.niosMaxDapLoad VX106x.mon.serial.niosOldaOverruns VX106x.mon.te.tfifo.extRamMaxByte VX106x.mon.xcpe.evtFifoMax /end REF_MEASUREMENT
/end GROUP
/begin GROUP VX113x "VX113x Base Module internal Measurements"
 /begin REF_MEASUREMENT VX113x.mon.bmTemperature VX113x.mon.hssl.TxFreqKHz VX113x.mon.hssl.pipe0RxCnt VX113x.mon.hssl.pipe1RxCnt VX113x.mon.hssl.pipe2RxCnt VX113x.mon.hssl.retransDLCnt VX113x.mon.hssl.retransULCnt VX113x.mon.monEvtCntDword VX113x.mon.serial.niosDapErrorCounter VX113x.mon.serial.niosMaxDapLoad VX113x.mon.serial.niosOldaOverruns VX113x.mon.te.tfifo.extRamMaxByte VX113x.mon.xcpe.evtFifoMax /end REF_MEASUREMENT
/end GROUP
/begin GROUP VX14xx "VX14xx POD internal Measurements"
 /begin REF_MEASUREMENT VX14xx.mon.monEvtCntDword VX14xx.mon.pcie.overloadCnt VX14xx.mon.pod.temperature VX14xx.mon.trace.adconInputCnt VX14xx.mon.trace.adfilOutputCnt VX14xx.mon.traceBuffer.externalMax VX14xx.mon.traceBuffer.outMax /end REF_MEASUREMENT
 /begin SUB_GROUP Aurix Nexus RH850 RIF RTPDMM /end SUB_GROUP
/end GROUP
/begin GROUP sys "VX1060, VX113x and VX1621 internal Measurements"
 /begin REF_CHARACTERISTIC VX1000.sys.usrCustomer VX1000.sys.usrPosition VX1000.sys.usrProject VX1000.sys.usrSample /end REF_CHARACTERISTIC
 /begin REF_MEASUREMENT VX1000.sys.ecuEdJtagId VX1000.sys.ecuJtagId VX1000.sys.ecuProcName VX1000.sys.ecuProcNameLen VX1000.sys.fpgaLeftVer VX1000.sys.fpgaLeftVer.build VX1000.sys.fpgaLeftVer.major VX1000.sys.fpgaLeftVer.minor VX1000.sys.fwVer VX1000.sys.fwVer.build VX1000.sys.fwVer.major VX1000.sys.fwVer.minor VX1000.sys.podECUIdMiscNumber VX1000.sys.podECUIdMuster VX1000.sys.podECUIdPosition VX1000.sys.podECUIdProject VX1000.sys.podFpgaVer VX1000.sys.podFpgaVer.build VX1000.sys.podFpgaVer.major VX1000.sys.podFpgaVer.minor VX1000.sys.podFwVer VX1000.sys.podFwVer.build VX1000.sys.podFwVer.major VX1000.sys.podFwVer.minor VX1000.sys.podHwTypeRev VX1000.sys.podVX1902HwTypeRev VX1000.sys.podVX1902VectorSerNo VX1000.sys.podVectorArtNo VX1000.sys.podVectorSerNo VX1000.sys.upTimeS VX1000.sys.vectorArtNo VX1000.sys.vectorSerNo /end REF_MEASUREMENT
/end GROUP
/end MODULE
/end PROJECT
