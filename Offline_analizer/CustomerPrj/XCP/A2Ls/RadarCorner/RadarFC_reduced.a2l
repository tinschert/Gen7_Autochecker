/* generated by ASAP2 Studio 2.2.52.10934 */ ASAP2_VERSION 1 71
/begin PROJECT GHS_PPC5674K ""
/begin MODULE CPP ""
/begin MOD_PAR "" NO_OF_INTERFACES 1
 /begin MEMORY_SEGMENT CALRAM "" DATA FLASH INTERN 0x30028 0xD88 -1 -1 -1 -1 -1
  /begin IF_DATA XCP
   /begin SEGMENT 0x00 0x01 0x00 0x00 0x00
    /begin PAGE 0x00 ECU_ACCESS_DONT_CARE XCP_READ_ACCESS_DONT_CARE XCP_WRITE_ACCESS_NOT_ALLOWED /end PAGE
    /begin ADDRESS_MAPPING 0x03001C 0x03001C 0x01D0 /end ADDRESS_MAPPING
   /end SEGMENT
  /end IF_DATA
 /end MEMORY_SEGMENT
/end MOD_PAR
/begin MOD_COMMON "" DEPOSIT ABSOLUTE ALIGNMENT_BYTE 1 ALIGNMENT_WORD 1 ALIGNMENT_LONG 1 ALIGNMENT_FLOAT16_IEEE 2 ALIGNMENT_FLOAT32_IEEE 1 ALIGNMENT_FLOAT64_IEEE 1 ALIGNMENT_INT64 1 /end MOD_COMMON
/begin IF_DATA XCP
 /begin PROTOCOL_LAYER 0x0104 0x09C4 0xC8 0x00 0x00 0x00 0x00 0x00 0xFA 0xFA BYTE_ORDER_MSB_LAST ADDRESS_GRANULARITY_BYTE OPTIONAL_CMD PROGRAM_PREPARE OPTIONAL_CMD PROGRAM_RESET OPTIONAL_CMD PROGRAM OPTIONAL_CMD PROGRAM_CLEAR OPTIONAL_CMD PROGRAM_START OPTIONAL_CMD ALLOC_ODT_ENTRY OPTIONAL_CMD ALLOC_ODT OPTIONAL_CMD ALLOC_DAQ OPTIONAL_CMD FREE_DAQ OPTIONAL_CMD GET_DAQ_EVENT_INFO OPTIONAL_CMD GET_DAQ_RESOLUTION_INFO OPTIONAL_CMD GET_DAQ_PROCESSOR_INFO OPTIONAL_CMD GET_DAQ_CLOCK OPTIONAL_CMD START_STOP_SYNCH OPTIONAL_CMD START_STOP_DAQ_LIST OPTIONAL_CMD GET_DAQ_LIST_MODE OPTIONAL_CMD SET_DAQ_LIST_MODE OPTIONAL_CMD WRITE_DAQ OPTIONAL_CMD SET_DAQ_PTR OPTIONAL_CMD CLEAR_DAQ_LIST OPTIONAL_CMD SHORT_DOWNLOAD OPTIONAL_CMD DOWNLOAD_MAX OPTIONAL_CMD DOWNLOAD OPTIONAL_CMD SHORT_UPLOAD OPTIONAL_CMD UPLOAD OPTIONAL_CMD SET_MTA OPTIONAL_CMD GET_COMM_MODE_INFO /end PROTOCOL_LAYER
 /begin DAQ DYNAMIC 0x00 0x1B 0x00 OPTIMISATION_TYPE_DEFAULT ADDRESS_EXTENSION_FREE IDENTIFICATION_FIELD_TYPE_RELATIVE_BYTE GRANULARITY_ODT_ENTRY_SIZE_DAQ_BYTE 0xF8 OVERLOAD_INDICATION_PID /begin STIM GRANULARITY_ODT_ENTRY_SIZE_STIM_BYTE 0xF8 /end STIM /begin TIMESTAMP_SUPPORTED 0x01 SIZE_DWORD UNIT_1US /end TIMESTAMP_SUPPORTED /begin EVENT "core0_t10" "core0_t10" 0x01 DAQ 0xFF 0x01 0x07 0x00 /end EVENT /begin EVENT "core0_t20" "core0_t20" 0x02 DAQ 0xFF 0x02 0x07 0x00 /end EVENT /begin EVENT "core0_bg" "core0_bg" 0x04 DAQ 0xFF 0x05 0x07 0x00 /end EVENT /begin EVENT "core0_t100" "core0_t10" 0x03 DAQ 0xFF 0x01 0x08 0x00 /end EVENT /begin EVENT "core1_t10" "core1_t10" 0x05 DAQ 0xFF 0x01 0x07 0x00 /end EVENT /begin EVENT "core1_t20" "core1_t20" 0x06 DAQ 0xFF 0x02 0x07 0x00 /end EVENT /begin EVENT "core1_bg" "core1_bg" 0x08 DAQ 0xFF 0x05 0x07 0x00 /end EVENT /begin EVENT "core1_t100" "core1_t10" 0x07 DAQ 0xFF 0x01 0x08 0x00 /end EVENT /begin EVENT "core2_t10" "core2_t10" 0x09 DAQ 0xFF 0x01 0x07 0x00 /end EVENT /begin EVENT "core2_t20" "core2_t20" 0x0A DAQ 0xFF 0x02 0x07 0x00 /end EVENT /begin EVENT "core2_bg" "core2_bg" 0x0C DAQ 0xFF 0x05 0x07 0x00 /end EVENT /begin EVENT "core2_t100" "core2_t10" 0x0B DAQ 0xFF 0x01 0x08 0x00 /end EVENT /begin EVENT "core3_t10" "core3_t10" 0x0D DAQ 0xFF 0x01 0x07 0x00 /end EVENT /begin EVENT "core3_t20" "core3_t20" 0x0E DAQ 0xFF 0x02 0x07 0x00 /end EVENT /begin EVENT "core3_bg" "core3_bg" 0x10 DAQ 0xFF 0x05 0x07 0x00 /end EVENT /begin EVENT "core3_t100" "core3_t10" 0x0F DAQ 0xFF 0x01 0x08 0x00 /end EVENT /begin EVENT "core4_t10" "core4_t10" 0x11 DAQ 0xFF 0x01 0x07 0x00 /end EVENT /begin EVENT "core4_t20" "core4_t20" 0x12 DAQ 0xFF 0x02 0x07 0x00 /end EVENT /begin EVENT "core4_t100" "core4_t10" 0x13 DAQ 0xFF 0x01 0x08 0x00 /end EVENT /begin EVENT "core4_bg" "core4_bg" 0x14 DAQ 0xFF 0x05 0x07 0x00 /end EVENT /begin EVENT "core5_t10" "core5_t10" 0x15 DAQ 0xFF 0x01 0x07 0x00 /end EVENT /begin EVENT "core5_t20" "core5_t20" 0x16 DAQ 0xFF 0x02 0x07 0x00 /end EVENT /begin EVENT "core5_t100" "core5_t10" 0x17 DAQ 0xFF 0x01 0x08 0x00 /end EVENT /begin EVENT "core5_bg" "core5_bg" 0x18 DAQ 0xFF 0x05 0x07 0x00 /end EVENT
  /begin EVENT "VX113x.mon.xcpTlasy.freeTLBsSocket0" "VX113x.mo" 0x8000 DAQ 0xFF 0x01 0x09 0x00 /end EVENT
  /begin EVENT "VX14xx.mon.aurix.aurora.phyDvCnt" "VX14xx.mo" 0x8001 DAQ 0xFF 0x01 0x09 0x00 /end EVENT
  /begin EVENT "MEAS_OBJ_HIL_BYPASS_EV" "MEAS_OBJ_" 0x1B DAQ 0xFF 0x05 0x07 0xFE /end EVENT
  /begin EVENT "STIM_OBJ_HIL_BYPASS_EV" "STIM_OBJ_" 0x1C STIM 0xFF 0x05 0x07 0xFF /end EVENT
  /begin EVENT "core2_t50" "core2_t50" 0x28 DAQ 0xFF 0x05 0x07 0x00 /end EVENT
  /begin EVENT "core0_t50" "core0_t50" 0x22 DAQ 0xFF 0x05 0x07 0x00 /end EVENT
  /begin EVENT "m7A341E75" "m7A341E75" 0x60 DAQ 0xFF 0x01 0x07 0x00 /end EVENT
  /begin EVENT "mF994493E" "mF994493E" 0x61 DAQ 0xFF 0x01 0x07 0x00 /end EVENT
  /begin EVENT "m8A9C8EBA" "m8A9C8EBA" 0x62 DAQ 0xFF 0x01 0x07 0x00 /end EVENT
  /begin EVENT "m15AB8D21" "m15AB8D21" 0x63 DAQ 0xFF 0x01 0x07 0x00 /end EVENT
  /begin EVENT "m6BEF78C0" "m6BEF78C0" 0x64 DAQ 0xFF 0x01 0x07 0x00 /end EVENT
  /begin EVENT "m37705A84" "m37705A84" 0x65 DAQ 0xFF 0x01 0x07 0x00 /end EVENT
  /begin EVENT "m35D9B1FF" "m35D9B1FF" 0x66 DAQ 0xFF 0x01 0x07 0x00 /end EVENT
  /begin EVENT "m8C5BDE2F" "m8C5BDE2F" 0x67 DAQ 0xFF 0x01 0x07 0x00 /end EVENT
  /begin EVENT "m5A94F4A1" "m5A94F4A1" 0x68 DAQ 0xFF 0x01 0x07 0x00 /end EVENT
  /begin EVENT "mAC17F8D1" "mAC17F8D1" 0x69 DAQ 0xFF 0x01 0x07 0x00 /end EVENT
  /begin EVENT "m84734F54" "m84734F54" 0x6A DAQ 0xFF 0x01 0x07 0x00 /end EVENT
  /begin EVENT "mAA240047" "mAA240047" 0x6B DAQ 0xFF 0x01 0x07 0x00 /end EVENT
  /begin EVENT "mA644C047" "mA644C047" 0x6C DAQ 0xFF 0x01 0x07 0x00 /end EVENT
  /begin EVENT "m72A9680D" "m72A9680D" 0x6D DAQ 0xFF 0x01 0x07 0x00 /end EVENT
  /begin EVENT "mEB21CDB8" "mEB21CDB8" 0x6E DAQ 0xFF 0x01 0x07 0x00 /end EVENT
  /begin EVENT "m2D2E5609" "m2D2E5609" 0x6F DAQ 0xFF 0x01 0x07 0x00 /end EVENT
  /begin EVENT "m3325390A" "m3325390A" 0x70 DAQ 0xFF 0x01 0x07 0x00 /end EVENT
  /begin EVENT "mA7A578A4" "mA7A578A4" 0x71 DAQ 0xFF 0x01 0x07 0x00 /end EVENT
  /begin EVENT "mD656D311" "mD656D311" 0x72 DAQ 0xFF 0x01 0x07 0x00 /end EVENT
  /begin EVENT "m7DDF19E6" "m7DDF19E6" 0x73 DAQ 0xFF 0x01 0x07 0x00 /end EVENT
  /begin EVENT "m650E30C0" "m650E30C0" 0x74 DAQ 0xFF 0x01 0x07 0x00 /end EVENT
  /begin EVENT "m68B1F925" "m68B1F925" 0x75 DAQ 0xFF 0x01 0x07 0x00 /end EVENT
  /begin EVENT "m9D9130A9" "m9D9130A9" 0x76 DAQ 0xFF 0x01 0x07 0x00 /end EVENT
  /begin EVENT "mD83B3204" "mD83B3204" 0x77 DAQ 0xFF 0x01 0x07 0x00 /end EVENT
  /begin EVENT "mE092094C" "mE092094C" 0x78 DAQ 0xFF 0x01 0x07 0x00 /end EVENT
  /begin EVENT "m3CA37603" "m3CA37603" 0x79 DAQ 0xFF 0x01 0x07 0x00 /end EVENT
  /begin EVENT "mDF571799" "mDF571799" 0x7A DAQ 0xFF 0x01 0x07 0x00 /end EVENT
  /begin EVENT "m50D5DC26" "m50D5DC26" 0x7B DAQ 0xFF 0x01 0x07 0x00 /end EVENT
  /begin EVENT "m89513841" "m89513841" 0x7C DAQ 0xFF 0x01 0x07 0x00 /end EVENT
  /begin EVENT "mA5705C7D" "mA5705C7D" 0x7D DAQ 0xFF 0x01 0x07 0x00 /end EVENT
  /begin EVENT "m1929C53A" "m1929C53A" 0x7E DAQ 0xFF 0x01 0x07 0x00 /end EVENT
  /begin EVENT "mE5EA5DE3" "mE5EA5DE3" 0x7F DAQ 0xFF 0x01 0x07 0x00 /end EVENT
  /begin EVENT "m57CE1E6D" "m57CE1E6D" 0x80 DAQ 0xFF 0x01 0x07 0x00 /end EVENT
  /begin EVENT "mA1E13654" "mA1E13654" 0x81 DAQ 0xFF 0x01 0x07 0x00 /end EVENT
  /begin EVENT "m05C7F6F4" "m05C7F6F4" 0x82 DAQ 0xFF 0x01 0x07 0x00 /end EVENT
  /begin EVENT "mFE89DA5C" "mFE89DA5C" 0x83 DAQ 0xFF 0x01 0x07 0x00 /end EVENT
  /begin EVENT "m07541D48" "m07541D48" 0x84 DAQ 0xFF 0x01 0x07 0x00 /end EVENT
  /begin EVENT "mA428B7EB" "mA428B7EB" 0x85 DAQ 0xFF 0x01 0x07 0x00 /end EVENT
  /begin EVENT "mE09DD5B2" "mE09DD5B2" 0x86 DAQ 0xFF 0x01 0x07 0x00 /end EVENT
  /begin EVENT "m9B4FA009" "m9B4FA009" 0x87 DAQ 0xFF 0x01 0x07 0x00 /end EVENT
  /begin EVENT "m27101580" "m27101580" 0x88 DAQ 0xFF 0x01 0x07 0x00 /end EVENT
  /begin EVENT "m132AF404" "m132AF404" 0x89 DAQ 0xFF 0x01 0x07 0x00 /end EVENT
  /begin EVENT "m31AF6F9F" "m31AF6F9F" 0x8A DAQ 0xFF 0x01 0x07 0x00 /end EVENT
  /begin EVENT "mA7B93784" "mA7B93784" 0x8B DAQ 0xFF 0x01 0x07 0x00 /end EVENT
  /begin EVENT "m0C03FF5E" "m0C03FF5E" 0x8C DAQ 0xFF 0x01 0x07 0x00 /end EVENT
  /begin EVENT "mC341E42F" "mC341E42F" 0x8D DAQ 0xFF 0x01 0x07 0x00 /end EVENT
  /begin EVENT "mFF777528" "mFF777528" 0x8E DAQ 0xFF 0x01 0x07 0x00 /end EVENT
  /begin EVENT "mFDC80AFA" "mFDC80AFA" 0x8F DAQ 0xFF 0x01 0x07 0x00 /end EVENT
  /begin EVENT "m14A55962" "m14A55962" 0x90 DAQ 0xFF 0x01 0x07 0x00 /end EVENT
  /begin EVENT "m9A5B2459" "m9A5B2459" 0x91 DAQ 0xFF 0x01 0x07 0x00 /end EVENT
  /begin EVENT "m6886390F" "m6886390F" 0x92 DAQ 0xFF 0x01 0x07 0x00 /end EVENT
  /begin EVENT "m784BD868" "m784BD868" 0x93 DAQ 0xFF 0x01 0x07 0x00 /end EVENT
  /begin EVENT "m7188F585" "m7188F585" 0x94 DAQ 0xFF 0x01 0x07 0x00 /end EVENT
  /begin EVENT "m790D3990" "m790D3990" 0x95 DAQ 0xFF 0x01 0x07 0x00 /end EVENT
  /begin EVENT "m2ABD273E" "m2ABD273E" 0x96 DAQ 0xFF 0x01 0x07 0x00 /end EVENT
  /begin EVENT "mEB8C65C2" "mEB8C65C2" 0x97 DAQ 0xFF 0x01 0x07 0x00 /end EVENT
  /begin EVENT "m8371D769" "m8371D769" 0x98 DAQ 0xFF 0x01 0x07 0x00 /end EVENT
  /begin EVENT "mB7DA73A2" "mB7DA73A2" 0x99 DAQ 0xFF 0x01 0x07 0x00 /end EVENT
  /begin EVENT "m5A19A22E" "m5A19A22E" 0x9A DAQ 0xFF 0x01 0x07 0x00 /end EVENT
  /begin EVENT "mCFD4284D" "mCFD4284D" 0x9B DAQ 0xFF 0x01 0x07 0x00 /end EVENT
  /begin EVENT "mDFDE97C7" "mDFDE97C7" 0x9C DAQ 0xFF 0x01 0x07 0x00 /end EVENT
  /begin EVENT "mCB77E5D0" "mCB77E5D0" 0x9D DAQ 0xFF 0x01 0x07 0x00 /end EVENT
  /begin EVENT "mF88C047E" "mF88C047E" 0x9E DAQ 0xFF 0x01 0x07 0x00 /end EVENT
  /begin EVENT "m1B5BADD4" "m1B5BADD4" 0x9F DAQ 0xFF 0x01 0x07 0x00 /end EVENT
  /begin EVENT "mDFBB62BE" "mDFBB62BE" 0xA0 DAQ 0xFF 0x01 0x07 0x00 /end EVENT
  /begin EVENT "m5D79D6C3" "m5D79D6C3" 0xA1 DAQ 0xFF 0x01 0x07 0x00 /end EVENT
  /begin EVENT "m855CCA98" "m855CCA98" 0xA2 DAQ 0xFF 0x01 0x07 0x00 /end EVENT
  /begin EVENT "mB9560014" "mB9560014" 0xA3 DAQ 0xFF 0x01 0x07 0x00 /end EVENT
  /begin EVENT "mBA3C92F5" "mBA3C92F5" 0xA4 DAQ 0xFF 0x01 0x07 0x00 /end EVENT
  /begin EVENT "mB29A7DE5" "mB29A7DE5" 0xA5 DAQ 0xFF 0x01 0x07 0x00 /end EVENT
  /begin EVENT "mF4A6B352" "mF4A6B352" 0xA6 DAQ 0xFF 0x01 0x07 0x00 /end EVENT
  /begin EVENT "mA9B93C39" "mA9B93C39" 0xA7 DAQ 0xFF 0x01 0x07 0x00 /end EVENT
  /begin EVENT "m34427138" "m34427138" 0xA8 DAQ 0xFF 0x01 0x07 0x00 /end EVENT
  /begin EVENT "mBCCD3E1F" "mBCCD3E1F" 0xA9 DAQ 0xFF 0x01 0x07 0x00 /end EVENT
  /begin EVENT "m5EA8D950" "m5EA8D950" 0xAA DAQ 0xFF 0x01 0x07 0x00 /end EVENT
  /begin EVENT "m89797748" "m89797748" 0xAB DAQ 0xFF 0x01 0x07 0x00 /end EVENT
  /begin EVENT "m92A80A8B" "m92A80A8B" 0xAC DAQ 0xFF 0x01 0x07 0x00 /end EVENT
  /begin EVENT "m399DE383" "m399DE383" 0xAD DAQ 0xFF 0x01 0x07 0x00 /end EVENT
  /begin EVENT "m1EF9BA4A" "m1EF9BA4A" 0xAE DAQ 0xFF 0x01 0x07 0x00 /end EVENT
  /begin EVENT "m9FE0939F" "m9FE0939F" 0xAF DAQ 0xFF 0x01 0x07 0x00 /end EVENT
  /begin EVENT "m981A6E69" "m981A6E69" 0xB0 DAQ 0xFF 0x01 0x07 0x00 /end EVENT
  /begin EVENT "m6A84EDC4" "m6A84EDC4" 0xB1 DAQ 0xFF 0x01 0x07 0x00 /end EVENT
  /begin EVENT "mA35AE844" "mA35AE844" 0xB2 DAQ 0xFF 0x01 0x07 0x00 /end EVENT
  /begin EVENT "mCDB1CC50" "mCDB1CC50" 0xB3 DAQ 0xFF 0x01 0x07 0x00 /end EVENT
  /begin EVENT "mFCFC6D76" "mFCFC6D76" 0xB4 DAQ 0xFF 0x01 0x07 0x00 /end EVENT
  /begin EVENT "m78FD6076" "m78FD6076" 0xB5 DAQ 0xFF 0x01 0x07 0x00 /end EVENT
  /begin EVENT "m04403CBF" "m04403CBF" 0xB6 DAQ 0xFF 0x01 0x07 0x00 /end EVENT
  /begin EVENT "m7E11BF38" "m7E11BF38" 0xB7 DAQ 0xFF 0x01 0x07 0x00 /end EVENT
  /begin EVENT "mC8602CFC" "mC8602CFC" 0xB8 DAQ 0xFF 0x01 0x07 0x00 /end EVENT
  /begin EVENT "m164B1F3F" "m164B1F3F" 0xB9 DAQ 0xFF 0x01 0x07 0x00 /end EVENT
  /begin EVENT "m6CDCA8EC" "m6CDCA8EC" 0xBA DAQ 0xFF 0x01 0x07 0x00 /end EVENT
  /begin EVENT "m74E3924E" "m74E3924E" 0xBB DAQ 0xFF 0x01 0x07 0x00 /end EVENT
 /end DAQ
 /begin PAG 0x02 /end PAG
 /begin PGM PGM_MODE_ABSOLUTE 0xB0 0x00 /begin SECTOR "" 0x00 0x00 0x01000000 0x00 0x00 0x00 /end SECTOR /end PGM
 /begin XCP_ON_TCP_IP 0x0104 0x15B3 ADDRESS "192.168.0.2" /end XCP_ON_TCP_IP
/end IF_DATA
/begin MEASUREMENT _FepMainDataPacket_st._OpMode "" UBYTE NO_COMPU_METHOD 0 0 0 255 ECU_ADDRESS 0x5000E1B4 FORMAT "%.15" /end MEASUREMENT
/begin GROUP Aurix "Measurements when using Infineon Aurix"
 /begin REF_MEASUREMENT VX1000.POD.mon.aurix.aurora.rxFreqKHz VX1000.POD.mon.aurix.dapFreqkHz VX1000.POD.mon.aurix.errorMsgCnt VX1000.POD.mon.aurix.lastAddrBeforeEcuOverrun VX1000.POD.mon.aurix.retransmitCnt /end REF_MEASUREMENT
/end GROUP
/begin GROUP BaseModule "VX1060, VX113x, VX1161.3x internal Measurements"
 /begin REF_MEASUREMENT VX1000.BM.mon.bmTemperature VX1000.BM.mon.monEvtCntDword VX1000.BM.mon.te.tfifo.extRamMaxByte VX1000.BM.mon.xcpSocket0.freeTLBs VX1000.BM.mon.xcpSocket1.freeTLBs VX1000.BM.mon.xcpSocket2.freeTLBs VX1000.BM.mon.xcpSocket3.freeTLBs VX1000.BM.mon.xcpe.evtFifoMax /end REF_MEASUREMENT
 /begin SUB_GROUP HSSL Serial /end SUB_GROUP
/end GROUP
/begin GROUP HSSL ""
 /begin REF_MEASUREMENT VX1000.BM.mon.hssl.TxFreqKHz VX1000.BM.mon.hssl.pipe0RxCnt VX1000.BM.mon.hssl.pipe1RxCnt VX1000.BM.mon.hssl.pipe2RxCnt VX1000.BM.mon.hssl.retransDLCnt VX1000.BM.mon.hssl.retransULCnt /end REF_MEASUREMENT
/end GROUP
/begin GROUP Nexus "Measurements when using Nexus AUX Trace Interface of PowerPC MCUs"
 /begin REF_MEASUREMENT VX1000.POD.mon.nexus.aurora.rxFreqKHz VX1000.POD.mon.nexus.aux.freqKHz VX1000.POD.mon.nexus.ecuOverrunCnt VX1000.POD.mon.nexus.ecuStallCnt VX1000.POD.mon.nexus.lastAddrBeforeEcuOverrun /end REF_MEASUREMENT
/end GROUP
/begin GROUP POD "VX14xx POD internal Measurements"
 /begin REF_MEASUREMENT VX1000.POD.mon.aurora.fifo.bufferUtilByte VX1000.POD.mon.aurora.fifo.din_fifo_usedw VX1000.POD.mon.aurora.fifo.dout_fifo_usedw VX1000.POD.mon.monEvtCntDword VX1000.POD.mon.pcie.overloadCnt VX1000.POD.mon.pod.temperature VX1000.POD.mon.trace.adconInputCnt VX1000.POD.mon.trace.adfilOutputCnt VX1000.POD.mon.traceBuffer.externalMax VX1000.POD.mon.traceBuffer.outMax /end REF_MEASUREMENT
 /begin SUB_GROUP Aurix Nexus RH850 RIF RTPDMM /end SUB_GROUP
/end GROUP
/begin GROUP RH850 "Measurements when using Renesas RH850 Data Trace"
 /begin REF_MEASUREMENT VX1000.POD.mon.rh850.aud.audFifoMax VX1000.POD.mon.rh850.aurora.rxFreqKHz VX1000.POD.mon.rh850.ecuOverrunCnt VX1000.POD.mon.rh850.lastAddrBeforeEcuOverrun VX1000.POD.mon.rh850.lastErrorMsgInfo /end REF_MEASUREMENT
/end GROUP
/begin GROUP RIF "Measurements when using the Radar RAW Data Interface" /begin REF_MEASUREMENT VX1000.POD.mon.rif1.crcErrorCnt /end REF_MEASUREMENT /end GROUP
/begin GROUP RTPDMM "Measurements when using the TI TMS570 RTP/DMM Data Trace Interface"
 /begin REF_MEASUREMENT VX1000.POD.mon.rtpdmm.dmmFreqKHz VX1000.POD.mon.rtpdmm.dmmStopCnt VX1000.POD.mon.rtpdmm.rtpFreqKHz VX1000.POD.mon.rtpdmm.rtpStopCnt /end REF_MEASUREMENT
/end GROUP
/begin GROUP Serial ""
 /begin REF_MEASUREMENT VX1000.BM.mon.serial.niosMaxDapLoad VX1000.BM.mon.serial.niosOldaOverruns VX1000.BM.mon.serial.targetIfRetryCounter /end REF_MEASUREMENT
/end GROUP
/begin GROUP SystemInfo "VX1060, VX113x, VX1621, VX1161.3x internal Measurements"
 /begin REF_CHARACTERISTIC VX1000.sys.usrCustomer VX1000.sys.usrPosition VX1000.sys.usrProject VX1000.sys.usrSample /end REF_CHARACTERISTIC
 /begin REF_MEASUREMENT VX1000.sys.ecuEdJtagId VX1000.sys.ecuJtagId VX1000.sys.ecuProcName VX1000.sys.ecuProcNameLen VX1000.sys.fpgaLeftVer VX1000.sys.fpgaLeftVer.build VX1000.sys.fpgaLeftVer.major VX1000.sys.fpgaLeftVer.minor VX1000.sys.fwVer VX1000.sys.fwVer.build VX1000.sys.fwVer.major VX1000.sys.fwVer.minor VX1000.sys.parentArticleNumber VX1000.sys.parentSerialNumber VX1000.sys.podECUIdMiscNumber VX1000.sys.podECUIdMuster VX1000.sys.podECUIdPosition VX1000.sys.podECUIdProject VX1000.sys.podFpgaVer VX1000.sys.podFpgaVer.build VX1000.sys.podFpgaVer.major VX1000.sys.podFpgaVer.minor VX1000.sys.podFwVer VX1000.sys.podFwVer.build VX1000.sys.podFwVer.major VX1000.sys.podFwVer.minor VX1000.sys.podHwTypeRev VX1000.sys.podTemp VX1000.sys.podVX1902HwTypeRev VX1000.sys.podVX1902VectorSerNo VX1000.sys.podVectorArtNo VX1000.sys.podVectorSerNo VX1000.sys.upTimeS VX1000.sys.vectorArtNo VX1000.sys.vectorSerNo VX1000.sys.vx1161SlotNumber /end REF_MEASUREMENT
/end GROUP
/begin GROUP VX1000 "VX1000 Internal Signals" ROOT /begin SUB_GROUP BaseModule POD SystemInfo XPOD /end SUB_GROUP /end GROUP
/begin GROUP XPOD "VX1621 internal Measurements"
 /begin REF_MEASUREMENT VX1000.xpod.ECU_IF_voltage VX1000.xpod.EMEM_voltage VX1000.xpod.Temperature VX1000.xpod.monEvtCntDword /end REF_MEASUREMENT
/end GROUP
/end MODULE
/end PROJECT
