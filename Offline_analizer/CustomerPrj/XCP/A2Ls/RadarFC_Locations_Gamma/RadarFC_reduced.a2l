ASAP2_VERSION 1 71
/begin PROJECT RADAR_GEN5 ""
/begin HEADER "" VERSION "TO_BE_FILLED" /end HEADER
/begin MODULE RADAR_GEN5 ""
/begin MOD_COMMON "" ALIGNMENT_BYTE 1 ALIGNMENT_WORD 2 ALIGNMENT_LONG 4 ALIGNMENT_FLOAT16_IEEE 2 ALIGNMENT_FLOAT32_IEEE 4 ALIGNMENT_FLOAT64_IEEE 4 ALIGNMENT_INT64 4 /end MOD_COMMON
/begin CHARACTERISTIC _g_PL_AD_fw_Radar_1R1V_rpc_LocBypassingRunnable_LocBypassingRunnable_m_pad_ensRLocationsPort_par_out_local.TChangeableMemPool._._._m_arrayPool._0_._elem._m_LocationList._Item._143_._idxAzimuthAmbiguityPeer "" VALUE 0xB0011216 __UWord_Value 0 NO_COMPU_METHOD 0 65535 ECU_ADDRESS_EXTENSION 0x2 BYTE_ORDER MSB_LAST /end CHARACTERISTIC
/begin CHARACTERISTIC _g_PL_AD_fw_Radar_1R1V_rpc_LocBypassingRunnable_LocBypassingRunnable_m_pad_ensRLocationsPort_par_out_local.TChangeableMemPool._._._m_arrayPool._0_._elem._m_LocationList._Item._143_._measStatus "" VALUE 0xB0011215 __UByte_Value 0 NO_COMPU_METHOD 0 255 ECU_ADDRESS_EXTENSION 0x2 BYTE_ORDER MSB_LAST /end CHARACTERISTIC
/begin CHARACTERISTIC _g_PL_AD_fw_Radar_1R1V_rpc_LocBypassingRunnable_LocBypassingRunnable_m_pad_ensRLocationsPort_par_out_local.TChangeableMemPool._._._m_arrayPool._0_._elem._m_LocationList._Item._143_._phi._m_value "" VALUE 0xB0011208 __Float16_Value 0 NO_COMPU_METHOD -65504 65504 ECU_ADDRESS_EXTENSION 0x2 BYTE_ORDER MSB_LAST /end CHARACTERISTIC
/begin CHARACTERISTIC _g_PL_AD_fw_Radar_1R1V_rpc_LocBypassingRunnable_LocBypassingRunnable_m_pad_ensRLocationsPort_par_out_local.TChangeableMemPool._._._m_arrayPool._0_._elem._m_LocationList._Item._143_._phiQly "" VALUE 0xB001120B __UByte_Value 0 NO_COMPU_METHOD 0 255 ECU_ADDRESS_EXTENSION 0x2 BYTE_ORDER MSB_LAST /end CHARACTERISTIC
/begin CHARACTERISTIC _g_PL_AD_fw_Radar_1R1V_rpc_LocBypassingRunnable_LocBypassingRunnable_m_pad_ensRLocationsPort_par_out_local.TChangeableMemPool._._._m_arrayPool._0_._elem._m_LocationList._Item._143_._phiVar._m_value "" VALUE 0xB001120E __Float16_Value 0 NO_COMPU_METHOD -65504 65504 ECU_ADDRESS_EXTENSION 0x2 BYTE_ORDER MSB_LAST /end CHARACTERISTIC
/begin CHARACTERISTIC _g_PL_AD_fw_Radar_1R1V_rpc_LocBypassingRunnable_LocBypassingRunnable_m_pad_ensRLocationsPort_par_out_local.TChangeableMemPool._._._m_arrayPool._0_._elem._m_LocationList._Item._143_._theta._m_value "" VALUE 0xB0011206 __Float16_Value 0 NO_COMPU_METHOD -65504 65504 ECU_ADDRESS_EXTENSION 0x2 BYTE_ORDER MSB_LAST /end CHARACTERISTIC
/begin CHARACTERISTIC _g_PL_AD_fw_Radar_1R1V_rpc_LocBypassingRunnable_LocBypassingRunnable_m_pad_ensRLocationsPort_par_out_local.TChangeableMemPool._._._m_arrayPool._0_._elem._m_LocationList._Item._143_._thetaQly "" VALUE 0xB001120A __UByte_Value 0 NO_COMPU_METHOD 0 255 ECU_ADDRESS_EXTENSION 0x2 BYTE_ORDER MSB_LAST /end CHARACTERISTIC
/begin CHARACTERISTIC _g_PL_AD_fw_Radar_1R1V_rpc_LocBypassingRunnable_LocBypassingRunnable_m_pad_ensRLocationsPort_par_out_local.TChangeableMemPool._._._m_arrayPool._0_._elem._m_LocationList._Item._143_._thetaVar._m_value "" VALUE 0xB001120C __Float16_Value 0 NO_COMPU_METHOD -65504 65504 ECU_ADDRESS_EXTENSION 0x2 BYTE_ORDER MSB_LAST /end CHARACTERISTIC
/begin CHARACTERISTIC _g_PL_AD_fw_Radar_1R1V_rpc_LocBypassingRunnable_LocBypassingRunnable_m_pad_ensRLocationsPort_par_out_local.TChangeableMemPool._._._m_arrayPool._0_._elem._m_LocationList._Item._143_._v "" VALUE 0xB00111FC __Float32_Value 0 NO_COMPU_METHOD -3.4028234663852886E+38 3.4028234663852886E+38 ECU_ADDRESS_EXTENSION 0x2 BYTE_ORDER MSB_LAST /end CHARACTERISTIC
/begin CHARACTERISTIC _g_PL_AD_fw_Radar_1R1V_rpc_LocBypassingRunnable_LocBypassingRunnable_m_pad_ensRLocationsPort_par_out_local.TChangeableMemPool._._._m_arrayPool._0_._elem._m_LocationList._Item._143_._vVar._m_value "" VALUE 0xB0011202 __Float16_Value 0 NO_COMPU_METHOD -65504 65504 ECU_ADDRESS_EXTENSION 0x2 BYTE_ORDER MSB_LAST /end CHARACTERISTIC
/begin CHARACTERISTIC _g_PL_AD_fw_Radar_1R1V_rpc_LocBypassingRunnable_LocBypassingRunnable_m_pad_ensRLocationsPort_par_out_local.TChangeableMemPool._._._m_arrayPool._0_._elem._m_LocationList._Item._144_._Rcs._m_value "" VALUE 0xB0011230 __Float16_Value 0 NO_COMPU_METHOD -65504 65504 ECU_ADDRESS_EXTENSION 0x2 BYTE_ORDER MSB_LAST /end CHARACTERISTIC
/begin CHARACTERISTIC _g_PL_AD_fw_Radar_1R1V_rpc_LocBypassingRunnable_LocBypassingRunnable_m_pad_ensRLocationsPort_par_out_local.TChangeableMemPool._._._m_arrayPool._0_._elem._m_LocationList._Item._144_._Rssi._m_value "" VALUE 0xB0011232 __Float16_Value 0 NO_COMPU_METHOD -65504 65504 ECU_ADDRESS_EXTENSION 0x2 BYTE_ORDER MSB_LAST /end CHARACTERISTIC
/begin CHARACTERISTIC _g_PL_AD_fw_Radar_1R1V_rpc_LocBypassingRunnable_LocBypassingRunnable_m_pad_ensRLocationsPort_par_out_local.TChangeableMemPool._._._m_arrayPool._0_._elem._m_LocationList._Item._144_._d "" VALUE 0xB0011218 __Float32_Value 0 NO_COMPU_METHOD -3.4028234663852886E+38 3.4028234663852886E+38 ECU_ADDRESS_EXTENSION 0x2 BYTE_ORDER MSB_LAST /end CHARACTERISTIC
/begin CHARACTERISTIC _g_PL_AD_fw_Radar_1R1V_rpc_LocBypassingRunnable_LocBypassingRunnable_m_pad_ensRLocationsPort_par_out_local.TChangeableMemPool._._._m_arrayPool._0_._elem._m_LocationList._Item._144_._dVar._m_value "" VALUE 0xB0011220 __Float16_Value 0 NO_COMPU_METHOD -65504 65504 ECU_ADDRESS_EXTENSION 0x2 BYTE_ORDER MSB_LAST /end CHARACTERISTIC
/begin CHARACTERISTIC _g_PL_AD_fw_Radar_1R1V_rpc_LocBypassingRunnable_LocBypassingRunnable_m_pad_ensRLocationsPort_par_out_local.TChangeableMemPool._._._m_arrayPool._0_._elem._m_LocationList._Item._144_._dvCov._m_value "" VALUE 0xB0011224 __Float16_Value 0 NO_COMPU_METHOD -65504 65504 ECU_ADDRESS_EXTENSION 0x2 BYTE_ORDER MSB_LAST /end CHARACTERISTIC
/begin CHARACTERISTIC _g_PL_AD_fw_Radar_1R1V_rpc_LocBypassingRunnable_LocBypassingRunnable_m_pad_ensRLocationsPort_par_out_local.TChangeableMemPool._._._m_arrayPool._0_._elem._m_LocationList._Item._144_._dvQly "" VALUE 0xB0011234 __UByte_Value 0 NO_COMPU_METHOD 0 255 ECU_ADDRESS_EXTENSION 0x2 BYTE_ORDER MSB_LAST /end CHARACTERISTIC
/begin CHARACTERISTIC _g_PL_AD_fw_Radar_1R1V_rpc_LocBypassingRunnable_LocBypassingRunnable_m_pad_ensRLocationsPort_par_out_local.TChangeableMemPool._._._m_arrayPool._0_._elem._m_LocationList._Item._144_._idxAzimuthAmbiguityPeer "" VALUE 0xB0011236 __UWord_Value 0 NO_COMPU_METHOD 0 65535 ECU_ADDRESS_EXTENSION 0x2 BYTE_ORDER MSB_LAST /end CHARACTERISTIC
/begin CHARACTERISTIC _g_PL_AD_fw_Radar_1R1V_rpc_LocBypassingRunnable_LocBypassingRunnable_m_pad_ensRLocationsPort_par_out_local.TChangeableMemPool._._._m_arrayPool._0_._elem._m_LocationList._Item._144_._measStatus "" VALUE 0xB0011235 __UByte_Value 0 NO_COMPU_METHOD 0 255 ECU_ADDRESS_EXTENSION 0x2 BYTE_ORDER MSB_LAST /end CHARACTERISTIC
/begin CHARACTERISTIC _g_PL_AD_fw_Radar_1R1V_rpc_LocBypassingRunnable_LocBypassingRunnable_m_pad_ensRLocationsPort_par_out_local.TChangeableMemPool._._._m_arrayPool._0_._elem._m_LocationList._Item._144_._phi._m_value "" VALUE 0xB0011228 __Float16_Value 0 NO_COMPU_METHOD -65504 65504 ECU_ADDRESS_EXTENSION 0x2 BYTE_ORDER MSB_LAST /end CHARACTERISTIC
/begin CHARACTERISTIC _g_PL_AD_fw_Radar_1R1V_rpc_LocBypassingRunnable_LocBypassingRunnable_m_pad_ensRLocationsPort_par_out_local.TChangeableMemPool._._._m_arrayPool._0_._elem._m_LocationList._Item._144_._phiQly "" VALUE 0xB001122B __UByte_Value 0 NO_COMPU_METHOD 0 255 ECU_ADDRESS_EXTENSION 0x2 BYTE_ORDER MSB_LAST /end CHARACTERISTIC
/begin CHARACTERISTIC _g_PL_AD_fw_Radar_1R1V_rpc_LocBypassingRunnable_LocBypassingRunnable_m_pad_ensRLocationsPort_par_out_local.TChangeableMemPool._._._m_arrayPool._0_._elem._m_LocationList._Item._144_._phiVar._m_value "" VALUE 0xB001122E __Float16_Value 0 NO_COMPU_METHOD -65504 65504 ECU_ADDRESS_EXTENSION 0x2 BYTE_ORDER MSB_LAST /end CHARACTERISTIC
/begin CHARACTERISTIC _g_PL_AD_fw_Radar_1R1V_rpc_LocBypassingRunnable_LocBypassingRunnable_m_pad_ensRLocationsPort_par_out_local.TChangeableMemPool._._._m_arrayPool._0_._elem._m_LocationList._Item._144_._theta._m_value "" VALUE 0xB0011226 __Float16_Value 0 NO_COMPU_METHOD -65504 65504 ECU_ADDRESS_EXTENSION 0x2 BYTE_ORDER MSB_LAST /end CHARACTERISTIC
/begin CHARACTERISTIC _g_PL_AD_fw_Radar_1R1V_rpc_LocBypassingRunnable_LocBypassingRunnable_m_pad_ensRLocationsPort_par_out_local.TChangeableMemPool._._._m_arrayPool._0_._elem._m_LocationList._Item._144_._thetaQly "" VALUE 0xB001122A __UByte_Value 0 NO_COMPU_METHOD 0 255 ECU_ADDRESS_EXTENSION 0x2 BYTE_ORDER MSB_LAST /end CHARACTERISTIC
/begin CHARACTERISTIC _g_PL_AD_fw_Radar_1R1V_rpc_LocBypassingRunnable_LocBypassingRunnable_m_pad_ensRLocationsPort_par_out_local.TChangeableMemPool._._._m_arrayPool._0_._elem._m_LocationList._Item._144_._thetaVar._m_value "" VALUE 0xB001122C __Float16_Value 0 NO_COMPU_METHOD -65504 65504 ECU_ADDRESS_EXTENSION 0x2 BYTE_ORDER MSB_LAST /end CHARACTERISTIC
/begin CHARACTERISTIC _g_PL_AD_fw_Radar_1R1V_rpc_LocBypassingRunnable_LocBypassingRunnable_m_pad_ensRLocationsPort_par_out_local.TChangeableMemPool._._._m_arrayPool._0_._elem._m_LocationList._Item._144_._v "" VALUE 0xB001121C __Float32_Value 0 NO_COMPU_METHOD -3.4028234663852886E+38 3.4028234663852886E+38 ECU_ADDRESS_EXTENSION 0x2 BYTE_ORDER MSB_LAST /end CHARACTERISTIC
/begin CHARACTERISTIC _g_PL_AD_fw_Radar_1R1V_rpc_LocBypassingRunnable_LocBypassingRunnable_m_pad_ensRLocationsPort_par_out_local.TChangeableMemPool._._._m_arrayPool._0_._elem._m_LocationList._Item._144_._vVar._m_value "" VALUE 0xB0011222 __Float16_Value 0 NO_COMPU_METHOD -65504 65504 ECU_ADDRESS_EXTENSION 0x2 BYTE_ORDER MSB_LAST /end CHARACTERISTIC
/begin CHARACTERISTIC _g_PL_AD_fw_Radar_1R1V_rpc_LocBypassingRunnable_LocBypassingRunnable_m_pad_ensRLocationsPort_par_out_local.TChangeableMemPool._._._m_arrayPool._0_._elem._m_LocationList._Item._145_._Rcs._m_value "" VALUE 0xB0011250 __Float16_Value 0 NO_COMPU_METHOD -65504 65504 ECU_ADDRESS_EXTENSION 0x2 BYTE_ORDER MSB_LAST /end CHARACTERISTIC
/begin CHARACTERISTIC _g_PL_AD_fw_Radar_1R1V_rpc_LocBypassingRunnable_LocBypassingRunnable_m_pad_ensRLocationsPort_par_out_local.TChangeableMemPool._._._m_arrayPool._0_._elem._m_LocationList._Item._145_._Rssi._m_value "" VALUE 0xB0011252 __Float16_Value 0 NO_COMPU_METHOD -65504 65504 ECU_ADDRESS_EXTENSION 0x2 BYTE_ORDER MSB_LAST /end CHARACTERISTIC
/begin CHARACTERISTIC _g_PL_AD_fw_Radar_1R1V_rpc_LocBypassingRunnable_LocBypassingRunnable_m_pad_ensRLocationsPort_par_out_local.TChangeableMemPool._._._m_arrayPool._0_._elem._m_LocationList._Item._145_._d "" VALUE 0xB0011238 __Float32_Value 0 NO_COMPU_METHOD -3.4028234663852886E+38 3.4028234663852886E+38 ECU_ADDRESS_EXTENSION 0x2 BYTE_ORDER MSB_LAST /end CHARACTERISTIC
/begin CHARACTERISTIC _g_PL_AD_fw_Radar_1R1V_rpc_LocBypassingRunnable_LocBypassingRunnable_m_pad_ensRLocationsPort_par_out_local.TChangeableMemPool._._._m_arrayPool._0_._elem._m_LocationList._Item._145_._dVar._m_value "" VALUE 0xB0011240 __Float16_Value 0 NO_COMPU_METHOD -65504 65504 ECU_ADDRESS_EXTENSION 0x2 BYTE_ORDER MSB_LAST /end CHARACTERISTIC
/begin CHARACTERISTIC _g_PL_AD_fw_Radar_1R1V_rpc_LocBypassingRunnable_LocBypassingRunnable_m_pad_ensRLocationsPort_par_out_local.TChangeableMemPool._._._m_arrayPool._0_._elem._m_LocationList._Item._145_._dvCov._m_value "" VALUE 0xB0011244 __Float16_Value 0 NO_COMPU_METHOD -65504 65504 ECU_ADDRESS_EXTENSION 0x2 BYTE_ORDER MSB_LAST /end CHARACTERISTIC
/begin CHARACTERISTIC _g_PL_AD_fw_Radar_1R1V_rpc_LocBypassingRunnable_LocBypassingRunnable_m_pad_ensRLocationsPort_par_out_local.TChangeableMemPool._._._m_arrayPool._0_._elem._m_LocationList._Item._145_._dvQly "" VALUE 0xB0011254 __UByte_Value 0 NO_COMPU_METHOD 0 255 ECU_ADDRESS_EXTENSION 0x2 BYTE_ORDER MSB_LAST /end CHARACTERISTIC
/begin CHARACTERISTIC _g_PL_AD_fw_Radar_1R1V_rpc_LocBypassingRunnable_LocBypassingRunnable_m_pad_ensRLocationsPort_par_out_local.TChangeableMemPool._._._m_arrayPool._0_._elem._m_LocationList._Item._145_._idxAzimuthAmbiguityPeer "" VALUE 0xB0011256 __UWord_Value 0 NO_COMPU_METHOD 0 65535 ECU_ADDRESS_EXTENSION 0x2 BYTE_ORDER MSB_LAST /end CHARACTERISTIC
/begin CHARACTERISTIC _g_PL_AD_fw_Radar_1R1V_rpc_LocBypassingRunnable_LocBypassingRunnable_m_pad_ensRLocationsPort_par_out_local.TChangeableMemPool._._._m_arrayPool._0_._elem._m_LocationList._Item._145_._measStatus "" VALUE 0xB0011255 __UByte_Value 0 NO_COMPU_METHOD 0 255 ECU_ADDRESS_EXTENSION 0x2 BYTE_ORDER MSB_LAST /end CHARACTERISTIC
/begin CHARACTERISTIC _g_PL_AD_fw_Radar_1R1V_rpc_LocBypassingRunnable_LocBypassingRunnable_m_pad_ensRLocationsPort_par_out_local.TChangeableMemPool._._._m_arrayPool._0_._elem._m_LocationList._Item._145_._phi._m_value "" VALUE 0xB0011248 __Float16_Value 0 NO_COMPU_METHOD -65504 65504 ECU_ADDRESS_EXTENSION 0x2 BYTE_ORDER MSB_LAST /end CHARACTERISTIC
/begin CHARACTERISTIC _g_PL_AD_fw_Radar_1R1V_rpc_LocBypassingRunnable_LocBypassingRunnable_m_pad_ensRLocationsPort_par_out_local.TChangeableMemPool._._._m_arrayPool._0_._elem._m_LocationList._Item._145_._phiQly "" VALUE 0xB001124B __UByte_Value 0 NO_COMPU_METHOD 0 255 ECU_ADDRESS_EXTENSION 0x2 BYTE_ORDER MSB_LAST /end CHARACTERISTIC
/begin CHARACTERISTIC _g_PL_AD_fw_Radar_1R1V_rpc_LocBypassingRunnable_LocBypassingRunnable_m_pad_ensRLocationsPort_par_out_local.TChangeableMemPool._._._m_arrayPool._0_._elem._m_LocationList._Item._145_._phiVar._m_value "" VALUE 0xB001124E __Float16_Value 0 NO_COMPU_METHOD -65504 65504 ECU_ADDRESS_EXTENSION 0x2 BYTE_ORDER MSB_LAST /end CHARACTERISTIC
/begin CHARACTERISTIC _g_PL_AD_fw_Radar_1R1V_rpc_LocBypassingRunnable_LocBypassingRunnable_m_pad_ensRLocationsPort_par_out_local.TChangeableMemPool._._._m_arrayPool._0_._elem._m_LocationList._Item._145_._theta._m_value "" VALUE 0xB0011246 __Float16_Value 0 NO_COMPU_METHOD -65504 65504 ECU_ADDRESS_EXTENSION 0x2 BYTE_ORDER MSB_LAST /end CHARACTERISTIC
/begin CHARACTERISTIC _g_PL_AD_fw_Radar_1R1V_rpc_LocBypassingRunnable_LocBypassingRunnable_m_pad_ensRLocationsPort_par_out_local.TChangeableMemPool._._._m_arrayPool._0_._elem._m_LocationList._Item._145_._thetaQly "" VALUE 0xB001124A __UByte_Value 0 NO_COMPU_METHOD 0 255 ECU_ADDRESS_EXTENSION 0x2 BYTE_ORDER MSB_LAST /end CHARACTERISTIC
/begin CHARACTERISTIC _g_PL_AD_fw_Radar_1R1V_rpc_LocBypassingRunnable_LocBypassingRunnable_m_pad_ensRLocationsPort_par_out_local.TChangeableMemPool._._._m_arrayPool._0_._elem._m_LocationList._Item._145_._thetaVar._m_value "" VALUE 0xB001124C __Float16_Value 0 NO_COMPU_METHOD -65504 65504 ECU_ADDRESS_EXTENSION 0x2 BYTE_ORDER MSB_LAST /end CHARACTERISTIC
/begin CHARACTERISTIC _g_PL_AD_fw_Radar_1R1V_rpc_LocBypassingRunnable_LocBypassingRunnable_m_pad_ensRLocationsPort_par_out_local.TChangeableMemPool._._._m_arrayPool._0_._elem._m_LocationList._Item._145_._v "" VALUE 0xB001123C __Float32_Value 0 NO_COMPU_METHOD -3.4028234663852886E+38 3.4028234663852886E+38 ECU_ADDRESS_EXTENSION 0x2 BYTE_ORDER MSB_LAST /end CHARACTERISTIC
/begin CHARACTERISTIC _g_PL_AD_fw_Radar_1R1V_rpc_LocBypassingRunnable_LocBypassingRunnable_m_pad_ensRLocationsPort_par_out_local.TChangeableMemPool._._._m_arrayPool._0_._elem._m_LocationList._Item._145_._vVar._m_value "" VALUE 0xB0011242 __Float16_Value 0 NO_COMPU_METHOD -65504 65504 ECU_ADDRESS_EXTENSION 0x2 BYTE_ORDER MSB_LAST /end CHARACTERISTIC
/begin CHARACTERISTIC _g_PL_AD_fw_Radar_1R1V_rpc_LocBypassingRunnable_LocBypassingRunnable_m_pad_ensRLocationsPort_par_out_local.TChangeableMemPool._._._m_arrayPool._0_._elem._m_LocationList._Item._146_._Rcs._m_value "" VALUE 0xB0011270 __Float16_Value 0 NO_COMPU_METHOD -65504 65504 ECU_ADDRESS_EXTENSION 0x2 BYTE_ORDER MSB_LAST /end CHARACTERISTIC
/begin CHARACTERISTIC _g_PL_AD_fw_Radar_1R1V_rpc_LocBypassingRunnable_LocBypassingRunnable_m_pad_ensRLocationsPort_par_out_local.TChangeableMemPool._._._m_arrayPool._0_._elem._m_LocationList._Item._146_._Rssi._m_value "" VALUE 0xB0011272 __Float16_Value 0 NO_COMPU_METHOD -65504 65504 ECU_ADDRESS_EXTENSION 0x2 BYTE_ORDER MSB_LAST /end CHARACTERISTIC
/begin CHARACTERISTIC _g_PL_AD_fw_Radar_1R1V_rpc_LocBypassingRunnable_LocBypassingRunnable_m_pad_ensRLocationsPort_par_out_local.TChangeableMemPool._._._m_arrayPool._0_._elem._m_LocationList._Item._146_._d "" VALUE 0xB0011258 __Float32_Value 0 NO_COMPU_METHOD -3.4028234663852886E+38 3.4028234663852886E+38 ECU_ADDRESS_EXTENSION 0x2 BYTE_ORDER MSB_LAST /end CHARACTERISTIC
/begin CHARACTERISTIC _g_PL_AD_fw_Radar_1R1V_rpc_LocBypassingRunnable_LocBypassingRunnable_m_pad_ensRLocationsPort_par_out_local.TChangeableMemPool._._._m_arrayPool._0_._elem._m_LocationList._Item._146_._dVar._m_value "" VALUE 0xB0011260 __Float16_Value 0 NO_COMPU_METHOD -65504 65504 ECU_ADDRESS_EXTENSION 0x2 BYTE_ORDER MSB_LAST /end CHARACTERISTIC
/begin CHARACTERISTIC _g_PL_AD_fw_Radar_1R1V_rpc_LocBypassingRunnable_LocBypassingRunnable_m_pad_ensRLocationsPort_par_out_local.TChangeableMemPool._._._m_arrayPool._0_._elem._m_LocationList._Item._146_._dvCov._m_value "" VALUE 0xB0011264 __Float16_Value 0 NO_COMPU_METHOD -65504 65504 ECU_ADDRESS_EXTENSION 0x2 BYTE_ORDER MSB_LAST /end CHARACTERISTIC
/begin CHARACTERISTIC _g_PL_AD_fw_Radar_1R1V_rpc_LocBypassingRunnable_LocBypassingRunnable_m_pad_ensRLocationsPort_par_out_local.TChangeableMemPool._._._m_arrayPool._0_._elem._m_LocationList._Item._146_._dvQly "" VALUE 0xB0011274 __UByte_Value 0 NO_COMPU_METHOD 0 255 ECU_ADDRESS_EXTENSION 0x2 BYTE_ORDER MSB_LAST /end CHARACTERISTIC
/begin CHARACTERISTIC _g_PL_AD_fw_Radar_1R1V_rpc_LocBypassingRunnable_LocBypassingRunnable_m_pad_ensRLocationsPort_par_out_local.TChangeableMemPool._._._m_arrayPool._0_._elem._m_LocationList._Item._146_._idxAzimuthAmbiguityPeer "" VALUE 0xB0011276 __UWord_Value 0 NO_COMPU_METHOD 0 65535 ECU_ADDRESS_EXTENSION 0x2 BYTE_ORDER MSB_LAST /end CHARACTERISTIC
/begin CHARACTERISTIC _g_PL_AD_fw_Radar_1R1V_rpc_LocBypassingRunnable_LocBypassingRunnable_m_pad_ensRLocationsPort_par_out_local.TChangeableMemPool._._._m_arrayPool._0_._elem._m_LocationList._Item._146_._measStatus "" VALUE 0xB0011275 __UByte_Value 0 NO_COMPU_METHOD 0 255 ECU_ADDRESS_EXTENSION 0x2 BYTE_ORDER MSB_LAST /end CHARACTERISTIC
/begin CHARACTERISTIC _g_PL_AD_fw_Radar_1R1V_rpc_LocBypassingRunnable_LocBypassingRunnable_m_pad_ensRLocationsPort_par_out_local.TChangeableMemPool._._._m_arrayPool._0_._elem._m_LocationList._Item._146_._phi._m_value "" VALUE 0xB0011268 __Float16_Value 0 NO_COMPU_METHOD -65504 65504 ECU_ADDRESS_EXTENSION 0x2 BYTE_ORDER MSB_LAST /end CHARACTERISTIC
/begin CHARACTERISTIC _g_PL_AD_fw_Radar_1R1V_rpc_LocBypassingRunnable_LocBypassingRunnable_m_pad_ensRLocationsPort_par_out_local.TChangeableMemPool._._._m_arrayPool._0_._elem._m_LocationList._Item._146_._phiQly "" VALUE 0xB001126B __UByte_Value 0 NO_COMPU_METHOD 0 255 ECU_ADDRESS_EXTENSION 0x2 BYTE_ORDER MSB_LAST /end CHARACTERISTIC
/begin CHARACTERISTIC _g_PL_AD_fw_Radar_1R1V_rpc_LocBypassingRunnable_LocBypassingRunnable_m_pad_ensRLocationsPort_par_out_local.TChangeableMemPool._._._m_arrayPool._0_._elem._m_LocationList._Item._146_._phiVar._m_value "" VALUE 0xB001126E __Float16_Value 0 NO_COMPU_METHOD -65504 65504 ECU_ADDRESS_EXTENSION 0x2 BYTE_ORDER MSB_LAST /end CHARACTERISTIC
/begin CHARACTERISTIC _g_PL_AD_fw_Radar_1R1V_rpc_LocBypassingRunnable_LocBypassingRunnable_m_pad_ensRLocationsPort_par_out_local.TChangeableMemPool._._._m_arrayPool._0_._elem._m_LocationList._Item._146_._theta._m_value "" VALUE 0xB0011266 __Float16_Value 0 NO_COMPU_METHOD -65504 65504 ECU_ADDRESS_EXTENSION 0x2 BYTE_ORDER MSB_LAST /end CHARACTERISTIC
/begin CHARACTERISTIC _g_PL_AD_fw_Radar_1R1V_rpc_LocBypassingRunnable_LocBypassingRunnable_m_pad_ensRLocationsPort_par_out_local.TChangeableMemPool._._._m_arrayPool._0_._elem._m_LocationList._Item._146_._thetaQly "" VALUE 0xB001126A __UByte_Value 0 NO_COMPU_METHOD 0 255 ECU_ADDRESS_EXTENSION 0x2 BYTE_ORDER MSB_LAST /end CHARACTERISTIC
/begin CHARACTERISTIC _g_PL_AD_fw_Radar_1R1V_rpc_LocBypassingRunnable_LocBypassingRunnable_m_pad_ensRLocationsPort_par_out_local.TChangeableMemPool._._._m_arrayPool._0_._elem._m_LocationList._Item._146_._thetaVar._m_value "" VALUE 0xB001126C __Float16_Value 0 NO_COMPU_METHOD -65504 65504 ECU_ADDRESS_EXTENSION 0x2 BYTE_ORDER MSB_LAST /end CHARACTERISTIC
/begin CHARACTERISTIC _g_PL_AD_fw_Radar_1R1V_rpc_LocBypassingRunnable_LocBypassingRunnable_m_pad_ensRLocationsPort_par_out_local.TChangeableMemPool._._._m_arrayPool._0_._elem._m_LocationList._Item._146_._v "" VALUE 0xB001125C __Float32_Value 0 NO_COMPU_METHOD -3.4028234663852886E+38 3.4028234663852886E+38 ECU_ADDRESS_EXTENSION 0x2 BYTE_ORDER MSB_LAST /end CHARACTERISTIC
/begin CHARACTERISTIC _g_PL_AD_fw_Radar_1R1V_rpc_LocBypassingRunnable_LocBypassingRunnable_m_pad_ensRLocationsPort_par_out_local.TChangeableMemPool._._._m_arrayPool._0_._elem._m_LocationList._Item._146_._vVar._m_value "" VALUE 0xB0011262 __Float16_Value 0 NO_COMPU_METHOD -65504 65504 ECU_ADDRESS_EXTENSION 0x2 BYTE_ORDER MSB_LAST /end CHARACTERISTIC
/begin CHARACTERISTIC _g_PL_AD_fw_Radar_1R1V_rpc_LocBypassingRunnable_LocBypassingRunnable_m_pad_ensRLocationsPort_par_out_local.TChangeableMemPool._._._m_arrayPool._0_._elem._m_LocationList._Item._147_._Rcs._m_value "" VALUE 0xB0011290 __Float16_Value 0 NO_COMPU_METHOD -65504 65504 ECU_ADDRESS_EXTENSION 0x2 BYTE_ORDER MSB_LAST /end CHARACTERISTIC
/begin CHARACTERISTIC _g_PL_AD_fw_Radar_1R1V_rpc_LocBypassingRunnable_LocBypassingRunnable_m_pad_ensRLocationsPort_par_out_local.TChangeableMemPool._._._m_arrayPool._0_._elem._m_LocationList._Item._147_._Rssi._m_value "" VALUE 0xB0011292 __Float16_Value 0 NO_COMPU_METHOD -65504 65504 ECU_ADDRESS_EXTENSION 0x2 BYTE_ORDER MSB_LAST /end CHARACTERISTIC
/begin CHARACTERISTIC _g_PL_AD_fw_Radar_1R1V_rpc_LocBypassingRunnable_LocBypassingRunnable_m_pad_ensRLocationsPort_par_out_local.TChangeableMemPool._._._m_arrayPool._0_._elem._m_LocationList._Item._147_._d "" VALUE 0xB0011278 __Float32_Value 0 NO_COMPU_METHOD -3.4028234663852886E+38 3.4028234663852886E+38 ECU_ADDRESS_EXTENSION 0x2 BYTE_ORDER MSB_LAST /end CHARACTERISTIC
/begin CHARACTERISTIC _g_PL_AD_fw_Radar_1R1V_rpc_LocBypassingRunnable_LocBypassingRunnable_m_pad_ensRLocationsPort_par_out_local.TChangeableMemPool._._._m_arrayPool._0_._elem._m_LocationList._Item._147_._dVar._m_value "" VALUE 0xB0011280 __Float16_Value 0 NO_COMPU_METHOD -65504 65504 ECU_ADDRESS_EXTENSION 0x2 BYTE_ORDER MSB_LAST /end CHARACTERISTIC
/begin CHARACTERISTIC _g_PL_AD_fw_Radar_1R1V_rpc_LocBypassingRunnable_LocBypassingRunnable_m_pad_ensRLocationsPort_par_out_local.TChangeableMemPool._._._m_arrayPool._0_._elem._m_LocationList._Item._147_._dvCov._m_value "" VALUE 0xB0011284 __Float16_Value 0 NO_COMPU_METHOD -65504 65504 ECU_ADDRESS_EXTENSION 0x2 BYTE_ORDER MSB_LAST /end CHARACTERISTIC
/begin CHARACTERISTIC _g_PL_AD_fw_Radar_1R1V_rpc_LocBypassingRunnable_LocBypassingRunnable_m_pad_ensRLocationsPort_par_out_local.TChangeableMemPool._._._m_arrayPool._0_._elem._m_LocationList._Item._147_._dvQly "" VALUE 0xB0011294 __UByte_Value 0 NO_COMPU_METHOD 0 255 ECU_ADDRESS_EXTENSION 0x2 BYTE_ORDER MSB_LAST /end CHARACTERISTIC
/begin CHARACTERISTIC _g_PL_AD_fw_Radar_1R1V_rpc_LocBypassingRunnable_LocBypassingRunnable_m_pad_ensRLocationsPort_par_out_local.TChangeableMemPool._._._m_arrayPool._0_._elem._m_LocationList._Item._147_._idxAzimuthAmbiguityPeer "" VALUE 0xB0011296 __UWord_Value 0 NO_COMPU_METHOD 0 65535 ECU_ADDRESS_EXTENSION 0x2 BYTE_ORDER MSB_LAST /end CHARACTERISTIC
/begin CHARACTERISTIC _g_PL_AD_fw_Radar_1R1V_rpc_LocBypassingRunnable_LocBypassingRunnable_m_pad_ensRLocationsPort_par_out_local.TChangeableMemPool._._._m_arrayPool._0_._elem._m_LocationList._Item._147_._measStatus "" VALUE 0xB0011295 __UByte_Value 0 NO_COMPU_METHOD 0 255 ECU_ADDRESS_EXTENSION 0x2 BYTE_ORDER MSB_LAST /end CHARACTERISTIC
/begin CHARACTERISTIC _g_PL_AD_fw_Radar_1R1V_rpc_LocBypassingRunnable_LocBypassingRunnable_m_pad_ensRLocationsPort_par_out_local.TChangeableMemPool._._._m_arrayPool._0_._elem._m_LocationList._Item._147_._phi._m_value "" VALUE 0xB0011288 __Float16_Value 0 NO_COMPU_METHOD -65504 65504 ECU_ADDRESS_EXTENSION 0x2 BYTE_ORDER MSB_LAST /end CHARACTERISTIC
/begin CHARACTERISTIC _g_PL_AD_fw_Radar_1R1V_rpc_LocBypassingRunnable_LocBypassingRunnable_m_pad_ensRLocationsPort_par_out_local.TChangeableMemPool._._._m_arrayPool._0_._elem._m_LocationList._Item._147_._phiQly "" VALUE 0xB001128B __UByte_Value 0 NO_COMPU_METHOD 0 255 ECU_ADDRESS_EXTENSION 0x2 BYTE_ORDER MSB_LAST /end CHARACTERISTIC
/begin CHARACTERISTIC _g_PL_AD_fw_Radar_1R1V_rpc_LocBypassingRunnable_LocBypassingRunnable_m_pad_ensRLocationsPort_par_out_local.TChangeableMemPool._._._m_arrayPool._0_._elem._m_LocationList._Item._147_._phiVar._m_value "" VALUE 0xB001128E __Float16_Value 0 NO_COMPU_METHOD -65504 65504 ECU_ADDRESS_EXTENSION 0x2 BYTE_ORDER MSB_LAST /end CHARACTERISTIC
/begin CHARACTERISTIC _g_PL_AD_fw_Radar_1R1V_rpc_LocBypassingRunnable_LocBypassingRunnable_m_pad_ensRLocationsPort_par_out_local.TChangeableMemPool._._._m_arrayPool._0_._elem._m_LocationList._Item._147_._theta._m_value "" VALUE 0xB0011286 __Float16_Value 0 NO_COMPU_METHOD -65504 65504 ECU_ADDRESS_EXTENSION 0x2 BYTE_ORDER MSB_LAST /end CHARACTERISTIC
/begin CHARACTERISTIC _g_PL_AD_fw_Radar_1R1V_rpc_LocBypassingRunnable_LocBypassingRunnable_m_pad_ensRLocationsPort_par_out_local.TChangeableMemPool._._._m_arrayPool._0_._elem._m_LocationList._Item._147_._thetaQly "" VALUE 0xB001128A __UByte_Value 0 NO_COMPU_METHOD 0 255 ECU_ADDRESS_EXTENSION 0x2 BYTE_ORDER MSB_LAST /end CHARACTERISTIC
/begin CHARACTERISTIC _g_PL_AD_fw_Radar_1R1V_rpc_LocBypassingRunnable_LocBypassingRunnable_m_pad_ensRLocationsPort_par_out_local.TChangeableMemPool._._._m_arrayPool._0_._elem._m_LocationList._Item._147_._thetaVar._m_value "" VALUE 0xB001128C __Float16_Value 0 NO_COMPU_METHOD -65504 65504 ECU_ADDRESS_EXTENSION 0x2 BYTE_ORDER MSB_LAST /end CHARACTERISTIC
/begin CHARACTERISTIC _g_PL_AD_fw_Radar_1R1V_rpc_LocBypassingRunnable_LocBypassingRunnable_m_pad_ensRLocationsPort_par_out_local.TChangeableMemPool._._._m_arrayPool._0_._elem._m_LocationList._Item._147_._v "" VALUE 0xB001127C __Float32_Value 0 NO_COMPU_METHOD -3.4028234663852886E+38 3.4028234663852886E+38 ECU_ADDRESS_EXTENSION 0x2 BYTE_ORDER MSB_LAST /end CHARACTERISTIC
/begin CHARACTERISTIC _g_PL_AD_fw_Radar_1R1V_rpc_LocBypassingRunnable_LocBypassingRunnable_m_pad_ensRLocationsPort_par_out_local.TChangeableMemPool._._._m_arrayPool._0_._elem._m_LocationList._Item._147_._vVar._m_value "" VALUE 0xB0011282 __Float16_Value 0 NO_COMPU_METHOD -65504 65504 ECU_ADDRESS_EXTENSION 0x2 BYTE_ORDER MSB_LAST /end CHARACTERISTIC
/begin CHARACTERISTIC _g_PL_AD_fw_Radar_1R1V_rpc_LocBypassingRunnable_LocBypassingRunnable_m_pad_ensRLocationsPort_par_out_local.TChangeableMemPool._._._m_arrayPool._0_._elem._m_LocationList._Item._148_._Rcs._m_value "" VALUE 0xB00112B0 __Float16_Value 0 NO_COMPU_METHOD -65504 65504 ECU_ADDRESS_EXTENSION 0x2 BYTE_ORDER MSB_LAST /end CHARACTERISTIC
/begin CHARACTERISTIC _g_PL_AD_fw_Radar_1R1V_rpc_LocBypassingRunnable_LocBypassingRunnable_m_pad_ensRLocationsPort_par_out_local.TChangeableMemPool._._._m_arrayPool._0_._elem._m_LocationList._Item._148_._Rssi._m_value "" VALUE 0xB00112B2 __Float16_Value 0 NO_COMPU_METHOD -65504 65504 ECU_ADDRESS_EXTENSION 0x2 BYTE_ORDER MSB_LAST /end CHARACTERISTIC
/begin CHARACTERISTIC _g_PL_AD_fw_Radar_1R1V_rpc_LocBypassingRunnable_LocBypassingRunnable_m_pad_ensRLocationsPort_par_out_local.TChangeableMemPool._._._m_arrayPool._0_._elem._m_LocationList._Item._148_._d "" VALUE 0xB0011298 __Float32_Value 0 NO_COMPU_METHOD -3.4028234663852886E+38 3.4028234663852886E+38 ECU_ADDRESS_EXTENSION 0x2 BYTE_ORDER MSB_LAST /end CHARACTERISTIC
/begin CHARACTERISTIC _g_PL_AD_fw_Radar_1R1V_rpc_LocBypassingRunnable_LocBypassingRunnable_m_pad_ensRLocationsPort_par_out_local.TChangeableMemPool._._._m_arrayPool._0_._elem._m_LocationList._Item._148_._dVar._m_value "" VALUE 0xB00112A0 __Float16_Value 0 NO_COMPU_METHOD -65504 65504 ECU_ADDRESS_EXTENSION 0x2 BYTE_ORDER MSB_LAST /end CHARACTERISTIC
/begin CHARACTERISTIC _g_PL_AD_fw_Radar_1R1V_rpc_LocBypassingRunnable_LocBypassingRunnable_m_pad_ensRLocationsPort_par_out_local.TChangeableMemPool._._._m_arrayPool._0_._elem._m_LocationList._Item._148_._dvCov._m_value "" VALUE 0xB00112A4 __Float16_Value 0 NO_COMPU_METHOD -65504 65504 ECU_ADDRESS_EXTENSION 0x2 BYTE_ORDER MSB_LAST /end CHARACTERISTIC
/begin CHARACTERISTIC _g_PL_AD_fw_Radar_1R1V_rpc_LocBypassingRunnable_LocBypassingRunnable_m_pad_ensRLocationsPort_par_out_local.TChangeableMemPool._._._m_arrayPool._0_._elem._m_LocationList._Item._148_._dvQly "" VALUE 0xB00112B4 __UByte_Value 0 NO_COMPU_METHOD 0 255 ECU_ADDRESS_EXTENSION 0x2 BYTE_ORDER MSB_LAST /end CHARACTERISTIC
/begin CHARACTERISTIC _g_PL_AD_fw_Radar_1R1V_rpc_LocBypassingRunnable_LocBypassingRunnable_m_pad_ensRLocationsPort_par_out_local.TChangeableMemPool._._._m_arrayPool._0_._elem._m_LocationList._Item._148_._idxAzimuthAmbiguityPeer "" VALUE 0xB00112B6 __UWord_Value 0 NO_COMPU_METHOD 0 65535 ECU_ADDRESS_EXTENSION 0x2 BYTE_ORDER MSB_LAST /end CHARACTERISTIC
/begin CHARACTERISTIC _g_PL_AD_fw_Radar_1R1V_rpc_LocBypassingRunnable_LocBypassingRunnable_m_pad_ensRLocationsPort_par_out_local.TChangeableMemPool._._._m_arrayPool._0_._elem._m_LocationList._Item._148_._measStatus "" VALUE 0xB00112B5 __UByte_Value 0 NO_COMPU_METHOD 0 255 ECU_ADDRESS_EXTENSION 0x2 BYTE_ORDER MSB_LAST /end CHARACTERISTIC
/begin CHARACTERISTIC _g_PL_AD_fw_Radar_1R1V_rpc_LocBypassingRunnable_LocBypassingRunnable_m_pad_ensRLocationsPort_par_out_local.TChangeableMemPool._._._m_arrayPool._0_._elem._m_LocationList._Item._148_._phi._m_value "" VALUE 0xB00112A8 __Float16_Value 0 NO_COMPU_METHOD -65504 65504 ECU_ADDRESS_EXTENSION 0x2 BYTE_ORDER MSB_LAST /end CHARACTERISTIC
/begin CHARACTERISTIC _g_PL_AD_fw_Radar_1R1V_rpc_LocBypassingRunnable_LocBypassingRunnable_m_pad_ensRLocationsPort_par_out_local.TChangeableMemPool._._._m_arrayPool._0_._elem._m_LocationList._Item._148_._phiQly "" VALUE 0xB00112AB __UByte_Value 0 NO_COMPU_METHOD 0 255 ECU_ADDRESS_EXTENSION 0x2 BYTE_ORDER MSB_LAST /end CHARACTERISTIC
/begin CHARACTERISTIC _g_PL_AD_fw_Radar_1R1V_rpc_LocBypassingRunnable_LocBypassingRunnable_m_pad_ensRLocationsPort_par_out_local.TChangeableMemPool._._._m_arrayPool._0_._elem._m_LocationList._Item._148_._phiVar._m_value "" VALUE 0xB00112AE __Float16_Value 0 NO_COMPU_METHOD -65504 65504 ECU_ADDRESS_EXTENSION 0x2 BYTE_ORDER MSB_LAST /end CHARACTERISTIC
/begin CHARACTERISTIC _g_PL_AD_fw_Radar_1R1V_rpc_LocBypassingRunnable_LocBypassingRunnable_m_pad_ensRLocationsPort_par_out_local.TChangeableMemPool._._._m_arrayPool._0_._elem._m_LocationList._Item._148_._theta._m_value "" VALUE 0xB00112A6 __Float16_Value 0 NO_COMPU_METHOD -65504 65504 ECU_ADDRESS_EXTENSION 0x2 BYTE_ORDER MSB_LAST /end CHARACTERISTIC
/begin CHARACTERISTIC _g_PL_AD_fw_Radar_1R1V_rpc_LocBypassingRunnable_LocBypassingRunnable_m_pad_ensRLocationsPort_par_out_local.TChangeableMemPool._._._m_arrayPool._0_._elem._m_LocationList._Item._148_._thetaQly "" VALUE 0xB00112AA __UByte_Value 0 NO_COMPU_METHOD 0 255 ECU_ADDRESS_EXTENSION 0x2 BYTE_ORDER MSB_LAST /end CHARACTERISTIC
/begin CHARACTERISTIC _g_PL_AD_fw_Radar_1R1V_rpc_LocBypassingRunnable_LocBypassingRunnable_m_pad_ensRLocationsPort_par_out_local.TChangeableMemPool._._._m_arrayPool._0_._elem._m_LocationList._Item._148_._thetaVar._m_value "" VALUE 0xB00112AC __Float16_Value 0 NO_COMPU_METHOD -65504 65504 ECU_ADDRESS_EXTENSION 0x2 BYTE_ORDER MSB_LAST /end CHARACTERISTIC
/begin CHARACTERISTIC _g_PL_AD_fw_Radar_1R1V_rpc_LocBypassingRunnable_LocBypassingRunnable_m_pad_ensRLocationsPort_par_out_local.TChangeableMemPool._._._m_arrayPool._0_._elem._m_LocationList._Item._148_._v "" VALUE 0xB001129C __Float32_Value 0 NO_COMPU_METHOD -3.4028234663852886E+38 3.4028234663852886E+38 ECU_ADDRESS_EXTENSION 0x2 BYTE_ORDER MSB_LAST /end CHARACTERISTIC
/begin CHARACTERISTIC _g_PL_AD_fw_Radar_1R1V_rpc_LocBypassingRunnable_LocBypassingRunnable_m_pad_ensRLocationsPort_par_out_local.TChangeableMemPool._._._m_arrayPool._0_._elem._m_LocationList._Item._148_._vVar._m_value "" VALUE 0xB00112A2 __Float16_Value 0 NO_COMPU_METHOD -65504 65504 ECU_ADDRESS_EXTENSION 0x2 BYTE_ORDER MSB_LAST /end CHARACTERISTIC
/begin CHARACTERISTIC _g_PL_AD_fw_Radar_1R1V_rpc_LocBypassingRunnable_LocBypassingRunnable_m_pad_ensRLocationsPort_par_out_local.TChangeableMemPool._._._m_arrayPool._0_._elem._m_LocationList._Item._149_._Rcs._m_value "" VALUE 0xB00112D0 __Float16_Value 0 NO_COMPU_METHOD -65504 65504 ECU_ADDRESS_EXTENSION 0x2 BYTE_ORDER MSB_LAST /end CHARACTERISTIC
/begin CHARACTERISTIC _g_PL_AD_fw_Radar_1R1V_rpc_LocBypassingRunnable_LocBypassingRunnable_m_pad_ensRLocationsPort_par_out_local.TChangeableMemPool._._._m_arrayPool._0_._elem._m_LocationList._Item._149_._Rssi._m_value "" VALUE 0xB00112D2 __Float16_Value 0 NO_COMPU_METHOD -65504 65504 ECU_ADDRESS_EXTENSION 0x2 BYTE_ORDER MSB_LAST /end CHARACTERISTIC
/begin CHARACTERISTIC _g_PL_AD_fw_Radar_1R1V_rpc_LocBypassingRunnable_LocBypassingRunnable_m_pad_ensRLocationsPort_par_out_local.TChangeableMemPool._._._m_arrayPool._0_._elem._m_LocationList._Item._149_._d "" VALUE 0xB00112B8 __Float32_Value 0 NO_COMPU_METHOD -3.4028234663852886E+38 3.4028234663852886E+38 ECU_ADDRESS_EXTENSION 0x2 BYTE_ORDER MSB_LAST /end CHARACTERISTIC
/begin CHARACTERISTIC _g_PL_AD_fw_Radar_1R1V_rpc_LocBypassingRunnable_LocBypassingRunnable_m_pad_ensRLocationsPort_par_out_local.TChangeableMemPool._._._m_arrayPool._0_._elem._m_LocationList._Item._149_._dVar._m_value "" VALUE 0xB00112C0 __Float16_Value 0 NO_COMPU_METHOD -65504 65504 ECU_ADDRESS_EXTENSION 0x2 BYTE_ORDER MSB_LAST /end CHARACTERISTIC
/begin CHARACTERISTIC _g_PL_AD_fw_Radar_1R1V_rpc_LocBypassingRunnable_LocBypassingRunnable_m_pad_ensRLocationsPort_par_out_local.TChangeableMemPool._._._m_arrayPool._0_._elem._m_LocationList._Item._149_._dvCov._m_value "" VALUE 0xB00112C4 __Float16_Value 0 NO_COMPU_METHOD -65504 65504 ECU_ADDRESS_EXTENSION 0x2 BYTE_ORDER MSB_LAST /end CHARACTERISTIC
/begin CHARACTERISTIC _g_PL_AD_fw_Radar_1R1V_rpc_LocBypassingRunnable_LocBypassingRunnable_m_pad_ensRLocationsPort_par_out_local.TChangeableMemPool._._._m_arrayPool._0_._elem._m_LocationList._Item._149_._dvQly "" VALUE 0xB00112D4 __UByte_Value 0 NO_COMPU_METHOD 0 255 ECU_ADDRESS_EXTENSION 0x2 BYTE_ORDER MSB_LAST /end CHARACTERISTIC
/begin CHARACTERISTIC _g_PL_AD_fw_Radar_1R1V_rpc_LocBypassingRunnable_LocBypassingRunnable_m_pad_ensRLocationsPort_par_out_local.TChangeableMemPool._._._m_arrayPool._0_._elem._m_LocationList._Item._149_._idxAzimuthAmbiguityPeer "" VALUE 0xB00112D6 __UWord_Value 0 NO_COMPU_METHOD 0 65535 ECU_ADDRESS_EXTENSION 0x2 BYTE_ORDER MSB_LAST /end CHARACTERISTIC
/begin CHARACTERISTIC _g_PL_AD_fw_Radar_1R1V_rpc_LocBypassingRunnable_LocBypassingRunnable_m_pad_ensRLocationsPort_par_out_local.TChangeableMemPool._._._m_arrayPool._0_._elem._m_LocationList._Item._149_._measStatus "" VALUE 0xB00112D5 __UByte_Value 0 NO_COMPU_METHOD 0 255 ECU_ADDRESS_EXTENSION 0x2 BYTE_ORDER MSB_LAST /end CHARACTERISTIC
/begin CHARACTERISTIC _g_PL_AD_fw_Radar_1R1V_rpc_LocBypassingRunnable_LocBypassingRunnable_m_pad_ensRLocationsPort_par_out_local.TChangeableMemPool._._._m_arrayPool._0_._elem._m_LocationList._Item._149_._phi._m_value "" VALUE 0xB00112C8 __Float16_Value 0 NO_COMPU_METHOD -65504 65504 ECU_ADDRESS_EXTENSION 0x2 BYTE_ORDER MSB_LAST /end CHARACTERISTIC
/begin CHARACTERISTIC _g_PL_AD_fw_Radar_1R1V_rpc_LocBypassingRunnable_LocBypassingRunnable_m_pad_ensRLocationsPort_par_out_local.TChangeableMemPool._._._m_arrayPool._0_._elem._m_LocationList._Item._149_._phiQly "" VALUE 0xB00112CB __UByte_Value 0 NO_COMPU_METHOD 0 255 ECU_ADDRESS_EXTENSION 0x2 BYTE_ORDER MSB_LAST /end CHARACTERISTIC
/begin CHARACTERISTIC _g_PL_AD_fw_Radar_1R1V_rpc_LocBypassingRunnable_LocBypassingRunnable_m_pad_ensRLocationsPort_par_out_local.TChangeableMemPool._._._m_arrayPool._0_._elem._m_LocationList._Item._149_._phiVar._m_value "" VALUE 0xB00112CE __Float16_Value 0 NO_COMPU_METHOD -65504 65504 ECU_ADDRESS_EXTENSION 0x2 BYTE_ORDER MSB_LAST /end CHARACTERISTIC
/begin CHARACTERISTIC _g_PL_AD_fw_Radar_1R1V_rpc_LocBypassingRunnable_LocBypassingRunnable_m_pad_ensRLocationsPort_par_out_local.TChangeableMemPool._._._m_arrayPool._0_._elem._m_LocationList._Item._149_._theta._m_value "" VALUE 0xB00112C6 __Float16_Value 0 NO_COMPU_METHOD -65504 65504 ECU_ADDRESS_EXTENSION 0x2 BYTE_ORDER MSB_LAST /end CHARACTERISTIC
/begin CHARACTERISTIC _g_PL_AD_fw_Radar_1R1V_rpc_LocBypassingRunnable_LocBypassingRunnable_m_pad_ensRLocationsPort_par_out_local.TChangeableMemPool._._._m_arrayPool._0_._elem._m_LocationList._Item._149_._thetaQly "" VALUE 0xB00112CA __UByte_Value 0 NO_COMPU_METHOD 0 255 ECU_ADDRESS_EXTENSION 0x2 BYTE_ORDER MSB_LAST /end CHARACTERISTIC
/begin CHARACTERISTIC _g_PL_AD_fw_Radar_1R1V_rpc_LocBypassingRunnable_LocBypassingRunnable_m_pad_ensRLocationsPort_par_out_local.TChangeableMemPool._._._m_arrayPool._0_._elem._m_LocationList._Item._149_._thetaVar._m_value "" VALUE 0xB00112CC __Float16_Value 0 NO_COMPU_METHOD -65504 65504 ECU_ADDRESS_EXTENSION 0x2 BYTE_ORDER MSB_LAST /end CHARACTERISTIC
/begin CHARACTERISTIC _g_PL_AD_fw_Radar_1R1V_rpc_LocBypassingRunnable_LocBypassingRunnable_m_pad_ensRLocationsPort_par_out_local.TChangeableMemPool._._._m_arrayPool._0_._elem._m_LocationList._Item._149_._v "" VALUE 0xB00112BC __Float32_Value 0 NO_COMPU_METHOD -3.4028234663852886E+38 3.4028234663852886E+38 ECU_ADDRESS_EXTENSION 0x2 BYTE_ORDER MSB_LAST /end CHARACTERISTIC
/begin CHARACTERISTIC _g_PL_AD_fw_Radar_1R1V_rpc_LocBypassingRunnable_LocBypassingRunnable_m_pad_ensRLocationsPort_par_out_local.TChangeableMemPool._._._m_arrayPool._0_._elem._m_LocationList._Item._149_._vVar._m_value "" VALUE 0xB00112C2 __Float16_Value 0 NO_COMPU_METHOD -65504 65504 ECU_ADDRESS_EXTENSION 0x2 BYTE_ORDER MSB_LAST /end CHARACTERISTIC
/begin CHARACTERISTIC _g_PL_AD_fw_Radar_1R1V_rpc_LocBypassingRunnable_LocBypassingRunnable_m_pad_ensRLocationsPort_par_out_local.TChangeableMemPool._._._m_arrayPool._0_._elem._m_LocationList._Item._14_._Rcs._m_value "" VALUE 0xB00101F0 __Float16_Value 0 NO_COMPU_METHOD -65504 65504 ECU_ADDRESS_EXTENSION 0x2 BYTE_ORDER MSB_LAST /end CHARACTERISTIC
/begin CHARACTERISTIC _g_PL_AD_fw_Radar_1R1V_rpc_LocBypassingRunnable_LocBypassingRunnable_m_pad_ensRLocationsPort_par_out_local.TChangeableMemPool._._._m_arrayPool._0_._elem._m_LocationList._Item._14_._Rssi._m_value "" VALUE 0xB00101F2 __Float16_Value 0 NO_COMPU_METHOD -65504 65504 ECU_ADDRESS_EXTENSION 0x2 BYTE_ORDER MSB_LAST /end CHARACTERISTIC
/begin CHARACTERISTIC _g_PL_AD_fw_Radar_1R1V_rpc_LocBypassingRunnable_LocBypassingRunnable_m_pad_ensRLocationsPort_par_out_local.TChangeableMemPool._._._m_arrayPool._0_._elem._m_LocationList._Item._14_._d "" VALUE 0xB00101D8 __Float32_Value 0 NO_COMPU_METHOD -3.4028234663852886E+38 3.4028234663852886E+38 ECU_ADDRESS_EXTENSION 0x2 BYTE_ORDER MSB_LAST /end CHARACTERISTIC
/begin CHARACTERISTIC _g_PL_AD_fw_Radar_1R1V_rpc_LocBypassingRunnable_LocBypassingRunnable_m_pad_ensRLocationsPort_par_out_local.TChangeableMemPool._._._m_arrayPool._0_._elem._m_LocationList._Item._14_._dVar._m_value "" VALUE 0xB00101E0 __Float16_Value 0 NO_COMPU_METHOD -65504 65504 ECU_ADDRESS_EXTENSION 0x2 BYTE_ORDER MSB_LAST /end CHARACTERISTIC
/begin CHARACTERISTIC _g_PL_AD_fw_Radar_1R1V_rpc_LocBypassingRunnable_LocBypassingRunnable_m_pad_ensRLocationsPort_par_out_local.TChangeableMemPool._._._m_arrayPool._0_._elem._m_LocationList._Item._14_._dvCov._m_value "" VALUE 0xB00101E4 __Float16_Value 0 NO_COMPU_METHOD -65504 65504 ECU_ADDRESS_EXTENSION 0x2 BYTE_ORDER MSB_LAST /end CHARACTERISTIC
/begin CHARACTERISTIC _g_PL_AD_fw_Radar_1R1V_rpc_LocBypassingRunnable_LocBypassingRunnable_m_pad_ensRLocationsPort_par_out_local.TChangeableMemPool._._._m_arrayPool._0_._elem._m_LocationList._Item._14_._dvQly "" VALUE 0xB00101F4 __UByte_Value 0 NO_COMPU_METHOD 0 255 ECU_ADDRESS_EXTENSION 0x2 BYTE_ORDER MSB_LAST /end CHARACTERISTIC
/begin CHARACTERISTIC _g_PL_AD_fw_Radar_1R1V_rpc_LocBypassingRunnable_LocBypassingRunnable_m_pad_ensRLocationsPort_par_out_local.TChangeableMemPool._._._m_arrayPool._0_._elem._m_LocationList._Item._14_._idxAzimuthAmbiguityPeer "" VALUE 0xB00101F6 __UWord_Value 0 NO_COMPU_METHOD 0 65535 ECU_ADDRESS_EXTENSION 0x2 BYTE_ORDER MSB_LAST /end CHARACTERISTIC
/begin CHARACTERISTIC _g_PL_AD_fw_Radar_1R1V_rpc_LocBypassingRunnable_LocBypassingRunnable_m_pad_ensRLocationsPort_par_out_local.TChangeableMemPool._._._m_arrayPool._0_._elem._m_LocationList._Item._14_._measStatus "" VALUE 0xB00101F5 __UByte_Value 0 NO_COMPU_METHOD 0 255 ECU_ADDRESS_EXTENSION 0x2 BYTE_ORDER MSB_LAST /end CHARACTERISTIC
/begin CHARACTERISTIC _g_PL_AD_fw_Radar_1R1V_rpc_LocBypassingRunnable_LocBypassingRunnable_m_pad_ensRLocationsPort_par_out_local.TChangeableMemPool._._._m_arrayPool._0_._elem._m_LocationList._Item._14_._phi._m_value "" VALUE 0xB00101E8 __Float16_Value 0 NO_COMPU_METHOD -65504 65504 ECU_ADDRESS_EXTENSION 0x2 BYTE_ORDER MSB_LAST /end CHARACTERISTIC
/begin CHARACTERISTIC _g_PL_AD_fw_Radar_1R1V_rpc_LocBypassingRunnable_LocBypassingRunnable_m_pad_ensRLocationsPort_par_out_local.TChangeableMemPool._._._m_arrayPool._0_._elem._m_LocationList._Item._14_._phiQly "" VALUE 0xB00101EB __UByte_Value 0 NO_COMPU_METHOD 0 255 ECU_ADDRESS_EXTENSION 0x2 BYTE_ORDER MSB_LAST /end CHARACTERISTIC
/begin CHARACTERISTIC _g_PL_AD_fw_Radar_1R1V_rpc_LocBypassingRunnable_LocBypassingRunnable_m_pad_ensRLocationsPort_par_out_local.TChangeableMemPool._._._m_arrayPool._0_._elem._m_LocationList._Item._14_._phiVar._m_value "" VALUE 0xB00101EE __Float16_Value 0 NO_COMPU_METHOD -65504 65504 ECU_ADDRESS_EXTENSION 0x2 BYTE_ORDER MSB_LAST /end CHARACTERISTIC
/begin CHARACTERISTIC _g_PL_AD_fw_Radar_1R1V_rpc_LocBypassingRunnable_LocBypassingRunnable_m_pad_ensRLocationsPort_par_out_local.TChangeableMemPool._._._m_arrayPool._0_._elem._m_LocationList._Item._14_._theta._m_value "" VALUE 0xB00101E6 __Float16_Value 0 NO_COMPU_METHOD -65504 65504 ECU_ADDRESS_EXTENSION 0x2 BYTE_ORDER MSB_LAST /end CHARACTERISTIC
/begin CHARACTERISTIC _g_PL_AD_fw_Radar_1R1V_rpc_LocBypassingRunnable_LocBypassingRunnable_m_pad_ensRLocationsPort_par_out_local.TChangeableMemPool._._._m_arrayPool._0_._elem._m_LocationList._Item._14_._thetaQly "" VALUE 0xB00101EA __UByte_Value 0 NO_COMPU_METHOD 0 255 ECU_ADDRESS_EXTENSION 0x2 BYTE_ORDER MSB_LAST /end CHARACTERISTIC
/begin CHARACTERISTIC _g_PL_AD_fw_Radar_1R1V_rpc_LocBypassingRunnable_LocBypassingRunnable_m_pad_ensRLocationsPort_par_out_local.TChangeableMemPool._._._m_arrayPool._0_._elem._m_LocationList._Item._14_._thetaVar._m_value "" VALUE 0xB00101EC __Float16_Value 0 NO_COMPU_METHOD -65504 65504 ECU_ADDRESS_EXTENSION 0x2 BYTE_ORDER MSB_LAST /end CHARACTERISTIC
/begin CHARACTERISTIC _g_PL_AD_fw_Radar_1R1V_rpc_LocBypassingRunnable_LocBypassingRunnable_m_pad_ensRLocationsPort_par_out_local.TChangeableMemPool._._._m_arrayPool._0_._elem._m_LocationList._Item._14_._v "" VALUE 0xB00101DC __Float32_Value 0 NO_COMPU_METHOD -3.4028234663852886E+38 3.4028234663852886E+38 ECU_ADDRESS_EXTENSION 0x2 BYTE_ORDER MSB_LAST /end CHARACTERISTIC
/begin CHARACTERISTIC _g_PL_AD_fw_Radar_1R1V_rpc_LocBypassingRunnable_LocBypassingRunnable_m_pad_ensRLocationsPort_par_out_local.TChangeableMemPool._._._m_arrayPool._0_._elem._m_LocationList._Item._14_._vVar._m_value "" VALUE 0xB00101E2 __Float16_Value 0 NO_COMPU_METHOD -65504 65504 ECU_ADDRESS_EXTENSION 0x2 BYTE_ORDER MSB_LAST /end CHARACTERISTIC
/begin CHARACTERISTIC _g_PL_AD_fw_Radar_1R1V_rpc_LocBypassingRunnable_LocBypassingRunnable_m_pad_ensRLocationsPort_par_out_local.TChangeableMemPool._._._m_arrayPool._0_._elem._m_LocationList._Item._150_._Rcs._m_value "" VALUE 0xB00112F0 __Float16_Value 0 NO_COMPU_METHOD -65504 65504 ECU_ADDRESS_EXTENSION 0x2 BYTE_ORDER MSB_LAST /end CHARACTERISTIC
/begin CHARACTERISTIC _g_PL_AD_fw_Radar_1R1V_rpc_LocBypassingRunnable_LocBypassingRunnable_m_pad_ensRLocationsPort_par_out_local.TChangeableMemPool._._._m_arrayPool._0_._elem._m_LocationList._Item._150_._Rssi._m_value "" VALUE 0xB00112F2 __Float16_Value 0 NO_COMPU_METHOD -65504 65504 ECU_ADDRESS_EXTENSION 0x2 BYTE_ORDER MSB_LAST /end CHARACTERISTIC
/begin CHARACTERISTIC _g_PL_AD_fw_Radar_1R1V_rpc_LocBypassingRunnable_LocBypassingRunnable_m_pad_ensRLocationsPort_par_out_local.TChangeableMemPool._._._m_arrayPool._0_._elem._m_LocationList._Item._150_._d "" VALUE 0xB00112D8 __Float32_Value 0 NO_COMPU_METHOD -3.4028234663852886E+38 3.4028234663852886E+38 ECU_ADDRESS_EXTENSION 0x2 BYTE_ORDER MSB_LAST /end CHARACTERISTIC
/begin CHARACTERISTIC _g_PL_AD_fw_Radar_1R1V_rpc_LocBypassingRunnable_LocBypassingRunnable_m_pad_ensRLocationsPort_par_out_local.TChangeableMemPool._._._m_arrayPool._0_._elem._m_LocationList._Item._150_._dVar._m_value "" VALUE 0xB00112E0 __Float16_Value 0 NO_COMPU_METHOD -65504 65504 ECU_ADDRESS_EXTENSION 0x2 BYTE_ORDER MSB_LAST /end CHARACTERISTIC
/begin CHARACTERISTIC _g_PL_AD_fw_Radar_1R1V_rpc_LocBypassingRunnable_LocBypassingRunnable_m_pad_ensRLocationsPort_par_out_local.TChangeableMemPool._._._m_arrayPool._0_._elem._m_LocationList._Item._150_._dvCov._m_value "" VALUE 0xB00112E4 __Float16_Value 0 NO_COMPU_METHOD -65504 65504 ECU_ADDRESS_EXTENSION 0x2 BYTE_ORDER MSB_LAST /end CHARACTERISTIC
/begin CHARACTERISTIC _g_PL_AD_fw_Radar_1R1V_rpc_LocBypassingRunnable_LocBypassingRunnable_m_pad_ensRLocationsPort_par_out_local.TChangeableMemPool._._._m_arrayPool._0_._elem._m_LocationList._Item._150_._dvQly "" VALUE 0xB00112F4 __UByte_Value 0 NO_COMPU_METHOD 0 255 ECU_ADDRESS_EXTENSION 0x2 BYTE_ORDER MSB_LAST /end CHARACTERISTIC
/begin CHARACTERISTIC _g_PL_AD_fw_Radar_1R1V_rpc_LocBypassingRunnable_LocBypassingRunnable_m_pad_ensRLocationsPort_par_out_local.TChangeableMemPool._._._m_arrayPool._0_._elem._m_LocationList._Item._150_._idxAzimuthAmbiguityPeer "" VALUE 0xB00112F6 __UWord_Value 0 NO_COMPU_METHOD 0 65535 ECU_ADDRESS_EXTENSION 0x2 BYTE_ORDER MSB_LAST /end CHARACTERISTIC
/begin CHARACTERISTIC _g_PL_AD_fw_Radar_1R1V_rpc_LocBypassingRunnable_LocBypassingRunnable_m_pad_ensRLocationsPort_par_out_local.TChangeableMemPool._._._m_arrayPool._0_._elem._m_LocationList._Item._150_._measStatus "" VALUE 0xB00112F5 __UByte_Value 0 NO_COMPU_METHOD 0 255 ECU_ADDRESS_EXTENSION 0x2 BYTE_ORDER MSB_LAST /end CHARACTERISTIC
/begin CHARACTERISTIC _g_PL_AD_fw_Radar_1R1V_rpc_LocBypassingRunnable_LocBypassingRunnable_m_pad_ensRLocationsPort_par_out_local.TChangeableMemPool._._._m_arrayPool._0_._elem._m_LocationList._Item._150_._phi._m_value "" VALUE 0xB00112E8 __Float16_Value 0 NO_COMPU_METHOD -65504 65504 ECU_ADDRESS_EXTENSION 0x2 BYTE_ORDER MSB_LAST /end CHARACTERISTIC
/begin CHARACTERISTIC _g_PL_AD_fw_Radar_1R1V_rpc_LocBypassingRunnable_LocBypassingRunnable_m_pad_ensRLocationsPort_par_out_local.TChangeableMemPool._._._m_arrayPool._0_._elem._m_LocationList._Item._150_._phiQly "" VALUE 0xB00112EB __UByte_Value 0 NO_COMPU_METHOD 0 255 ECU_ADDRESS_EXTENSION 0x2 BYTE_ORDER MSB_LAST /end CHARACTERISTIC
/begin CHARACTERISTIC _g_PL_AD_fw_Radar_1R1V_rpc_LocBypassingRunnable_LocBypassingRunnable_m_pad_ensRLocationsPort_par_out_local.TChangeableMemPool._._._m_arrayPool._0_._elem._m_LocationList._Item._150_._phiVar._m_value "" VALUE 0xB00112EE __Float16_Value 0 NO_COMPU_METHOD -65504 65504 ECU_ADDRESS_EXTENSION 0x2 BYTE_ORDER MSB_LAST /end CHARACTERISTIC
/begin CHARACTERISTIC _g_PL_AD_fw_Radar_1R1V_rpc_LocBypassingRunnable_LocBypassingRunnable_m_pad_ensRLocationsPort_par_out_local.TChangeableMemPool._._._m_arrayPool._0_._elem._m_LocationList._Item._150_._theta._m_value "" VALUE 0xB00112E6 __Float16_Value 0 NO_COMPU_METHOD -65504 65504 ECU_ADDRESS_EXTENSION 0x2 BYTE_ORDER MSB_LAST /end CHARACTERISTIC
/begin CHARACTERISTIC _g_PL_AD_fw_Radar_1R1V_rpc_LocBypassingRunnable_LocBypassingRunnable_m_pad_ensRLocationsPort_par_out_local.TChangeableMemPool._._._m_arrayPool._0_._elem._m_LocationList._Item._150_._thetaQly "" VALUE 0xB00112EA __UByte_Value 0 NO_COMPU_METHOD 0 255 ECU_ADDRESS_EXTENSION 0x2 BYTE_ORDER MSB_LAST /end CHARACTERISTIC
/begin CHARACTERISTIC _g_PL_AD_fw_Radar_1R1V_rpc_LocBypassingRunnable_LocBypassingRunnable_m_pad_ensRLocationsPort_par_out_local.TChangeableMemPool._._._m_arrayPool._0_._elem._m_LocationList._Item._150_._thetaVar._m_value "" VALUE 0xB00112EC __Float16_Value 0 NO_COMPU_METHOD -65504 65504 ECU_ADDRESS_EXTENSION 0x2 BYTE_ORDER MSB_LAST /end CHARACTERISTIC
/begin CHARACTERISTIC _g_PL_AD_fw_Radar_1R1V_rpc_LocBypassingRunnable_LocBypassingRunnable_m_pad_ensRLocationsPort_par_out_local.TChangeableMemPool._._._m_arrayPool._0_._elem._m_LocationList._Item._150_._v "" VALUE 0xB00112DC __Float32_Value 0 NO_COMPU_METHOD -3.4028234663852886E+38 3.4028234663852886E+38 ECU_ADDRESS_EXTENSION 0x2 BYTE_ORDER MSB_LAST /end CHARACTERISTIC
/begin CHARACTERISTIC _g_PL_AD_fw_Radar_1R1V_rpc_LocBypassingRunnable_LocBypassingRunnable_m_pad_ensRLocationsPort_par_out_local.TChangeableMemPool._._._m_arrayPool._0_._elem._m_LocationList._Item._150_._vVar._m_value "" VALUE 0xB00112E2 __Float16_Value 0 NO_COMPU_METHOD -65504 65504 ECU_ADDRESS_EXTENSION 0x2 BYTE_ORDER MSB_LAST /end CHARACTERISTIC
/begin CHARACTERISTIC _g_PL_AD_fw_Radar_1R1V_rpc_LocBypassingRunnable_LocBypassingRunnable_m_pad_ensRLocationsPort_par_out_local.TChangeableMemPool._._._m_arrayPool._0_._elem._m_LocationList._Item._151_._Rcs._m_value "" VALUE 0xB0011310 __Float16_Value 0 NO_COMPU_METHOD -65504 65504 ECU_ADDRESS_EXTENSION 0x2 BYTE_ORDER MSB_LAST /end CHARACTERISTIC
/begin CHARACTERISTIC _g_PL_AD_fw_Radar_1R1V_rpc_LocBypassingRunnable_LocBypassingRunnable_m_pad_ensRLocationsPort_par_out_local.TChangeableMemPool._._._m_arrayPool._0_._elem._m_LocationList._Item._151_._Rssi._m_value "" VALUE 0xB0011312 __Float16_Value 0 NO_COMPU_METHOD -65504 65504 ECU_ADDRESS_EXTENSION 0x2 BYTE_ORDER MSB_LAST /end CHARACTERISTIC
/begin CHARACTERISTIC _g_PL_AD_fw_Radar_1R1V_rpc_LocBypassingRunnable_LocBypassingRunnable_m_pad_ensRLocationsPort_par_out_local.TChangeableMemPool._._._m_arrayPool._0_._elem._m_LocationList._Item._151_._d "" VALUE 0xB00112F8 __Float32_Value 0 NO_COMPU_METHOD -3.4028234663852886E+38 3.4028234663852886E+38 ECU_ADDRESS_EXTENSION 0x2 BYTE_ORDER MSB_LAST /end CHARACTERISTIC
/begin CHARACTERISTIC _g_PL_AD_fw_Radar_1R1V_rpc_LocBypassingRunnable_LocBypassingRunnable_m_pad_ensRLocationsPort_par_out_local.TChangeableMemPool._._._m_arrayPool._0_._elem._m_LocationList._Item._151_._dVar._m_value "" VALUE 0xB0011300 __Float16_Value 0 NO_COMPU_METHOD -65504 65504 ECU_ADDRESS_EXTENSION 0x2 BYTE_ORDER MSB_LAST /end CHARACTERISTIC
/begin CHARACTERISTIC _g_PL_AD_fw_Radar_1R1V_rpc_LocBypassingRunnable_LocBypassingRunnable_m_pad_ensRLocationsPort_par_out_local.TChangeableMemPool._._._m_arrayPool._0_._elem._m_LocationList._Item._151_._dvCov._m_value "" VALUE 0xB0011304 __Float16_Value 0 NO_COMPU_METHOD -65504 65504 ECU_ADDRESS_EXTENSION 0x2 BYTE_ORDER MSB_LAST /end CHARACTERISTIC
/begin CHARACTERISTIC _g_PL_AD_fw_Radar_1R1V_rpc_LocBypassingRunnable_LocBypassingRunnable_m_pad_ensRLocationsPort_par_out_local.TChangeableMemPool._._._m_arrayPool._0_._elem._m_LocationList._Item._151_._dvQly "" VALUE 0xB0011314 __UByte_Value 0 NO_COMPU_METHOD 0 255 ECU_ADDRESS_EXTENSION 0x2 BYTE_ORDER MSB_LAST /end CHARACTERISTIC
/begin CHARACTERISTIC _g_PL_AD_fw_Radar_1R1V_rpc_LocBypassingRunnable_LocBypassingRunnable_m_pad_ensRLocationsPort_par_out_local.TChangeableMemPool._._._m_arrayPool._0_._elem._m_LocationList._Item._151_._idxAzimuthAmbiguityPeer "" VALUE 0xB0011316 __UWord_Value 0 NO_COMPU_METHOD 0 65535 ECU_ADDRESS_EXTENSION 0x2 BYTE_ORDER MSB_LAST /end CHARACTERISTIC
/begin CHARACTERISTIC _g_PL_AD_fw_Radar_1R1V_rpc_LocBypassingRunnable_LocBypassingRunnable_m_pad_ensRLocationsPort_par_out_local.TChangeableMemPool._._._m_arrayPool._0_._elem._m_LocationList._Item._151_._measStatus "" VALUE 0xB0011315 __UByte_Value 0 NO_COMPU_METHOD 0 255 ECU_ADDRESS_EXTENSION 0x2 BYTE_ORDER MSB_LAST /end CHARACTERISTIC
/begin CHARACTERISTIC _g_PL_AD_fw_Radar_1R1V_rpc_LocBypassingRunnable_LocBypassingRunnable_m_pad_ensRLocationsPort_par_out_local.TChangeableMemPool._._._m_arrayPool._0_._elem._m_LocationList._Item._151_._phi._m_value "" VALUE 0xB0011308 __Float16_Value 0 NO_COMPU_METHOD -65504 65504 ECU_ADDRESS_EXTENSION 0x2 BYTE_ORDER MSB_LAST /end CHARACTERISTIC
/begin CHARACTERISTIC _g_PL_AD_fw_Radar_1R1V_rpc_LocBypassingRunnable_LocBypassingRunnable_m_pad_ensRLocationsPort_par_out_local.TChangeableMemPool._._._m_arrayPool._0_._elem._m_LocationList._Item._151_._phiQly "" VALUE 0xB001130B __UByte_Value 0 NO_COMPU_METHOD 0 255 ECU_ADDRESS_EXTENSION 0x2 BYTE_ORDER MSB_LAST /end CHARACTERISTIC
/begin CHARACTERISTIC _g_PL_AD_fw_Radar_1R1V_rpc_LocBypassingRunnable_LocBypassingRunnable_m_pad_ensRLocationsPort_par_out_local.TChangeableMemPool._._._m_arrayPool._0_._elem._m_LocationList._Item._151_._phiVar._m_value "" VALUE 0xB001130E __Float16_Value 0 NO_COMPU_METHOD -65504 65504 ECU_ADDRESS_EXTENSION 0x2 BYTE_ORDER MSB_LAST /end CHARACTERISTIC
/begin CHARACTERISTIC _g_PL_AD_fw_Radar_1R1V_rpc_LocBypassingRunnable_LocBypassingRunnable_m_pad_ensRLocationsPort_par_out_local.TChangeableMemPool._._._m_arrayPool._0_._elem._m_LocationList._Item._151_._theta._m_value "" VALUE 0xB0011306 __Float16_Value 0 NO_COMPU_METHOD -65504 65504 ECU_ADDRESS_EXTENSION 0x2 BYTE_ORDER MSB_LAST /end CHARACTERISTIC
/begin CHARACTERISTIC _g_PL_AD_fw_Radar_1R1V_rpc_LocBypassingRunnable_LocBypassingRunnable_m_pad_ensRLocationsPort_par_out_local.TChangeableMemPool._._._m_arrayPool._0_._elem._m_LocationList._Item._151_._thetaQly "" VALUE 0xB001130A __UByte_Value 0 NO_COMPU_METHOD 0 255 ECU_ADDRESS_EXTENSION 0x2 BYTE_ORDER MSB_LAST /end CHARACTERISTIC
/begin CHARACTERISTIC _g_PL_AD_fw_Radar_1R1V_rpc_LocBypassingRunnable_LocBypassingRunnable_m_pad_ensRLocationsPort_par_out_local.TChangeableMemPool._._._m_arrayPool._0_._elem._m_LocationList._Item._151_._thetaVar._m_value "" VALUE 0xB001130C __Float16_Value 0 NO_COMPU_METHOD -65504 65504 ECU_ADDRESS_EXTENSION 0x2 BYTE_ORDER MSB_LAST /end CHARACTERISTIC
/begin CHARACTERISTIC _g_PL_AD_fw_Radar_1R1V_rpc_LocBypassingRunnable_LocBypassingRunnable_m_pad_ensRLocationsPort_par_out_local.TChangeableMemPool._._._m_arrayPool._0_._elem._m_LocationList._Item._151_._v "" VALUE 0xB00112FC __Float32_Value 0 NO_COMPU_METHOD -3.4028234663852886E+38 3.4028234663852886E+38 ECU_ADDRESS_EXTENSION 0x2 BYTE_ORDER MSB_LAST /end CHARACTERISTIC
/begin CHARACTERISTIC _g_PL_AD_fw_Radar_1R1V_rpc_LocBypassingRunnable_LocBypassingRunnable_m_pad_ensRLocationsPort_par_out_local.TChangeableMemPool._._._m_arrayPool._0_._elem._m_LocationList._Item._151_._vVar._m_value "" VALUE 0xB0011302 __Float16_Value 0 NO_COMPU_METHOD -65504 65504 ECU_ADDRESS_EXTENSION 0x2 BYTE_ORDER MSB_LAST /end CHARACTERISTIC
/begin CHARACTERISTIC _g_PL_AD_fw_Radar_1R1V_rpc_LocBypassingRunnable_LocBypassingRunnable_m_pad_ensRLocationsPort_par_out_local.TChangeableMemPool._._._m_arrayPool._0_._elem._m_LocationList._Item._152_._Rcs._m_value "" VALUE 0xB0011330 __Float16_Value 0 NO_COMPU_METHOD -65504 65504 ECU_ADDRESS_EXTENSION 0x2 BYTE_ORDER MSB_LAST /end CHARACTERISTIC
/begin CHARACTERISTIC _g_PL_AD_fw_Radar_1R1V_rpc_LocBypassingRunnable_LocBypassingRunnable_m_pad_ensRLocationsPort_par_out_local.TChangeableMemPool._._._m_arrayPool._0_._elem._m_LocationList._Item._152_._Rssi._m_value "" VALUE 0xB0011332 __Float16_Value 0 NO_COMPU_METHOD -65504 65504 ECU_ADDRESS_EXTENSION 0x2 BYTE_ORDER MSB_LAST /end CHARACTERISTIC
/begin CHARACTERISTIC _g_PL_AD_fw_Radar_1R1V_rpc_LocBypassingRunnable_LocBypassingRunnable_m_pad_ensRLocationsPort_par_out_local.TChangeableMemPool._._._m_arrayPool._0_._elem._m_LocationList._Item._152_._d "" VALUE 0xB0011318 __Float32_Value 0 NO_COMPU_METHOD -3.4028234663852886E+38 3.4028234663852886E+38 ECU_ADDRESS_EXTENSION 0x2 BYTE_ORDER MSB_LAST /end CHARACTERISTIC
/begin CHARACTERISTIC _g_PL_AD_fw_Radar_1R1V_rpc_LocBypassingRunnable_LocBypassingRunnable_m_pad_ensRLocationsPort_par_out_local.TChangeableMemPool._._._m_arrayPool._0_._elem._m_LocationList._Item._152_._dVar._m_value "" VALUE 0xB0011320 __Float16_Value 0 NO_COMPU_METHOD -65504 65504 ECU_ADDRESS_EXTENSION 0x2 BYTE_ORDER MSB_LAST /end CHARACTERISTIC
/begin CHARACTERISTIC _g_PL_AD_fw_Radar_1R1V_rpc_LocBypassingRunnable_LocBypassingRunnable_m_pad_ensRLocationsPort_par_out_local.TChangeableMemPool._._._m_arrayPool._0_._elem._m_LocationList._Item._152_._dvCov._m_value "" VALUE 0xB0011324 __Float16_Value 0 NO_COMPU_METHOD -65504 65504 ECU_ADDRESS_EXTENSION 0x2 BYTE_ORDER MSB_LAST /end CHARACTERISTIC
/begin CHARACTERISTIC _g_PL_AD_fw_Radar_1R1V_rpc_LocBypassingRunnable_LocBypassingRunnable_m_pad_ensRLocationsPort_par_out_local.TChangeableMemPool._._._m_arrayPool._0_._elem._m_LocationList._Item._152_._dvQly "" VALUE 0xB0011334 __UByte_Value 0 NO_COMPU_METHOD 0 255 ECU_ADDRESS_EXTENSION 0x2 BYTE_ORDER MSB_LAST /end CHARACTERISTIC
/begin CHARACTERISTIC _g_PL_AD_fw_Radar_1R1V_rpc_LocBypassingRunnable_LocBypassingRunnable_m_pad_ensRLocationsPort_par_out_local.TChangeableMemPool._._._m_arrayPool._0_._elem._m_LocationList._Item._152_._idxAzimuthAmbiguityPeer "" VALUE 0xB0011336 __UWord_Value 0 NO_COMPU_METHOD 0 65535 ECU_ADDRESS_EXTENSION 0x2 BYTE_ORDER MSB_LAST /end CHARACTERISTIC
/begin CHARACTERISTIC _g_PL_AD_fw_Radar_1R1V_rpc_LocBypassingRunnable_LocBypassingRunnable_m_pad_ensRLocationsPort_par_out_local.TChangeableMemPool._._._m_arrayPool._0_._elem._m_LocationList._Item._152_._measStatus "" VALUE 0xB0011335 __UByte_Value 0 NO_COMPU_METHOD 0 255 ECU_ADDRESS_EXTENSION 0x2 BYTE_ORDER MSB_LAST /end CHARACTERISTIC
/begin CHARACTERISTIC _g_PL_AD_fw_Radar_1R1V_rpc_LocBypassingRunnable_LocBypassingRunnable_m_pad_ensRLocationsPort_par_out_local.TChangeableMemPool._._._m_arrayPool._0_._elem._m_LocationList._Item._152_._phi._m_value "" VALUE 0xB0011328 __Float16_Value 0 NO_COMPU_METHOD -65504 65504 ECU_ADDRESS_EXTENSION 0x2 BYTE_ORDER MSB_LAST /end CHARACTERISTIC
/begin CHARACTERISTIC _g_PL_AD_fw_Radar_1R1V_rpc_LocBypassingRunnable_LocBypassingRunnable_m_pad_ensRLocationsPort_par_out_local.TChangeableMemPool._._._m_arrayPool._0_._elem._m_LocationList._Item._152_._phiQly "" VALUE 0xB001132B __UByte_Value 0 NO_COMPU_METHOD 0 255 ECU_ADDRESS_EXTENSION 0x2 BYTE_ORDER MSB_LAST /end CHARACTERISTIC
/begin CHARACTERISTIC _g_PL_AD_fw_Radar_1R1V_rpc_LocBypassingRunnable_LocBypassingRunnable_m_pad_ensRLocationsPort_par_out_local.TChangeableMemPool._._._m_arrayPool._0_._elem._m_LocationList._Item._152_._phiVar._m_value "" VALUE 0xB001132E __Float16_Value 0 NO_COMPU_METHOD -65504 65504 ECU_ADDRESS_EXTENSION 0x2 BYTE_ORDER MSB_LAST /end CHARACTERISTIC
/begin CHARACTERISTIC _g_PL_AD_fw_Radar_1R1V_rpc_LocBypassingRunnable_LocBypassingRunnable_m_pad_ensRLocationsPort_par_out_local.TChangeableMemPool._._._m_arrayPool._0_._elem._m_LocationList._Item._152_._theta._m_value "" VALUE 0xB0011326 __Float16_Value 0 NO_COMPU_METHOD -65504 65504 ECU_ADDRESS_EXTENSION 0x2 BYTE_ORDER MSB_LAST /end CHARACTERISTIC
/begin CHARACTERISTIC _g_PL_AD_fw_Radar_1R1V_rpc_LocBypassingRunnable_LocBypassingRunnable_m_pad_ensRLocationsPort_par_out_local.TChangeableMemPool._._._m_arrayPool._0_._elem._m_LocationList._Item._152_._thetaQly "" VALUE 0xB001132A __UByte_Value 0 NO_COMPU_METHOD 0 255 ECU_ADDRESS_EXTENSION 0x2 BYTE_ORDER MSB_LAST /end CHARACTERISTIC
/begin CHARACTERISTIC _g_PL_AD_fw_Radar_1R1V_rpc_LocBypassingRunnable_LocBypassingRunnable_m_pad_ensRLocationsPort_par_out_local.TChangeableMemPool._._._m_arrayPool._0_._elem._m_LocationList._Item._152_._thetaVar._m_value "" VALUE 0xB001132C __Float16_Value 0 NO_COMPU_METHOD -65504 65504 ECU_ADDRESS_EXTENSION 0x2 BYTE_ORDER MSB_LAST /end CHARACTERISTIC
/begin CHARACTERISTIC _g_PL_AD_fw_Radar_1R1V_rpc_LocBypassingRunnable_LocBypassingRunnable_m_pad_ensRLocationsPort_par_out_local.TChangeableMemPool._._._m_arrayPool._0_._elem._m_LocationList._Item._152_._v "" VALUE 0xB001131C __Float32_Value 0 NO_COMPU_METHOD -3.4028234663852886E+38 3.4028234663852886E+38 ECU_ADDRESS_EXTENSION 0x2 BYTE_ORDER MSB_LAST /end CHARACTERISTIC
/begin CHARACTERISTIC _g_PL_AD_fw_Radar_1R1V_rpc_LocBypassingRunnable_LocBypassingRunnable_m_pad_ensRLocationsPort_par_out_local.TChangeableMemPool._._._m_arrayPool._0_._elem._m_LocationList._Item._152_._vVar._m_value "" VALUE 0xB0011322 __Float16_Value 0 NO_COMPU_METHOD -65504 65504 ECU_ADDRESS_EXTENSION 0x2 BYTE_ORDER MSB_LAST /end CHARACTERISTIC
/begin CHARACTERISTIC _g_PL_AD_fw_Radar_1R1V_rpc_LocBypassingRunnable_LocBypassingRunnable_m_pad_ensRLocationsPort_par_out_local.TChangeableMemPool._._._m_arrayPool._0_._elem._m_LocationList._Item._153_._Rcs._m_value "" VALUE 0xB0011350 __Float16_Value 0 NO_COMPU_METHOD -65504 65504 ECU_ADDRESS_EXTENSION 0x2 BYTE_ORDER MSB_LAST /end CHARACTERISTIC
/begin CHARACTERISTIC _g_PL_AD_fw_Radar_1R1V_rpc_LocBypassingRunnable_LocBypassingRunnable_m_pad_ensRLocationsPort_par_out_local.TChangeableMemPool._._._m_arrayPool._0_._elem._m_LocationList._Item._153_._Rssi._m_value "" VALUE 0xB0011352 __Float16_Value 0 NO_COMPU_METHOD -65504 65504 ECU_ADDRESS_EXTENSION 0x2 BYTE_ORDER MSB_LAST /end CHARACTERISTIC
/begin CHARACTERISTIC _g_PL_AD_fw_Radar_1R1V_rpc_LocBypassingRunnable_LocBypassingRunnable_m_pad_ensRLocationsPort_par_out_local.TChangeableMemPool._._._m_arrayPool._0_._elem._m_LocationList._Item._153_._d "" VALUE 0xB0011338 __Float32_Value 0 NO_COMPU_METHOD -3.4028234663852886E+38 3.4028234663852886E+38 ECU_ADDRESS_EXTENSION 0x2 BYTE_ORDER MSB_LAST /end CHARACTERISTIC
/begin CHARACTERISTIC _g_PL_AD_fw_Radar_1R1V_rpc_LocBypassingRunnable_LocBypassingRunnable_m_pad_ensRLocationsPort_par_out_local.TChangeableMemPool._._._m_arrayPool._0_._elem._m_LocationList._Item._153_._dVar._m_value "" VALUE 0xB0011340 __Float16_Value 0 NO_COMPU_METHOD -65504 65504 ECU_ADDRESS_EXTENSION 0x2 BYTE_ORDER MSB_LAST /end CHARACTERISTIC
/begin CHARACTERISTIC _g_PL_AD_fw_Radar_1R1V_rpc_LocBypassingRunnable_LocBypassingRunnable_m_pad_ensRLocationsPort_par_out_local.TChangeableMemPool._._._m_arrayPool._0_._elem._m_LocationList._Item._153_._dvCov._m_value "" VALUE 0xB0011344 __Float16_Value 0 NO_COMPU_METHOD -65504 65504 ECU_ADDRESS_EXTENSION 0x2 BYTE_ORDER MSB_LAST /end CHARACTERISTIC
/begin CHARACTERISTIC _g_PL_AD_fw_Radar_1R1V_rpc_LocBypassingRunnable_LocBypassingRunnable_m_pad_ensRLocationsPort_par_out_local.TChangeableMemPool._._._m_arrayPool._0_._elem._m_LocationList._Item._153_._dvQly "" VALUE 0xB0011354 __UByte_Value 0 NO_COMPU_METHOD 0 255 ECU_ADDRESS_EXTENSION 0x2 BYTE_ORDER MSB_LAST /end CHARACTERISTIC
/begin CHARACTERISTIC _g_PL_AD_fw_Radar_1R1V_rpc_LocBypassingRunnable_LocBypassingRunnable_m_pad_ensRLocationsPort_par_out_local.TChangeableMemPool._._._m_arrayPool._0_._elem._m_LocationList._Item._153_._idxAzimuthAmbiguityPeer "" VALUE 0xB0011356 __UWord_Value 0 NO_COMPU_METHOD 0 65535 ECU_ADDRESS_EXTENSION 0x2 BYTE_ORDER MSB_LAST /end CHARACTERISTIC
/begin CHARACTERISTIC _g_PL_AD_fw_Radar_1R1V_rpc_LocBypassingRunnable_LocBypassingRunnable_m_pad_ensRLocationsPort_par_out_local.TChangeableMemPool._._._m_arrayPool._0_._elem._m_LocationList._Item._153_._measStatus "" VALUE 0xB0011355 __UByte_Value 0 NO_COMPU_METHOD 0 255 ECU_ADDRESS_EXTENSION 0x2 BYTE_ORDER MSB_LAST /end CHARACTERISTIC
/begin CHARACTERISTIC _g_PL_AD_fw_Radar_1R1V_rpc_LocBypassingRunnable_LocBypassingRunnable_m_pad_ensRLocationsPort_par_out_local.TChangeableMemPool._._._m_arrayPool._0_._elem._m_LocationList._Item._153_._phi._m_value "" VALUE 0xB0011348 __Float16_Value 0 NO_COMPU_METHOD -65504 65504 ECU_ADDRESS_EXTENSION 0x2 BYTE_ORDER MSB_LAST /end CHARACTERISTIC
/begin CHARACTERISTIC _g_PL_AD_fw_Radar_1R1V_rpc_LocBypassingRunnable_LocBypassingRunnable_m_pad_ensRLocationsPort_par_out_local.TChangeableMemPool._._._m_arrayPool._0_._elem._m_LocationList._Item._153_._phiQly "" VALUE 0xB001134B __UByte_Value 0 NO_COMPU_METHOD 0 255 ECU_ADDRESS_EXTENSION 0x2 BYTE_ORDER MSB_LAST /end CHARACTERISTIC
/begin CHARACTERISTIC _g_PL_AD_fw_Radar_1R1V_rpc_LocBypassingRunnable_LocBypassingRunnable_m_pad_ensRLocationsPort_par_out_local.TChangeableMemPool._._._m_arrayPool._0_._elem._m_LocationList._Item._153_._phiVar._m_value "" VALUE 0xB001134E __Float16_Value 0 NO_COMPU_METHOD -65504 65504 ECU_ADDRESS_EXTENSION 0x2 BYTE_ORDER MSB_LAST /end CHARACTERISTIC
/begin CHARACTERISTIC _g_PL_AD_fw_Radar_1R1V_rpc_LocBypassingRunnable_LocBypassingRunnable_m_pad_ensRLocationsPort_par_out_local.TChangeableMemPool._._._m_arrayPool._0_._elem._m_LocationList._Item._153_._theta._m_value "" VALUE 0xB0011346 __Float16_Value 0 NO_COMPU_METHOD -65504 65504 ECU_ADDRESS_EXTENSION 0x2 BYTE_ORDER MSB_LAST /end CHARACTERISTIC
/begin CHARACTERISTIC _g_PL_AD_fw_Radar_1R1V_rpc_LocBypassingRunnable_LocBypassingRunnable_m_pad_ensRLocationsPort_par_out_local.TChangeableMemPool._._._m_arrayPool._0_._elem._m_LocationList._Item._153_._thetaQly "" VALUE 0xB001134A __UByte_Value 0 NO_COMPU_METHOD 0 255 ECU_ADDRESS_EXTENSION 0x2 BYTE_ORDER MSB_LAST /end CHARACTERISTIC
/begin CHARACTERISTIC _g_PL_AD_fw_Radar_1R1V_rpc_LocBypassingRunnable_LocBypassingRunnable_m_pad_ensRLocationsPort_par_out_local.TChangeableMemPool._._._m_arrayPool._0_._elem._m_LocationList._Item._153_._thetaVar._m_value "" VALUE 0xB001134C __Float16_Value 0 NO_COMPU_METHOD -65504 65504 ECU_ADDRESS_EXTENSION 0x2 BYTE_ORDER MSB_LAST /end CHARACTERISTIC
/begin CHARACTERISTIC _g_PL_AD_fw_Radar_1R1V_rpc_LocBypassingRunnable_LocBypassingRunnable_m_pad_ensRLocationsPort_par_out_local.TChangeableMemPool._._._m_arrayPool._0_._elem._m_LocationList._Item._153_._v "" VALUE 0xB001133C __Float32_Value 0 NO_COMPU_METHOD -3.4028234663852886E+38 3.4028234663852886E+38 ECU_ADDRESS_EXTENSION 0x2 BYTE_ORDER MSB_LAST /end CHARACTERISTIC
/begin CHARACTERISTIC _g_PL_AD_fw_Radar_1R1V_rpc_LocBypassingRunnable_LocBypassingRunnable_m_pad_ensRLocationsPort_par_out_local.TChangeableMemPool._._._m_arrayPool._0_._elem._m_LocationList._Item._153_._vVar._m_value "" VALUE 0xB0011342 __Float16_Value 0 NO_COMPU_METHOD -65504 65504 ECU_ADDRESS_EXTENSION 0x2 BYTE_ORDER MSB_LAST /end CHARACTERISTIC
/begin CHARACTERISTIC _g_PL_AD_fw_Radar_1R1V_rpc_LocBypassingRunnable_LocBypassingRunnable_m_pad_ensRLocationsPort_par_out_local.TChangeableMemPool._._._m_arrayPool._0_._elem._m_LocationList._Item._154_._Rcs._m_value "" VALUE 0xB0011370 __Float16_Value 0 NO_COMPU_METHOD -65504 65504 ECU_ADDRESS_EXTENSION 0x2 BYTE_ORDER MSB_LAST /end CHARACTERISTIC
/begin CHARACTERISTIC _g_PL_AD_fw_Radar_1R1V_rpc_LocBypassingRunnable_LocBypassingRunnable_m_pad_ensRLocationsPort_par_out_local.TChangeableMemPool._._._m_arrayPool._0_._elem._m_LocationList._Item._154_._Rssi._m_value "" VALUE 0xB0011372 __Float16_Value 0 NO_COMPU_METHOD -65504 65504 ECU_ADDRESS_EXTENSION 0x2 BYTE_ORDER MSB_LAST /end CHARACTERISTIC
/begin CHARACTERISTIC _g_PL_AD_fw_Radar_1R1V_rpc_LocBypassingRunnable_LocBypassingRunnable_m_pad_ensRLocationsPort_par_out_local.TChangeableMemPool._._._m_arrayPool._0_._elem._m_LocationList._Item._154_._d "" VALUE 0xB0011358 __Float32_Value 0 NO_COMPU_METHOD -3.4028234663852886E+38 3.4028234663852886E+38 ECU_ADDRESS_EXTENSION 0x2 BYTE_ORDER MSB_LAST /end CHARACTERISTIC
/begin CHARACTERISTIC _g_PL_AD_fw_Radar_1R1V_rpc_LocBypassingRunnable_LocBypassingRunnable_m_pad_ensRLocationsPort_par_out_local.TChangeableMemPool._._._m_arrayPool._0_._elem._m_LocationList._Item._154_._dVar._m_value "" VALUE 0xB0011360 __Float16_Value 0 NO_COMPU_METHOD -65504 65504 ECU_ADDRESS_EXTENSION 0x2 BYTE_ORDER MSB_LAST /end CHARACTERISTIC
/begin CHARACTERISTIC _g_PL_AD_fw_Radar_1R1V_rpc_LocBypassingRunnable_LocBypassingRunnable_m_pad_ensRLocationsPort_par_out_local.TChangeableMemPool._._._m_arrayPool._0_._elem._m_LocationList._Item._154_._dvCov._m_value "" VALUE 0xB0011364 __Float16_Value 0 NO_COMPU_METHOD -65504 65504 ECU_ADDRESS_EXTENSION 0x2 BYTE_ORDER MSB_LAST /end CHARACTERISTIC
/begin CHARACTERISTIC _g_PL_AD_fw_Radar_1R1V_rpc_LocBypassingRunnable_LocBypassingRunnable_m_pad_ensRLocationsPort_par_out_local.TChangeableMemPool._._._m_arrayPool._0_._elem._m_LocationList._Item._154_._dvQly "" VALUE 0xB0011374 __UByte_Value 0 NO_COMPU_METHOD 0 255 ECU_ADDRESS_EXTENSION 0x2 BYTE_ORDER MSB_LAST /end CHARACTERISTIC
/begin CHARACTERISTIC _g_PL_AD_fw_Radar_1R1V_rpc_LocBypassingRunnable_LocBypassingRunnable_m_pad_ensRLocationsPort_par_out_local.TChangeableMemPool._._._m_arrayPool._0_._elem._m_LocationList._Item._154_._idxAzimuthAmbiguityPeer "" VALUE 0xB0011376 __UWord_Value 0 NO_COMPU_METHOD 0 65535 ECU_ADDRESS_EXTENSION 0x2 BYTE_ORDER MSB_LAST /end CHARACTERISTIC
/begin CHARACTERISTIC _g_PL_AD_fw_Radar_1R1V_rpc_LocBypassingRunnable_LocBypassingRunnable_m_pad_ensRLocationsPort_par_out_local.TChangeableMemPool._._._m_arrayPool._0_._elem._m_LocationList._Item._154_._measStatus "" VALUE 0xB0011375 __UByte_Value 0 NO_COMPU_METHOD 0 255 ECU_ADDRESS_EXTENSION 0x2 BYTE_ORDER MSB_LAST /end CHARACTERISTIC
/begin CHARACTERISTIC _g_PL_AD_fw_Radar_1R1V_rpc_LocBypassingRunnable_LocBypassingRunnable_m_pad_ensRLocationsPort_par_out_local.TChangeableMemPool._._._m_arrayPool._0_._elem._m_LocationList._Item._154_._phi._m_value "" VALUE 0xB0011368 __Float16_Value 0 NO_COMPU_METHOD -65504 65504 ECU_ADDRESS_EXTENSION 0x2 BYTE_ORDER MSB_LAST /end CHARACTERISTIC
/begin CHARACTERISTIC _g_PL_AD_fw_Radar_1R1V_rpc_LocBypassingRunnable_LocBypassingRunnable_m_pad_ensRLocationsPort_par_out_local.TChangeableMemPool._._._m_arrayPool._0_._elem._m_LocationList._Item._154_._phiQly "" VALUE 0xB001136B __UByte_Value 0 NO_COMPU_METHOD 0 255 ECU_ADDRESS_EXTENSION 0x2 BYTE_ORDER MSB_LAST /end CHARACTERISTIC
/begin CHARACTERISTIC _g_PL_AD_fw_Radar_1R1V_rpc_LocBypassingRunnable_LocBypassingRunnable_m_pad_ensRLocationsPort_par_out_local.TChangeableMemPool._._._m_arrayPool._0_._elem._m_LocationList._Item._154_._phiVar._m_value "" VALUE 0xB001136E __Float16_Value 0 NO_COMPU_METHOD -65504 65504 ECU_ADDRESS_EXTENSION 0x2 BYTE_ORDER MSB_LAST /end CHARACTERISTIC
/begin CHARACTERISTIC _g_PL_AD_fw_Radar_1R1V_rpc_LocBypassingRunnable_LocBypassingRunnable_m_pad_ensRLocationsPort_par_out_local.TChangeableMemPool._._._m_arrayPool._0_._elem._m_LocationList._Item._154_._theta._m_value "" VALUE 0xB0011366 __Float16_Value 0 NO_COMPU_METHOD -65504 65504 ECU_ADDRESS_EXTENSION 0x2 BYTE_ORDER MSB_LAST /end CHARACTERISTIC
/begin CHARACTERISTIC _g_PL_AD_fw_Radar_1R1V_rpc_LocBypassingRunnable_LocBypassingRunnable_m_pad_ensRLocationsPort_par_out_local.TChangeableMemPool._._._m_arrayPool._0_._elem._m_LocationList._Item._154_._thetaQly "" VALUE 0xB001136A __UByte_Value 0 NO_COMPU_METHOD 0 255 ECU_ADDRESS_EXTENSION 0x2 BYTE_ORDER MSB_LAST /end CHARACTERISTIC
/begin CHARACTERISTIC _g_PL_AD_fw_Radar_1R1V_rpc_LocBypassingRunnable_LocBypassingRunnable_m_pad_ensRLocationsPort_par_out_local.TChangeableMemPool._._._m_arrayPool._0_._elem._m_LocationList._Item._154_._thetaVar._m_value "" VALUE 0xB001136C __Float16_Value 0 NO_COMPU_METHOD -65504 65504 ECU_ADDRESS_EXTENSION 0x2 BYTE_ORDER MSB_LAST /end CHARACTERISTIC
/begin CHARACTERISTIC _g_PL_AD_fw_Radar_1R1V_rpc_LocBypassingRunnable_LocBypassingRunnable_m_pad_ensRLocationsPort_par_out_local.TChangeableMemPool._._._m_arrayPool._0_._elem._m_LocationList._Item._154_._v "" VALUE 0xB001135C __Float32_Value 0 NO_COMPU_METHOD -3.4028234663852886E+38 3.4028234663852886E+38 ECU_ADDRESS_EXTENSION 0x2 BYTE_ORDER MSB_LAST /end CHARACTERISTIC
/begin CHARACTERISTIC _g_PL_AD_fw_Radar_1R1V_rpc_LocBypassingRunnable_LocBypassingRunnable_m_pad_ensRLocationsPort_par_out_local.TChangeableMemPool._._._m_arrayPool._0_._elem._m_LocationList._Item._154_._vVar._m_value "" VALUE 0xB0011362 __Float16_Value 0 NO_COMPU_METHOD -65504 65504 ECU_ADDRESS_EXTENSION 0x2 BYTE_ORDER MSB_LAST /end CHARACTERISTIC
/begin CHARACTERISTIC _g_PL_AD_fw_Radar_1R1V_rpc_LocBypassingRunnable_LocBypassingRunnable_m_pad_ensRLocationsPort_par_out_local.TChangeableMemPool._._._m_arrayPool._0_._elem._m_LocationList._Item._155_._Rcs._m_value "" VALUE 0xB0011390 __Float16_Value 0 NO_COMPU_METHOD -65504 65504 ECU_ADDRESS_EXTENSION 0x2 BYTE_ORDER MSB_LAST /end CHARACTERISTIC
/begin CHARACTERISTIC _g_PL_AD_fw_Radar_1R1V_rpc_LocBypassingRunnable_LocBypassingRunnable_m_pad_ensRLocationsPort_par_out_local.TChangeableMemPool._._._m_arrayPool._0_._elem._m_LocationList._Item._155_._Rssi._m_value "" VALUE 0xB0011392 __Float16_Value 0 NO_COMPU_METHOD -65504 65504 ECU_ADDRESS_EXTENSION 0x2 BYTE_ORDER MSB_LAST /end CHARACTERISTIC
/begin CHARACTERISTIC _g_PL_AD_fw_Radar_1R1V_rpc_LocBypassingRunnable_LocBypassingRunnable_m_pad_ensRLocationsPort_par_out_local.TChangeableMemPool._._._m_arrayPool._0_._elem._m_LocationList._Item._155_._d "" VALUE 0xB0011378 __Float32_Value 0 NO_COMPU_METHOD -3.4028234663852886E+38 3.4028234663852886E+38 ECU_ADDRESS_EXTENSION 0x2 BYTE_ORDER MSB_LAST /end CHARACTERISTIC
/begin CHARACTERISTIC _g_PL_AD_fw_Radar_1R1V_rpc_LocBypassingRunnable_LocBypassingRunnable_m_pad_ensRLocationsPort_par_out_local.TChangeableMemPool._._._m_arrayPool._0_._elem._m_LocationList._Item._155_._dVar._m_value "" VALUE 0xB0011380 __Float16_Value 0 NO_COMPU_METHOD -65504 65504 ECU_ADDRESS_EXTENSION 0x2 BYTE_ORDER MSB_LAST /end CHARACTERISTIC
/begin CHARACTERISTIC _g_PL_AD_fw_Radar_1R1V_rpc_LocBypassingRunnable_LocBypassingRunnable_m_pad_ensRLocationsPort_par_out_local.TChangeableMemPool._._._m_arrayPool._0_._elem._m_LocationList._Item._155_._dvCov._m_value "" VALUE 0xB0011384 __Float16_Value 0 NO_COMPU_METHOD -65504 65504 ECU_ADDRESS_EXTENSION 0x2 BYTE_ORDER MSB_LAST /end CHARACTERISTIC
/begin CHARACTERISTIC _g_PL_AD_fw_Radar_1R1V_rpc_LocBypassingRunnable_LocBypassingRunnable_m_pad_ensRLocationsPort_par_out_local.TChangeableMemPool._._._m_arrayPool._0_._elem._m_LocationList._Item._155_._dvQly "" VALUE 0xB0011394 __UByte_Value 0 NO_COMPU_METHOD 0 255 ECU_ADDRESS_EXTENSION 0x2 BYTE_ORDER MSB_LAST /end CHARACTERISTIC
/begin CHARACTERISTIC _g_PL_AD_fw_Radar_1R1V_rpc_LocBypassingRunnable_LocBypassingRunnable_m_pad_ensRLocationsPort_par_out_local.TChangeableMemPool._._._m_arrayPool._0_._elem._m_LocationList._Item._155_._idxAzimuthAmbiguityPeer "" VALUE 0xB0011396 __UWord_Value 0 NO_COMPU_METHOD 0 65535 ECU_ADDRESS_EXTENSION 0x2 BYTE_ORDER MSB_LAST /end CHARACTERISTIC
/begin CHARACTERISTIC _g_PL_AD_fw_Radar_1R1V_rpc_LocBypassingRunnable_LocBypassingRunnable_m_pad_ensRLocationsPort_par_out_local.TChangeableMemPool._._._m_arrayPool._0_._elem._m_LocationList._Item._155_._measStatus "" VALUE 0xB0011395 __UByte_Value 0 NO_COMPU_METHOD 0 255 ECU_ADDRESS_EXTENSION 0x2 BYTE_ORDER MSB_LAST /end CHARACTERISTIC
/begin CHARACTERISTIC _g_PL_AD_fw_Radar_1R1V_rpc_LocBypassingRunnable_LocBypassingRunnable_m_pad_ensRLocationsPort_par_out_local.TChangeableMemPool._._._m_arrayPool._0_._elem._m_LocationList._Item._155_._phi._m_value "" VALUE 0xB0011388 __Float16_Value 0 NO_COMPU_METHOD -65504 65504 ECU_ADDRESS_EXTENSION 0x2 BYTE_ORDER MSB_LAST /end CHARACTERISTIC
/begin CHARACTERISTIC _g_PL_AD_fw_Radar_1R1V_rpc_LocBypassingRunnable_LocBypassingRunnable_m_pad_ensRLocationsPort_par_out_local.TChangeableMemPool._._._m_arrayPool._0_._elem._m_LocationList._Item._155_._phiQly "" VALUE 0xB001138B __UByte_Value 0 NO_COMPU_METHOD 0 255 ECU_ADDRESS_EXTENSION 0x2 BYTE_ORDER MSB_LAST /end CHARACTERISTIC
/begin CHARACTERISTIC _g_PL_AD_fw_Radar_1R1V_rpc_LocBypassingRunnable_LocBypassingRunnable_m_pad_ensRLocationsPort_par_out_local.TChangeableMemPool._._._m_arrayPool._0_._elem._m_LocationList._Item._155_._phiVar._m_value "" VALUE 0xB001138E __Float16_Value 0 NO_COMPU_METHOD -65504 65504 ECU_ADDRESS_EXTENSION 0x2 BYTE_ORDER MSB_LAST /end CHARACTERISTIC
/begin CHARACTERISTIC _g_PL_AD_fw_Radar_1R1V_rpc_LocBypassingRunnable_LocBypassingRunnable_m_pad_ensRLocationsPort_par_out_local.TChangeableMemPool._._._m_arrayPool._0_._elem._m_LocationList._Item._155_._theta._m_value "" VALUE 0xB0011386 __Float16_Value 0 NO_COMPU_METHOD -65504 65504 ECU_ADDRESS_EXTENSION 0x2 BYTE_ORDER MSB_LAST /end CHARACTERISTIC
/begin CHARACTERISTIC _g_PL_AD_fw_Radar_1R1V_rpc_LocBypassingRunnable_LocBypassingRunnable_m_pad_ensRLocationsPort_par_out_local.TChangeableMemPool._._._m_arrayPool._0_._elem._m_LocationList._Item._155_._thetaQly "" VALUE 0xB001138A __UByte_Value 0 NO_COMPU_METHOD 0 255 ECU_ADDRESS_EXTENSION 0x2 BYTE_ORDER MSB_LAST /end CHARACTERISTIC
/begin CHARACTERISTIC _g_PL_AD_fw_Radar_1R1V_rpc_LocBypassingRunnable_LocBypassingRunnable_m_pad_ensRLocationsPort_par_out_local.TChangeableMemPool._._._m_arrayPool._0_._elem._m_LocationList._Item._155_._thetaVar._m_value "" VALUE 0xB001138C __Float16_Value 0 NO_COMPU_METHOD -65504 65504 ECU_ADDRESS_EXTENSION 0x2 BYTE_ORDER MSB_LAST /end CHARACTERISTIC
/begin CHARACTERISTIC _g_PL_AD_fw_Radar_1R1V_rpc_LocBypassingRunnable_LocBypassingRunnable_m_pad_ensRLocationsPort_par_out_local.TChangeableMemPool._._._m_arrayPool._0_._elem._m_LocationList._Item._155_._v "" VALUE 0xB001137C __Float32_Value 0 NO_COMPU_METHOD -3.4028234663852886E+38 3.4028234663852886E+38 ECU_ADDRESS_EXTENSION 0x2 BYTE_ORDER MSB_LAST /end CHARACTERISTIC
/begin CHARACTERISTIC _g_PL_AD_fw_Radar_1R1V_rpc_LocBypassingRunnable_LocBypassingRunnable_m_pad_ensRLocationsPort_par_out_local.TChangeableMemPool._._._m_arrayPool._0_._elem._m_LocationList._Item._155_._vVar._m_value "" VALUE 0xB0011382 __Float16_Value 0 NO_COMPU_METHOD -65504 65504 ECU_ADDRESS_EXTENSION 0x2 BYTE_ORDER MSB_LAST /end CHARACTERISTIC
/begin CHARACTERISTIC _g_PL_AD_fw_Radar_1R1V_rpc_LocBypassingRunnable_LocBypassingRunnable_m_pad_ensRLocationsPort_par_out_local.TChangeableMemPool._._._m_arrayPool._0_._elem._m_LocationList._Item._156_._Rcs._m_value "" VALUE 0xB00113B0 __Float16_Value 0 NO_COMPU_METHOD -65504 65504 ECU_ADDRESS_EXTENSION 0x2 BYTE_ORDER MSB_LAST /end CHARACTERISTIC
/begin CHARACTERISTIC _g_PL_AD_fw_Radar_1R1V_rpc_LocBypassingRunnable_LocBypassingRunnable_m_pad_ensRLocationsPort_par_out_local.TChangeableMemPool._._._m_arrayPool._0_._elem._m_LocationList._Item._156_._Rssi._m_value "" VALUE 0xB00113B2 __Float16_Value 0 NO_COMPU_METHOD -65504 65504 ECU_ADDRESS_EXTENSION 0x2 BYTE_ORDER MSB_LAST /end CHARACTERISTIC
/begin CHARACTERISTIC _g_PL_AD_fw_Radar_1R1V_rpc_LocBypassingRunnable_LocBypassingRunnable_m_pad_ensRLocationsPort_par_out_local.TChangeableMemPool._._._m_arrayPool._0_._elem._m_LocationList._Item._156_._d "" VALUE 0xB0011398 __Float32_Value 0 NO_COMPU_METHOD -3.4028234663852886E+38 3.4028234663852886E+38 ECU_ADDRESS_EXTENSION 0x2 BYTE_ORDER MSB_LAST /end CHARACTERISTIC
/begin CHARACTERISTIC _g_PL_AD_fw_Radar_1R1V_rpc_LocBypassingRunnable_LocBypassingRunnable_m_pad_ensRLocationsPort_par_out_local.TChangeableMemPool._._._m_arrayPool._0_._elem._m_LocationList._Item._156_._dVar._m_value "" VALUE 0xB00113A0 __Float16_Value 0 NO_COMPU_METHOD -65504 65504 ECU_ADDRESS_EXTENSION 0x2 BYTE_ORDER MSB_LAST /end CHARACTERISTIC
/begin CHARACTERISTIC _g_PL_AD_fw_Radar_1R1V_rpc_LocBypassingRunnable_LocBypassingRunnable_m_pad_ensRLocationsPort_par_out_local.TChangeableMemPool._._._m_arrayPool._0_._elem._m_LocationList._Item._156_._dvCov._m_value "" VALUE 0xB00113A4 __Float16_Value 0 NO_COMPU_METHOD -65504 65504 ECU_ADDRESS_EXTENSION 0x2 BYTE_ORDER MSB_LAST /end CHARACTERISTIC
/begin CHARACTERISTIC _g_PL_AD_fw_Radar_1R1V_rpc_LocBypassingRunnable_LocBypassingRunnable_m_pad_ensRLocationsPort_par_out_local.TChangeableMemPool._._._m_arrayPool._0_._elem._m_LocationList._Item._156_._dvQly "" VALUE 0xB00113B4 __UByte_Value 0 NO_COMPU_METHOD 0 255 ECU_ADDRESS_EXTENSION 0x2 BYTE_ORDER MSB_LAST /end CHARACTERISTIC
/begin CHARACTERISTIC _g_PL_AD_fw_Radar_1R1V_rpc_LocBypassingRunnable_LocBypassingRunnable_m_pad_ensRLocationsPort_par_out_local.TChangeableMemPool._._._m_arrayPool._0_._elem._m_LocationList._Item._156_._idxAzimuthAmbiguityPeer "" VALUE 0xB00113B6 __UWord_Value 0 NO_COMPU_METHOD 0 65535 ECU_ADDRESS_EXTENSION 0x2 BYTE_ORDER MSB_LAST /end CHARACTERISTIC
/begin CHARACTERISTIC _g_PL_AD_fw_Radar_1R1V_rpc_LocBypassingRunnable_LocBypassingRunnable_m_pad_ensRLocationsPort_par_out_local.TChangeableMemPool._._._m_arrayPool._0_._elem._m_LocationList._Item._156_._measStatus "" VALUE 0xB00113B5 __UByte_Value 0 NO_COMPU_METHOD 0 255 ECU_ADDRESS_EXTENSION 0x2 BYTE_ORDER MSB_LAST /end CHARACTERISTIC
/begin CHARACTERISTIC _g_PL_AD_fw_Radar_1R1V_rpc_LocBypassingRunnable_LocBypassingRunnable_m_pad_ensRLocationsPort_par_out_local.TChangeableMemPool._._._m_arrayPool._0_._elem._m_LocationList._Item._156_._phi._m_value "" VALUE 0xB00113A8 __Float16_Value 0 NO_COMPU_METHOD -65504 65504 ECU_ADDRESS_EXTENSION 0x2 BYTE_ORDER MSB_LAST /end CHARACTERISTIC
/begin CHARACTERISTIC _g_PL_AD_fw_Radar_1R1V_rpc_LocBypassingRunnable_LocBypassingRunnable_m_pad_ensRLocationsPort_par_out_local.TChangeableMemPool._._._m_arrayPool._0_._elem._m_LocationList._Item._156_._phiQly "" VALUE 0xB00113AB __UByte_Value 0 NO_COMPU_METHOD 0 255 ECU_ADDRESS_EXTENSION 0x2 BYTE_ORDER MSB_LAST /end CHARACTERISTIC
/begin CHARACTERISTIC _g_PL_AD_fw_Radar_1R1V_rpc_LocBypassingRunnable_LocBypassingRunnable_m_pad_ensRLocationsPort_par_out_local.TChangeableMemPool._._._m_arrayPool._0_._elem._m_LocationList._Item._156_._phiVar._m_value "" VALUE 0xB00113AE __Float16_Value 0 NO_COMPU_METHOD -65504 65504 ECU_ADDRESS_EXTENSION 0x2 BYTE_ORDER MSB_LAST /end CHARACTERISTIC
/begin CHARACTERISTIC _g_PL_AD_fw_Radar_1R1V_rpc_LocBypassingRunnable_LocBypassingRunnable_m_pad_ensRLocationsPort_par_out_local.TChangeableMemPool._._._m_arrayPool._0_._elem._m_LocationList._Item._156_._theta._m_value "" VALUE 0xB00113A6 __Float16_Value 0 NO_COMPU_METHOD -65504 65504 ECU_ADDRESS_EXTENSION 0x2 BYTE_ORDER MSB_LAST /end CHARACTERISTIC
/begin CHARACTERISTIC _g_PL_AD_fw_Radar_1R1V_rpc_LocBypassingRunnable_LocBypassingRunnable_m_pad_ensRLocationsPort_par_out_local.TChangeableMemPool._._._m_arrayPool._0_._elem._m_LocationList._Item._156_._thetaQly "" VALUE 0xB00113AA __UByte_Value 0 NO_COMPU_METHOD 0 255 ECU_ADDRESS_EXTENSION 0x2 BYTE_ORDER MSB_LAST /end CHARACTERISTIC
/begin CHARACTERISTIC _g_PL_AD_fw_Radar_1R1V_rpc_LocBypassingRunnable_LocBypassingRunnable_m_pad_ensRLocationsPort_par_out_local.TChangeableMemPool._._._m_arrayPool._0_._elem._m_LocationList._Item._156_._thetaVar._m_value "" VALUE 0xB00113AC __Float16_Value 0 NO_COMPU_METHOD -65504 65504 ECU_ADDRESS_EXTENSION 0x2 BYTE_ORDER MSB_LAST /end CHARACTERISTIC
/begin CHARACTERISTIC _g_PL_AD_fw_Radar_1R1V_rpc_LocBypassingRunnable_LocBypassingRunnable_m_pad_ensRLocationsPort_par_out_local.TChangeableMemPool._._._m_arrayPool._0_._elem._m_LocationList._Item._156_._v "" VALUE 0xB001139C __Float32_Value 0 NO_COMPU_METHOD -3.4028234663852886E+38 3.4028234663852886E+38 ECU_ADDRESS_EXTENSION 0x2 BYTE_ORDER MSB_LAST /end CHARACTERISTIC
/begin CHARACTERISTIC _g_PL_AD_fw_Radar_1R1V_rpc_LocBypassingRunnable_LocBypassingRunnable_m_pad_ensRLocationsPort_par_out_local.TChangeableMemPool._._._m_arrayPool._0_._elem._m_LocationList._Item._156_._vVar._m_value "" VALUE 0xB00113A2 __Float16_Value 0 NO_COMPU_METHOD -65504 65504 ECU_ADDRESS_EXTENSION 0x2 BYTE_ORDER MSB_LAST /end CHARACTERISTIC
/begin CHARACTERISTIC _g_PL_AD_fw_Radar_1R1V_rpc_LocBypassingRunnable_LocBypassingRunnable_m_pad_ensRLocationsPort_par_out_local.TChangeableMemPool._._._m_arrayPool._0_._elem._m_LocationList._Item._157_._Rcs._m_value "" VALUE 0xB00113D0 __Float16_Value 0 NO_COMPU_METHOD -65504 65504 ECU_ADDRESS_EXTENSION 0x2 BYTE_ORDER MSB_LAST /end CHARACTERISTIC
/begin CHARACTERISTIC _g_PL_AD_fw_Radar_1R1V_rpc_LocBypassingRunnable_LocBypassingRunnable_m_pad_ensRLocationsPort_par_out_local.TChangeableMemPool._._._m_arrayPool._0_._elem._m_LocationList._Item._157_._Rssi._m_value "" VALUE 0xB00113D2 __Float16_Value 0 NO_COMPU_METHOD -65504 65504 ECU_ADDRESS_EXTENSION 0x2 BYTE_ORDER MSB_LAST /end CHARACTERISTIC
/begin CHARACTERISTIC _g_PL_AD_fw_Radar_1R1V_rpc_LocBypassingRunnable_LocBypassingRunnable_m_pad_ensRLocationsPort_par_out_local.TChangeableMemPool._._._m_arrayPool._0_._elem._m_LocationList._Item._157_._d "" VALUE 0xB00113B8 __Float32_Value 0 NO_COMPU_METHOD -3.4028234663852886E+38 3.4028234663852886E+38 ECU_ADDRESS_EXTENSION 0x2 BYTE_ORDER MSB_LAST /end CHARACTERISTIC
/begin CHARACTERISTIC _g_PL_AD_fw_Radar_1R1V_rpc_LocBypassingRunnable_LocBypassingRunnable_m_pad_ensRLocationsPort_par_out_local.TChangeableMemPool._._._m_arrayPool._0_._elem._m_LocationList._Item._157_._dVar._m_value "" VALUE 0xB00113C0 __Float16_Value 0 NO_COMPU_METHOD -65504 65504 ECU_ADDRESS_EXTENSION 0x2 BYTE_ORDER MSB_LAST /end CHARACTERISTIC
/begin CHARACTERISTIC _g_PL_AD_fw_Radar_1R1V_rpc_LocBypassingRunnable_LocBypassingRunnable_m_pad_ensRLocationsPort_par_out_local.TChangeableMemPool._._._m_arrayPool._0_._elem._m_LocationList._Item._157_._dvCov._m_value "" VALUE 0xB00113C4 __Float16_Value 0 NO_COMPU_METHOD -65504 65504 ECU_ADDRESS_EXTENSION 0x2 BYTE_ORDER MSB_LAST /end CHARACTERISTIC
/begin CHARACTERISTIC _g_PL_AD_fw_Radar_1R1V_rpc_LocBypassingRunnable_LocBypassingRunnable_m_pad_ensRLocationsPort_par_out_local.TChangeableMemPool._._._m_arrayPool._0_._elem._m_LocationList._Item._157_._dvQly "" VALUE 0xB00113D4 __UByte_Value 0 NO_COMPU_METHOD 0 255 ECU_ADDRESS_EXTENSION 0x2 BYTE_ORDER MSB_LAST /end CHARACTERISTIC
/begin CHARACTERISTIC _g_PL_AD_fw_Radar_1R1V_rpc_LocBypassingRunnable_LocBypassingRunnable_m_pad_ensRLocationsPort_par_out_local.TChangeableMemPool._._._m_arrayPool._0_._elem._m_LocationList._Item._157_._idxAzimuthAmbiguityPeer "" VALUE 0xB00113D6 __UWord_Value 0 NO_COMPU_METHOD 0 65535 ECU_ADDRESS_EXTENSION 0x2 BYTE_ORDER MSB_LAST /end CHARACTERISTIC
/begin CHARACTERISTIC _g_PL_AD_fw_Radar_1R1V_rpc_LocBypassingRunnable_LocBypassingRunnable_m_pad_ensRLocationsPort_par_out_local.TChangeableMemPool._._._m_arrayPool._0_._elem._m_LocationList._Item._157_._measStatus "" VALUE 0xB00113D5 __UByte_Value 0 NO_COMPU_METHOD 0 255 ECU_ADDRESS_EXTENSION 0x2 BYTE_ORDER MSB_LAST /end CHARACTERISTIC
/begin CHARACTERISTIC _g_PL_AD_fw_Radar_1R1V_rpc_LocBypassingRunnable_LocBypassingRunnable_m_pad_ensRLocationsPort_par_out_local.TChangeableMemPool._._._m_arrayPool._0_._elem._m_LocationList._Item._157_._phi._m_value "" VALUE 0xB00113C8 __Float16_Value 0 NO_COMPU_METHOD -65504 65504 ECU_ADDRESS_EXTENSION 0x2 BYTE_ORDER MSB_LAST /end CHARACTERISTIC
/begin CHARACTERISTIC _g_PL_AD_fw_Radar_1R1V_rpc_LocBypassingRunnable_LocBypassingRunnable_m_pad_ensRLocationsPort_par_out_local.TChangeableMemPool._._._m_arrayPool._0_._elem._m_LocationList._Item._157_._phiQly "" VALUE 0xB00113CB __UByte_Value 0 NO_COMPU_METHOD 0 255 ECU_ADDRESS_EXTENSION 0x2 BYTE_ORDER MSB_LAST /end CHARACTERISTIC
/begin CHARACTERISTIC _g_PL_AD_fw_Radar_1R1V_rpc_LocBypassingRunnable_LocBypassingRunnable_m_pad_ensRLocationsPort_par_out_local.TChangeableMemPool._._._m_arrayPool._0_._elem._m_LocationList._Item._157_._phiVar._m_value "" VALUE 0xB00113CE __Float16_Value 0 NO_COMPU_METHOD -65504 65504 ECU_ADDRESS_EXTENSION 0x2 BYTE_ORDER MSB_LAST /end CHARACTERISTIC
/begin CHARACTERISTIC _g_PL_AD_fw_Radar_1R1V_rpc_LocBypassingRunnable_LocBypassingRunnable_m_pad_ensRLocationsPort_par_out_local.TChangeableMemPool._._._m_arrayPool._0_._elem._m_LocationList._Item._157_._theta._m_value "" VALUE 0xB00113C6 __Float16_Value 0 NO_COMPU_METHOD -65504 65504 ECU_ADDRESS_EXTENSION 0x2 BYTE_ORDER MSB_LAST /end CHARACTERISTIC
/begin CHARACTERISTIC _g_PL_AD_fw_Radar_1R1V_rpc_LocBypassingRunnable_LocBypassingRunnable_m_pad_ensRLocationsPort_par_out_local.TChangeableMemPool._._._m_arrayPool._0_._elem._m_LocationList._Item._157_._thetaQly "" VALUE 0xB00113CA __UByte_Value 0 NO_COMPU_METHOD 0 255 ECU_ADDRESS_EXTENSION 0x2 BYTE_ORDER MSB_LAST /end CHARACTERISTIC
/begin CHARACTERISTIC _g_PL_AD_fw_Radar_1R1V_rpc_LocBypassingRunnable_LocBypassingRunnable_m_pad_ensRLocationsPort_par_out_local.TChangeableMemPool._._._m_arrayPool._0_._elem._m_LocationList._Item._157_._thetaVar._m_value "" VALUE 0xB00113CC __Float16_Value 0 NO_COMPU_METHOD -65504 65504 ECU_ADDRESS_EXTENSION 0x2 BYTE_ORDER MSB_LAST /end CHARACTERISTIC
/begin CHARACTERISTIC _g_PL_AD_fw_Radar_1R1V_rpc_LocBypassingRunnable_LocBypassingRunnable_m_pad_ensRLocationsPort_par_out_local.TChangeableMemPool._._._m_arrayPool._0_._elem._m_LocationList._Item._157_._v "" VALUE 0xB00113BC __Float32_Value 0 NO_COMPU_METHOD -3.4028234663852886E+38 3.4028234663852886E+38 ECU_ADDRESS_EXTENSION 0x2 BYTE_ORDER MSB_LAST /end CHARACTERISTIC
/begin CHARACTERISTIC _g_PL_AD_fw_Radar_1R1V_rpc_LocBypassingRunnable_LocBypassingRunnable_m_pad_ensRLocationsPort_par_out_local.TChangeableMemPool._._._m_arrayPool._0_._elem._m_LocationList._Item._157_._vVar._m_value "" VALUE 0xB00113C2 __Float16_Value 0 NO_COMPU_METHOD -65504 65504 ECU_ADDRESS_EXTENSION 0x2 BYTE_ORDER MSB_LAST /end CHARACTERISTIC
/begin CHARACTERISTIC _g_PL_AD_fw_Radar_1R1V_rpc_LocBypassingRunnable_LocBypassingRunnable_m_pad_ensRLocationsPort_par_out_local.TChangeableMemPool._._._m_arrayPool._0_._elem._m_LocationList._Item._158_._Rcs._m_value "" VALUE 0xB00113F0 __Float16_Value 0 NO_COMPU_METHOD -65504 65504 ECU_ADDRESS_EXTENSION 0x2 BYTE_ORDER MSB_LAST /end CHARACTERISTIC
/begin CHARACTERISTIC _g_PL_AD_fw_Radar_1R1V_rpc_LocBypassingRunnable_LocBypassingRunnable_m_pad_ensRLocationsPort_par_out_local.TChangeableMemPool._._._m_arrayPool._0_._elem._m_LocationList._Item._158_._Rssi._m_value "" VALUE 0xB00113F2 __Float16_Value 0 NO_COMPU_METHOD -65504 65504 ECU_ADDRESS_EXTENSION 0x2 BYTE_ORDER MSB_LAST /end CHARACTERISTIC
/begin CHARACTERISTIC _g_PL_AD_fw_Radar_1R1V_rpc_LocBypassingRunnable_LocBypassingRunnable_m_pad_ensRLocationsPort_par_out_local.TChangeableMemPool._._._m_arrayPool._0_._elem._m_LocationList._Item._158_._d "" VALUE 0xB00113D8 __Float32_Value 0 NO_COMPU_METHOD -3.4028234663852886E+38 3.4028234663852886E+38 ECU_ADDRESS_EXTENSION 0x2 BYTE_ORDER MSB_LAST /end CHARACTERISTIC
/begin CHARACTERISTIC _g_PL_AD_fw_Radar_1R1V_rpc_LocBypassingRunnable_LocBypassingRunnable_m_pad_ensRLocationsPort_par_out_local.TChangeableMemPool._._._m_arrayPool._0_._elem._m_LocationList._Item._158_._dVar._m_value "" VALUE 0xB00113E0 __Float16_Value 0 NO_COMPU_METHOD -65504 65504 ECU_ADDRESS_EXTENSION 0x2 BYTE_ORDER MSB_LAST /end CHARACTERISTIC
/begin CHARACTERISTIC _g_PL_AD_fw_Radar_1R1V_rpc_LocBypassingRunnable_LocBypassingRunnable_m_pad_ensRLocationsPort_par_out_local.TChangeableMemPool._._._m_arrayPool._0_._elem._m_LocationList._Item._158_._dvCov._m_value "" VALUE 0xB00113E4 __Float16_Value 0 NO_COMPU_METHOD -65504 65504 ECU_ADDRESS_EXTENSION 0x2 BYTE_ORDER MSB_LAST /end CHARACTERISTIC
/begin CHARACTERISTIC _g_PL_AD_fw_Radar_1R1V_rpc_LocBypassingRunnable_LocBypassingRunnable_m_pad_ensRLocationsPort_par_out_local.TChangeableMemPool._._._m_arrayPool._0_._elem._m_LocationList._Item._158_._dvQly "" VALUE 0xB00113F4 __UByte_Value 0 NO_COMPU_METHOD 0 255 ECU_ADDRESS_EXTENSION 0x2 BYTE_ORDER MSB_LAST /end CHARACTERISTIC
/begin CHARACTERISTIC _g_PL_AD_fw_Radar_1R1V_rpc_LocBypassingRunnable_LocBypassingRunnable_m_pad_ensRLocationsPort_par_out_local.TChangeableMemPool._._._m_arrayPool._0_._elem._m_LocationList._Item._158_._idxAzimuthAmbiguityPeer "" VALUE 0xB00113F6 __UWord_Value 0 NO_COMPU_METHOD 0 65535 ECU_ADDRESS_EXTENSION 0x2 BYTE_ORDER MSB_LAST /end CHARACTERISTIC
/begin CHARACTERISTIC _g_PL_AD_fw_Radar_1R1V_rpc_LocBypassingRunnable_LocBypassingRunnable_m_pad_ensRLocationsPort_par_out_local.TChangeableMemPool._._._m_arrayPool._0_._elem._m_LocationList._Item._158_._measStatus "" VALUE 0xB00113F5 __UByte_Value 0 NO_COMPU_METHOD 0 255 ECU_ADDRESS_EXTENSION 0x2 BYTE_ORDER MSB_LAST /end CHARACTERISTIC
/begin CHARACTERISTIC _g_PL_AD_fw_Radar_1R1V_rpc_LocBypassingRunnable_LocBypassingRunnable_m_pad_ensRLocationsPort_par_out_local.TChangeableMemPool._._._m_arrayPool._0_._elem._m_LocationList._Item._158_._phi._m_value "" VALUE 0xB00113E8 __Float16_Value 0 NO_COMPU_METHOD -65504 65504 ECU_ADDRESS_EXTENSION 0x2 BYTE_ORDER MSB_LAST /end CHARACTERISTIC
/begin CHARACTERISTIC _g_PL_AD_fw_Radar_1R1V_rpc_LocBypassingRunnable_LocBypassingRunnable_m_pad_ensRLocationsPort_par_out_local.TChangeableMemPool._._._m_arrayPool._0_._elem._m_LocationList._Item._158_._phiQly "" VALUE 0xB00113EB __UByte_Value 0 NO_COMPU_METHOD 0 255 ECU_ADDRESS_EXTENSION 0x2 BYTE_ORDER MSB_LAST /end CHARACTERISTIC
/begin CHARACTERISTIC _g_PL_AD_fw_Radar_1R1V_rpc_LocBypassingRunnable_LocBypassingRunnable_m_pad_ensRLocationsPort_par_out_local.TChangeableMemPool._._._m_arrayPool._0_._elem._m_LocationList._Item._158_._phiVar._m_value "" VALUE 0xB00113EE __Float16_Value 0 NO_COMPU_METHOD -65504 65504 ECU_ADDRESS_EXTENSION 0x2 BYTE_ORDER MSB_LAST /end CHARACTERISTIC
/begin CHARACTERISTIC _g_PL_AD_fw_Radar_1R1V_rpc_LocBypassingRunnable_LocBypassingRunnable_m_pad_ensRLocationsPort_par_out_local.TChangeableMemPool._._._m_arrayPool._0_._elem._m_LocationList._Item._158_._theta._m_value "" VALUE 0xB00113E6 __Float16_Value 0 NO_COMPU_METHOD -65504 65504 ECU_ADDRESS_EXTENSION 0x2 BYTE_ORDER MSB_LAST /end CHARACTERISTIC
/begin CHARACTERISTIC _g_PL_AD_fw_Radar_1R1V_rpc_LocBypassingRunnable_LocBypassingRunnable_m_pad_ensRLocationsPort_par_out_local.TChangeableMemPool._._._m_arrayPool._0_._elem._m_LocationList._Item._158_._thetaQly "" VALUE 0xB00113EA __UByte_Value 0 NO_COMPU_METHOD 0 255 ECU_ADDRESS_EXTENSION 0x2 BYTE_ORDER MSB_LAST /end CHARACTERISTIC
/begin CHARACTERISTIC _g_PL_AD_fw_Radar_1R1V_rpc_LocBypassingRunnable_LocBypassingRunnable_m_pad_ensRLocationsPort_par_out_local.TChangeableMemPool._._._m_arrayPool._0_._elem._m_LocationList._Item._158_._thetaVar._m_value "" VALUE 0xB00113EC __Float16_Value 0 NO_COMPU_METHOD -65504 65504 ECU_ADDRESS_EXTENSION 0x2 BYTE_ORDER MSB_LAST /end CHARACTERISTIC
/begin CHARACTERISTIC _g_PL_AD_fw_Radar_1R1V_rpc_LocBypassingRunnable_LocBypassingRunnable_m_pad_ensRLocationsPort_par_out_local.TChangeableMemPool._._._m_arrayPool._0_._elem._m_LocationList._Item._158_._v "" VALUE 0xB00113DC __Float32_Value 0 NO_COMPU_METHOD -3.4028234663852886E+38 3.4028234663852886E+38 ECU_ADDRESS_EXTENSION 0x2 BYTE_ORDER MSB_LAST /end CHARACTERISTIC
/begin CHARACTERISTIC _g_PL_AD_fw_Radar_1R1V_rpc_LocBypassingRunnable_LocBypassingRunnable_m_pad_ensRLocationsPort_par_out_local.TChangeableMemPool._._._m_arrayPool._0_._elem._m_LocationList._Item._158_._vVar._m_value "" VALUE 0xB00113E2 __Float16_Value 0 NO_COMPU_METHOD -65504 65504 ECU_ADDRESS_EXTENSION 0x2 BYTE_ORDER MSB_LAST /end CHARACTERISTIC
/begin CHARACTERISTIC _g_PL_AD_fw_Radar_1R1V_rpc_LocBypassingRunnable_LocBypassingRunnable_m_pad_ensRLocationsPort_par_out_local.TChangeableMemPool._._._m_arrayPool._0_._elem._m_LocationList._Item._159_._Rcs._m_value "" VALUE 0xB0011410 __Float16_Value 0 NO_COMPU_METHOD -65504 65504 ECU_ADDRESS_EXTENSION 0x2 BYTE_ORDER MSB_LAST /end CHARACTERISTIC
/begin CHARACTERISTIC _g_PL_AD_fw_Radar_1R1V_rpc_LocBypassingRunnable_LocBypassingRunnable_m_pad_ensRLocationsPort_par_out_local.TChangeableMemPool._._._m_arrayPool._0_._elem._m_LocationList._Item._159_._Rssi._m_value "" VALUE 0xB0011412 __Float16_Value 0 NO_COMPU_METHOD -65504 65504 ECU_ADDRESS_EXTENSION 0x2 BYTE_ORDER MSB_LAST /end CHARACTERISTIC
/begin CHARACTERISTIC _g_PL_AD_fw_Radar_1R1V_rpc_LocBypassingRunnable_LocBypassingRunnable_m_pad_ensRLocationsPort_par_out_local.TChangeableMemPool._._._m_arrayPool._0_._elem._m_LocationList._Item._159_._d "" VALUE 0xB00113F8 __Float32_Value 0 NO_COMPU_METHOD -3.4028234663852886E+38 3.4028234663852886E+38 ECU_ADDRESS_EXTENSION 0x2 BYTE_ORDER MSB_LAST /end CHARACTERISTIC
/begin CHARACTERISTIC _g_PL_AD_fw_Radar_1R1V_rpc_LocBypassingRunnable_LocBypassingRunnable_m_pad_ensRLocationsPort_par_out_local.TChangeableMemPool._._._m_arrayPool._0_._elem._m_LocationList._Item._159_._dVar._m_value "" VALUE 0xB0011400 __Float16_Value 0 NO_COMPU_METHOD -65504 65504 ECU_ADDRESS_EXTENSION 0x2 BYTE_ORDER MSB_LAST /end CHARACTERISTIC
/begin CHARACTERISTIC _g_PL_AD_fw_Radar_1R1V_rpc_LocBypassingRunnable_LocBypassingRunnable_m_pad_ensRLocationsPort_par_out_local.TChangeableMemPool._._._m_arrayPool._0_._elem._m_LocationList._Item._159_._dvCov._m_value "" VALUE 0xB0011404 __Float16_Value 0 NO_COMPU_METHOD -65504 65504 ECU_ADDRESS_EXTENSION 0x2 BYTE_ORDER MSB_LAST /end CHARACTERISTIC
/begin CHARACTERISTIC _g_PL_AD_fw_Radar_1R1V_rpc_LocBypassingRunnable_LocBypassingRunnable_m_pad_ensRLocationsPort_par_out_local.TChangeableMemPool._._._m_arrayPool._0_._elem._m_LocationList._Item._159_._dvQly "" VALUE 0xB0011414 __UByte_Value 0 NO_COMPU_METHOD 0 255 ECU_ADDRESS_EXTENSION 0x2 BYTE_ORDER MSB_LAST /end CHARACTERISTIC
/begin CHARACTERISTIC _g_PL_AD_fw_Radar_1R1V_rpc_LocBypassingRunnable_LocBypassingRunnable_m_pad_ensRLocationsPort_par_out_local.TChangeableMemPool._._._m_arrayPool._0_._elem._m_LocationList._Item._159_._idxAzimuthAmbiguityPeer "" VALUE 0xB0011416 __UWord_Value 0 NO_COMPU_METHOD 0 65535 ECU_ADDRESS_EXTENSION 0x2 BYTE_ORDER MSB_LAST /end CHARACTERISTIC
/begin CHARACTERISTIC _g_PL_AD_fw_Radar_1R1V_rpc_LocBypassingRunnable_LocBypassingRunnable_m_pad_ensRLocationsPort_par_out_local.TChangeableMemPool._._._m_arrayPool._0_._elem._m_LocationList._Item._159_._measStatus "" VALUE 0xB0011415 __UByte_Value 0 NO_COMPU_METHOD 0 255 ECU_ADDRESS_EXTENSION 0x2 BYTE_ORDER MSB_LAST /end CHARACTERISTIC
/begin CHARACTERISTIC _g_PL_AD_fw_Radar_1R1V_rpc_LocBypassingRunnable_LocBypassingRunnable_m_pad_ensRLocationsPort_par_out_local.TChangeableMemPool._._._m_arrayPool._0_._elem._m_LocationList._Item._159_._phi._m_value "" VALUE 0xB0011408 __Float16_Value 0 NO_COMPU_METHOD -65504 65504 ECU_ADDRESS_EXTENSION 0x2 BYTE_ORDER MSB_LAST /end CHARACTERISTIC
/begin CHARACTERISTIC _g_PL_AD_fw_Radar_1R1V_rpc_LocBypassingRunnable_LocBypassingRunnable_m_pad_ensRLocationsPort_par_out_local.TChangeableMemPool._._._m_arrayPool._0_._elem._m_LocationList._Item._159_._phiQly "" VALUE 0xB001140B __UByte_Value 0 NO_COMPU_METHOD 0 255 ECU_ADDRESS_EXTENSION 0x2 BYTE_ORDER MSB_LAST /end CHARACTERISTIC
/begin CHARACTERISTIC _g_PL_AD_fw_Radar_1R1V_rpc_LocBypassingRunnable_LocBypassingRunnable_m_pad_ensRLocationsPort_par_out_local.TChangeableMemPool._._._m_arrayPool._0_._elem._m_LocationList._Item._159_._phiVar._m_value "" VALUE 0xB001140E __Float16_Value 0 NO_COMPU_METHOD -65504 65504 ECU_ADDRESS_EXTENSION 0x2 BYTE_ORDER MSB_LAST /end CHARACTERISTIC
/begin CHARACTERISTIC _g_PL_AD_fw_Radar_1R1V_rpc_LocBypassingRunnable_LocBypassingRunnable_m_pad_ensRLocationsPort_par_out_local.TChangeableMemPool._._._m_arrayPool._0_._elem._m_LocationList._Item._159_._theta._m_value "" VALUE 0xB0011406 __Float16_Value 0 NO_COMPU_METHOD -65504 65504 ECU_ADDRESS_EXTENSION 0x2 BYTE_ORDER MSB_LAST /end CHARACTERISTIC
/begin CHARACTERISTIC _g_PL_AD_fw_Radar_1R1V_rpc_LocBypassingRunnable_LocBypassingRunnable_m_pad_ensRLocationsPort_par_out_local.TChangeableMemPool._._._m_arrayPool._0_._elem._m_LocationList._Item._159_._thetaQly "" VALUE 0xB001140A __UByte_Value 0 NO_COMPU_METHOD 0 255 ECU_ADDRESS_EXTENSION 0x2 BYTE_ORDER MSB_LAST /end CHARACTERISTIC
/begin CHARACTERISTIC _g_PL_AD_fw_Radar_1R1V_rpc_LocBypassingRunnable_LocBypassingRunnable_m_pad_ensRLocationsPort_par_out_local.TChangeableMemPool._._._m_arrayPool._0_._elem._m_LocationList._Item._159_._thetaVar._m_value "" VALUE 0xB001140C __Float16_Value 0 NO_COMPU_METHOD -65504 65504 ECU_ADDRESS_EXTENSION 0x2 BYTE_ORDER MSB_LAST /end CHARACTERISTIC
/begin CHARACTERISTIC _g_PL_AD_fw_Radar_1R1V_rpc_LocBypassingRunnable_LocBypassingRunnable_m_pad_ensRLocationsPort_par_out_local.TChangeableMemPool._._._m_arrayPool._0_._elem._m_LocationList._Item._159_._v "" VALUE 0xB00113FC __Float32_Value 0 NO_COMPU_METHOD -3.4028234663852886E+38 3.4028234663852886E+38 ECU_ADDRESS_EXTENSION 0x2 BYTE_ORDER MSB_LAST /end CHARACTERISTIC
/begin CHARACTERISTIC _g_PL_AD_fw_Radar_1R1V_rpc_LocBypassingRunnable_LocBypassingRunnable_m_pad_ensRLocationsPort_par_out_local.TChangeableMemPool._._._m_arrayPool._0_._elem._m_LocationList._Item._159_._vVar._m_value "" VALUE 0xB0011402 __Float16_Value 0 NO_COMPU_METHOD -65504 65504 ECU_ADDRESS_EXTENSION 0x2 BYTE_ORDER MSB_LAST /end CHARACTERISTIC
/begin CHARACTERISTIC _g_PL_AD_fw_Radar_1R1V_rpc_LocBypassingRunnable_LocBypassingRunnable_m_pad_ensRLocationsPort_par_out_local.TChangeableMemPool._._._m_arrayPool._0_._elem._m_LocationList._Item._15_._Rcs._m_value "" VALUE 0xB0010210 __Float16_Value 0 NO_COMPU_METHOD -65504 65504 ECU_ADDRESS_EXTENSION 0x2 BYTE_ORDER MSB_LAST /end CHARACTERISTIC
/begin CHARACTERISTIC _g_PL_AD_fw_Radar_1R1V_rpc_LocBypassingRunnable_LocBypassingRunnable_m_pad_ensRLocationsPort_par_out_local.TChangeableMemPool._._._m_arrayPool._0_._elem._m_LocationList._Item._15_._Rssi._m_value "" VALUE 0xB0010212 __Float16_Value 0 NO_COMPU_METHOD -65504 65504 ECU_ADDRESS_EXTENSION 0x2 BYTE_ORDER MSB_LAST /end CHARACTERISTIC
/begin CHARACTERISTIC _g_PL_AD_fw_Radar_1R1V_rpc_LocBypassingRunnable_LocBypassingRunnable_m_pad_ensRLocationsPort_par_out_local.TChangeableMemPool._._._m_arrayPool._0_._elem._m_LocationList._Item._15_._d "" VALUE 0xB00101F8 __Float32_Value 0 NO_COMPU_METHOD -3.4028234663852886E+38 3.4028234663852886E+38 ECU_ADDRESS_EXTENSION 0x2 BYTE_ORDER MSB_LAST /end CHARACTERISTIC
/begin CHARACTERISTIC _g_PL_AD_fw_Radar_1R1V_rpc_LocBypassingRunnable_LocBypassingRunnable_m_pad_ensRLocationsPort_par_out_local.TChangeableMemPool._._._m_arrayPool._0_._elem._m_LocationList._Item._15_._dVar._m_value "" VALUE 0xB0010200 __Float16_Value 0 NO_COMPU_METHOD -65504 65504 ECU_ADDRESS_EXTENSION 0x2 BYTE_ORDER MSB_LAST /end CHARACTERISTIC
/begin CHARACTERISTIC _g_PL_AD_fw_Radar_1R1V_rpc_LocBypassingRunnable_LocBypassingRunnable_m_pad_ensRLocationsPort_par_out_local.TChangeableMemPool._._._m_arrayPool._0_._elem._m_LocationList._Item._15_._dvCov._m_value "" VALUE 0xB0010204 __Float16_Value 0 NO_COMPU_METHOD -65504 65504 ECU_ADDRESS_EXTENSION 0x2 BYTE_ORDER MSB_LAST /end CHARACTERISTIC
/begin CHARACTERISTIC _g_PL_AD_fw_Radar_1R1V_rpc_LocBypassingRunnable_LocBypassingRunnable_m_pad_ensRLocationsPort_par_out_local.TChangeableMemPool._._._m_arrayPool._0_._elem._m_LocationList._Item._15_._dvQly "" VALUE 0xB0010214 __UByte_Value 0 NO_COMPU_METHOD 0 255 ECU_ADDRESS_EXTENSION 0x2 BYTE_ORDER MSB_LAST /end CHARACTERISTIC
/begin CHARACTERISTIC _g_PL_AD_fw_Radar_1R1V_rpc_LocBypassingRunnable_LocBypassingRunnable_m_pad_ensRLocationsPort_par_out_local.TChangeableMemPool._._._m_arrayPool._0_._elem._m_LocationList._Item._15_._idxAzimuthAmbiguityPeer "" VALUE 0xB0010216 __UWord_Value 0 NO_COMPU_METHOD 0 65535 ECU_ADDRESS_EXTENSION 0x2 BYTE_ORDER MSB_LAST /end CHARACTERISTIC
/begin CHARACTERISTIC _g_PL_AD_fw_Radar_1R1V_rpc_LocBypassingRunnable_LocBypassingRunnable_m_pad_ensRLocationsPort_par_out_local.TChangeableMemPool._._._m_arrayPool._0_._elem._m_LocationList._Item._15_._measStatus "" VALUE 0xB0010215 __UByte_Value 0 NO_COMPU_METHOD 0 255 ECU_ADDRESS_EXTENSION 0x2 BYTE_ORDER MSB_LAST /end CHARACTERISTIC
/begin CHARACTERISTIC _g_PL_AD_fw_Radar_1R1V_rpc_LocBypassingRunnable_LocBypassingRunnable_m_pad_ensRLocationsPort_par_out_local.TChangeableMemPool._._._m_arrayPool._0_._elem._m_LocationList._Item._15_._phi._m_value "" VALUE 0xB0010208 __Float16_Value 0 NO_COMPU_METHOD -65504 65504 ECU_ADDRESS_EXTENSION 0x2 BYTE_ORDER MSB_LAST /end CHARACTERISTIC
/begin CHARACTERISTIC _g_PL_AD_fw_Radar_1R1V_rpc_LocBypassingRunnable_LocBypassingRunnable_m_pad_ensRLocationsPort_par_out_local.TChangeableMemPool._._._m_arrayPool._0_._elem._m_LocationList._Item._15_._phiQly "" VALUE 0xB001020B __UByte_Value 0 NO_COMPU_METHOD 0 255 ECU_ADDRESS_EXTENSION 0x2 BYTE_ORDER MSB_LAST /end CHARACTERISTIC
/begin CHARACTERISTIC _g_PL_AD_fw_Radar_1R1V_rpc_LocBypassingRunnable_LocBypassingRunnable_m_pad_ensRLocationsPort_par_out_local.TChangeableMemPool._._._m_arrayPool._0_._elem._m_LocationList._Item._15_._phiVar._m_value "" VALUE 0xB001020E __Float16_Value 0 NO_COMPU_METHOD -65504 65504 ECU_ADDRESS_EXTENSION 0x2 BYTE_ORDER MSB_LAST /end CHARACTERISTIC
/begin CHARACTERISTIC _g_PL_AD_fw_Radar_1R1V_rpc_LocBypassingRunnable_LocBypassingRunnable_m_pad_ensRLocationsPort_par_out_local.TChangeableMemPool._._._m_arrayPool._0_._elem._m_LocationList._Item._15_._theta._m_value "" VALUE 0xB0010206 __Float16_Value 0 NO_COMPU_METHOD -65504 65504 ECU_ADDRESS_EXTENSION 0x2 BYTE_ORDER MSB_LAST /end CHARACTERISTIC
/begin CHARACTERISTIC _g_PL_AD_fw_Radar_1R1V_rpc_LocBypassingRunnable_LocBypassingRunnable_m_pad_ensRLocationsPort_par_out_local.TChangeableMemPool._._._m_arrayPool._0_._elem._m_LocationList._Item._15_._thetaQly "" VALUE 0xB001020A __UByte_Value 0 NO_COMPU_METHOD 0 255 ECU_ADDRESS_EXTENSION 0x2 BYTE_ORDER MSB_LAST /end CHARACTERISTIC
/begin CHARACTERISTIC _g_PL_AD_fw_Radar_1R1V_rpc_LocBypassingRunnable_LocBypassingRunnable_m_pad_ensRLocationsPort_par_out_local.TChangeableMemPool._._._m_arrayPool._0_._elem._m_LocationList._Item._15_._thetaVar._m_value "" VALUE 0xB001020C __Float16_Value 0 NO_COMPU_METHOD -65504 65504 ECU_ADDRESS_EXTENSION 0x2 BYTE_ORDER MSB_LAST /end CHARACTERISTIC
/begin CHARACTERISTIC _g_PL_AD_fw_Radar_1R1V_rpc_LocBypassingRunnable_LocBypassingRunnable_m_pad_ensRLocationsPort_par_out_local.TChangeableMemPool._._._m_arrayPool._0_._elem._m_LocationList._Item._15_._v "" VALUE 0xB00101FC __Float32_Value 0 NO_COMPU_METHOD -3.4028234663852886E+38 3.4028234663852886E+38 ECU_ADDRESS_EXTENSION 0x2 BYTE_ORDER MSB_LAST /end CHARACTERISTIC
/begin CHARACTERISTIC _g_PL_AD_fw_Radar_1R1V_rpc_LocBypassingRunnable_LocBypassingRunnable_m_pad_ensRLocationsPort_par_out_local.TChangeableMemPool._._._m_arrayPool._0_._elem._m_LocationList._Item._15_._vVar._m_value "" VALUE 0xB0010202 __Float16_Value 0 NO_COMPU_METHOD -65504 65504 ECU_ADDRESS_EXTENSION 0x2 BYTE_ORDER MSB_LAST /end CHARACTERISTIC
/begin CHARACTERISTIC _g_PL_AD_fw_Radar_1R1V_rpc_LocBypassingRunnable_LocBypassingRunnable_m_pad_ensRLocationsPort_par_out_local.TChangeableMemPool._._._m_arrayPool._0_._elem._m_LocationList._Item._160_._Rcs._m_value "" VALUE 0xB0011430 __Float16_Value 0 NO_COMPU_METHOD -65504 65504 ECU_ADDRESS_EXTENSION 0x2 BYTE_ORDER MSB_LAST /end CHARACTERISTIC
/begin CHARACTERISTIC _g_PL_AD_fw_Radar_1R1V_rpc_LocBypassingRunnable_LocBypassingRunnable_m_pad_ensRLocationsPort_par_out_local.TChangeableMemPool._._._m_arrayPool._0_._elem._m_LocationList._Item._160_._Rssi._m_value "" VALUE 0xB0011432 __Float16_Value 0 NO_COMPU_METHOD -65504 65504 ECU_ADDRESS_EXTENSION 0x2 BYTE_ORDER MSB_LAST /end CHARACTERISTIC
/begin CHARACTERISTIC _g_PL_AD_fw_Radar_1R1V_rpc_LocBypassingRunnable_LocBypassingRunnable_m_pad_ensRLocationsPort_par_out_local.TChangeableMemPool._._._m_arrayPool._0_._elem._m_LocationList._Item._160_._d "" VALUE 0xB0011418 __Float32_Value 0 NO_COMPU_METHOD -3.4028234663852886E+38 3.4028234663852886E+38 ECU_ADDRESS_EXTENSION 0x2 BYTE_ORDER MSB_LAST /end CHARACTERISTIC
/begin CHARACTERISTIC _g_PL_AD_fw_Radar_1R1V_rpc_LocBypassingRunnable_LocBypassingRunnable_m_pad_ensRLocationsPort_par_out_local.TChangeableMemPool._._._m_arrayPool._0_._elem._m_LocationList._Item._160_._dVar._m_value "" VALUE 0xB0011420 __Float16_Value 0 NO_COMPU_METHOD -65504 65504 ECU_ADDRESS_EXTENSION 0x2 BYTE_ORDER MSB_LAST /end CHARACTERISTIC
/begin CHARACTERISTIC _g_PL_AD_fw_Radar_1R1V_rpc_LocBypassingRunnable_LocBypassingRunnable_m_pad_ensRLocationsPort_par_out_local.TChangeableMemPool._._._m_arrayPool._0_._elem._m_LocationList._Item._160_._dvCov._m_value "" VALUE 0xB0011424 __Float16_Value 0 NO_COMPU_METHOD -65504 65504 ECU_ADDRESS_EXTENSION 0x2 BYTE_ORDER MSB_LAST /end CHARACTERISTIC
/begin CHARACTERISTIC _g_PL_AD_fw_Radar_1R1V_rpc_LocBypassingRunnable_LocBypassingRunnable_m_pad_ensRLocationsPort_par_out_local.TChangeableMemPool._._._m_arrayPool._0_._elem._m_LocationList._Item._160_._dvQly "" VALUE 0xB0011434 __UByte_Value 0 NO_COMPU_METHOD 0 255 ECU_ADDRESS_EXTENSION 0x2 BYTE_ORDER MSB_LAST /end CHARACTERISTIC
/begin CHARACTERISTIC _g_PL_AD_fw_Radar_1R1V_rpc_LocBypassingRunnable_LocBypassingRunnable_m_pad_ensRLocationsPort_par_out_local.TChangeableMemPool._._._m_arrayPool._0_._elem._m_LocationList._Item._160_._idxAzimuthAmbiguityPeer "" VALUE 0xB0011436 __UWord_Value 0 NO_COMPU_METHOD 0 65535 ECU_ADDRESS_EXTENSION 0x2 BYTE_ORDER MSB_LAST /end CHARACTERISTIC
/begin CHARACTERISTIC _g_PL_AD_fw_Radar_1R1V_rpc_LocBypassingRunnable_LocBypassingRunnable_m_pad_ensRLocationsPort_par_out_local.TChangeableMemPool._._._m_arrayPool._0_._elem._m_LocationList._Item._160_._measStatus "" VALUE 0xB0011435 __UByte_Value 0 NO_COMPU_METHOD 0 255 ECU_ADDRESS_EXTENSION 0x2 BYTE_ORDER MSB_LAST /end CHARACTERISTIC
/begin CHARACTERISTIC _g_PL_AD_fw_Radar_1R1V_rpc_LocBypassingRunnable_LocBypassingRunnable_m_pad_ensRLocationsPort_par_out_local.TChangeableMemPool._._._m_arrayPool._0_._elem._m_LocationList._Item._160_._phi._m_value "" VALUE 0xB0011428 __Float16_Value 0 NO_COMPU_METHOD -65504 65504 ECU_ADDRESS_EXTENSION 0x2 BYTE_ORDER MSB_LAST /end CHARACTERISTIC
/begin CHARACTERISTIC _g_PL_AD_fw_Radar_1R1V_rpc_LocBypassingRunnable_LocBypassingRunnable_m_pad_ensRLocationsPort_par_out_local.TChangeableMemPool._._._m_arrayPool._0_._elem._m_LocationList._Item._160_._phiQly "" VALUE 0xB001142B __UByte_Value 0 NO_COMPU_METHOD 0 255 ECU_ADDRESS_EXTENSION 0x2 BYTE_ORDER MSB_LAST /end CHARACTERISTIC
/begin CHARACTERISTIC _g_PL_AD_fw_Radar_1R1V_rpc_LocBypassingRunnable_LocBypassingRunnable_m_pad_ensRLocationsPort_par_out_local.TChangeableMemPool._._._m_arrayPool._0_._elem._m_LocationList._Item._160_._phiVar._m_value "" VALUE 0xB001142E __Float16_Value 0 NO_COMPU_METHOD -65504 65504 ECU_ADDRESS_EXTENSION 0x2 BYTE_ORDER MSB_LAST /end CHARACTERISTIC
/begin CHARACTERISTIC _g_PL_AD_fw_Radar_1R1V_rpc_LocBypassingRunnable_LocBypassingRunnable_m_pad_ensRLocationsPort_par_out_local.TChangeableMemPool._._._m_arrayPool._0_._elem._m_LocationList._Item._160_._theta._m_value "" VALUE 0xB0011426 __Float16_Value 0 NO_COMPU_METHOD -65504 65504 ECU_ADDRESS_EXTENSION 0x2 BYTE_ORDER MSB_LAST /end CHARACTERISTIC
/begin CHARACTERISTIC _g_PL_AD_fw_Radar_1R1V_rpc_LocBypassingRunnable_LocBypassingRunnable_m_pad_ensRLocationsPort_par_out_local.TChangeableMemPool._._._m_arrayPool._0_._elem._m_LocationList._Item._160_._thetaQly "" VALUE 0xB001142A __UByte_Value 0 NO_COMPU_METHOD 0 255 ECU_ADDRESS_EXTENSION 0x2 BYTE_ORDER MSB_LAST /end CHARACTERISTIC
/begin CHARACTERISTIC _g_PL_AD_fw_Radar_1R1V_rpc_LocBypassingRunnable_LocBypassingRunnable_m_pad_ensRLocationsPort_par_out_local.TChangeableMemPool._._._m_arrayPool._0_._elem._m_LocationList._Item._160_._thetaVar._m_value "" VALUE 0xB001142C __Float16_Value 0 NO_COMPU_METHOD -65504 65504 ECU_ADDRESS_EXTENSION 0x2 BYTE_ORDER MSB_LAST /end CHARACTERISTIC
/begin CHARACTERISTIC _g_PL_AD_fw_Radar_1R1V_rpc_LocBypassingRunnable_LocBypassingRunnable_m_pad_ensRLocationsPort_par_out_local.TChangeableMemPool._._._m_arrayPool._0_._elem._m_LocationList._Item._160_._v "" VALUE 0xB001141C __Float32_Value 0 NO_COMPU_METHOD -3.4028234663852886E+38 3.4028234663852886E+38 ECU_ADDRESS_EXTENSION 0x2 BYTE_ORDER MSB_LAST /end CHARACTERISTIC
/begin CHARACTERISTIC _g_PL_AD_fw_Radar_1R1V_rpc_LocBypassingRunnable_LocBypassingRunnable_m_pad_ensRLocationsPort_par_out_local.TChangeableMemPool._._._m_arrayPool._0_._elem._m_LocationList._Item._160_._vVar._m_value "" VALUE 0xB0011422 __Float16_Value 0 NO_COMPU_METHOD -65504 65504 ECU_ADDRESS_EXTENSION 0x2 BYTE_ORDER MSB_LAST /end CHARACTERISTIC
/begin CHARACTERISTIC _g_PL_AD_fw_Radar_1R1V_rpc_LocBypassingRunnable_LocBypassingRunnable_m_pad_ensRLocationsPort_par_out_local.TChangeableMemPool._._._m_arrayPool._0_._elem._m_LocationList._Item._161_._Rcs._m_value "" VALUE 0xB0011450 __Float16_Value 0 NO_COMPU_METHOD -65504 65504 ECU_ADDRESS_EXTENSION 0x2 BYTE_ORDER MSB_LAST /end CHARACTERISTIC
/begin CHARACTERISTIC _g_PL_AD_fw_Radar_1R1V_rpc_LocBypassingRunnable_LocBypassingRunnable_m_pad_ensRLocationsPort_par_out_local.TChangeableMemPool._._._m_arrayPool._0_._elem._m_LocationList._Item._161_._Rssi._m_value "" VALUE 0xB0011452 __Float16_Value 0 NO_COMPU_METHOD -65504 65504 ECU_ADDRESS_EXTENSION 0x2 BYTE_ORDER MSB_LAST /end CHARACTERISTIC
/begin CHARACTERISTIC _g_PL_AD_fw_Radar_1R1V_rpc_LocBypassingRunnable_LocBypassingRunnable_m_pad_ensRLocationsPort_par_out_local.TChangeableMemPool._._._m_arrayPool._0_._elem._m_LocationList._Item._161_._d "" VALUE 0xB0011438 __Float32_Value 0 NO_COMPU_METHOD -3.4028234663852886E+38 3.4028234663852886E+38 ECU_ADDRESS_EXTENSION 0x2 BYTE_ORDER MSB_LAST /end CHARACTERISTIC
/begin CHARACTERISTIC _g_PL_AD_fw_Radar_1R1V_rpc_LocBypassingRunnable_LocBypassingRunnable_m_pad_ensRLocationsPort_par_out_local.TChangeableMemPool._._._m_arrayPool._0_._elem._m_LocationList._Item._161_._dVar._m_value "" VALUE 0xB0011440 __Float16_Value 0 NO_COMPU_METHOD -65504 65504 ECU_ADDRESS_EXTENSION 0x2 BYTE_ORDER MSB_LAST /end CHARACTERISTIC
/begin CHARACTERISTIC _g_PL_AD_fw_Radar_1R1V_rpc_LocBypassingRunnable_LocBypassingRunnable_m_pad_ensRLocationsPort_par_out_local.TChangeableMemPool._._._m_arrayPool._0_._elem._m_LocationList._Item._161_._dvCov._m_value "" VALUE 0xB0011444 __Float16_Value 0 NO_COMPU_METHOD -65504 65504 ECU_ADDRESS_EXTENSION 0x2 BYTE_ORDER MSB_LAST /end CHARACTERISTIC
/begin CHARACTERISTIC _g_PL_AD_fw_Radar_1R1V_rpc_LocBypassingRunnable_LocBypassingRunnable_m_pad_ensRLocationsPort_par_out_local.TChangeableMemPool._._._m_arrayPool._0_._elem._m_LocationList._Item._161_._dvQly "" VALUE 0xB0011454 __UByte_Value 0 NO_COMPU_METHOD 0 255 ECU_ADDRESS_EXTENSION 0x2 BYTE_ORDER MSB_LAST /end CHARACTERISTIC
/begin CHARACTERISTIC _g_PL_AD_fw_Radar_1R1V_rpc_LocBypassingRunnable_LocBypassingRunnable_m_pad_ensRLocationsPort_par_out_local.TChangeableMemPool._._._m_arrayPool._0_._elem._m_LocationList._Item._161_._idxAzimuthAmbiguityPeer "" VALUE 0xB0011456 __UWord_Value 0 NO_COMPU_METHOD 0 65535 ECU_ADDRESS_EXTENSION 0x2 BYTE_ORDER MSB_LAST /end CHARACTERISTIC
/begin CHARACTERISTIC _g_PL_AD_fw_Radar_1R1V_rpc_LocBypassingRunnable_LocBypassingRunnable_m_pad_ensRLocationsPort_par_out_local.TChangeableMemPool._._._m_arrayPool._0_._elem._m_LocationList._Item._161_._measStatus "" VALUE 0xB0011455 __UByte_Value 0 NO_COMPU_METHOD 0 255 ECU_ADDRESS_EXTENSION 0x2 BYTE_ORDER MSB_LAST /end CHARACTERISTIC
/begin CHARACTERISTIC _g_PL_AD_fw_Radar_1R1V_rpc_LocBypassingRunnable_LocBypassingRunnable_m_pad_ensRLocationsPort_par_out_local.TChangeableMemPool._._._m_arrayPool._0_._elem._m_LocationList._Item._161_._phi._m_value "" VALUE 0xB0011448 __Float16_Value 0 NO_COMPU_METHOD -65504 65504 ECU_ADDRESS_EXTENSION 0x2 BYTE_ORDER MSB_LAST /end CHARACTERISTIC
/begin CHARACTERISTIC _g_PL_AD_fw_Radar_1R1V_rpc_LocBypassingRunnable_LocBypassingRunnable_m_pad_ensRLocationsPort_par_out_local.TChangeableMemPool._._._m_arrayPool._0_._elem._m_LocationList._Item._161_._phiQly "" VALUE 0xB001144B __UByte_Value 0 NO_COMPU_METHOD 0 255 ECU_ADDRESS_EXTENSION 0x2 BYTE_ORDER MSB_LAST /end CHARACTERISTIC
/begin CHARACTERISTIC _g_PL_AD_fw_Radar_1R1V_rpc_LocBypassingRunnable_LocBypassingRunnable_m_pad_ensRLocationsPort_par_out_local.TChangeableMemPool._._._m_arrayPool._0_._elem._m_LocationList._Item._161_._phiVar._m_value "" VALUE 0xB001144E __Float16_Value 0 NO_COMPU_METHOD -65504 65504 ECU_ADDRESS_EXTENSION 0x2 BYTE_ORDER MSB_LAST /end CHARACTERISTIC
/begin CHARACTERISTIC _g_PL_AD_fw_Radar_1R1V_rpc_LocBypassingRunnable_LocBypassingRunnable_m_pad_ensRLocationsPort_par_out_local.TChangeableMemPool._._._m_arrayPool._0_._elem._m_LocationList._Item._161_._theta._m_value "" VALUE 0xB0011446 __Float16_Value 0 NO_COMPU_METHOD -65504 65504 ECU_ADDRESS_EXTENSION 0x2 BYTE_ORDER MSB_LAST /end CHARACTERISTIC
/begin CHARACTERISTIC _g_PL_AD_fw_Radar_1R1V_rpc_LocBypassingRunnable_LocBypassingRunnable_m_pad_ensRLocationsPort_par_out_local.TChangeableMemPool._._._m_arrayPool._0_._elem._m_LocationList._Item._161_._thetaQly "" VALUE 0xB001144A __UByte_Value 0 NO_COMPU_METHOD 0 255 ECU_ADDRESS_EXTENSION 0x2 BYTE_ORDER MSB_LAST /end CHARACTERISTIC
/begin CHARACTERISTIC _g_PL_AD_fw_Radar_1R1V_rpc_LocBypassingRunnable_LocBypassingRunnable_m_pad_ensRLocationsPort_par_out_local.TChangeableMemPool._._._m_arrayPool._0_._elem._m_LocationList._Item._161_._thetaVar._m_value "" VALUE 0xB001144C __Float16_Value 0 NO_COMPU_METHOD -65504 65504 ECU_ADDRESS_EXTENSION 0x2 BYTE_ORDER MSB_LAST /end CHARACTERISTIC
/begin CHARACTERISTIC _g_PL_AD_fw_Radar_1R1V_rpc_LocBypassingRunnable_LocBypassingRunnable_m_pad_ensRLocationsPort_par_out_local.TChangeableMemPool._._._m_arrayPool._0_._elem._m_LocationList._Item._161_._v "" VALUE 0xB001143C __Float32_Value 0 NO_COMPU_METHOD -3.4028234663852886E+38 3.4028234663852886E+38 ECU_ADDRESS_EXTENSION 0x2 BYTE_ORDER MSB_LAST /end CHARACTERISTIC
/begin CHARACTERISTIC _g_PL_AD_fw_Radar_1R1V_rpc_LocBypassingRunnable_LocBypassingRunnable_m_pad_ensRLocationsPort_par_out_local.TChangeableMemPool._._._m_arrayPool._0_._elem._m_LocationList._Item._161_._vVar._m_value "" VALUE 0xB0011442 __Float16_Value 0 NO_COMPU_METHOD -65504 65504 ECU_ADDRESS_EXTENSION 0x2 BYTE_ORDER MSB_LAST /end CHARACTERISTIC
/begin CHARACTERISTIC _g_PL_AD_fw_Radar_1R1V_rpc_LocBypassingRunnable_LocBypassingRunnable_m_pad_ensRLocationsPort_par_out_local.TChangeableMemPool._._._m_arrayPool._0_._elem._m_LocationList._Item._162_._Rcs._m_value "" VALUE 0xB0011470 __Float16_Value 0 NO_COMPU_METHOD -65504 65504 ECU_ADDRESS_EXTENSION 0x2 BYTE_ORDER MSB_LAST /end CHARACTERISTIC
/begin CHARACTERISTIC _g_PL_AD_fw_Radar_1R1V_rpc_LocBypassingRunnable_LocBypassingRunnable_m_pad_ensRLocationsPort_par_out_local.TChangeableMemPool._._._m_arrayPool._0_._elem._m_LocationList._Item._162_._Rssi._m_value "" VALUE 0xB0011472 __Float16_Value 0 NO_COMPU_METHOD -65504 65504 ECU_ADDRESS_EXTENSION 0x2 BYTE_ORDER MSB_LAST /end CHARACTERISTIC
/begin CHARACTERISTIC _g_PL_AD_fw_Radar_1R1V_rpc_LocBypassingRunnable_LocBypassingRunnable_m_pad_ensRLocationsPort_par_out_local.TChangeableMemPool._._._m_arrayPool._0_._elem._m_LocationList._Item._162_._d "" VALUE 0xB0011458 __Float32_Value 0 NO_COMPU_METHOD -3.4028234663852886E+38 3.4028234663852886E+38 ECU_ADDRESS_EXTENSION 0x2 BYTE_ORDER MSB_LAST /end CHARACTERISTIC
/begin CHARACTERISTIC _g_PL_AD_fw_Radar_1R1V_rpc_LocBypassingRunnable_LocBypassingRunnable_m_pad_ensRLocationsPort_par_out_local.TChangeableMemPool._._._m_arrayPool._0_._elem._m_LocationList._Item._162_._dVar._m_value "" VALUE 0xB0011460 __Float16_Value 0 NO_COMPU_METHOD -65504 65504 ECU_ADDRESS_EXTENSION 0x2 BYTE_ORDER MSB_LAST /end CHARACTERISTIC
/begin CHARACTERISTIC _g_PL_AD_fw_Radar_1R1V_rpc_LocBypassingRunnable_LocBypassingRunnable_m_pad_ensRLocationsPort_par_out_local.TChangeableMemPool._._._m_arrayPool._0_._elem._m_LocationList._Item._162_._dvCov._m_value "" VALUE 0xB0011464 __Float16_Value 0 NO_COMPU_METHOD -65504 65504 ECU_ADDRESS_EXTENSION 0x2 BYTE_ORDER MSB_LAST /end CHARACTERISTIC
/begin CHARACTERISTIC _g_PL_AD_fw_Radar_1R1V_rpc_LocBypassingRunnable_LocBypassingRunnable_m_pad_ensRLocationsPort_par_out_local.TChangeableMemPool._._._m_arrayPool._0_._elem._m_LocationList._Item._162_._dvQly "" VALUE 0xB0011474 __UByte_Value 0 NO_COMPU_METHOD 0 255 ECU_ADDRESS_EXTENSION 0x2 BYTE_ORDER MSB_LAST /end CHARACTERISTIC
/begin CHARACTERISTIC _g_PL_AD_fw_Radar_1R1V_rpc_LocBypassingRunnable_LocBypassingRunnable_m_pad_ensRLocationsPort_par_out_local.TChangeableMemPool._._._m_arrayPool._0_._elem._m_LocationList._Item._162_._idxAzimuthAmbiguityPeer "" VALUE 0xB0011476 __UWord_Value 0 NO_COMPU_METHOD 0 65535 ECU_ADDRESS_EXTENSION 0x2 BYTE_ORDER MSB_LAST /end CHARACTERISTIC
/begin CHARACTERISTIC _g_PL_AD_fw_Radar_1R1V_rpc_LocBypassingRunnable_LocBypassingRunnable_m_pad_ensRLocationsPort_par_out_local.TChangeableMemPool._._._m_arrayPool._0_._elem._m_LocationList._Item._162_._measStatus "" VALUE 0xB0011475 __UByte_Value 0 NO_COMPU_METHOD 0 255 ECU_ADDRESS_EXTENSION 0x2 BYTE_ORDER MSB_LAST /end CHARACTERISTIC
/begin CHARACTERISTIC _g_PL_AD_fw_Radar_1R1V_rpc_LocBypassingRunnable_LocBypassingRunnable_m_pad_ensRLocationsPort_par_out_local.TChangeableMemPool._._._m_arrayPool._0_._elem._m_LocationList._Item._162_._phi._m_value "" VALUE 0xB0011468 __Float16_Value 0 NO_COMPU_METHOD -65504 65504 ECU_ADDRESS_EXTENSION 0x2 BYTE_ORDER MSB_LAST /end CHARACTERISTIC
/begin CHARACTERISTIC _g_PL_AD_fw_Radar_1R1V_rpc_LocBypassingRunnable_LocBypassingRunnable_m_pad_ensRLocationsPort_par_out_local.TChangeableMemPool._._._m_arrayPool._0_._elem._m_LocationList._Item._162_._phiQly "" VALUE 0xB001146B __UByte_Value 0 NO_COMPU_METHOD 0 255 ECU_ADDRESS_EXTENSION 0x2 BYTE_ORDER MSB_LAST /end CHARACTERISTIC
/begin CHARACTERISTIC _g_PL_AD_fw_Radar_1R1V_rpc_LocBypassingRunnable_LocBypassingRunnable_m_pad_ensRLocationsPort_par_out_local.TChangeableMemPool._._._m_arrayPool._0_._elem._m_LocationList._Item._162_._phiVar._m_value "" VALUE 0xB001146E __Float16_Value 0 NO_COMPU_METHOD -65504 65504 ECU_ADDRESS_EXTENSION 0x2 BYTE_ORDER MSB_LAST /end CHARACTERISTIC
/begin CHARACTERISTIC _g_PL_AD_fw_Radar_1R1V_rpc_LocBypassingRunnable_LocBypassingRunnable_m_pad_ensRLocationsPort_par_out_local.TChangeableMemPool._._._m_arrayPool._0_._elem._m_LocationList._Item._162_._theta._m_value "" VALUE 0xB0011466 __Float16_Value 0 NO_COMPU_METHOD -65504 65504 ECU_ADDRESS_EXTENSION 0x2 BYTE_ORDER MSB_LAST /end CHARACTERISTIC
/begin CHARACTERISTIC _g_PL_AD_fw_Radar_1R1V_rpc_LocBypassingRunnable_LocBypassingRunnable_m_pad_ensRLocationsPort_par_out_local.TChangeableMemPool._._._m_arrayPool._0_._elem._m_LocationList._Item._162_._thetaQly "" VALUE 0xB001146A __UByte_Value 0 NO_COMPU_METHOD 0 255 ECU_ADDRESS_EXTENSION 0x2 BYTE_ORDER MSB_LAST /end CHARACTERISTIC
/begin CHARACTERISTIC _g_PL_AD_fw_Radar_1R1V_rpc_LocBypassingRunnable_LocBypassingRunnable_m_pad_ensRLocationsPort_par_out_local.TChangeableMemPool._._._m_arrayPool._0_._elem._m_LocationList._Item._162_._thetaVar._m_value "" VALUE 0xB001146C __Float16_Value 0 NO_COMPU_METHOD -65504 65504 ECU_ADDRESS_EXTENSION 0x2 BYTE_ORDER MSB_LAST /end CHARACTERISTIC
/begin CHARACTERISTIC _g_PL_AD_fw_Radar_1R1V_rpc_LocBypassingRunnable_LocBypassingRunnable_m_pad_ensRLocationsPort_par_out_local.TChangeableMemPool._._._m_arrayPool._0_._elem._m_LocationList._Item._162_._v "" VALUE 0xB001145C __Float32_Value 0 NO_COMPU_METHOD -3.4028234663852886E+38 3.4028234663852886E+38 ECU_ADDRESS_EXTENSION 0x2 BYTE_ORDER MSB_LAST /end CHARACTERISTIC
/begin CHARACTERISTIC _g_PL_AD_fw_Radar_1R1V_rpc_LocBypassingRunnable_LocBypassingRunnable_m_pad_ensRLocationsPort_par_out_local.TChangeableMemPool._._._m_arrayPool._0_._elem._m_LocationList._Item._162_._vVar._m_value "" VALUE 0xB0011462 __Float16_Value 0 NO_COMPU_METHOD -65504 65504 ECU_ADDRESS_EXTENSION 0x2 BYTE_ORDER MSB_LAST /end CHARACTERISTIC
/begin CHARACTERISTIC _g_PL_AD_fw_Radar_1R1V_rpc_LocBypassingRunnable_LocBypassingRunnable_m_pad_ensRLocationsPort_par_out_local.TChangeableMemPool._._._m_arrayPool._0_._elem._m_LocationList._Item._163_._Rcs._m_value "" VALUE 0xB0011490 __Float16_Value 0 NO_COMPU_METHOD -65504 65504 ECU_ADDRESS_EXTENSION 0x2 BYTE_ORDER MSB_LAST /end CHARACTERISTIC
/begin CHARACTERISTIC _g_PL_AD_fw_Radar_1R1V_rpc_LocBypassingRunnable_LocBypassingRunnable_m_pad_ensRLocationsPort_par_out_local.TChangeableMemPool._._._m_arrayPool._0_._elem._m_LocationList._Item._163_._Rssi._m_value "" VALUE 0xB0011492 __Float16_Value 0 NO_COMPU_METHOD -65504 65504 ECU_ADDRESS_EXTENSION 0x2 BYTE_ORDER MSB_LAST /end CHARACTERISTIC
/begin CHARACTERISTIC _g_PL_AD_fw_Radar_1R1V_rpc_LocBypassingRunnable_LocBypassingRunnable_m_pad_ensRLocationsPort_par_out_local.TChangeableMemPool._._._m_arrayPool._0_._elem._m_LocationList._Item._163_._d "" VALUE 0xB0011478 __Float32_Value 0 NO_COMPU_METHOD -3.4028234663852886E+38 3.4028234663852886E+38 ECU_ADDRESS_EXTENSION 0x2 BYTE_ORDER MSB_LAST /end CHARACTERISTIC
/begin CHARACTERISTIC _g_PL_AD_fw_Radar_1R1V_rpc_LocBypassingRunnable_LocBypassingRunnable_m_pad_ensRLocationsPort_par_out_local.TChangeableMemPool._._._m_arrayPool._0_._elem._m_LocationList._Item._163_._dVar._m_value "" VALUE 0xB0011480 __Float16_Value 0 NO_COMPU_METHOD -65504 65504 ECU_ADDRESS_EXTENSION 0x2 BYTE_ORDER MSB_LAST /end CHARACTERISTIC
/begin CHARACTERISTIC _g_PL_AD_fw_Radar_1R1V_rpc_LocBypassingRunnable_LocBypassingRunnable_m_pad_ensRLocationsPort_par_out_local.TChangeableMemPool._._._m_arrayPool._0_._elem._m_LocationList._Item._163_._dvCov._m_value "" VALUE 0xB0011484 __Float16_Value 0 NO_COMPU_METHOD -65504 65504 ECU_ADDRESS_EXTENSION 0x2 BYTE_ORDER MSB_LAST /end CHARACTERISTIC
/begin CHARACTERISTIC _g_PL_AD_fw_Radar_1R1V_rpc_LocBypassingRunnable_LocBypassingRunnable_m_pad_ensRLocationsPort_par_out_local.TChangeableMemPool._._._m_arrayPool._0_._elem._m_LocationList._Item._163_._dvQly "" VALUE 0xB0011494 __UByte_Value 0 NO_COMPU_METHOD 0 255 ECU_ADDRESS_EXTENSION 0x2 BYTE_ORDER MSB_LAST /end CHARACTERISTIC
/begin CHARACTERISTIC _g_PL_AD_fw_Radar_1R1V_rpc_LocBypassingRunnable_LocBypassingRunnable_m_pad_ensRLocationsPort_par_out_local.TChangeableMemPool._._._m_arrayPool._0_._elem._m_LocationList._Item._163_._idxAzimuthAmbiguityPeer "" VALUE 0xB0011496 __UWord_Value 0 NO_COMPU_METHOD 0 65535 ECU_ADDRESS_EXTENSION 0x2 BYTE_ORDER MSB_LAST /end CHARACTERISTIC
/begin CHARACTERISTIC _g_PL_AD_fw_Radar_1R1V_rpc_LocBypassingRunnable_LocBypassingRunnable_m_pad_ensRLocationsPort_par_out_local.TChangeableMemPool._._._m_arrayPool._0_._elem._m_LocationList._Item._163_._measStatus "" VALUE 0xB0011495 __UByte_Value 0 NO_COMPU_METHOD 0 255 ECU_ADDRESS_EXTENSION 0x2 BYTE_ORDER MSB_LAST /end CHARACTERISTIC
/begin CHARACTERISTIC _g_PL_AD_fw_Radar_1R1V_rpc_LocBypassingRunnable_LocBypassingRunnable_m_pad_ensRLocationsPort_par_out_local.TChangeableMemPool._._._m_arrayPool._0_._elem._m_LocationList._Item._163_._phi._m_value "" VALUE 0xB0011488 __Float16_Value 0 NO_COMPU_METHOD -65504 65504 ECU_ADDRESS_EXTENSION 0x2 BYTE_ORDER MSB_LAST /end CHARACTERISTIC
/begin CHARACTERISTIC _g_PL_AD_fw_Radar_1R1V_rpc_LocBypassingRunnable_LocBypassingRunnable_m_pad_ensRLocationsPort_par_out_local.TChangeableMemPool._._._m_arrayPool._0_._elem._m_LocationList._Item._163_._phiQly "" VALUE 0xB001148B __UByte_Value 0 NO_COMPU_METHOD 0 255 ECU_ADDRESS_EXTENSION 0x2 BYTE_ORDER MSB_LAST /end CHARACTERISTIC
/begin CHARACTERISTIC _g_PL_AD_fw_Radar_1R1V_rpc_LocBypassingRunnable_LocBypassingRunnable_m_pad_ensRLocationsPort_par_out_local.TChangeableMemPool._._._m_arrayPool._0_._elem._m_LocationList._Item._163_._phiVar._m_value "" VALUE 0xB001148E __Float16_Value 0 NO_COMPU_METHOD -65504 65504 ECU_ADDRESS_EXTENSION 0x2 BYTE_ORDER MSB_LAST /end CHARACTERISTIC
/begin CHARACTERISTIC _g_PL_AD_fw_Radar_1R1V_rpc_LocBypassingRunnable_LocBypassingRunnable_m_pad_ensRLocationsPort_par_out_local.TChangeableMemPool._._._m_arrayPool._0_._elem._m_LocationList._Item._163_._theta._m_value "" VALUE 0xB0011486 __Float16_Value 0 NO_COMPU_METHOD -65504 65504 ECU_ADDRESS_EXTENSION 0x2 BYTE_ORDER MSB_LAST /end CHARACTERISTIC
/begin CHARACTERISTIC _g_PL_AD_fw_Radar_1R1V_rpc_LocBypassingRunnable_LocBypassingRunnable_m_pad_ensRLocationsPort_par_out_local.TChangeableMemPool._._._m_arrayPool._0_._elem._m_LocationList._Item._163_._thetaQly "" VALUE 0xB001148A __UByte_Value 0 NO_COMPU_METHOD 0 255 ECU_ADDRESS_EXTENSION 0x2 BYTE_ORDER MSB_LAST /end CHARACTERISTIC
/begin CHARACTERISTIC _g_PL_AD_fw_Radar_1R1V_rpc_LocBypassingRunnable_LocBypassingRunnable_m_pad_ensRLocationsPort_par_out_local.TChangeableMemPool._._._m_arrayPool._0_._elem._m_LocationList._Item._163_._thetaVar._m_value "" VALUE 0xB001148C __Float16_Value 0 NO_COMPU_METHOD -65504 65504 ECU_ADDRESS_EXTENSION 0x2 BYTE_ORDER MSB_LAST /end CHARACTERISTIC
/begin CHARACTERISTIC _g_PL_AD_fw_Radar_1R1V_rpc_LocBypassingRunnable_LocBypassingRunnable_m_pad_ensRLocationsPort_par_out_local.TChangeableMemPool._._._m_arrayPool._0_._elem._m_LocationList._Item._163_._v "" VALUE 0xB001147C __Float32_Value 0 NO_COMPU_METHOD -3.4028234663852886E+38 3.4028234663852886E+38 ECU_ADDRESS_EXTENSION 0x2 BYTE_ORDER MSB_LAST /end CHARACTERISTIC
/begin CHARACTERISTIC _g_PL_AD_fw_Radar_1R1V_rpc_LocBypassingRunnable_LocBypassingRunnable_m_pad_ensRLocationsPort_par_out_local.TChangeableMemPool._._._m_arrayPool._0_._elem._m_LocationList._Item._163_._vVar._m_value "" VALUE 0xB0011482 __Float16_Value 0 NO_COMPU_METHOD -65504 65504 ECU_ADDRESS_EXTENSION 0x2 BYTE_ORDER MSB_LAST /end CHARACTERISTIC
/begin CHARACTERISTIC _g_PL_AD_fw_Radar_1R1V_rpc_LocBypassingRunnable_LocBypassingRunnable_m_pad_ensRLocationsPort_par_out_local.TChangeableMemPool._._._m_arrayPool._0_._elem._m_LocationList._Item._164_._Rcs._m_value "" VALUE 0xB00114B0 __Float16_Value 0 NO_COMPU_METHOD -65504 65504 ECU_ADDRESS_EXTENSION 0x2 BYTE_ORDER MSB_LAST /end CHARACTERISTIC
/begin CHARACTERISTIC _g_PL_AD_fw_Radar_1R1V_rpc_LocBypassingRunnable_LocBypassingRunnable_m_pad_ensRLocationsPort_par_out_local.TChangeableMemPool._._._m_arrayPool._0_._elem._m_LocationList._Item._164_._Rssi._m_value "" VALUE 0xB00114B2 __Float16_Value 0 NO_COMPU_METHOD -65504 65504 ECU_ADDRESS_EXTENSION 0x2 BYTE_ORDER MSB_LAST /end CHARACTERISTIC
/begin CHARACTERISTIC _g_PL_AD_fw_Radar_1R1V_rpc_LocBypassingRunnable_LocBypassingRunnable_m_pad_ensRLocationsPort_par_out_local.TChangeableMemPool._._._m_arrayPool._0_._elem._m_LocationList._Item._164_._d "" VALUE 0xB0011498 __Float32_Value 0 NO_COMPU_METHOD -3.4028234663852886E+38 3.4028234663852886E+38 ECU_ADDRESS_EXTENSION 0x2 BYTE_ORDER MSB_LAST /end CHARACTERISTIC
/begin CHARACTERISTIC _g_PL_AD_fw_Radar_1R1V_rpc_LocBypassingRunnable_LocBypassingRunnable_m_pad_ensRLocationsPort_par_out_local.TChangeableMemPool._._._m_arrayPool._0_._elem._m_LocationList._Item._164_._dVar._m_value "" VALUE 0xB00114A0 __Float16_Value 0 NO_COMPU_METHOD -65504 65504 ECU_ADDRESS_EXTENSION 0x2 BYTE_ORDER MSB_LAST /end CHARACTERISTIC
/begin CHARACTERISTIC _g_PL_AD_fw_Radar_1R1V_rpc_LocBypassingRunnable_LocBypassingRunnable_m_pad_ensRLocationsPort_par_out_local.TChangeableMemPool._._._m_arrayPool._0_._elem._m_LocationList._Item._164_._dvCov._m_value "" VALUE 0xB00114A4 __Float16_Value 0 NO_COMPU_METHOD -65504 65504 ECU_ADDRESS_EXTENSION 0x2 BYTE_ORDER MSB_LAST /end CHARACTERISTIC
/begin CHARACTERISTIC _g_PL_AD_fw_Radar_1R1V_rpc_LocBypassingRunnable_LocBypassingRunnable_m_pad_ensRLocationsPort_par_out_local.TChangeableMemPool._._._m_arrayPool._0_._elem._m_LocationList._Item._164_._dvQly "" VALUE 0xB00114B4 __UByte_Value 0 NO_COMPU_METHOD 0 255 ECU_ADDRESS_EXTENSION 0x2 BYTE_ORDER MSB_LAST /end CHARACTERISTIC
/begin CHARACTERISTIC _g_PL_AD_fw_Radar_1R1V_rpc_LocBypassingRunnable_LocBypassingRunnable_m_pad_ensRLocationsPort_par_out_local.TChangeableMemPool._._._m_arrayPool._0_._elem._m_LocationList._Item._164_._idxAzimuthAmbiguityPeer "" VALUE 0xB00114B6 __UWord_Value 0 NO_COMPU_METHOD 0 65535 ECU_ADDRESS_EXTENSION 0x2 BYTE_ORDER MSB_LAST /end CHARACTERISTIC
/begin CHARACTERISTIC _g_PL_AD_fw_Radar_1R1V_rpc_LocBypassingRunnable_LocBypassingRunnable_m_pad_ensRLocationsPort_par_out_local.TChangeableMemPool._._._m_arrayPool._0_._elem._m_LocationList._Item._164_._measStatus "" VALUE 0xB00114B5 __UByte_Value 0 NO_COMPU_METHOD 0 255 ECU_ADDRESS_EXTENSION 0x2 BYTE_ORDER MSB_LAST /end CHARACTERISTIC
/begin CHARACTERISTIC _g_PL_AD_fw_Radar_1R1V_rpc_LocBypassingRunnable_LocBypassingRunnable_m_pad_ensRLocationsPort_par_out_local.TChangeableMemPool._._._m_arrayPool._0_._elem._m_LocationList._Item._164_._phi._m_value "" VALUE 0xB00114A8 __Float16_Value 0 NO_COMPU_METHOD -65504 65504 ECU_ADDRESS_EXTENSION 0x2 BYTE_ORDER MSB_LAST /end CHARACTERISTIC
/begin CHARACTERISTIC _g_PL_AD_fw_Radar_1R1V_rpc_LocBypassingRunnable_LocBypassingRunnable_m_pad_ensRLocationsPort_par_out_local.TChangeableMemPool._._._m_arrayPool._0_._elem._m_LocationList._Item._164_._phiQly "" VALUE 0xB00114AB __UByte_Value 0 NO_COMPU_METHOD 0 255 ECU_ADDRESS_EXTENSION 0x2 BYTE_ORDER MSB_LAST /end CHARACTERISTIC
/begin CHARACTERISTIC _g_PL_AD_fw_Radar_1R1V_rpc_LocBypassingRunnable_LocBypassingRunnable_m_pad_ensRLocationsPort_par_out_local.TChangeableMemPool._._._m_arrayPool._0_._elem._m_LocationList._Item._164_._phiVar._m_value "" VALUE 0xB00114AE __Float16_Value 0 NO_COMPU_METHOD -65504 65504 ECU_ADDRESS_EXTENSION 0x2 BYTE_ORDER MSB_LAST /end CHARACTERISTIC
/begin CHARACTERISTIC _g_PL_AD_fw_Radar_1R1V_rpc_LocBypassingRunnable_LocBypassingRunnable_m_pad_ensRLocationsPort_par_out_local.TChangeableMemPool._._._m_arrayPool._0_._elem._m_LocationList._Item._164_._theta._m_value "" VALUE 0xB00114A6 __Float16_Value 0 NO_COMPU_METHOD -65504 65504 ECU_ADDRESS_EXTENSION 0x2 BYTE_ORDER MSB_LAST /end CHARACTERISTIC
/begin CHARACTERISTIC _g_PL_AD_fw_Radar_1R1V_rpc_LocBypassingRunnable_LocBypassingRunnable_m_pad_ensRLocationsPort_par_out_local.TChangeableMemPool._._._m_arrayPool._0_._elem._m_LocationList._Item._164_._thetaQly "" VALUE 0xB00114AA __UByte_Value 0 NO_COMPU_METHOD 0 255 ECU_ADDRESS_EXTENSION 0x2 BYTE_ORDER MSB_LAST /end CHARACTERISTIC
/begin CHARACTERISTIC _g_PL_AD_fw_Radar_1R1V_rpc_LocBypassingRunnable_LocBypassingRunnable_m_pad_ensRLocationsPort_par_out_local.TChangeableMemPool._._._m_arrayPool._0_._elem._m_LocationList._Item._164_._thetaVar._m_value "" VALUE 0xB00114AC __Float16_Value 0 NO_COMPU_METHOD -65504 65504 ECU_ADDRESS_EXTENSION 0x2 BYTE_ORDER MSB_LAST /end CHARACTERISTIC
/begin CHARACTERISTIC _g_PL_AD_fw_Radar_1R1V_rpc_LocBypassingRunnable_LocBypassingRunnable_m_pad_ensRLocationsPort_par_out_local.TChangeableMemPool._._._m_arrayPool._0_._elem._m_LocationList._Item._164_._v "" VALUE 0xB001149C __Float32_Value 0 NO_COMPU_METHOD -3.4028234663852886E+38 3.4028234663852886E+38 ECU_ADDRESS_EXTENSION 0x2 BYTE_ORDER MSB_LAST /end CHARACTERISTIC
/begin CHARACTERISTIC _g_PL_AD_fw_Radar_1R1V_rpc_LocBypassingRunnable_LocBypassingRunnable_m_pad_ensRLocationsPort_par_out_local.TChangeableMemPool._._._m_arrayPool._0_._elem._m_LocationList._Item._164_._vVar._m_value "" VALUE 0xB00114A2 __Float16_Value 0 NO_COMPU_METHOD -65504 65504 ECU_ADDRESS_EXTENSION 0x2 BYTE_ORDER MSB_LAST /end CHARACTERISTIC
/begin CHARACTERISTIC _g_PL_AD_fw_Radar_1R1V_rpc_LocBypassingRunnable_LocBypassingRunnable_m_pad_ensRLocationsPort_par_out_local.TChangeableMemPool._._._m_arrayPool._0_._elem._m_LocationList._Item._165_._Rcs._m_value "" VALUE 0xB00114D0 __Float16_Value 0 NO_COMPU_METHOD -65504 65504 ECU_ADDRESS_EXTENSION 0x2 BYTE_ORDER MSB_LAST /end CHARACTERISTIC
/begin CHARACTERISTIC _g_PL_AD_fw_Radar_1R1V_rpc_LocBypassingRunnable_LocBypassingRunnable_m_pad_ensRLocationsPort_par_out_local.TChangeableMemPool._._._m_arrayPool._0_._elem._m_LocationList._Item._165_._Rssi._m_value "" VALUE 0xB00114D2 __Float16_Value 0 NO_COMPU_METHOD -65504 65504 ECU_ADDRESS_EXTENSION 0x2 BYTE_ORDER MSB_LAST /end CHARACTERISTIC
/begin CHARACTERISTIC _g_PL_AD_fw_Radar_1R1V_rpc_LocBypassingRunnable_LocBypassingRunnable_m_pad_ensRLocationsPort_par_out_local.TChangeableMemPool._._._m_arrayPool._0_._elem._m_LocationList._Item._165_._d "" VALUE 0xB00114B8 __Float32_Value 0 NO_COMPU_METHOD -3.4028234663852886E+38 3.4028234663852886E+38 ECU_ADDRESS_EXTENSION 0x2 BYTE_ORDER MSB_LAST /end CHARACTERISTIC
/begin CHARACTERISTIC _g_PL_AD_fw_Radar_1R1V_rpc_LocBypassingRunnable_LocBypassingRunnable_m_pad_ensRLocationsPort_par_out_local.TChangeableMemPool._._._m_arrayPool._0_._elem._m_LocationList._Item._165_._dVar._m_value "" VALUE 0xB00114C0 __Float16_Value 0 NO_COMPU_METHOD -65504 65504 ECU_ADDRESS_EXTENSION 0x2 BYTE_ORDER MSB_LAST /end CHARACTERISTIC
/begin CHARACTERISTIC _g_PL_AD_fw_Radar_1R1V_rpc_LocBypassingRunnable_LocBypassingRunnable_m_pad_ensRLocationsPort_par_out_local.TChangeableMemPool._._._m_arrayPool._0_._elem._m_LocationList._Item._165_._dvCov._m_value "" VALUE 0xB00114C4 __Float16_Value 0 NO_COMPU_METHOD -65504 65504 ECU_ADDRESS_EXTENSION 0x2 BYTE_ORDER MSB_LAST /end CHARACTERISTIC
/begin CHARACTERISTIC _g_PL_AD_fw_Radar_1R1V_rpc_LocBypassingRunnable_LocBypassingRunnable_m_pad_ensRLocationsPort_par_out_local.TChangeableMemPool._._._m_arrayPool._0_._elem._m_LocationList._Item._165_._dvQly "" VALUE 0xB00114D4 __UByte_Value 0 NO_COMPU_METHOD 0 255 ECU_ADDRESS_EXTENSION 0x2 BYTE_ORDER MSB_LAST /end CHARACTERISTIC
/begin CHARACTERISTIC _g_PL_AD_fw_Radar_1R1V_rpc_LocBypassingRunnable_LocBypassingRunnable_m_pad_ensRLocationsPort_par_out_local.TChangeableMemPool._._._m_arrayPool._0_._elem._m_LocationList._Item._165_._idxAzimuthAmbiguityPeer "" VALUE 0xB00114D6 __UWord_Value 0 NO_COMPU_METHOD 0 65535 ECU_ADDRESS_EXTENSION 0x2 BYTE_ORDER MSB_LAST /end CHARACTERISTIC
/begin CHARACTERISTIC _g_PL_AD_fw_Radar_1R1V_rpc_LocBypassingRunnable_LocBypassingRunnable_m_pad_ensRLocationsPort_par_out_local.TChangeableMemPool._._._m_arrayPool._0_._elem._m_LocationList._Item._165_._measStatus "" VALUE 0xB00114D5 __UByte_Value 0 NO_COMPU_METHOD 0 255 ECU_ADDRESS_EXTENSION 0x2 BYTE_ORDER MSB_LAST /end CHARACTERISTIC
/begin CHARACTERISTIC _g_PL_AD_fw_Radar_1R1V_rpc_LocBypassingRunnable_LocBypassingRunnable_m_pad_ensRLocationsPort_par_out_local.TChangeableMemPool._._._m_arrayPool._0_._elem._m_LocationList._Item._165_._phi._m_value "" VALUE 0xB00114C8 __Float16_Value 0 NO_COMPU_METHOD -65504 65504 ECU_ADDRESS_EXTENSION 0x2 BYTE_ORDER MSB_LAST /end CHARACTERISTIC
/begin CHARACTERISTIC _g_PL_AD_fw_Radar_1R1V_rpc_LocBypassingRunnable_LocBypassingRunnable_m_pad_ensRLocationsPort_par_out_local.TChangeableMemPool._._._m_arrayPool._0_._elem._m_LocationList._Item._165_._phiQly "" VALUE 0xB00114CB __UByte_Value 0 NO_COMPU_METHOD 0 255 ECU_ADDRESS_EXTENSION 0x2 BYTE_ORDER MSB_LAST /end CHARACTERISTIC
/begin CHARACTERISTIC _g_PL_AD_fw_Radar_1R1V_rpc_LocBypassingRunnable_LocBypassingRunnable_m_pad_ensRLocationsPort_par_out_local.TChangeableMemPool._._._m_arrayPool._0_._elem._m_LocationList._Item._165_._phiVar._m_value "" VALUE 0xB00114CE __Float16_Value 0 NO_COMPU_METHOD -65504 65504 ECU_ADDRESS_EXTENSION 0x2 BYTE_ORDER MSB_LAST /end CHARACTERISTIC
/begin CHARACTERISTIC _g_PL_AD_fw_Radar_1R1V_rpc_LocBypassingRunnable_LocBypassingRunnable_m_pad_ensRLocationsPort_par_out_local.TChangeableMemPool._._._m_arrayPool._0_._elem._m_LocationList._Item._165_._theta._m_value "" VALUE 0xB00114C6 __Float16_Value 0 NO_COMPU_METHOD -65504 65504 ECU_ADDRESS_EXTENSION 0x2 BYTE_ORDER MSB_LAST /end CHARACTERISTIC
/begin CHARACTERISTIC _g_PL_AD_fw_Radar_1R1V_rpc_LocBypassingRunnable_LocBypassingRunnable_m_pad_ensRLocationsPort_par_out_local.TChangeableMemPool._._._m_arrayPool._0_._elem._m_LocationList._Item._165_._thetaQly "" VALUE 0xB00114CA __UByte_Value 0 NO_COMPU_METHOD 0 255 ECU_ADDRESS_EXTENSION 0x2 BYTE_ORDER MSB_LAST /end CHARACTERISTIC
/begin CHARACTERISTIC _g_PL_AD_fw_Radar_1R1V_rpc_LocBypassingRunnable_LocBypassingRunnable_m_pad_ensRLocationsPort_par_out_local.TChangeableMemPool._._._m_arrayPool._0_._elem._m_LocationList._Item._165_._thetaVar._m_value "" VALUE 0xB00114CC __Float16_Value 0 NO_COMPU_METHOD -65504 65504 ECU_ADDRESS_EXTENSION 0x2 BYTE_ORDER MSB_LAST /end CHARACTERISTIC
/begin CHARACTERISTIC _g_PL_AD_fw_Radar_1R1V_rpc_LocBypassingRunnable_LocBypassingRunnable_m_pad_ensRLocationsPort_par_out_local.TChangeableMemPool._._._m_arrayPool._0_._elem._m_LocationList._Item._165_._v "" VALUE 0xB00114BC __Float32_Value 0 NO_COMPU_METHOD -3.4028234663852886E+38 3.4028234663852886E+38 ECU_ADDRESS_EXTENSION 0x2 BYTE_ORDER MSB_LAST /end CHARACTERISTIC
/begin CHARACTERISTIC _g_PL_AD_fw_Radar_1R1V_rpc_LocBypassingRunnable_LocBypassingRunnable_m_pad_ensRLocationsPort_par_out_local.TChangeableMemPool._._._m_arrayPool._0_._elem._m_LocationList._Item._165_._vVar._m_value "" VALUE 0xB00114C2 __Float16_Value 0 NO_COMPU_METHOD -65504 65504 ECU_ADDRESS_EXTENSION 0x2 BYTE_ORDER MSB_LAST /end CHARACTERISTIC
/begin CHARACTERISTIC _g_PL_AD_fw_Radar_1R1V_rpc_LocBypassingRunnable_LocBypassingRunnable_m_pad_ensRLocationsPort_par_out_local.TChangeableMemPool._._._m_arrayPool._0_._elem._m_LocationList._Item._166_._Rcs._m_value "" VALUE 0xB00114F0 __Float16_Value 0 NO_COMPU_METHOD -65504 65504 ECU_ADDRESS_EXTENSION 0x2 BYTE_ORDER MSB_LAST /end CHARACTERISTIC
/begin CHARACTERISTIC _g_PL_AD_fw_Radar_1R1V_rpc_LocBypassingRunnable_LocBypassingRunnable_m_pad_ensRLocationsPort_par_out_local.TChangeableMemPool._._._m_arrayPool._0_._elem._m_LocationList._Item._166_._Rssi._m_value "" VALUE 0xB00114F2 __Float16_Value 0 NO_COMPU_METHOD -65504 65504 ECU_ADDRESS_EXTENSION 0x2 BYTE_ORDER MSB_LAST /end CHARACTERISTIC
/begin CHARACTERISTIC _g_PL_AD_fw_Radar_1R1V_rpc_LocBypassingRunnable_LocBypassingRunnable_m_pad_ensRLocationsPort_par_out_local.TChangeableMemPool._._._m_arrayPool._0_._elem._m_LocationList._Item._166_._d "" VALUE 0xB00114D8 __Float32_Value 0 NO_COMPU_METHOD -3.4028234663852886E+38 3.4028234663852886E+38 ECU_ADDRESS_EXTENSION 0x2 BYTE_ORDER MSB_LAST /end CHARACTERISTIC
/begin CHARACTERISTIC _g_PL_AD_fw_Radar_1R1V_rpc_LocBypassingRunnable_LocBypassingRunnable_m_pad_ensRLocationsPort_par_out_local.TChangeableMemPool._._._m_arrayPool._0_._elem._m_LocationList._Item._166_._dVar._m_value "" VALUE 0xB00114E0 __Float16_Value 0 NO_COMPU_METHOD -65504 65504 ECU_ADDRESS_EXTENSION 0x2 BYTE_ORDER MSB_LAST /end CHARACTERISTIC
/begin CHARACTERISTIC _g_PL_AD_fw_Radar_1R1V_rpc_LocBypassingRunnable_LocBypassingRunnable_m_pad_ensRLocationsPort_par_out_local.TChangeableMemPool._._._m_arrayPool._0_._elem._m_LocationList._Item._166_._dvCov._m_value "" VALUE 0xB00114E4 __Float16_Value 0 NO_COMPU_METHOD -65504 65504 ECU_ADDRESS_EXTENSION 0x2 BYTE_ORDER MSB_LAST /end CHARACTERISTIC
/begin CHARACTERISTIC _g_PL_AD_fw_Radar_1R1V_rpc_LocBypassingRunnable_LocBypassingRunnable_m_pad_ensRLocationsPort_par_out_local.TChangeableMemPool._._._m_arrayPool._0_._elem._m_LocationList._Item._166_._dvQly "" VALUE 0xB00114F4 __UByte_Value 0 NO_COMPU_METHOD 0 255 ECU_ADDRESS_EXTENSION 0x2 BYTE_ORDER MSB_LAST /end CHARACTERISTIC
/begin COMPU_METHOD OosIds "enumeration table" TAB_VERB "%.0" "" COMPU_TAB_REF OosIds /end COMPU_METHOD
/begin COMPU_METHOD OoseqStrategy "enumeration table" TAB_VERB "%.0" "" COMPU_TAB_REF OoseqStrategy /end COMPU_METHOD
/begin COMPU_METHOD OoseqStrategy_Copy1 "enumeration table" TAB_VERB "%.0" "" COMPU_TAB_REF OoseqStrategy_Copy1 /end COMPU_METHOD
/begin COMPU_METHOD Os_ScheduleTableStatusType "enumeration table" TAB_VERB "%.0" "" COMPU_TAB_REF Os_ScheduleTableStatusType /end COMPU_METHOD
/begin COMPU_METHOD PER_ALGOS_MBF_TYPES "enumeration table" TAB_VERB "%.0" "" COMPU_TAB_REF PER_ALGOS_MBF_TYPES /end COMPU_METHOD
/begin COMPU_METHOD PER_ALGOS_MBF_TYPES_Copy1 "enumeration table" TAB_VERB "%.0" "" COMPU_TAB_REF PER_ALGOS_MBF_TYPES_Copy1 /end COMPU_METHOD
/begin COMPU_METHOD PER_ALGOS_MBF_TYPES_Copy99 "enumeration table" TAB_VERB "%.0" "" COMPU_TAB_REF PER_ALGOS_MBF_TYPES_Copy99 /end COMPU_METHOD
/begin COMPU_METHOD PER_ASIL_LEVELS "enumeration table" TAB_VERB "%.0" "" COMPU_TAB_REF PER_ASIL_LEVELS /end COMPU_METHOD
/begin COMPU_METHOD PER_PER_TYPES "enumeration table" TAB_VERB "%.0" "" COMPU_TAB_REF PER_PER_TYPES /end COMPU_METHOD
/begin COMPU_METHOD PER_RAW_FEATURES "enumeration table" TAB_VERB "%.0" "" COMPU_TAB_REF PER_RAW_FEATURES /end COMPU_METHOD
/begin COMPU_METHOD PER_REFERENCE_POINTS "enumeration table" TAB_VERB "%.0" "" COMPU_TAB_REF PER_REFERENCE_POINTS /end COMPU_METHOD
/begin COMPU_METHOD PER_REFERENCE_POINTS.OLD_Copy1 "enumeration table" TAB_VERB "%.0" "" COMPU_TAB_REF PER_REFERENCE_POINTS.OLD_1 /end COMPU_METHOD
/begin COMPU_METHOD PER_REFERENCE_POINTS_Copy1 "enumeration table" TAB_VERB "%.0" "" COMPU_TAB_REF PER_REFERENCE_POINTS_Copy1 /end COMPU_METHOD
/begin COMPU_METHOD PER_REFERENCE_POINTS_Copy2 "enumeration table" TAB_VERB "%.0" "" COMPU_TAB_REF PER_REFERENCE_POINTS_Copy2 /end COMPU_METHOD
/begin COMPU_METHOD PER_SENSOR_TYPES "enumeration table" TAB_VERB "%.0" "" COMPU_TAB_REF PER_SENSOR_TYPES /end COMPU_METHOD
/begin COMPU_METHOD PER_SENSOR_TYPES_Copy1 "enumeration table" TAB_VERB "%.0" "" COMPU_TAB_REF PER_SENSOR_TYPES_Copy1 /end COMPU_METHOD
/begin COMPU_METHOD PortStates "enumeration table" TAB_VERB "%.0" "" COMPU_TAB_REF PortStates /end COMPU_METHOD
/begin COMPU_METHOD Pre_NoCom_No_PN_Substates_Enum "enumeration table" TAB_VERB "%.0" "" COMPU_TAB_REF Pre_NoCom_No_PN_Substates_Enum /end COMPU_METHOD
/begin COMPU_METHOD PswRequestType "enumeration table" TAB_VERB "%.0" "" COMPU_TAB_REF PswRequestType /end COMPU_METHOD
/begin COMPU_METHOD RIF_STATUS "enumeration table" TAB_VERB "%.0" "" COMPU_TAB_REF RIF_STATUS /end COMPU_METHOD
/begin COMPU_METHOD RIF_STATUS.OLD_Copy1 "enumeration table" TAB_VERB "%.0" "" COMPU_TAB_REF RIF_STATUS.OLD_1 /end COMPU_METHOD
/begin COMPU_METHOD RIF_STATUS_Copy1 "enumeration table" TAB_VERB "%.0" "" COMPU_TAB_REF RIF_STATUS_Copy1 /end COMPU_METHOD
/begin COMPU_METHOD RPType.OLD_Copy1 "enumeration table" TAB_VERB "%.0" "" COMPU_TAB_REF RPType.OLD_1 /end COMPU_METHOD
/begin COMPU_METHOD ReactionPatternType "enumeration table" TAB_VERB "%.0" "" COMPU_TAB_REF ReactionPatternType /end COMPU_METHOD
/begin COMPU_METHOD ReceiverPortStates "enumeration table" TAB_VERB "%.0" "" COMPU_TAB_REF ReceiverPortStates /end COMPU_METHOD
/begin COMPU_METHOD RifNumChanType "enumeration table" TAB_VERB "%.0" "" COMPU_TAB_REF RifNumChanType /end COMPU_METHOD
/begin COMPU_METHOD RightOfWay "enumeration table" TAB_VERB "%.0" "" COMPU_TAB_REF RightOfWay /end COMPU_METHOD
/begin COMPU_METHOD RoadSignType "enumeration table" TAB_VERB "%.0" "" COMPU_TAB_REF RoadSignType /end COMPU_METHOD
/begin COMPU_METHOD RoadSignType.OLD_Copy1 "enumeration table" TAB_VERB "%.0" "" COMPU_TAB_REF RoadSignType.OLD_1 /end COMPU_METHOD
/begin COMPU_METHOD RoadSignType_Copy1 "enumeration table" TAB_VERB "%.0" "" COMPU_TAB_REF RoadSignType_Copy1 /end COMPU_METHOD
/begin COMPU_METHOD SC_USGuete "" LINEAR "%8.8" "" COEFFS_LINEAR 0.00390625 0 /end COMPU_METHOD
/begin COMPU_METHOD SC_USRadius "" LINEAR "%10.7" "" COEFFS_LINEAR 0.0078125 0 /end COMPU_METHOD
/begin COMPU_METHOD SC_US_w_Free "" LINEAR "%16.15" "" COEFFS_LINEAR 3.0517578125E-05 0 /end COMPU_METHOD
/begin COMPU_METHOD SC_dx "" LINEAR "%13.12" "" COEFFS_LINEAR 0.000244140625 0 /end COMPU_METHOD
/begin COMPU_METHOD SC_i16_Geschwindigkeit "" LINEAR "%11.8" "" COEFFS_LINEAR 0.00390625 0 /end COMPU_METHOD
/begin COMPU_METHOD SC_i16_Rotationsfaktor "" LINEAR "%15.14" "" COEFFS_LINEAR 6.103515625E-05 0 /end COMPU_METHOD
/begin COMPU_METHOD SPU_Status_t "enumeration table" TAB_VERB "%.0" "" COMPU_TAB_REF SPU_Status_t /end COMPU_METHOD
/begin COMPU_METHOD SPU_Status_t.OLD_Copy1 "enumeration table" TAB_VERB "%.0" "" COMPU_TAB_REF SPU_Status_t.OLD_1 /end COMPU_METHOD
/begin COMPU_METHOD SPU_Status_t.OLD_Copy2 "enumeration table" TAB_VERB "%.0" "" COMPU_TAB_REF SPU_Status_t.OLD_2 /end COMPU_METHOD
/begin COMPU_METHOD SPU_Status_t_Copy1 "enumeration table" TAB_VERB "%.0" "" COMPU_TAB_REF SPU_Status_t_Copy1 /end COMPU_METHOD
/begin COMPU_METHOD SPU_Status_t_Copy2 "enumeration table" TAB_VERB "%.0" "" COMPU_TAB_REF SPU_Status_t_Copy2 /end COMPU_METHOD
/begin COMPU_METHOD SPU_Status_t_Copy3 "enumeration table" TAB_VERB "%.0" "" COMPU_TAB_REF SPU_Status_t_Copy3 /end COMPU_METHOD
/begin COMPU_METHOD SSCState "enumeration table" TAB_VERB "%.0" "" COMPU_TAB_REF SSCState /end COMPU_METHOD
/begin COMPU_METHOD SeqIntDef "enumeration table" TAB_VERB "%.0" "" COMPU_TAB_REF SeqIntDef /end COMPU_METHOD
/begin COMPU_METHOD ServiceId "enumeration table" TAB_VERB "%.0" "" COMPU_TAB_REF ServiceId /end COMPU_METHOD
/begin COMPU_METHOD Side "enumeration table" TAB_VERB "%.0" "" COMPU_TAB_REF Side /end COMPU_METHOD
/begin COMPU_METHOD SmStateId "enumeration table" TAB_VERB "%.0" "" COMPU_TAB_REF SmStateId /end COMPU_METHOD
/begin COMPU_METHOD SscOosConfigurationType "enumeration table" TAB_VERB "%.0" "" COMPU_TAB_REF SscOosConfigurationType /end COMPU_METHOD
/begin COMPU_METHOD SscPhase "enumeration table" TAB_VERB "%.0" "" COMPU_TAB_REF SscPhase /end COMPU_METHOD
/begin COMPU_METHOD SscPhase.OLD_Copy1 "enumeration table" TAB_VERB "%.0" "" COMPU_TAB_REF SscPhase.OLD_1 /end COMPU_METHOD
/begin COMPU_METHOD StalinResult "enumeration table" TAB_VERB "%.0" "" COMPU_TAB_REF StalinResult /end COMPU_METHOD
/begin COMPU_METHOD StateMachineStates "enumeration table" TAB_VERB "%.0" "" COMPU_TAB_REF StateMachineStates /end COMPU_METHOD
/begin COMPU_METHOD StateMachineType "enumeration table" TAB_VERB "%.0" "" COMPU_TAB_REF StateMachineType /end COMPU_METHOD
/begin COMPU_METHOD StateMachineType_Copy1 "enumeration table" TAB_VERB "%.0" "" COMPU_TAB_REF StateMachineType_Copy1 /end COMPU_METHOD
/begin COMPU_METHOD StateMachine_Type "enumeration table" TAB_VERB "%.0" "" COMPU_TAB_REF StateMachine_Type /end COMPU_METHOD
/begin COMPU_METHOD Static2DMotionGoal "enumeration table" TAB_VERB "%.0" "" COMPU_TAB_REF Static2DMotionGoal /end COMPU_METHOD
/begin COMPU_METHOD Static2DMotionGoal_v0 "enumeration table" TAB_VERB "%.0" "" COMPU_TAB_REF Static2DMotionGoal_v0 /end COMPU_METHOD
/begin COMPU_METHOD StationaryHoldModePrivate "enumeration table" TAB_VERB "%.0" "" COMPU_TAB_REF StationaryHoldModePrivate /end COMPU_METHOD
/begin COMPU_METHOD Status "enumeration table" TAB_VERB "%.0" "" COMPU_TAB_REF Status /end COMPU_METHOD
/begin COMPU_METHOD SteeringWheelAssistState "enumeration table" TAB_VERB "%.0" "" COMPU_TAB_REF SteeringWheelAssistState /end COMPU_METHOD
/begin COMPU_METHOD SystemServiceIds "enumeration table" TAB_VERB "%.0" "" COMPU_TAB_REF SystemServiceIds /end COMPU_METHOD
/begin COMPU_METHOD SystemServiceResponseType "enumeration table" TAB_VERB "%.0" "" COMPU_TAB_REF SystemServiceResponseType /end COMPU_METHOD
/begin COMPU_METHOD SystemServiceState "enumeration table" TAB_VERB "%.0" "" COMPU_TAB_REF SystemServiceState /end COMPU_METHOD
/begin COMPU_METHOD Table_1 "enumeration table" TAB_VERB "%.0" "" COMPU_TAB_REF Table_1 /end COMPU_METHOD
/begin COMPU_METHOD Table_1081 "enumeration table" TAB_VERB "%.0" "" COMPU_TAB_REF Table_1081 /end COMPU_METHOD
/begin COMPU_METHOD Table_1082 "enumeration table" TAB_VERB "%.0" "" COMPU_TAB_REF Table_1082 /end COMPU_METHOD
/begin COMPU_METHOD Table_1083 "enumeration table" TAB_VERB "%.0" "" COMPU_TAB_REF Table_1083 /end COMPU_METHOD
/begin COMPU_METHOD Table_1084 "enumeration table" TAB_VERB "%.0" "" COMPU_TAB_REF Table_1084 /end COMPU_METHOD
/begin COMPU_METHOD Table_116 "enumeration table" TAB_VERB "%.0" "" COMPU_TAB_REF Table_116 /end COMPU_METHOD
/begin COMPU_METHOD Table_121 "enumeration table" TAB_VERB "%.0" "" COMPU_TAB_REF Table_121 /end COMPU_METHOD
/begin COMPU_METHOD Table_122 "enumeration table" TAB_VERB "%.0" "" COMPU_TAB_REF Table_122 /end COMPU_METHOD
/begin COMPU_METHOD Table_123 "enumeration table" TAB_VERB "%.0" "" COMPU_TAB_REF Table_123 /end COMPU_METHOD
/begin COMPU_METHOD Table_124 "enumeration table" TAB_VERB "%.0" "" COMPU_TAB_REF Table_124 /end COMPU_METHOD
/begin COMPU_VTAB_RANGE OosIds "" 3 0 0 "INSPEC" 1 1 "PER_PME_VELOCITY_SERVICE_OOS" 2 2 "PER_PME_YAW_RATE_SERVICE_OOS" DEFAULT_VALUE "" /end COMPU_VTAB_RANGE
/begin COMPU_VTAB_RANGE OoseqStrategy "" 6 0 0 "DISCARD" 1 1 "NEGLECT" 2 2 "WAIT" 3 3 "PREDICT_OBJECTLIST" 4 4 "PREDICT_MEASUREMENT" 5 5 "TWOSTEP" DEFAULT_VALUE "" /end COMPU_VTAB_RANGE
/begin COMPU_VTAB OoseqStrategy_Copy1 "enumeration table" TAB_VERB 4 0 "USE" 1 "REWRITE" 2 "DISCARD" 3 "IMPLAUSIBLE" /end COMPU_VTAB
/begin COMPU_VTAB_RANGE Os_ScheduleTableStatusType "" 5 0 0 "SCHEDULETABLE_STOPPED" 1 1 "SCHEDULETABLE_NEXT" 2 2 "SCHEDULETABLE_WAITING" 3 3 "SCHEDULETABLE_RUNNING" 4 4 "SCHEDULETABLE_RUNNING_AND_SYNCHRONOUS" DEFAULT_VALUE "" /end COMPU_VTAB_RANGE
/begin COMPU_VTAB_RANGE PER_ALGOS_MBF_TYPES "" 8 1 1 "TYPE_MBF_DEFAULT" 1 1 "TYPE_LKF_WNJ_CART" 3 3 "TYPE_LKF_LA_CART" 4 4 "TYPE_LKF_FH_CART" 5 5 "TYPE_EKF_WNJ_POL" 6 6 "TYPE_EKF_CT_POL" 7 7 "TYPE_EKF_LA_POL" 8 8 "TYPE_EKF_FH_POL" DEFAULT_VALUE "" /end COMPU_VTAB_RANGE
/begin COMPU_VTAB PER_ALGOS_MBF_TYPES_Copy1 "enumeration table" TAB_VERB 5 0 "TYPE_WNJ" 0 "TYPE_MBF_DEFAULT" 1 "TYPE_LA" 2 "TYPE_FH" 3 "TYPE_CT" /end COMPU_VTAB
/begin COMPU_VTAB PER_ALGOS_MBF_TYPES_Copy99 "enumeration table" TAB_VERB 8 1 "TYPE_LKF_WNJ_CART" 1 "TYPE_MBF_DEFAULT" 3 "TYPE_LKF_LA_CART" 4 "TYPE_LKF_FH_CART" 5 "TYPE_EKF_WNJ_POL" 6 "TYPE_EKF_CT_POL" 7 "TYPE_EKF_LA_POL" 8 "TYPE_EKF_FH_POL" /end COMPU_VTAB
/begin COMPU_VTAB_RANGE PER_ASIL_LEVELS "" 6 0 0 "ASIL_UNKNOWN" 1 1 "ASIL_QM" 2 2 "ASIL_A" 3 3 "ASIL_B" 4 4 "ASIL_C" 5 5 "ASIL_D" DEFAULT_VALUE "" /end COMPU_VTAB_RANGE
/begin COMPU_VTAB PER_PER_TYPES "enumeration table" TAB_VERB 6 1 "TYPE_DEP" 2 "TYPE_SEP" 3 "TYPE_REP" 5 "TYPE_ADEP" 6 "TYPE_ASEP" 7 "TYPE_AREP" /end COMPU_VTAB
/begin COMPU_VTAB_RANGE PER_RAW_FEATURES "" 6 0 0 "RAW_FEATURE_INVALID" 1 1 "RAW_FEATURE_LENGTH" 2 2 "RAW_FEATURE_WIDTH" 3 3 "RAW_FEATURE_RADIALDIST" 4 4 "RAW_FEATURE_RCS" 5 5 "RAW_FEATURE_ELEVATION" DEFAULT_VALUE "" /end COMPU_VTAB_RANGE
/begin COMPU_VTAB_RANGE PER_REFERENCE_POINTS "" 16 0 0 "REF_POS_FL" 1 1 "REF_POS_FC" 2 2 "REF_POS_FR" 3 3 "REF_POS_FWL" 4 4 "REF_POS_FWR" 5 5 "REF_POS_SML" 6 6 "REF_POS_SMR" 7 7 "REF_POS_RWL" 8 8 "REF_POS_RWR" 9 9 "REF_POS_RL" 10 10 "REF_POS_RC" 11 11 "REF_POS_RR" 12 12 "REF_POS_CENTER" 13 13 "REF_POS_RWC" 14 14 "REF_POS_FWC" 255 255 "REF_POS_INVALID" DEFAULT_VALUE "" /end COMPU_VTAB_RANGE
/begin COMPU_VTAB_RANGE PER_REFERENCE_POINTS.OLD_1 "" 14 0 0 "REF_POS_FL" 1 1 "REF_POS_FC" 2 2 "REF_POS_FR" 3 3 "REF_POS_FWL" 4 4 "REF_POS_FWR" 5 5 "REF_POS_SML" 6 6 "REF_POS_SMR" 7 7 "REF_POS_RWL" 8 8 "REF_POS_RWR" 9 9 "REF_POS_RL" 10 10 "REF_POS_RC" 11 11 "REF_POS_RR" 12 12 "REF_POS_CENTER" 255 255 "REF_POS_INVALID" DEFAULT_VALUE "" /end COMPU_VTAB_RANGE
/begin COMPU_VTAB PER_REFERENCE_POINTS_Copy1 "enumeration table" TAB_VERB 17 0 "REF_POS_FL" 1 "REF_POS_FC" 2 "REF_POS_FR" 3 "REF_POS_FWL" 4 "REF_POS_FWR" 5 "REF_POS_SML" 6 "REF_POS_SMR" 7 "REF_POS_RWL" 8 "REF_POS_RWR" 9 "REF_POS_RL" 10 "REF_POS_RC" 11 "REF_POS_RR" 12 "REF_POS_CENTER" 13 "REF_POS_RWC" 14 "REF_POS_FWC" 15 "REF_POS_ADAPTIVE" 255 "REF_POS_INVALID" /end COMPU_VTAB
/begin COMPU_VTAB PER_REFERENCE_POINTS_Copy2 "enumeration table" TAB_VERB 18 0 "REF_POS_FL" 1 "REF_POS_FC" 2 "REF_POS_FR" 3 "REF_POS_FWL" 4 "REF_POS_FWR" 5 "REF_POS_SML" 6 "REF_POS_SMR" 7 "REF_POS_RWL" 8 "REF_POS_RWR" 9 "REF_POS_RL" 10 "REF_POS_RC" 11 "REF_POS_RR" 12 "REF_POS_CENTER" 13 "REF_POS_RWC" 14 "REF_POS_FWC" 15 "REF_POS_INVALID" 16 "REF_POS_NLR" 17 "REF_POS_NFR" /end COMPU_VTAB
/begin COMPU_VTAB_RANGE PER_SENSOR_TYPES "" 8 0 0 "TYPE_PER" 1 1 "TYPE_RADAR" 2 2 "TYPE_VIDEO" 3 3 "TYPE_LIDAR" 4 4 "TYPE_ULTRASONIC" 5 5 "TYPE_MAP" 6 6 "TYPE_SIGN" 7 7 "TYPE_LANE" DEFAULT_VALUE "" /end COMPU_VTAB_RANGE
/begin COMPU_VTAB PER_SENSOR_TYPES_Copy1 "enumeration table" TAB_VERB 10 0 "TYPE_PER" 1 "TYPE_RADAR" 2 "TYPE_VIDEO" 3 "TYPE_LIDAR" 4 "TYPE_FUSED" 4 "TYPE_ENVMODEL" 5 "TYPE_MAP" 6 "TYPE_SIGN" 7 "TYPE_LANE" 8 "TYPE_FREESPACE" /end COMPU_VTAB
/begin COMPU_VTAB_RANGE PortStates "" 4 0 0 "PortStateUnknown" 1 1 "PortStateNoData" 2 2 "PortStateOldData" 3 3 "PortStateNewData" DEFAULT_VALUE "" /end COMPU_VTAB_RANGE
/begin COMPU_VTAB_RANGE Pre_NoCom_No_PN_Substates_Enum "" 9 0 0 "CANSM_NO_PN_DEFAULT" 1 1 "CANSM_NO_PN_S_CC_STOPPED" 2 2 "CANSM_NO_PN_S_CC_STOPPED_WAIT" 3 3 "CANSM_NO_PN_S_CC_SLEEP" 4 4 "CANSM_NO_PN_S_CC_SLEEP_WAIT" 5 5 "CANSM_NO_PN_S_TRCV_NORMAL" 6 6 "CANSM_NO_PN_S_TRCV_NORMAL_WAIT" 7 7 "CANSM_NO_PN_S_TRCV_STANDBY" 8 8 "CANSM_NO_PN_S_TRCV_STANDBY_WAIT" DEFAULT_VALUE "" /end COMPU_VTAB_RANGE
/begin COMPU_VTAB_RANGE PswRequestType "" 3 0 0 "NO_WRITE" 1 1 "WRITE" 2 2 "FORCE_WRITE" DEFAULT_VALUE "" /end COMPU_VTAB_RANGE
/begin COMPU_VTAB_RANGE RIF_STATUS "" 11 0 0 "RIF_OK" 1 1 "RIF_CONF_ENABLE_TIMEOUT_ERR" 2 2 "RIF_CONF_DISABLE_TIMEOUT_ERR" 3 3 "RIF_CONF_RESET_TIMEOUT_ERR" 4 4 "RIF_DATA_CRC_ERR" 5 5 "RIF_DATA_COUNTER_ERR" 6 6 "RIF_DFU_LKSTP_ERR" 7 7 "RIF_REG_CRC_ERR" 8 8 "RIF_SFTY_CTRL_ERR" 9 9 "RIF_CAL_DESKEW_ERR" 10 10 "RIF_CAL_TIMEOUT_ERR" DEFAULT_VALUE "" /end COMPU_VTAB_RANGE
/begin COMPU_VTAB_RANGE RIF_STATUS.OLD_1 "" 8 0 0 "RIF_OK" 1 1 "RIF_CONF_ENABLE_TIMEOUT_ERR" 2 2 "RIF_CONF_DISABLE_TIMEOUT_ERR" 3 3 "RIF_CONF_RESET_TIMEOUT_ERR" 4 4 "RIF_DATA_CRC_ERR" 5 5 "RIF_DATA_COUNTER_ERR" 6 6 "RIF_CAL_DESKEW_ERR" 7 7 "RIF_CAL_TIMEOUT_ERR" DEFAULT_VALUE "" /end COMPU_VTAB_RANGE
/begin COMPU_VTAB RIF_STATUS_Copy1 "enumeration table" TAB_VERB 12 0 "RIF_OK" 1 "RIF_CONF_ENABLE_TIMEOUT_ERR" 2 "RIF_CONF_DISABLE_TIMEOUT_ERR" 3 "RIF_CONF_RESET_TIMEOUT_ERR" 4 "RIF_DATA_CRC_ERR" 5 "RIF_DATA_COUNTER_ERR" 6 "RIF_DFU_LKSTP_ERR" 7 "RIF_REG_CRC_ERR" 8 "RIF_SFTY_CTRL_ERR" 9 "RIF_CAL_DESKEW_ERR" 10 "RIF_CAL_TIMEOUT_ERR" 11 "RIF_HW_REGISTER_ERR" /end COMPU_VTAB
/begin COMPU_VTAB_RANGE RPType.OLD_1 "" 6 0 0 "RPT_UNDEFINED" 1 1 "RPT_ALD" 2 2 "RPT_ALC" 3 3 "RPT_AEB_M" 4 4 "RPT_TOR" 5 5 "RPT_HWA_ALD" DEFAULT_VALUE "" /end COMPU_VTAB_RANGE
/begin COMPU_VTAB ReactionPatternType "enumeration table" TAB_VERB 7 0 "undefined" 1 "laneDriving" 2 "laneChange" 3 "emergencyAvoidance" 4 "immediateBrake" 5 "returnToLane" 6 "activeWarning" /end COMPU_VTAB
/begin COMPU_VTAB_RANGE ReceiverPortStates "" 4 0 0 "Unkown" 1 1 "NoData" 2 2 "OldData" 3 3 "NewData" DEFAULT_VALUE "" /end COMPU_VTAB_RANGE
/begin COMPU_VTAB RifNumChanType "enumeration table" TAB_VERB 4 1 "Rif_NumChan_1" 2 "Rif_NumChan_2" 3 "Rif_NumChan_3" 4 "Rif_NumChan_4" /end COMPU_VTAB
/begin COMPU_VTAB RightOfWay "enumeration table" TAB_VERB 4 0 "drivingInHasPriority" 1 "drivingInHasToYield" 2 "unknownRightOfWay" 3 "notAvailable" /end COMPU_VTAB
/begin COMPU_VTAB_RANGE RoadSignType "" 218 0 0 "UNKNOWN" 1 1 "SL5" 2 2 "SL10" 3 3 "SL15" 4 4 "SL20" 5 5 "SL25" 6 6 "SL30" 7 7 "SL35" 8 8 "SL40" 9 9 "SL45" 10 10 "SL50" 11 11 "SL55" 12 12 "SL60" 13 13 "SL65" 14 14 "SL70" 15 15 "SL75" 16 16 "SL80" 17 17 "SL85" 18 18 "SL90" 19 19 "SL95" 20 20 "SL100" 21 21 "SL105" 22 22 "SL110" 23 23 "SL115" 24 24 "SL120" 25 25 "SL125" 26 26 "SL130" 27 27 "SL135" 28 28 "SL140" 29 29 "SL145" 30 30 "SL150" 31 31 "SL155" 32 32 "SL160" 33 33 "OP" 34 34 "OL" 35 35 "ESL" 36 36 "EOP" 37 37 "EOL" 38 38 "EA" 77 77 "ADDCAR" 78 78 "ADDLORRY" 79 79 "ADDTRAILER" 80 80 "ADDCARAVAN" 81 81 "ADDBUS" 82 82 "ADDTRACTOR" 83 83 "ADDMCYCLE" 84 84 "ADDLORRYBUSTRAILER_DEPRECATED" 85 85 "ADDLORRYBUS_DEPRECATED" 86 86 "ADDHAZMAT" 87 87 "ADDTANK" 88 88 "ADDTRAM" 89 89 "ADDWET" 90 90 "ADDFOG" 91 91 "ADDRAIN" 92 92 "ADDSNOW" 93 93 "ADDTIME" 94 94 "ADDSECTION" 95 95 "ADDDISTANCE" 96 96 "ADDWEIGHT" 97 97 "ADDEXITL" 98 98 "ADDEXITR" 99 99 "ADDLANES" 100 100 "ADDRADAR" 101 101 "ADDRAPPEL" 102 102 "ADDPRIOTURN" 103 103 "ADDLORRY_EXCEPT" 104 104 "ADDTRACTOR_OVER" 105 105 "NOENTRY" 106 106 "NOALL" 107 107 "NOCAR" 108 108 "NOLORRY" 109 109 "NOHAZMAT" 110 110 "NOBIKE" 111 111 "NOPED" 112 112 "NOCARBIKE" 113 113 "NOTWOWAY" 114 114 "WEIGHT" 115 115 "HEIGHT" 116 116 "WIDTH" 117 117 "LENGTH" 118 118 "PRIOCROSS" 119 119 "GIVEWAY" 120 120 "PRIOCROSSYIELDTORIGHT" 121 121 "WARNDANGER" 122 122 "WARNCURVEL" 123 123 "WARNCURVER" 124 124 "WARNDCURVEL" 125 125 "WARNDCURVER" 126 126 "WARNTRAIN" 127 127 "WARNJAM" 128 128 "WARNANIMAL_DEPRECATED" 129 129 "WARNRWORKS" 130 130 "WARNSLOPED" 131 131 "WARNSLOPEU" 132 132 "PRIOSTREET" 133 133 "EPRIOSTREET" 134 134 "STOP" 135 135 "EXIT" 136 136 "ASL" 137 137 "EASL" 138 138 "MSL" 139 139 "EMSL" 140 140 "MLC" 141 141 "WBDIAGL" 142 142 "WBDIAGR" 143 143 "WBROUND" 144 144 "NOLTURN" 145 145 "NORTURN" 146 146 "NOUTURN" 147 147 "NOPARK" 148 148 "NOSTOP" 149 149 "SMOG" 150 150 "UMWELT" 151 151 "EUMWELT" 152 152 "DOUANE" 153 153 "LOGO_LIDL" 154 154 "LOGO_ESSO" 155 155 "LOGO_SHELL" 156 156 "LOGO_VW" 157 157 "PICT_HOTEL" 158 158 "PICT_PHONE" 159 159 "PICT_FOOD" 160 160 "LAMP" 161 161 "ADDTEXT" 162 162 "REJECTION" 163 163 "ADDSIGN" 164 164 "FWAY" 165 165 "EFWAY" 166 166 "HWAY" 167 167 "EHWAY" 168 168 "NORIDER" 169 169 "ADDRAINSNOW" 170 170 "ADDHUMP" 171 171 "WARNCONST" 172 172 "WARNCONSTL" 173 173 "WARNCONSTR" 174 174 "WARNPED" 175 175 "WARNKIDS" 176 176 "WARNBIKE" 177 177 "WARNSKID" 178 178 "ZEBRA" 179 179 "ONEWAYS" 180 180 "ONEWAYU" 184 184 "ADDLORRYTRAILER_DEPRECATED" 185 185 "SLOWDOWN" 186 186 "NOCARRIAGE" 187 187 "NOLORRYTRAILER" 188 188 "NOBUS" 189 189 "NOTRACTOR" 190 190 "LORRYDIST" 191 191 "CARDIST" 192 192 "WARNROUND" 193 193 "WARNWILDANIMAL" 194 194 "WARNCATTLE" 195 195 "WARNFROG" 196 196 "WARNBUS" 197 197 "WARNWIND" 198 198 "WARNSNOW" 199 199 "WARNPCROSS" 200 200 "WARNHUMP" 201 201 "WARNROCK" 202 202 "WARNLOWTREE" 203 203 "WARNGRAVEL" 204 204 "WARNTWOWAY" 205 205 "WARNLIGHTS" 206 206 "WARNPLANE" 207 207 "ADDCAMPER" 208 208 "ADDZONE" 209 209 "ADDCRASHRISK" 210 210 "ADDACCIDENT" 211 211 "ADDJAM" 212 212 "ADDSMOKE" 213 213 "ADDOILTRAIL" 214 214 "ADDGRAVEL" 215 215 "ADDDIRT" 216 216 "ADDRWORKSEXIT" 217 217 "ADDROADDAMAGE" 218 218 "ADDRWORKSENTRY" 219 219 "ADDLOWTREE" 220 220 "ADDRWORKSACCESS" 221 221 "ADDRUTS" 222 222 "ADDSOFTSHOULDERCAR" 223 223 "ADDSOFTSHOULDERLORRY" 270 270 "CALM" 271 271 "ECALM" 272 272 "TWN" 273 273 "ETWN" 274 274 "DEADEND" 275 275 "AXLEWEIGHT" 276 276 "WARNRIDER" 277 277 "WARNDRAWBRIDGE" 278 278 "WARNPIER" 279 279 "TRINATURE" 288 288 "WBBENTLEFT" 289 289 "WBBENTLEFTRIGHT" 290 290 "WBBENTRIGHT" 291 291 "WBDIAGLR" 292 292 "WBLEFT" 293 293 "WBRIGHT" 294 294 "WBUP" 295 295 "WBUPLEFT" 296 296 "WBUPRIGHT" 297 297 "ADDNOSTOPSHOULDER" 298 298 "ADDTOWING" 299 299 "ADDSCHOOL" 300 300 "ADDNIGHT" 301 301 "ADDEND" 302 302 "ADDBEGINS" 303 303 "ADDWITHIN" 304 304 "WBHAZWATER" 305 305 "NOHAZWATER" 306 306 "ADDDISTANCEBARS" 307 307 "ADDMINIMUM" 308 308 "ADDADVICE" 309 309 "SCHOOL" 310 310 "ESCHOOL" 311 311 "HAZMAT" 312 312 "COUNT" DEFAULT_VALUE "" /end COMPU_VTAB_RANGE
/begin COMPU_VTAB_RANGE RoadSignType.OLD_1 "" 313 0 0 "UNKNOWN" 1 1 "SL5" 2 2 "SL10" 3 3 "SL15" 4 4 "SL20" 5 5 "SL25" 6 6 "SL30" 7 7 "SL35" 8 8 "SL40" 9 9 "SL45" 10 10 "SL50" 11 11 "SL55" 12 12 "SL60" 13 13 "SL65" 14 14 "SL70" 15 15 "SL75" 16 16 "SL80" 17 17 "SL85" 18 18 "SL90" 19 19 "SL95" 20 20 "SL100" 21 21 "SL105" 22 22 "SL110" 23 23 "SL115" 24 24 "SL120" 25 25 "SL125" 26 26 "SL130" 27 27 "SL135" 28 28 "SL140" 29 29 "SL145" 30 30 "SL150" 31 31 "SL155" 32 32 "SL160" 33 33 "OP" 34 34 "OL" 35 35 "ESL" 36 36 "EOP" 37 37 "EOL" 38 38 "EA" 39 39 "VSL5" 40 40 "VSL10" 41 41 "VSL15" 42 42 "VSL20" 43 43 "VSL25" 44 44 "VSL30" 45 45 "VSL35" 46 46 "VSL40" 47 47 "VSL45" 48 48 "VSL50" 49 49 "VSL55" 50 50 "VSL60" 51 51 "VSL65" 52 52 "VSL70" 53 53 "VSL75" 54 54 "VSL80" 55 55 "VSL85" 56 56 "VSL90" 57 57 "VSL95" 58 58 "VSL100" 59 59 "VSL105" 60 60 "VSL110" 61 61 "VSL115" 62 62 "VSL120" 63 63 "VSL125" 64 64 "VSL130" 65 65 "VSL135" 66 66 "VSL140" 67 67 "VSL145" 68 68 "VSL150" 69 69 "VSL155" 70 70 "VSL160" 71 71 "VOP" 72 72 "VOL" 73 73 "VESL" 74 74 "VEOP" 75 75 "VEOL" 76 76 "VEA" 77 77 "ADDCAR" 78 78 "ADDLORRY" 79 79 "ADDTRAILER" 80 80 "ADDCARAVAN" 81 81 "ADDBUS" 82 82 "ADDTRACTOR" 83 83 "ADDMCYCLE" 84 84 "ADDLORRYBUSTRAILER_DEPRECATED" 85 85 "ADDLORRYBUS_DEPRECATED" 86 86 "ADDHAZMAT" 87 87 "ADDTANK" 88 88 "ADDTRAM" 89 89 "ADDWET" 90 90 "ADDFOG" 91 91 "ADDRAIN" 92 92 "ADDSNOW" 93 93 "ADDTIME" 94 94 "ADDSECTION" 95 95 "ADDDISTANCE" 96 96 "ADDWEIGHT" 97 97 "ADDEXITL" 98 98 "ADDEXITR" 99 99 "ADDLANES" 100 100 "ADDRADAR" 101 101 "ADDRAPPEL" 102 102 "ADDPRIOTURN" 103 103 "ADDLORRY_EXCEPT" 104 104 "ADDTRACTOR_OVER" 105 105 "NOENTRY" 106 106 "NOALL" 107 107 "NOCAR" 108 108 "NOLORRY" 109 109 "NOHAZMAT" 110 110 "NOBIKE" 111 111 "NOPED" 112 112 "NOCARBIKE" 113 113 "NOTWOWAY" 114 114 "WEIGHT" 115 115 "HEIGHT" 116 116 "WIDTH" 117 117 "LENGTH" 118 118 "PRIOCROSS" 119 119 "GIVEWAY" 120 120 "PRIOCROSSYIELDTORIGHT" 121 121 "WARNDANGER" 122 122 "WARNCURVEL" 123 123 "WARNCURVER" 124 124 "WARNDCURVEL" 125 125 "WARNDCURVER" 126 126 "WARNTRAIN" 127 127 "WARNJAM" 128 128 "WARNANIMAL_DEPRECATED" 129 129 "WARNRWORKS" 130 130 "WARNSLOPED" 131 131 "WARNSLOPEU" 132 132 "PRIOSTREET" 133 133 "EPRIOSTREET" 134 134 "STOP" 135 135 "EXIT" 136 136 "ASL" 137 137 "EASL" 138 138 "MSL" 139 139 "EMSL" 140 140 "MLC" 141 141 "WBDIAGL" 142 142 "WBDIAGR" 143 143 "WBROUND" 144 144 "NOLTURN" 145 145 "NORTURN" 146 146 "NOUTURN" 147 147 "NOPARK" 148 148 "NOSTOP" 149 149 "SMOG" 150 150 "UMWELT" 151 151 "EUMWELT" 152 152 "DOUANE" 153 153 "LOGO_LIDL" 154 154 "LOGO_ESSO" 155 155 "LOGO_SHELL" 156 156 "LOGO_VW" 157 157 "PICT_HOTEL" 158 158 "PICT_PHONE" 159 159 "PICT_FOOD" 160 160 "LAMP" 161 161 "ADDTEXT" 162 162 "REJECTION" 163 163 "ADDSIGN" 164 164 "FWAY" 165 165 "EFWAY" 166 166 "HWAY" 167 167 "EHWAY" 168 168 "NORIDER" 169 169 "ADDRAINSNOW" 170 170 "ADDHUMP" 171 171 "WARNCONST" 172 172 "WARNCONSTL" 173 173 "WARNCONSTR" 174 174 "WARNPED" 175 175 "WARNKIDS" 176 176 "WARNBIKE" 177 177 "WARNSKID" 178 178 "ZEBRA" 179 179 "ONEWAYS" 180 180 "ONEWAYU" 181 181 "VADDLORRYBUSTRAILER_DEPRECATED" 182 182 "VADDLORRYBUS_DEPRECATED" 183 183 "VADDLORRYTRAILER_DEPRECATED" 184 184 "ADDLORRYTRAILER_DEPRECATED" 185 185 "SLOWDOWN" 186 186 "NOCARRIAGE" 187 187 "NOLORRYTRAILER" 188 188 "NOBUS" 189 189 "NOTRACTOR" 190 190 "LORRYDIST" 191 191 "CARDIST" 192 192 "WARNROUND" 193 193 "WARNWILDANIMAL" 194 194 "WARNCATTLE" 195 195 "WARNFROG" 196 196 "WARNBUS" 197 197 "WARNWIND" 198 198 "WARNSNOW" 199 199 "WARNPCROSS" 200 200 "WARNHUMP" 201 201 "WARNROCK" 202 202 "WARNLOWTREE" 203 203 "WARNGRAVEL" 204 204 "WARNTWOWAY" 205 205 "WARNLIGHTS" 206 206 "WARNPLANE" 207 207 "ADDCAMPER" 208 208 "ADDZONE" 209 209 "ADDCRASHRISK" 210 210 "ADDACCIDENT" 211 211 "ADDJAM" 212 212 "ADDSMOKE" 213 213 "ADDOILTRAIL" 214 214 "ADDGRAVEL" 215 215 "ADDDIRT" 216 216 "ADDRWORKSEXIT" 217 217 "ADDROADDAMAGE" 218 218 "ADDRWORKSENTRY" 219 219 "ADDLOWTREE" 220 220 "ADDRWORKSACCESS" 221 221 "ADDRUTS" 222 222 "ADDSOFTSHOULDERCAR" 223 223 "ADDSOFTSHOULDERLORRY" 224 224 "VADDSIGN" 225 225 "VADDCAR" 226 226 "VADDLORRY" 227 227 "VADDTRAILER" 228 228 "VADDCARAVAN" 229 229 "VADDBUS" 230 230 "VADDWET" 231 231 "VADDFOG" 232 232 "VADDRAIN" 233 233 "VADDSNOW" 234 234 "VADDRAINSNOW" 235 235 "VADDTEXT" 236 236 "VADDSECTION" 237 237 "VADDDISTANCE" 238 238 "VADDWEIGHT" 239 239 "VNOENTRY" 240 240 "VNOALL" 241 241 "VNOCAR" 242 242 "VNOLORRY" 243 243 "VNOCARBIKE" 244 244 "VWEIGHT" 245 245 "VHEIGHT" 246 246 "VWIDTH" 247 247 "VLENGTH" 248 248 "VWARNDANGER" 249 249 "VWARNJAM" 250 250 "VWARNRWORKS" 251 251 "VWARNSKID" 252 252 "VASL" 253 253 "VEASL" 254 254 "VNOLORRYTRAILER" 255 255 "VNOBUS" 256 256 "VLORRYDIST" 257 257 "VCARDIST" 258 258 "VWARNSNOW" 259 259 "VWARNHUMP" 260 260 "VWARNGRAVEL" 261 261 "VADDZONE" 262 262 "VADDCRASHRISK" 263 263 "VADDACCIDENT" 264 264 "VADDJAM" 265 265 "VADDOILTRAIL" 266 266 "VADDGRAVEL" 267 267 "VADDDIRT" 268 268 "VADDROADDAMAGE" 269 269 "VADDRUTS" 270 270 "CALM" 271 271 "ECALM" 272 272 "TWN" 273 273 "ETWN" 274 274 "DEADEND" 275 275 "AXLEWEIGHT" 276 276 "WARNRIDER" 277 277 "WARNDRAWBRIDGE" 278 278 "WARNPIER" 279 279 "TRINATURE" 280 280 "VWARNCONST" 281 281 "VWARNCONSTL" 282 282 "VWARNCONSTR" 283 283 "VWARNCURVEL" 284 284 "VWARNCURVER" 285 285 "VWARNDCURVEL" 286 286 "VWARNDCURVER" 287 287 "VWARNLIGHTS" 288 288 "WBBENTLEFT" 289 289 "WBBENTLEFTRIGHT" 290 290 "WBBENTRIGHT" 291 291 "WBDIAGLR" 292 292 "WBLEFT" 293 293 "WBRIGHT" 294 294 "WBUP" 295 295 "WBUPLEFT" 296 296 "WBUPRIGHT" 297 297 "ADDNOSTOPSHOULDER" 298 298 "ADDTOWING" 299 299 "ADDSCHOOL" 300 300 "ADDNIGHT" 301 301 "ADDEND" 302 302 "ADDBEGINS" 303 303 "ADDWITHIN" 304 304 "WBHAZWATER" 305 305 "NOHAZWATER" 306 306 "ADDDISTANCEBARS" 307 307 "ADDMINIMUM" 308 308 "ADDADVICE" 309 309 "SCHOOL" 310 310 "ESCHOOL" 311 311 "HAZMAT" 312 312 "COUNT" DEFAULT_VALUE "" /end COMPU_VTAB_RANGE
/begin COMPU_VTAB RoadSignType_Copy1 "enumeration table" TAB_VERB 429 0 "UNKNOWN" 1 "SL5" 2 "SL10" 3 "SL15" 4 "SL20" 5 "SL25" 6 "SL30" 7 "SL35" 8 "SL40" 9 "SL45" 10 "SL50" 11 "SL55" 12 "SL60" 13 "SL65" 14 "SL70" 15 "SL75" 16 "SL80" 17 "SL85" 18 "SL90" 19 "SL95" 20 "SL100" 21 "SL105" 22 "SL110" 23 "SL115" 24 "SL120" 25 "SL125" 26 "SL130" 27 "SL135" 28 "SL140" 29 "SL145" 30 "SL150" 31 "SL155" 32 "SL160" 33 "OP" 34 "OL" 35 "ESL" 36 "EOP" 37 "EOL" 38 "EA" 77 "ADDCAR" 78 "ADDLORRY" 79 "ADDTRAILER" 80 "ADDCARAVAN" 81 "ADDBUS" 82 "ADDTRACTOR" 83 "ADDMCYCLE" 84 "ADDLORRYBUSTRAILER_DEPRECATED" 85 "ADDLORRYBUS_DEPRECATED" 86 "ADDHAZMAT" 87 "ADDTANK" 88 "ADDTRAM" 89 "ADDWET" 90 "ADDFOG" 91 "ADDRAIN" 92 "ADDSNOW" 93 "ADDTIME" 94 "ADDSECTION" 95 "ADDDISTANCE" 96 "ADDWEIGHT" 97 "ADDEXITL" 98 "ADDEXITR" 99 "ADDLANES" 100 "ADDRADAR" 101 "ADDRAPPEL" 102 "ADDPRIOTURN" 103 "ADDLORRY_EXCEPT" 104 "ADDTRACTOR_OVER" 105 "NOENTRY" 106 "NOALL" 107 "NOCAR" 108 "NOLORRY" 109 "NOHAZMAT" 110 "NOBIKE" 111 "NOPED" 112 "NOCARBIKE" 113 "NOTWOWAY" 114 "WEIGHT" 115 "HEIGHT" 116 "WIDTH" 117 "LENGTH" 118 "PRIOCROSS" 119 "GIVEWAY" 120 "PRIOCROSSYIELDTORIGHT" 121 "WARNDANGER" 122 "WARNCURVEL" 123 "WARNCURVER" 124 "WARNDCURVEL" 125 "WARNDCURVER" 126 "WARNTRAIN" 127 "WARNJAM" 128 "WARNANIMAL_DEPRECATED" 129 "WARNRWORKS" 130 "WARNSLOPED" 131 "WARNSLOPEU" 132 "PRIOSTREET" 133 "EPRIOSTREET" 134 "STOP" 135 "EXIT" 136 "ASL" 137 "EASL" 138 "MSL" 139 "EMSL" 140 "MLC" 141 "WBDIAGL" 142 "WBDIAGR" 143 "WBROUND" 144 "NOLTURN" 145 "NORTURN" 146 "NOUTURN" 147 "NOPARK" 148 "NOSTOP" 149 "SMOG" 150 "UMWELT" 151 "EUMWELT" 152 "DOUANE" 153 "LOGO_LIDL" 154 "LOGO_ESSO" 155 "LOGO_SHELL" 156 "LOGO_VW" 157 "PICT_HOTEL" 158 "PICT_PHONE" 159 "PICT_FOOD" 160 "LAMP" 161 "ADDTEXT" 162 "REJECTION" 163 "ADDSIGN" 164 "FWAY" 165 "EFWAY" 166 "HWAY" 167 "EHWAY" 168 "NORIDER" 169 "ADDRAINSNOW" 170 "ADDHUMP" 171 "WARNCONST" 172 "WARNCONSTL" 173 "WARNCONSTR" 174 "WARNPED" 175 "WARNKIDS" 176 "WARNBIKE" 177 "WARNSKID" 178 "ZEBRA" 179 "ONEWAYS" 180 "ONEWAYU" 184 "ADDLORRYTRAILER_DEPRECATED" 185 "SLOWDOWN" 186 "NOCARRIAGE" 187 "NOLORRYTRAILER" 188 "NOBUS" 189 "NOTRACTOR" 190 "LORRYDIST" 191 "CARDIST" 192 "WARNROUND" 193 "WARNWILDANIMAL" 194 "WARNCATTLE" 195 "WARNFROG" 196 "WARNBUS" 197 "WARNWIND" 198 "WARNSNOW" 199 "WARNPCROSS" 200 "WARNHUMP" 201 "WARNROCK" 202 "WARNLOWTREE" 203 "WARNGRAVEL" 204 "WARNTWOWAY" 205 "WARNLIGHTS" 206 "WARNPLANE" 207 "ADDCAMPER" 208 "ADDZONE" 209 "ADDCRASHRISK" 210 "ADDACCIDENT" 211 "ADDJAM" 212 "ADDSMOKE" 213 "ADDOILTRAIL" 214 "ADDGRAVEL" 215 "ADDDIRT" 216 "ADDRWORKSEXIT" 217 "ADDROADDAMAGE" 218 "ADDRWORKSENTRY" 219 "ADDLOWTREE" 220 "ADDRWORKSACCESS" 221 "ADDRUTS" 222 "ADDSOFTSHOULDERCAR" 223 "ADDSOFTSHOULDERLORRY" 270 "CALM" 271 "ECALM" 272 "TWN" 273 "ETWN" 274 "DEADEND" 275 "AXLEWEIGHT" 276 "WARNRIDER" 277 "WARNDRAWBRIDGE" 278 "WARNPIER" 279 "TRINATURE" 288 "WBBENTLEFT" 289 "WBBENTLEFTRIGHT" 290 "WBBENTRIGHT" 291 "WBDIAGLR" 292 "WBLEFT" 293 "WBRIGHT" 294 "WBUP" 295 "WBUPLEFT" 296 "WBUPRIGHT" 297 "ADDNOSTOPSHOULDER" 298 "ADDTOWING" 299 "ADDSCHOOL" 300 "ADDNIGHT" 301 "ADDEND" 302 "ADDBEGINS" 303 "ADDWITHIN" 304 "WBHAZWATER" 305 "NOHAZWATER" 306 "ADDDISTANCEBARS" 307 "ADDMINIMUM" 308 "ADDADVICE" 309 "SCHOOL" 310 "ESCHOOL" 311 "HAZMAT" 312 "WARNCURVE" 313 "WARNRIVERBANK" 314 "WARNRIVERBANKL" 315 "WARNDIP" 316 "WARNCYCLIST" 317 "WARNINTERSECTION" 318 "WARNDANGERINT" 319 "WARNINTWITHMINOR" 320 "WARNTRAM" 321 "PRIOFORONCOMINGTRAFFIC" 322 "PRIOOVERONCOMINGTRAFFIC" 323 "PASSRIGHT" 324 "PASSLEFTORRIGHT" 325 "PASSLEFT" 326 "TUNNEL" 327 "LANEMERGER" 328 "LANEMERGEL" 329 "LANEMERGEC" 330 "WARNBRIDGE" 331 "FERRYTERMINAL" 332 "WARNICYROAD" 333 "WARNSTEEPDROPR" 334 "WARNSTEEPDROPL" 335 "WARNROADFLOODS" 336 "WARNACCIDENT" 337 "SL" 338 "ADDACCESS" 339 "ADDALLWAY" 340 "ADDBUS_EXCEPT" 341 "ADDEXCEPTDELIVERY" 342 "ADDEXCEPTLOCAL" 343 "ADDFROG" 344 "ADDPRIOTURNL" 345 "ADDPRIOTURNR" 346 "ADDSTART" 347 "ADDSTOPIN" 348 "EMERGENCYBAY" 349 "ENDOFLANEL" 350 "ENDOFLANER" 351 "ENOPARK" 352 "EONEWAY" 353 "EPARK" 354 "ETOLL" 355 "NOPARKL" 356 "NOPARKLR" 357 "NOPARKR" 358 "NOSTOPL" 359 "NOSTOPLR" 360 "NOSTOPR" 361 "NOTURNONRED" 362 "ONEWAYL" 363 "ONEWAYR" 364 "PARK" 365 "PRIOCROSSL" 366 "PRIOCROSSR" 367 "TOLL" 368 "TWOWAY" 369 "WARNCROSS" 370 "WARNCROSSL" 371 "WARNCROSSLR" 372 "WARNCROSSR" 373 "WARNCROSSRL" 374 "WARNCROSST" 375 "WARNGIVEWAYAHEAD" 376 "WARNSLAHEAD" 377 "WARNSTOPAHEAD" 378 "WBBUS" 379 "WRONGWAY" 380 "ADDEXIT" 381 "HAZWATER" 382 "GIVEWAYROUND" 383 "WARNWINDINGL" 384 "WARNWINDINGR" 385 "WARNHAIRPINL" 386 "WARNHAIRPINR" 387 "WARNPEDBIKE" 388 "WARNCROSSY" 389 "WARNBRANCHL" 390 "WARNBRANCHR" 391 "WARNAXLEWEIGHT" 392 "WARNWEIGHT" 393 "WARNHEIGHT" 394 "WARNLENGTH" 395 "WARNWIDTH" 396 "WARNBLACKSPOT" 397 "WARNMERGEL" 398 "WARNMERGER" 399 "WARNTUNNEL" 400 "WARNTRACTOR" 401 "WARNRWORKSVEHICLE" 402 "WARNNARROWBRIDGE" 403 "WARNFLAGGER" 404 "LANES" 405 "LANESHIFTL" 406 "LANESHIFTR" 407 "NEWLANEL" 408 "NEWLANER" 409 "RIGHTTURNONRED" 410 "BORDERLIMIT" 411 "EMBEDDEDRAIN" 412 "ADDHAZWATER" 413 "ADDDAY" 414 "ADDSL" 426 "NOUP" 428 "ASL5" 429 "ASL10" 430 "ASL15" 431 "ASL20" 432 "ASL25" 433 "ASL30" 434 "ASL35" 435 "ASL40" 436 "ASL45" 437 "ASL50" 438 "ASL55" 439 "ASL60" 440 "ASL65" 441 "ASL70" 442 "ASL75" 443 "ASL80" 444 "ASL85" 445 "ASL90" 446 "ASL95" 447 "ASL100" 448 "ASL105" 449 "ASL110" 450 "ASL115" 451 "ASL120" 452 "ASL125" 453 "ASL130" 454 "ASL135" 455 "ASL140" 456 "ASL145" 457 "ASL150" 458 "ASL155" 459 "ASL160" 492 "WARNTRAINGATED" 493 "ADDLORRYTRAILER" 494 "ADDLORRYSEMI" 497 "KEEPRIGHTCAR" 498 "ASLCURVE5" 499 "ASLCURVE10" 500 "ASLCURVE15" 501 "ASLCURVE20" 502 "ASLCURVE25" 503 "ASLCURVE30" 504 "ASLCURVE35" 505 "ASLCURVE40" 506 "ASLCURVE45" 507 "ASLCURVE50" 508 "ASLCURVE55" 509 "ASLCURVE60" 510 "ASLCURVE65" 511 "ASLCURVE70" 512 "ASLCURVE75" 513 "ASLCURVE80" 514 "ASLCURVE85" 515 "ASLCURVE90" 516 "ASLCURVE95" 517 "ASLCURVE100" 518 "ASLCURVE105" 519 "ASLCURVE110" 520 "ASLCURVE115" 521 "ASLCURVE120" 522 "ASLCURVE125" 523 "ASLCURVE130" 524 "ASLCURVE135" 525 "ASLCURVE140" 526 "ASLCURVE145" 527 "ASLCURVE150" 528 "ASLCURVE155" 529 "ASLCURVE160" 530 "ADDSLOW" 531 "KIDS" 532 "EKIDS" 533 "BIKEROAD" 534 "EBIKEROAD" 535 "PEDSTREET" 536 "EPEDSTREET" 537 "PEDBIKESTREET" 538 "EPEDBIKESTREET" 539 "EWARNKIDS" 572 "CALM20" 573 "CALM30" 574 "ECALM20" 575 "ECALM30" 576 "FWAYGREEN" 577 "TWN40" 578 "TWN50" 579 "TWN60" 580 "TWN70" 581 "ETWN40" 582 "ETWN50" 583 "ETWN60" 584 "ETWN70" 585 "WBBIKE" 586 "EWBBIKE" 587 "WBPED" 588 "EWBPED" 589 "WBPEDBIKESEP" 590 "EWBPEDBIKESEP" 591 "WBPEDBIKESHARED" 592 "EWBPEDBIKESHARED" 593 "ADDBIKEROAD" 594 "ADDLANES_DEPRECATED" 595 "ADDPRIOTURN_DEPRECATED" 596 "ADDMINIMUM_DEPRECATED" 597 "OFF" 598 "EFWAYGREEN" 599 "ADDLORRYTRAILER_EXCEPT" 600 "ADDLORRYSEMI_EXCEPT" 601 "COUNT" /end COMPU_VTAB
/begin COMPU_VTAB_RANGE SPU_Status_t "" 5 0 0 "SPU_STATUS_OK" 1 1 "SPU_STATUS_ERROR_INT_TIMEOUT" 2 2 "SPU_STATUS_ERROR_MON_STAT_REG" 3 3 "SPU_STATUS_ERROR_HW_INIT" 4 4 "SPU_STATUS_ERROR_SBST" DEFAULT_VALUE "" /end COMPU_VTAB_RANGE
/begin COMPU_VTAB_RANGE SPU_Status_t.OLD_1 "" 3 0 0 "SPU_STATUS_OK" 1 1 "SPU_STATUS_TIMEOUT" 2 2 "SPU_STATUS_INVALID_MON_REG" DEFAULT_VALUE "" /end COMPU_VTAB_RANGE
/begin COMPU_VTAB_RANGE SPU_Status_t.OLD_2 "" 4 0 0 "SPU_STATUS_OK" 1 1 "SPU_STATUS_ERROR_INT_TIMEOUT" 2 2 "SPU_STATUS_ERROR_MON_STAT_REG" 3 3 "SPU_STATUS_ERROR_HW_INIT" DEFAULT_VALUE "" /end COMPU_VTAB_RANGE
/begin COMPU_VTAB SPU_Status_t_Copy1 "enumeration table" TAB_VERB 9 0 "SPU_STATUS_OK" 1 "SPU_STATUS_ERROR_INT_TIMEOUT" 2 "SPU_STATUS_ERROR_MON_STAT_REG" 3 "SPU_STATUS_ERROR_HW_INIT" 4 "SPU_STATUS_ERROR_SBST" 5 "SPU_STATUS_ERROR_CONF_SLOT_REG_CRC" 6 "SPU_STATUS_ERROR_EMEM_INTERFACE" 7 "SPU_STATUS_ERROR_RIF_INTERFACE" 8 "SPU_STATUS_ERROR_EXEC_TIME" /end COMPU_VTAB
/begin COMPU_VTAB SPU_Status_t_Copy2 "enumeration table" TAB_VERB 12 0 "SPU_STATUS_OK" 1 "SPU_STATUS_ERROR_INT_TIMEOUT" 2 "SPU_STATUS_ERROR_MON_STAT_REG" 3 "SPU_STATUS_ERROR_HW_INIT" 4 "SPU_STATUS_ERROR_SBST" 5 "SPU_STATUS_ERROR_CONF_SLOT_REG_CRC" 6 "SPU_STATUS_ERROR_EMEM_INTERFACE" 7 "SPU_STATUS_ERROR_RIF_INTERFACE" 8 "SPU_STATUS_ERROR_EXEC_TIME" 9 "SPU_STATUS_ERROR_CTRL_FLOW_CRC" 10 "SPU_STATUS_ERROR_SM_CTRL_STAT" 11 "SPU_STATUS_ERROR_ERR_INT" /end COMPU_VTAB
/begin COMPU_VTAB SPU_Status_t_Copy3 "enumeration table" TAB_VERB 13 0 "enSpuStatusOk" 1 "enSpuStatusErrorIntTimeout" 2 "enSpuStatusErrorMonStatReg" 3 "enSpuStatusErrorHwInit" 4 "enSpuStatusErrorSbst" 5 "enSpuStatusErrorConfSlotRegCrc" 6 "enSpuStatusErrorEmemInterface" 7 "enSpuStatusErrorRifInterface" 8 "enSpuStatusErrorExecTime" 9 "enSpuStatusErrorCtrlFlowCrc" 10 "enSpuStatusErrorSmCtrlStat" 11 "enSpuStatusErrorErrInt" 12 "enSpuStatusErrorCmem" /end COMPU_VTAB
/begin COMPU_VTAB_RANGE SSCState "" 4 0 0 "SYS_INSPEC" 1 1 "SYS_OOSPEC" 2 2 "SYS_SAVE" 3 3 "SYS_STARTUP" DEFAULT_VALUE "" /end COMPU_VTAB_RANGE
/begin COMPU_VTAB SeqIntDef "enumeration table" TAB_VERB 8 0 "enSeqNoint" 0 "enInt0" 1 "enSeqIntSpuVar" 1 "enInt1" 2 "enSeqIntVarOnly" 2 "enInt2" 3 "enSeqIntSpuOnly" 3 "enInt3" /end COMPU_VTAB
/begin COMPU_VTAB ServiceId "enumeration table" TAB_VERB 22 0 "HV" 1 "ENV_MODEL" 2 "ENV_MODEL2" 3 "BC" 4 "BC2" 5 "BS" 6 "BS2" 7 "RPM_EXECUTION" 8 "LONG_TARGET" 9 "ACF" 10 "REF_LAT" 11 "TRP_LAT" 12 "TRC_LAT" 13 "STEERING_ANGLE" 14 "STEERING_TORQUE" 15 "MCAM_LONG" 16 "EXTERNAL" 17 "SSU" 18 "LONG_OUTPUTPROC" 19 "BA" 20 "TOTAL_NUMBER" 65535 "NOT_DEFINED" /end COMPU_VTAB
/begin COMPU_VTAB_RANGE Side "" 3 0 0 "UNKNOWN" 1 1 "RIGHT" 2 2 "LEFT" DEFAULT_VALUE "" /end COMPU_VTAB_RANGE
/begin COMPU_VTAB SmStateId "enumeration table" TAB_VERB 6 0 "startup_ending" 1 "bad" 2 "badConnection" 3 "reinit" 4 "reinit_ending" 5 "normalOperation" /end COMPU_VTAB
/begin COMPU_VTAB_RANGE SscOosConfigurationType "" 2 0 0 "REVERSIBLE" 1 1 "IRREVERSIBLE" DEFAULT_VALUE "" /end COMPU_VTAB_RANGE
/begin COMPU_VTAB_RANGE SscPhase "" 4 0 0 "INSPEC_PHASE" 1 1 "OOS_PHASE" 2 2 "SAFE_PHASE" 3 3 "STARTUP_PHASE" DEFAULT_VALUE "" /end COMPU_VTAB_RANGE
/begin COMPU_VTAB_RANGE SscPhase.OLD_1 "" 4 0 0 "INSPEC_PHASE" 1 1 "OOS_PHASE" 2 2 "SAVE_PHASE" 3 3 "STARTUP_PHASE" DEFAULT_VALUE "" /end COMPU_VTAB_RANGE
/begin COMPU_VTAB StalinResult "enumeration table" TAB_VERB 4 0 "successful" 1 "dspStateNotOk" 2 "locationListEmpty" 3 "noValidLocation" /end COMPU_VTAB
/begin COMPU_VTAB_RANGE StateMachineStates "" 8 0 0 "Init" 1 1 "Passive" 2 2 "ActiveControl" 3 3 "ActiveControlSwOffState" 4 4 "ActiveSuspend" 5 5 "DriverRequest" 6 6 "RevFailure" 7 7 "IrrevFailure" DEFAULT_VALUE "" /end COMPU_VTAB_RANGE
/begin COMPU_VTAB_RANGE StateMachineType "" 7 0 0 "Long" 1 1 "Pss" 2 2 "Aeb_M" 3 3 "Aeb_Ped" 4 4 "Fcw" 5 5 "Aeb_P" 6 6 "Fta" DEFAULT_VALUE "" /end COMPU_VTAB_RANGE
/begin COMPU_VTAB StateMachineType_Copy1 "enumeration table" TAB_VERB 8 0 "Longitudinal" 1 "SafetyFunctions" 2 "AebFullBrake" 3 "EmergencyBrakeAssist" 4 "AebPartialBrake" 5 "ForwardCollisionWarning" 6 "AebPedestrian" 7 "FarsideTurnAssist" /end COMPU_VTAB
/begin COMPU_VTAB_RANGE StateMachine_Type "" 7 0 0 "SM_Long" 1 1 "SM_Lat" 2 2 "SM_Lc" 3 3 "SM_Mes" 4 4 "SM_Pss" 5 5 "SM_Aeb_M" 6 6 "SM_Aeb_Ped" DEFAULT_VALUE "" /end COMPU_VTAB_RANGE
/begin COMPU_VTAB Static2DMotionGoal "enumeration table" TAB_VERB 2 0 "stayLaterallyWithinYellowStaticCorridor" 1 "stayInParallelWithYellowStaticCorridor" /end COMPU_VTAB
/begin COMPU_VTAB Static2DMotionGoal_v0 "enumeration table" TAB_VERB 5 0 "stayLaterallyWithinYellowStaticCorridor" 1 "stayInParallelWithYellowStaticCorridor" 2 "keepLeft" 3 "keepRight" 4 "doFollow" /end COMPU_VTAB
/begin COMPU_VTAB StationaryHoldModePrivate "enumeration table" TAB_VERB 3 0 "normal" 1 "secure" 2 "lockedSecure" /end COMPU_VTAB
/begin COMPU_VTAB_RANGE Status "" 3 0 0 "INVALID" 1 1 "AVAILABLE" 2 2 "REGULATED_UPON" DEFAULT_VALUE "" /end COMPU_VTAB_RANGE
/begin COMPU_VTAB_RANGE SteeringWheelAssistState "" 4 0 0 "EPS_OFF" 1 1 "EPS_READY" 2 2 "EPS_ACTIVE" 3 3 "EPS_RESERVED" DEFAULT_VALUE "" /end COMPU_VTAB_RANGE
/begin COMPU_VTAB_RANGE SystemServiceIds "" 3 0 0 "PER_PME_VELOCITY_SERVICE" 1 1 "PER_PME_YAW_RATE_SERVICE" 255 255 "NOT_DEFINED" DEFAULT_VALUE "" /end COMPU_VTAB_RANGE
/begin COMPU_VTAB_RANGE SystemServiceResponseType "" 6 0 0 "RESPONSE_TYPE_SUCCESSFUL" 1 1 "RESPONSE_TYPE_FAILED" 2 2 "RESPONSE_TYPE_NOT_POSSIBLE" 3 3 "RESPONSE_TYPE_PENDING" 4 4 "RESPONSE_TYPE_TIMEOUT" 5 5 "RESPONSE_TYPE_INVALID" DEFAULT_VALUE "" /end COMPU_VTAB_RANGE
/begin COMPU_VTAB_RANGE SystemServiceState "" 4 0 0 "INVALID_STATE" 1 1 "NOT_INITIALIZED_STATE" 2 2 "SHUTDOWN_STATE" 3 3 "SAFE_STATE" DEFAULT_VALUE "" /end COMPU_VTAB_RANGE
/begin COMPU_VTAB Table_1 "enumeration table" TAB_VERB 5 0 "rbHsmPrepare_NotStarted_e" 1 "rbHsmPrepare_AccessPending_e" 2 "rbHsmPrepare_AccessFailed_e" 3 "rbHsmPrepare_AccessStateOK_e" 4 "rbHsmPrepare_PreInitDone_e" /end COMPU_VTAB
/begin COMPU_VTAB Table_1081 "enumeration table" TAB_VERB 4 0 "CANTSYN_CRC_IGNORED" 1 "CANTSYN_CRC_NOT_VALIDATED" 2 "CANTSYN_CRC_OPTIONAL" 3 "CANTSYN_CRC_VALIDATED" /end COMPU_VTAB
/begin COMPU_VTAB Table_1082 "enumeration table" TAB_VERB 3 0 "STBM_NVM_NO_STORAGE" 1 "STBM_NVM_STORAGE_AT_SHUTDOWN" 2 "STBM_NVM_NOT_CONFIGURED" /end COMPU_VTAB
/begin COMPU_VTAB Table_1083 "enumeration table" TAB_VERB 3 0 "STBM_MASTER" 1 "STBM_SLAVE" 2 "STBM_GATEWAY" /end COMPU_VTAB
/begin COMPU_VTAB Table_1084 "enumeration table" TAB_VERB 5 0 "OS" 1 "ETHTSYN" 2 "GPT" 3 "EXTERNAL_COUNTER" 4 "STBMLOCALTIMEHARDWARE_NOT_CONFIGURED" /end COMPU_VTAB
/begin COMPU_VTAB Table_116 "enumeration table" TAB_VERB 6 0 "RBPFLSINTY_NOTSTARTED" 1 "RBPFLSINTY_INITFAILED" 2 "RBPFLSINTY_CALCINPROGRESS" 3 "RBPFLSINTY_CALCCOMPLETED" 4 "RBPFLSINTY_EVALCOMPLETEDPASSED" 5 "RBPFLSINTY_EVALCOMPLETEDFAILED" /end COMPU_VTAB
/begin COMPU_VTAB Table_121 "enumeration table" TAB_VERB 5 0 "RBSYSLOG_INVALIDATE_NOT_REQUESTED_EN" 1 "RBSYSLOG_INVALIDATE_SUCCESSFUL_EN" 2 "RBSYSLOG_INVALIDATE_JOB_REQUEST_FAILED_EN" 3 "RBSYSLOG_INVALIDATE_JOB_FAILED_EN" 4 "RBSYSLOG_INVALIDATE_TIMEOUT_EN" /end COMPU_VTAB
/begin COMPU_VTAB Table_122 "enumeration table" TAB_VERB 3 0 "RBSYSLOG_INVALIDATE_UNSUCCESSFUL" 1 "RBSYSLOG_INVALIDATE_PENDING" 2 "RBSYSLOG_INVALIDATE_SUCCESSFUL" /end COMPU_VTAB
/begin COMPU_VTAB Table_123 "enumeration table" TAB_VERB 3 0 "RBADC_UNINIT" 1 "RBADC_RUN" 2 "RBADC_ERROR" /end COMPU_VTAB
/begin COMPU_VTAB Table_124 "enumeration table" TAB_VERB 8 0 "RBBIST_NOERROR" 1 "RBBIST_MBIST_SERR_E" 2 "RBBIST_MBIST_CERR_E" 4 "RBBIST_MBIST_UCERR_E" 8 "RBBIST_MBIST_MERR_E" 16 "RBBIST_MONBIST_SMUERR_E" 32 "RBBIST_MONBIST_PMSERR_E" 48 "RBBIST_MONBIST_SMUERR_AND_PMSERR_E" /end COMPU_VTAB
/begin RECORD_LAYOUT __Float16_Value FNC_VALUES 1 FLOAT16_IEEE ROW_DIR DIRECT /end RECORD_LAYOUT
/begin RECORD_LAYOUT __Float32_Value FNC_VALUES 1 FLOAT32_IEEE ROW_DIR DIRECT /end RECORD_LAYOUT
/begin RECORD_LAYOUT __UByte_Value FNC_VALUES 1 UBYTE ROW_DIR DIRECT /end RECORD_LAYOUT
/begin RECORD_LAYOUT __UWord_Value FNC_VALUES 1 UWORD ROW_DIR DIRECT /end RECORD_LAYOUT
/end MODULE
/end PROJECT
