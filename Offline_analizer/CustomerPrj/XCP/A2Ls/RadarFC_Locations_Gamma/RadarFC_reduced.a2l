ASAP2_VERSION 1 71
/begin PROJECT RADAR_GEN5 ""
/begin HEADER "" VERSION "TO_BE_FILLED" /end HEADER
/begin MODULE RADAR_GEN5 ""
/begin MOD_COMMON "" ALIGNMENT_BYTE 1 ALIGNMENT_WORD 2 ALIGNMENT_LONG 4 ALIGNMENT_FLOAT16_IEEE 2 ALIGNMENT_FLOAT32_IEEE 4 ALIGNMENT_FLOAT64_IEEE 4 ALIGNMENT_INT64 4 /end MOD_COMMON
/begin CHARACTERISTIC _g_PL_AD_fw_Radar_1R1V_rpc_LocBypassingRunnable_LocBypassingRunnable_m_pad_ensRLocationsPort_par_out_local.TChangeableMemPool._._._m_arrayPool._0_._elem._m_LocationList._Item._55_._phiVar._m_value "" VALUE 0xB001070E __Float16_Value 0 NO_COMPU_METHOD -65504 65504 ECU_ADDRESS_EXTENSION 0x2 BYTE_ORDER MSB_LAST /end CHARACTERISTIC
/begin CHARACTERISTIC _g_PL_AD_fw_Radar_1R1V_rpc_LocBypassingRunnable_LocBypassingRunnable_m_pad_ensRLocationsPort_par_out_local.TChangeableMemPool._._._m_arrayPool._0_._elem._m_LocationList._Item._55_._theta._m_value "" VALUE 0xB0010706 __Float16_Value 0 NO_COMPU_METHOD -65504 65504 ECU_ADDRESS_EXTENSION 0x2 BYTE_ORDER MSB_LAST /end CHARACTERISTIC
/begin CHARACTERISTIC _g_PL_AD_fw_Radar_1R1V_rpc_LocBypassingRunnable_LocBypassingRunnable_m_pad_ensRLocationsPort_par_out_local.TChangeableMemPool._._._m_arrayPool._0_._elem._m_LocationList._Item._55_._thetaQly "" VALUE 0xB001070A __UByte_Value 0 NO_COMPU_METHOD 0 255 ECU_ADDRESS_EXTENSION 0x2 BYTE_ORDER MSB_LAST /end CHARACTERISTIC
/begin CHARACTERISTIC _g_PL_AD_fw_Radar_1R1V_rpc_LocBypassingRunnable_LocBypassingRunnable_m_pad_ensRLocationsPort_par_out_local.TChangeableMemPool._._._m_arrayPool._0_._elem._m_LocationList._Item._55_._thetaVar._m_value "" VALUE 0xB001070C __Float16_Value 0 NO_COMPU_METHOD -65504 65504 ECU_ADDRESS_EXTENSION 0x2 BYTE_ORDER MSB_LAST /end CHARACTERISTIC
/begin CHARACTERISTIC _g_PL_AD_fw_Radar_1R1V_rpc_LocBypassingRunnable_LocBypassingRunnable_m_pad_ensRLocationsPort_par_out_local.TChangeableMemPool._._._m_arrayPool._0_._elem._m_LocationList._Item._55_._v "" VALUE 0xB00106FC __Float32_Value 0 NO_COMPU_METHOD -3.4028234663852886E+38 3.4028234663852886E+38 ECU_ADDRESS_EXTENSION 0x2 BYTE_ORDER MSB_LAST /end CHARACTERISTIC
/begin CHARACTERISTIC _g_PL_AD_fw_Radar_1R1V_rpc_LocBypassingRunnable_LocBypassingRunnable_m_pad_ensRLocationsPort_par_out_local.TChangeableMemPool._._._m_arrayPool._0_._elem._m_LocationList._Item._55_._vVar._m_value "" VALUE 0xB0010702 __Float16_Value 0 NO_COMPU_METHOD -65504 65504 ECU_ADDRESS_EXTENSION 0x2 BYTE_ORDER MSB_LAST /end CHARACTERISTIC
/begin CHARACTERISTIC _g_PL_AD_fw_Radar_1R1V_rpc_LocBypassingRunnable_LocBypassingRunnable_m_pad_ensRLocationsPort_par_out_local.TChangeableMemPool._._._m_arrayPool._0_._elem._m_LocationList._Item._56_._Rcs._m_value "" VALUE 0xB0010730 __Float16_Value 0 NO_COMPU_METHOD -65504 65504 ECU_ADDRESS_EXTENSION 0x2 BYTE_ORDER MSB_LAST /end CHARACTERISTIC
/begin CHARACTERISTIC _g_PL_AD_fw_Radar_1R1V_rpc_LocBypassingRunnable_LocBypassingRunnable_m_pad_ensRLocationsPort_par_out_local.TChangeableMemPool._._._m_arrayPool._0_._elem._m_LocationList._Item._56_._Rssi._m_value "" VALUE 0xB0010732 __Float16_Value 0 NO_COMPU_METHOD -65504 65504 ECU_ADDRESS_EXTENSION 0x2 BYTE_ORDER MSB_LAST /end CHARACTERISTIC
/begin CHARACTERISTIC _g_PL_AD_fw_Radar_1R1V_rpc_LocBypassingRunnable_LocBypassingRunnable_m_pad_ensRLocationsPort_par_out_local.TChangeableMemPool._._._m_arrayPool._0_._elem._m_LocationList._Item._56_._d "" VALUE 0xB0010718 __Float32_Value 0 NO_COMPU_METHOD -3.4028234663852886E+38 3.4028234663852886E+38 ECU_ADDRESS_EXTENSION 0x2 BYTE_ORDER MSB_LAST /end CHARACTERISTIC
/begin CHARACTERISTIC _g_PL_AD_fw_Radar_1R1V_rpc_LocBypassingRunnable_LocBypassingRunnable_m_pad_ensRLocationsPort_par_out_local.TChangeableMemPool._._._m_arrayPool._0_._elem._m_LocationList._Item._56_._dVar._m_value "" VALUE 0xB0010720 __Float16_Value 0 NO_COMPU_METHOD -65504 65504 ECU_ADDRESS_EXTENSION 0x2 BYTE_ORDER MSB_LAST /end CHARACTERISTIC
/begin CHARACTERISTIC _g_PL_AD_fw_Radar_1R1V_rpc_LocBypassingRunnable_LocBypassingRunnable_m_pad_ensRLocationsPort_par_out_local.TChangeableMemPool._._._m_arrayPool._0_._elem._m_LocationList._Item._56_._dvCov._m_value "" VALUE 0xB0010724 __Float16_Value 0 NO_COMPU_METHOD -65504 65504 ECU_ADDRESS_EXTENSION 0x2 BYTE_ORDER MSB_LAST /end CHARACTERISTIC
/begin CHARACTERISTIC _g_PL_AD_fw_Radar_1R1V_rpc_LocBypassingRunnable_LocBypassingRunnable_m_pad_ensRLocationsPort_par_out_local.TChangeableMemPool._._._m_arrayPool._0_._elem._m_LocationList._Item._56_._dvQly "" VALUE 0xB0010734 __UByte_Value 0 NO_COMPU_METHOD 0 255 ECU_ADDRESS_EXTENSION 0x2 BYTE_ORDER MSB_LAST /end CHARACTERISTIC
/begin CHARACTERISTIC _g_PL_AD_fw_Radar_1R1V_rpc_LocBypassingRunnable_LocBypassingRunnable_m_pad_ensRLocationsPort_par_out_local.TChangeableMemPool._._._m_arrayPool._0_._elem._m_LocationList._Item._56_._idxAzimuthAmbiguityPeer "" VALUE 0xB0010736 __UWord_Value 0 NO_COMPU_METHOD 0 65535 ECU_ADDRESS_EXTENSION 0x2 BYTE_ORDER MSB_LAST /end CHARACTERISTIC
/begin CHARACTERISTIC _g_PL_AD_fw_Radar_1R1V_rpc_LocBypassingRunnable_LocBypassingRunnable_m_pad_ensRLocationsPort_par_out_local.TChangeableMemPool._._._m_arrayPool._0_._elem._m_LocationList._Item._56_._measStatus "" VALUE 0xB0010735 __UByte_Value 0 NO_COMPU_METHOD 0 255 ECU_ADDRESS_EXTENSION 0x2 BYTE_ORDER MSB_LAST /end CHARACTERISTIC
/begin CHARACTERISTIC _g_PL_AD_fw_Radar_1R1V_rpc_LocBypassingRunnable_LocBypassingRunnable_m_pad_ensRLocationsPort_par_out_local.TChangeableMemPool._._._m_arrayPool._0_._elem._m_LocationList._Item._56_._phi._m_value "" VALUE 0xB0010728 __Float16_Value 0 NO_COMPU_METHOD -65504 65504 ECU_ADDRESS_EXTENSION 0x2 BYTE_ORDER MSB_LAST /end CHARACTERISTIC
/begin CHARACTERISTIC _g_PL_AD_fw_Radar_1R1V_rpc_LocBypassingRunnable_LocBypassingRunnable_m_pad_ensRLocationsPort_par_out_local.TChangeableMemPool._._._m_arrayPool._0_._elem._m_LocationList._Item._56_._phiQly "" VALUE 0xB001072B __UByte_Value 0 NO_COMPU_METHOD 0 255 ECU_ADDRESS_EXTENSION 0x2 BYTE_ORDER MSB_LAST /end CHARACTERISTIC
/begin CHARACTERISTIC _g_PL_AD_fw_Radar_1R1V_rpc_LocBypassingRunnable_LocBypassingRunnable_m_pad_ensRLocationsPort_par_out_local.TChangeableMemPool._._._m_arrayPool._0_._elem._m_LocationList._Item._56_._phiVar._m_value "" VALUE 0xB001072E __Float16_Value 0 NO_COMPU_METHOD -65504 65504 ECU_ADDRESS_EXTENSION 0x2 BYTE_ORDER MSB_LAST /end CHARACTERISTIC
/begin CHARACTERISTIC _g_PL_AD_fw_Radar_1R1V_rpc_LocBypassingRunnable_LocBypassingRunnable_m_pad_ensRLocationsPort_par_out_local.TChangeableMemPool._._._m_arrayPool._0_._elem._m_LocationList._Item._56_._theta._m_value "" VALUE 0xB0010726 __Float16_Value 0 NO_COMPU_METHOD -65504 65504 ECU_ADDRESS_EXTENSION 0x2 BYTE_ORDER MSB_LAST /end CHARACTERISTIC
/begin CHARACTERISTIC _g_PL_AD_fw_Radar_1R1V_rpc_LocBypassingRunnable_LocBypassingRunnable_m_pad_ensRLocationsPort_par_out_local.TChangeableMemPool._._._m_arrayPool._0_._elem._m_LocationList._Item._56_._thetaQly "" VALUE 0xB001072A __UByte_Value 0 NO_COMPU_METHOD 0 255 ECU_ADDRESS_EXTENSION 0x2 BYTE_ORDER MSB_LAST /end CHARACTERISTIC
/begin CHARACTERISTIC _g_PL_AD_fw_Radar_1R1V_rpc_LocBypassingRunnable_LocBypassingRunnable_m_pad_ensRLocationsPort_par_out_local.TChangeableMemPool._._._m_arrayPool._0_._elem._m_LocationList._Item._56_._thetaVar._m_value "" VALUE 0xB001072C __Float16_Value 0 NO_COMPU_METHOD -65504 65504 ECU_ADDRESS_EXTENSION 0x2 BYTE_ORDER MSB_LAST /end CHARACTERISTIC
/begin CHARACTERISTIC _g_PL_AD_fw_Radar_1R1V_rpc_LocBypassingRunnable_LocBypassingRunnable_m_pad_ensRLocationsPort_par_out_local.TChangeableMemPool._._._m_arrayPool._0_._elem._m_LocationList._Item._56_._v "" VALUE 0xB001071C __Float32_Value 0 NO_COMPU_METHOD -3.4028234663852886E+38 3.4028234663852886E+38 ECU_ADDRESS_EXTENSION 0x2 BYTE_ORDER MSB_LAST /end CHARACTERISTIC
/begin CHARACTERISTIC _g_PL_AD_fw_Radar_1R1V_rpc_LocBypassingRunnable_LocBypassingRunnable_m_pad_ensRLocationsPort_par_out_local.TChangeableMemPool._._._m_arrayPool._0_._elem._m_LocationList._Item._56_._vVar._m_value "" VALUE 0xB0010722 __Float16_Value 0 NO_COMPU_METHOD -65504 65504 ECU_ADDRESS_EXTENSION 0x2 BYTE_ORDER MSB_LAST /end CHARACTERISTIC
/begin CHARACTERISTIC _g_PL_AD_fw_Radar_1R1V_rpc_LocBypassingRunnable_LocBypassingRunnable_m_pad_ensRLocationsPort_par_out_local.TChangeableMemPool._._._m_arrayPool._0_._elem._m_LocationList._Item._57_._Rcs._m_value "" VALUE 0xB0010750 __Float16_Value 0 NO_COMPU_METHOD -65504 65504 ECU_ADDRESS_EXTENSION 0x2 BYTE_ORDER MSB_LAST /end CHARACTERISTIC
/begin CHARACTERISTIC _g_PL_AD_fw_Radar_1R1V_rpc_LocBypassingRunnable_LocBypassingRunnable_m_pad_ensRLocationsPort_par_out_local.TChangeableMemPool._._._m_arrayPool._0_._elem._m_LocationList._Item._57_._Rssi._m_value "" VALUE 0xB0010752 __Float16_Value 0 NO_COMPU_METHOD -65504 65504 ECU_ADDRESS_EXTENSION 0x2 BYTE_ORDER MSB_LAST /end CHARACTERISTIC
/begin CHARACTERISTIC _g_PL_AD_fw_Radar_1R1V_rpc_LocBypassingRunnable_LocBypassingRunnable_m_pad_ensRLocationsPort_par_out_local.TChangeableMemPool._._._m_arrayPool._0_._elem._m_LocationList._Item._57_._d "" VALUE 0xB0010738 __Float32_Value 0 NO_COMPU_METHOD -3.4028234663852886E+38 3.4028234663852886E+38 ECU_ADDRESS_EXTENSION 0x2 BYTE_ORDER MSB_LAST /end CHARACTERISTIC
/begin CHARACTERISTIC _g_PL_AD_fw_Radar_1R1V_rpc_LocBypassingRunnable_LocBypassingRunnable_m_pad_ensRLocationsPort_par_out_local.TChangeableMemPool._._._m_arrayPool._0_._elem._m_LocationList._Item._57_._dVar._m_value "" VALUE 0xB0010740 __Float16_Value 0 NO_COMPU_METHOD -65504 65504 ECU_ADDRESS_EXTENSION 0x2 BYTE_ORDER MSB_LAST /end CHARACTERISTIC
/begin CHARACTERISTIC _g_PL_AD_fw_Radar_1R1V_rpc_LocBypassingRunnable_LocBypassingRunnable_m_pad_ensRLocationsPort_par_out_local.TChangeableMemPool._._._m_arrayPool._0_._elem._m_LocationList._Item._57_._dvCov._m_value "" VALUE 0xB0010744 __Float16_Value 0 NO_COMPU_METHOD -65504 65504 ECU_ADDRESS_EXTENSION 0x2 BYTE_ORDER MSB_LAST /end CHARACTERISTIC
/begin CHARACTERISTIC _g_PL_AD_fw_Radar_1R1V_rpc_LocBypassingRunnable_LocBypassingRunnable_m_pad_ensRLocationsPort_par_out_local.TChangeableMemPool._._._m_arrayPool._0_._elem._m_LocationList._Item._57_._dvQly "" VALUE 0xB0010754 __UByte_Value 0 NO_COMPU_METHOD 0 255 ECU_ADDRESS_EXTENSION 0x2 BYTE_ORDER MSB_LAST /end CHARACTERISTIC
/begin CHARACTERISTIC _g_PL_AD_fw_Radar_1R1V_rpc_LocBypassingRunnable_LocBypassingRunnable_m_pad_ensRLocationsPort_par_out_local.TChangeableMemPool._._._m_arrayPool._0_._elem._m_LocationList._Item._57_._idxAzimuthAmbiguityPeer "" VALUE 0xB0010756 __UWord_Value 0 NO_COMPU_METHOD 0 65535 ECU_ADDRESS_EXTENSION 0x2 BYTE_ORDER MSB_LAST /end CHARACTERISTIC
/begin CHARACTERISTIC _g_PL_AD_fw_Radar_1R1V_rpc_LocBypassingRunnable_LocBypassingRunnable_m_pad_ensRLocationsPort_par_out_local.TChangeableMemPool._._._m_arrayPool._0_._elem._m_LocationList._Item._57_._measStatus "" VALUE 0xB0010755 __UByte_Value 0 NO_COMPU_METHOD 0 255 ECU_ADDRESS_EXTENSION 0x2 BYTE_ORDER MSB_LAST /end CHARACTERISTIC
/begin CHARACTERISTIC _g_PL_AD_fw_Radar_1R1V_rpc_LocBypassingRunnable_LocBypassingRunnable_m_pad_ensRLocationsPort_par_out_local.TChangeableMemPool._._._m_arrayPool._0_._elem._m_LocationList._Item._57_._phi._m_value "" VALUE 0xB0010748 __Float16_Value 0 NO_COMPU_METHOD -65504 65504 ECU_ADDRESS_EXTENSION 0x2 BYTE_ORDER MSB_LAST /end CHARACTERISTIC
/begin CHARACTERISTIC _g_PL_AD_fw_Radar_1R1V_rpc_LocBypassingRunnable_LocBypassingRunnable_m_pad_ensRLocationsPort_par_out_local.TChangeableMemPool._._._m_arrayPool._0_._elem._m_LocationList._Item._57_._phiQly "" VALUE 0xB001074B __UByte_Value 0 NO_COMPU_METHOD 0 255 ECU_ADDRESS_EXTENSION 0x2 BYTE_ORDER MSB_LAST /end CHARACTERISTIC
/begin CHARACTERISTIC _g_PL_AD_fw_Radar_1R1V_rpc_LocBypassingRunnable_LocBypassingRunnable_m_pad_ensRLocationsPort_par_out_local.TChangeableMemPool._._._m_arrayPool._0_._elem._m_LocationList._Item._57_._phiVar._m_value "" VALUE 0xB001074E __Float16_Value 0 NO_COMPU_METHOD -65504 65504 ECU_ADDRESS_EXTENSION 0x2 BYTE_ORDER MSB_LAST /end CHARACTERISTIC
/begin CHARACTERISTIC _g_PL_AD_fw_Radar_1R1V_rpc_LocBypassingRunnable_LocBypassingRunnable_m_pad_ensRLocationsPort_par_out_local.TChangeableMemPool._._._m_arrayPool._0_._elem._m_LocationList._Item._57_._theta._m_value "" VALUE 0xB0010746 __Float16_Value 0 NO_COMPU_METHOD -65504 65504 ECU_ADDRESS_EXTENSION 0x2 BYTE_ORDER MSB_LAST /end CHARACTERISTIC
/begin CHARACTERISTIC _g_PL_AD_fw_Radar_1R1V_rpc_LocBypassingRunnable_LocBypassingRunnable_m_pad_ensRLocationsPort_par_out_local.TChangeableMemPool._._._m_arrayPool._0_._elem._m_LocationList._Item._57_._thetaQly "" VALUE 0xB001074A __UByte_Value 0 NO_COMPU_METHOD 0 255 ECU_ADDRESS_EXTENSION 0x2 BYTE_ORDER MSB_LAST /end CHARACTERISTIC
/begin CHARACTERISTIC _g_PL_AD_fw_Radar_1R1V_rpc_LocBypassingRunnable_LocBypassingRunnable_m_pad_ensRLocationsPort_par_out_local.TChangeableMemPool._._._m_arrayPool._0_._elem._m_LocationList._Item._57_._thetaVar._m_value "" VALUE 0xB001074C __Float16_Value 0 NO_COMPU_METHOD -65504 65504 ECU_ADDRESS_EXTENSION 0x2 BYTE_ORDER MSB_LAST /end CHARACTERISTIC
/begin CHARACTERISTIC _g_PL_AD_fw_Radar_1R1V_rpc_LocBypassingRunnable_LocBypassingRunnable_m_pad_ensRLocationsPort_par_out_local.TChangeableMemPool._._._m_arrayPool._0_._elem._m_LocationList._Item._57_._v "" VALUE 0xB001073C __Float32_Value 0 NO_COMPU_METHOD -3.4028234663852886E+38 3.4028234663852886E+38 ECU_ADDRESS_EXTENSION 0x2 BYTE_ORDER MSB_LAST /end CHARACTERISTIC
/begin CHARACTERISTIC _g_PL_AD_fw_Radar_1R1V_rpc_LocBypassingRunnable_LocBypassingRunnable_m_pad_ensRLocationsPort_par_out_local.TChangeableMemPool._._._m_arrayPool._0_._elem._m_LocationList._Item._57_._vVar._m_value "" VALUE 0xB0010742 __Float16_Value 0 NO_COMPU_METHOD -65504 65504 ECU_ADDRESS_EXTENSION 0x2 BYTE_ORDER MSB_LAST /end CHARACTERISTIC
/begin CHARACTERISTIC _g_PL_AD_fw_Radar_1R1V_rpc_LocBypassingRunnable_LocBypassingRunnable_m_pad_ensRLocationsPort_par_out_local.TChangeableMemPool._._._m_arrayPool._0_._elem._m_LocationList._Item._58_._Rcs._m_value "" VALUE 0xB0010770 __Float16_Value 0 NO_COMPU_METHOD -65504 65504 ECU_ADDRESS_EXTENSION 0x2 BYTE_ORDER MSB_LAST /end CHARACTERISTIC
/begin CHARACTERISTIC _g_PL_AD_fw_Radar_1R1V_rpc_LocBypassingRunnable_LocBypassingRunnable_m_pad_ensRLocationsPort_par_out_local.TChangeableMemPool._._._m_arrayPool._0_._elem._m_LocationList._Item._58_._Rssi._m_value "" VALUE 0xB0010772 __Float16_Value 0 NO_COMPU_METHOD -65504 65504 ECU_ADDRESS_EXTENSION 0x2 BYTE_ORDER MSB_LAST /end CHARACTERISTIC
/begin CHARACTERISTIC _g_PL_AD_fw_Radar_1R1V_rpc_LocBypassingRunnable_LocBypassingRunnable_m_pad_ensRLocationsPort_par_out_local.TChangeableMemPool._._._m_arrayPool._0_._elem._m_LocationList._Item._58_._d "" VALUE 0xB0010758 __Float32_Value 0 NO_COMPU_METHOD -3.4028234663852886E+38 3.4028234663852886E+38 ECU_ADDRESS_EXTENSION 0x2 BYTE_ORDER MSB_LAST /end CHARACTERISTIC
/begin CHARACTERISTIC _g_PL_AD_fw_Radar_1R1V_rpc_LocBypassingRunnable_LocBypassingRunnable_m_pad_ensRLocationsPort_par_out_local.TChangeableMemPool._._._m_arrayPool._0_._elem._m_LocationList._Item._58_._dVar._m_value "" VALUE 0xB0010760 __Float16_Value 0 NO_COMPU_METHOD -65504 65504 ECU_ADDRESS_EXTENSION 0x2 BYTE_ORDER MSB_LAST /end CHARACTERISTIC
/begin CHARACTERISTIC _g_PL_AD_fw_Radar_1R1V_rpc_LocBypassingRunnable_LocBypassingRunnable_m_pad_ensRLocationsPort_par_out_local.TChangeableMemPool._._._m_arrayPool._0_._elem._m_LocationList._Item._58_._dvCov._m_value "" VALUE 0xB0010764 __Float16_Value 0 NO_COMPU_METHOD -65504 65504 ECU_ADDRESS_EXTENSION 0x2 BYTE_ORDER MSB_LAST /end CHARACTERISTIC
/begin CHARACTERISTIC _g_PL_AD_fw_Radar_1R1V_rpc_LocBypassingRunnable_LocBypassingRunnable_m_pad_ensRLocationsPort_par_out_local.TChangeableMemPool._._._m_arrayPool._0_._elem._m_LocationList._Item._58_._dvQly "" VALUE 0xB0010774 __UByte_Value 0 NO_COMPU_METHOD 0 255 ECU_ADDRESS_EXTENSION 0x2 BYTE_ORDER MSB_LAST /end CHARACTERISTIC
/begin CHARACTERISTIC _g_PL_AD_fw_Radar_1R1V_rpc_LocBypassingRunnable_LocBypassingRunnable_m_pad_ensRLocationsPort_par_out_local.TChangeableMemPool._._._m_arrayPool._0_._elem._m_LocationList._Item._58_._idxAzimuthAmbiguityPeer "" VALUE 0xB0010776 __UWord_Value 0 NO_COMPU_METHOD 0 65535 ECU_ADDRESS_EXTENSION 0x2 BYTE_ORDER MSB_LAST /end CHARACTERISTIC
/begin CHARACTERISTIC _g_PL_AD_fw_Radar_1R1V_rpc_LocBypassingRunnable_LocBypassingRunnable_m_pad_ensRLocationsPort_par_out_local.TChangeableMemPool._._._m_arrayPool._0_._elem._m_LocationList._Item._58_._measStatus "" VALUE 0xB0010775 __UByte_Value 0 NO_COMPU_METHOD 0 255 ECU_ADDRESS_EXTENSION 0x2 BYTE_ORDER MSB_LAST /end CHARACTERISTIC
/begin CHARACTERISTIC _g_PL_AD_fw_Radar_1R1V_rpc_LocBypassingRunnable_LocBypassingRunnable_m_pad_ensRLocationsPort_par_out_local.TChangeableMemPool._._._m_arrayPool._0_._elem._m_LocationList._Item._58_._phi._m_value "" VALUE 0xB0010768 __Float16_Value 0 NO_COMPU_METHOD -65504 65504 ECU_ADDRESS_EXTENSION 0x2 BYTE_ORDER MSB_LAST /end CHARACTERISTIC
/begin CHARACTERISTIC _g_PL_AD_fw_Radar_1R1V_rpc_LocBypassingRunnable_LocBypassingRunnable_m_pad_ensRLocationsPort_par_out_local.TChangeableMemPool._._._m_arrayPool._0_._elem._m_LocationList._Item._58_._phiQly "" VALUE 0xB001076B __UByte_Value 0 NO_COMPU_METHOD 0 255 ECU_ADDRESS_EXTENSION 0x2 BYTE_ORDER MSB_LAST /end CHARACTERISTIC
/begin CHARACTERISTIC _g_PL_AD_fw_Radar_1R1V_rpc_LocBypassingRunnable_LocBypassingRunnable_m_pad_ensRLocationsPort_par_out_local.TChangeableMemPool._._._m_arrayPool._0_._elem._m_LocationList._Item._58_._phiVar._m_value "" VALUE 0xB001076E __Float16_Value 0 NO_COMPU_METHOD -65504 65504 ECU_ADDRESS_EXTENSION 0x2 BYTE_ORDER MSB_LAST /end CHARACTERISTIC
/begin CHARACTERISTIC _g_PL_AD_fw_Radar_1R1V_rpc_LocBypassingRunnable_LocBypassingRunnable_m_pad_ensRLocationsPort_par_out_local.TChangeableMemPool._._._m_arrayPool._0_._elem._m_LocationList._Item._58_._theta._m_value "" VALUE 0xB0010766 __Float16_Value 0 NO_COMPU_METHOD -65504 65504 ECU_ADDRESS_EXTENSION 0x2 BYTE_ORDER MSB_LAST /end CHARACTERISTIC
/begin CHARACTERISTIC _g_PL_AD_fw_Radar_1R1V_rpc_LocBypassingRunnable_LocBypassingRunnable_m_pad_ensRLocationsPort_par_out_local.TChangeableMemPool._._._m_arrayPool._0_._elem._m_LocationList._Item._58_._thetaQly "" VALUE 0xB001076A __UByte_Value 0 NO_COMPU_METHOD 0 255 ECU_ADDRESS_EXTENSION 0x2 BYTE_ORDER MSB_LAST /end CHARACTERISTIC
/begin CHARACTERISTIC _g_PL_AD_fw_Radar_1R1V_rpc_LocBypassingRunnable_LocBypassingRunnable_m_pad_ensRLocationsPort_par_out_local.TChangeableMemPool._._._m_arrayPool._0_._elem._m_LocationList._Item._58_._thetaVar._m_value "" VALUE 0xB001076C __Float16_Value 0 NO_COMPU_METHOD -65504 65504 ECU_ADDRESS_EXTENSION 0x2 BYTE_ORDER MSB_LAST /end CHARACTERISTIC
/begin CHARACTERISTIC _g_PL_AD_fw_Radar_1R1V_rpc_LocBypassingRunnable_LocBypassingRunnable_m_pad_ensRLocationsPort_par_out_local.TChangeableMemPool._._._m_arrayPool._0_._elem._m_LocationList._Item._58_._v "" VALUE 0xB001075C __Float32_Value 0 NO_COMPU_METHOD -3.4028234663852886E+38 3.4028234663852886E+38 ECU_ADDRESS_EXTENSION 0x2 BYTE_ORDER MSB_LAST /end CHARACTERISTIC
/begin CHARACTERISTIC _g_PL_AD_fw_Radar_1R1V_rpc_LocBypassingRunnable_LocBypassingRunnable_m_pad_ensRLocationsPort_par_out_local.TChangeableMemPool._._._m_arrayPool._0_._elem._m_LocationList._Item._58_._vVar._m_value "" VALUE 0xB0010762 __Float16_Value 0 NO_COMPU_METHOD -65504 65504 ECU_ADDRESS_EXTENSION 0x2 BYTE_ORDER MSB_LAST /end CHARACTERISTIC
/begin CHARACTERISTIC _g_PL_AD_fw_Radar_1R1V_rpc_LocBypassingRunnable_LocBypassingRunnable_m_pad_ensRLocationsPort_par_out_local.TChangeableMemPool._._._m_arrayPool._0_._elem._m_LocationList._Item._59_._Rcs._m_value "" VALUE 0xB0010790 __Float16_Value 0 NO_COMPU_METHOD -65504 65504 ECU_ADDRESS_EXTENSION 0x2 BYTE_ORDER MSB_LAST /end CHARACTERISTIC
/begin CHARACTERISTIC _g_PL_AD_fw_Radar_1R1V_rpc_LocBypassingRunnable_LocBypassingRunnable_m_pad_ensRLocationsPort_par_out_local.TChangeableMemPool._._._m_arrayPool._0_._elem._m_LocationList._Item._59_._Rssi._m_value "" VALUE 0xB0010792 __Float16_Value 0 NO_COMPU_METHOD -65504 65504 ECU_ADDRESS_EXTENSION 0x2 BYTE_ORDER MSB_LAST /end CHARACTERISTIC
/begin CHARACTERISTIC _g_PL_AD_fw_Radar_1R1V_rpc_LocBypassingRunnable_LocBypassingRunnable_m_pad_ensRLocationsPort_par_out_local.TChangeableMemPool._._._m_arrayPool._0_._elem._m_LocationList._Item._59_._d "" VALUE 0xB0010778 __Float32_Value 0 NO_COMPU_METHOD -3.4028234663852886E+38 3.4028234663852886E+38 ECU_ADDRESS_EXTENSION 0x2 BYTE_ORDER MSB_LAST /end CHARACTERISTIC
/begin CHARACTERISTIC _g_PL_AD_fw_Radar_1R1V_rpc_LocBypassingRunnable_LocBypassingRunnable_m_pad_ensRLocationsPort_par_out_local.TChangeableMemPool._._._m_arrayPool._0_._elem._m_LocationList._Item._59_._dVar._m_value "" VALUE 0xB0010780 __Float16_Value 0 NO_COMPU_METHOD -65504 65504 ECU_ADDRESS_EXTENSION 0x2 BYTE_ORDER MSB_LAST /end CHARACTERISTIC
/begin CHARACTERISTIC _g_PL_AD_fw_Radar_1R1V_rpc_LocBypassingRunnable_LocBypassingRunnable_m_pad_ensRLocationsPort_par_out_local.TChangeableMemPool._._._m_arrayPool._0_._elem._m_LocationList._Item._59_._dvCov._m_value "" VALUE 0xB0010784 __Float16_Value 0 NO_COMPU_METHOD -65504 65504 ECU_ADDRESS_EXTENSION 0x2 BYTE_ORDER MSB_LAST /end CHARACTERISTIC
/begin CHARACTERISTIC _g_PL_AD_fw_Radar_1R1V_rpc_LocBypassingRunnable_LocBypassingRunnable_m_pad_ensRLocationsPort_par_out_local.TChangeableMemPool._._._m_arrayPool._0_._elem._m_LocationList._Item._59_._dvQly "" VALUE 0xB0010794 __UByte_Value 0 NO_COMPU_METHOD 0 255 ECU_ADDRESS_EXTENSION 0x2 BYTE_ORDER MSB_LAST /end CHARACTERISTIC
/begin CHARACTERISTIC _g_PL_AD_fw_Radar_1R1V_rpc_LocBypassingRunnable_LocBypassingRunnable_m_pad_ensRLocationsPort_par_out_local.TChangeableMemPool._._._m_arrayPool._0_._elem._m_LocationList._Item._59_._idxAzimuthAmbiguityPeer "" VALUE 0xB0010796 __UWord_Value 0 NO_COMPU_METHOD 0 65535 ECU_ADDRESS_EXTENSION 0x2 BYTE_ORDER MSB_LAST /end CHARACTERISTIC
/begin CHARACTERISTIC _g_PL_AD_fw_Radar_1R1V_rpc_LocBypassingRunnable_LocBypassingRunnable_m_pad_ensRLocationsPort_par_out_local.TChangeableMemPool._._._m_arrayPool._0_._elem._m_LocationList._Item._59_._measStatus "" VALUE 0xB0010795 __UByte_Value 0 NO_COMPU_METHOD 0 255 ECU_ADDRESS_EXTENSION 0x2 BYTE_ORDER MSB_LAST /end CHARACTERISTIC
/begin CHARACTERISTIC _g_PL_AD_fw_Radar_1R1V_rpc_LocBypassingRunnable_LocBypassingRunnable_m_pad_ensRLocationsPort_par_out_local.TChangeableMemPool._._._m_arrayPool._0_._elem._m_LocationList._Item._59_._phi._m_value "" VALUE 0xB0010788 __Float16_Value 0 NO_COMPU_METHOD -65504 65504 ECU_ADDRESS_EXTENSION 0x2 BYTE_ORDER MSB_LAST /end CHARACTERISTIC
/begin CHARACTERISTIC _g_PL_AD_fw_Radar_1R1V_rpc_LocBypassingRunnable_LocBypassingRunnable_m_pad_ensRLocationsPort_par_out_local.TChangeableMemPool._._._m_arrayPool._0_._elem._m_LocationList._Item._59_._phiQly "" VALUE 0xB001078B __UByte_Value 0 NO_COMPU_METHOD 0 255 ECU_ADDRESS_EXTENSION 0x2 BYTE_ORDER MSB_LAST /end CHARACTERISTIC
/begin CHARACTERISTIC _g_PL_AD_fw_Radar_1R1V_rpc_LocBypassingRunnable_LocBypassingRunnable_m_pad_ensRLocationsPort_par_out_local.TChangeableMemPool._._._m_arrayPool._0_._elem._m_LocationList._Item._59_._phiVar._m_value "" VALUE 0xB001078E __Float16_Value 0 NO_COMPU_METHOD -65504 65504 ECU_ADDRESS_EXTENSION 0x2 BYTE_ORDER MSB_LAST /end CHARACTERISTIC
/begin CHARACTERISTIC _g_PL_AD_fw_Radar_1R1V_rpc_LocBypassingRunnable_LocBypassingRunnable_m_pad_ensRLocationsPort_par_out_local.TChangeableMemPool._._._m_arrayPool._0_._elem._m_LocationList._Item._59_._theta._m_value "" VALUE 0xB0010786 __Float16_Value 0 NO_COMPU_METHOD -65504 65504 ECU_ADDRESS_EXTENSION 0x2 BYTE_ORDER MSB_LAST /end CHARACTERISTIC
/begin CHARACTERISTIC _g_PL_AD_fw_Radar_1R1V_rpc_LocBypassingRunnable_LocBypassingRunnable_m_pad_ensRLocationsPort_par_out_local.TChangeableMemPool._._._m_arrayPool._0_._elem._m_LocationList._Item._59_._thetaQly "" VALUE 0xB001078A __UByte_Value 0 NO_COMPU_METHOD 0 255 ECU_ADDRESS_EXTENSION 0x2 BYTE_ORDER MSB_LAST /end CHARACTERISTIC
/begin CHARACTERISTIC _g_PL_AD_fw_Radar_1R1V_rpc_LocBypassingRunnable_LocBypassingRunnable_m_pad_ensRLocationsPort_par_out_local.TChangeableMemPool._._._m_arrayPool._0_._elem._m_LocationList._Item._59_._thetaVar._m_value "" VALUE 0xB001078C __Float16_Value 0 NO_COMPU_METHOD -65504 65504 ECU_ADDRESS_EXTENSION 0x2 BYTE_ORDER MSB_LAST /end CHARACTERISTIC
/begin CHARACTERISTIC _g_PL_AD_fw_Radar_1R1V_rpc_LocBypassingRunnable_LocBypassingRunnable_m_pad_ensRLocationsPort_par_out_local.TChangeableMemPool._._._m_arrayPool._0_._elem._m_LocationList._Item._59_._v "" VALUE 0xB001077C __Float32_Value 0 NO_COMPU_METHOD -3.4028234663852886E+38 3.4028234663852886E+38 ECU_ADDRESS_EXTENSION 0x2 BYTE_ORDER MSB_LAST /end CHARACTERISTIC
/begin CHARACTERISTIC _g_PL_AD_fw_Radar_1R1V_rpc_LocBypassingRunnable_LocBypassingRunnable_m_pad_ensRLocationsPort_par_out_local.TChangeableMemPool._._._m_arrayPool._0_._elem._m_LocationList._Item._59_._vVar._m_value "" VALUE 0xB0010782 __Float16_Value 0 NO_COMPU_METHOD -65504 65504 ECU_ADDRESS_EXTENSION 0x2 BYTE_ORDER MSB_LAST /end CHARACTERISTIC
/begin CHARACTERISTIC _g_PL_AD_fw_Radar_1R1V_rpc_LocBypassingRunnable_LocBypassingRunnable_m_pad_ensRLocationsPort_par_out_local.TChangeableMemPool._._._m_arrayPool._0_._elem._m_LocationList._Item._5_._Rcs._m_value "" VALUE 0xB00100D0 __Float16_Value 0 NO_COMPU_METHOD -65504 65504 ECU_ADDRESS_EXTENSION 0x2 BYTE_ORDER MSB_LAST /end CHARACTERISTIC
/begin CHARACTERISTIC _g_PL_AD_fw_Radar_1R1V_rpc_LocBypassingRunnable_LocBypassingRunnable_m_pad_ensRLocationsPort_par_out_local.TChangeableMemPool._._._m_arrayPool._0_._elem._m_LocationList._Item._5_._Rssi._m_value "" VALUE 0xB00100D2 __Float16_Value 0 NO_COMPU_METHOD -65504 65504 ECU_ADDRESS_EXTENSION 0x2 BYTE_ORDER MSB_LAST /end CHARACTERISTIC
/begin CHARACTERISTIC _g_PL_AD_fw_Radar_1R1V_rpc_LocBypassingRunnable_LocBypassingRunnable_m_pad_ensRLocationsPort_par_out_local.TChangeableMemPool._._._m_arrayPool._0_._elem._m_LocationList._Item._5_._d "" VALUE 0xB00100B8 __Float32_Value 0 NO_COMPU_METHOD -3.4028234663852886E+38 3.4028234663852886E+38 ECU_ADDRESS_EXTENSION 0x2 BYTE_ORDER MSB_LAST /end CHARACTERISTIC
/begin CHARACTERISTIC _g_PL_AD_fw_Radar_1R1V_rpc_LocBypassingRunnable_LocBypassingRunnable_m_pad_ensRLocationsPort_par_out_local.TChangeableMemPool._._._m_arrayPool._0_._elem._m_LocationList._Item._5_._dVar._m_value "" VALUE 0xB00100C0 __Float16_Value 0 NO_COMPU_METHOD -65504 65504 ECU_ADDRESS_EXTENSION 0x2 BYTE_ORDER MSB_LAST /end CHARACTERISTIC
/begin CHARACTERISTIC _g_PL_AD_fw_Radar_1R1V_rpc_LocBypassingRunnable_LocBypassingRunnable_m_pad_ensRLocationsPort_par_out_local.TChangeableMemPool._._._m_arrayPool._0_._elem._m_LocationList._Item._5_._dvCov._m_value "" VALUE 0xB00100C4 __Float16_Value 0 NO_COMPU_METHOD -65504 65504 ECU_ADDRESS_EXTENSION 0x2 BYTE_ORDER MSB_LAST /end CHARACTERISTIC
/begin CHARACTERISTIC _g_PL_AD_fw_Radar_1R1V_rpc_LocBypassingRunnable_LocBypassingRunnable_m_pad_ensRLocationsPort_par_out_local.TChangeableMemPool._._._m_arrayPool._0_._elem._m_LocationList._Item._5_._dvQly "" VALUE 0xB00100D4 __UByte_Value 0 NO_COMPU_METHOD 0 255 ECU_ADDRESS_EXTENSION 0x2 BYTE_ORDER MSB_LAST /end CHARACTERISTIC
/begin CHARACTERISTIC _g_PL_AD_fw_Radar_1R1V_rpc_LocBypassingRunnable_LocBypassingRunnable_m_pad_ensRLocationsPort_par_out_local.TChangeableMemPool._._._m_arrayPool._0_._elem._m_LocationList._Item._5_._idxAzimuthAmbiguityPeer "" VALUE 0xB00100D6 __UWord_Value 0 NO_COMPU_METHOD 0 65535 ECU_ADDRESS_EXTENSION 0x2 BYTE_ORDER MSB_LAST /end CHARACTERISTIC
/begin CHARACTERISTIC _g_PL_AD_fw_Radar_1R1V_rpc_LocBypassingRunnable_LocBypassingRunnable_m_pad_ensRLocationsPort_par_out_local.TChangeableMemPool._._._m_arrayPool._0_._elem._m_LocationList._Item._5_._measStatus "" VALUE 0xB00100D5 __UByte_Value 0 NO_COMPU_METHOD 0 255 ECU_ADDRESS_EXTENSION 0x2 BYTE_ORDER MSB_LAST /end CHARACTERISTIC
/begin CHARACTERISTIC _g_PL_AD_fw_Radar_1R1V_rpc_LocBypassingRunnable_LocBypassingRunnable_m_pad_ensRLocationsPort_par_out_local.TChangeableMemPool._._._m_arrayPool._0_._elem._m_LocationList._Item._5_._phi._m_value "" VALUE 0xB00100C8 __Float16_Value 0 NO_COMPU_METHOD -65504 65504 ECU_ADDRESS_EXTENSION 0x2 BYTE_ORDER MSB_LAST /end CHARACTERISTIC
/begin CHARACTERISTIC _g_PL_AD_fw_Radar_1R1V_rpc_LocBypassingRunnable_LocBypassingRunnable_m_pad_ensRLocationsPort_par_out_local.TChangeableMemPool._._._m_arrayPool._0_._elem._m_LocationList._Item._5_._phiQly "" VALUE 0xB00100CB __UByte_Value 0 NO_COMPU_METHOD 0 255 ECU_ADDRESS_EXTENSION 0x2 BYTE_ORDER MSB_LAST /end CHARACTERISTIC
/begin CHARACTERISTIC _g_PL_AD_fw_Radar_1R1V_rpc_LocBypassingRunnable_LocBypassingRunnable_m_pad_ensRLocationsPort_par_out_local.TChangeableMemPool._._._m_arrayPool._0_._elem._m_LocationList._Item._5_._phiVar._m_value "" VALUE 0xB00100CE __Float16_Value 0 NO_COMPU_METHOD -65504 65504 ECU_ADDRESS_EXTENSION 0x2 BYTE_ORDER MSB_LAST /end CHARACTERISTIC
/begin CHARACTERISTIC _g_PL_AD_fw_Radar_1R1V_rpc_LocBypassingRunnable_LocBypassingRunnable_m_pad_ensRLocationsPort_par_out_local.TChangeableMemPool._._._m_arrayPool._0_._elem._m_LocationList._Item._5_._theta._m_value "" VALUE 0xB00100C6 __Float16_Value 0 NO_COMPU_METHOD -65504 65504 ECU_ADDRESS_EXTENSION 0x2 BYTE_ORDER MSB_LAST /end CHARACTERISTIC
/begin CHARACTERISTIC _g_PL_AD_fw_Radar_1R1V_rpc_LocBypassingRunnable_LocBypassingRunnable_m_pad_ensRLocationsPort_par_out_local.TChangeableMemPool._._._m_arrayPool._0_._elem._m_LocationList._Item._5_._thetaQly "" VALUE 0xB00100CA __UByte_Value 0 NO_COMPU_METHOD 0 255 ECU_ADDRESS_EXTENSION 0x2 BYTE_ORDER MSB_LAST /end CHARACTERISTIC
/begin CHARACTERISTIC _g_PL_AD_fw_Radar_1R1V_rpc_LocBypassingRunnable_LocBypassingRunnable_m_pad_ensRLocationsPort_par_out_local.TChangeableMemPool._._._m_arrayPool._0_._elem._m_LocationList._Item._5_._thetaVar._m_value "" VALUE 0xB00100CC __Float16_Value 0 NO_COMPU_METHOD -65504 65504 ECU_ADDRESS_EXTENSION 0x2 BYTE_ORDER MSB_LAST /end CHARACTERISTIC
/begin CHARACTERISTIC _g_PL_AD_fw_Radar_1R1V_rpc_LocBypassingRunnable_LocBypassingRunnable_m_pad_ensRLocationsPort_par_out_local.TChangeableMemPool._._._m_arrayPool._0_._elem._m_LocationList._Item._5_._v "" VALUE 0xB00100BC __Float32_Value 0 NO_COMPU_METHOD -3.4028234663852886E+38 3.4028234663852886E+38 ECU_ADDRESS_EXTENSION 0x2 BYTE_ORDER MSB_LAST /end CHARACTERISTIC
/begin CHARACTERISTIC _g_PL_AD_fw_Radar_1R1V_rpc_LocBypassingRunnable_LocBypassingRunnable_m_pad_ensRLocationsPort_par_out_local.TChangeableMemPool._._._m_arrayPool._0_._elem._m_LocationList._Item._5_._vVar._m_value "" VALUE 0xB00100C2 __Float16_Value 0 NO_COMPU_METHOD -65504 65504 ECU_ADDRESS_EXTENSION 0x2 BYTE_ORDER MSB_LAST /end CHARACTERISTIC
/begin CHARACTERISTIC _g_PL_AD_fw_Radar_1R1V_rpc_LocBypassingRunnable_LocBypassingRunnable_m_pad_ensRLocationsPort_par_out_local.TChangeableMemPool._._._m_arrayPool._0_._elem._m_LocationList._Item._60_._Rcs._m_value "" VALUE 0xB00107B0 __Float16_Value 0 NO_COMPU_METHOD -65504 65504 ECU_ADDRESS_EXTENSION 0x2 BYTE_ORDER MSB_LAST /end CHARACTERISTIC
/begin CHARACTERISTIC _g_PL_AD_fw_Radar_1R1V_rpc_LocBypassingRunnable_LocBypassingRunnable_m_pad_ensRLocationsPort_par_out_local.TChangeableMemPool._._._m_arrayPool._0_._elem._m_LocationList._Item._60_._Rssi._m_value "" VALUE 0xB00107B2 __Float16_Value 0 NO_COMPU_METHOD -65504 65504 ECU_ADDRESS_EXTENSION 0x2 BYTE_ORDER MSB_LAST /end CHARACTERISTIC
/begin CHARACTERISTIC _g_PL_AD_fw_Radar_1R1V_rpc_LocBypassingRunnable_LocBypassingRunnable_m_pad_ensRLocationsPort_par_out_local.TChangeableMemPool._._._m_arrayPool._0_._elem._m_LocationList._Item._60_._d "" VALUE 0xB0010798 __Float32_Value 0 NO_COMPU_METHOD -3.4028234663852886E+38 3.4028234663852886E+38 ECU_ADDRESS_EXTENSION 0x2 BYTE_ORDER MSB_LAST /end CHARACTERISTIC
/begin CHARACTERISTIC _g_PL_AD_fw_Radar_1R1V_rpc_LocBypassingRunnable_LocBypassingRunnable_m_pad_ensRLocationsPort_par_out_local.TChangeableMemPool._._._m_arrayPool._0_._elem._m_LocationList._Item._60_._dVar._m_value "" VALUE 0xB00107A0 __Float16_Value 0 NO_COMPU_METHOD -65504 65504 ECU_ADDRESS_EXTENSION 0x2 BYTE_ORDER MSB_LAST /end CHARACTERISTIC
/begin CHARACTERISTIC _g_PL_AD_fw_Radar_1R1V_rpc_LocBypassingRunnable_LocBypassingRunnable_m_pad_ensRLocationsPort_par_out_local.TChangeableMemPool._._._m_arrayPool._0_._elem._m_LocationList._Item._60_._dvCov._m_value "" VALUE 0xB00107A4 __Float16_Value 0 NO_COMPU_METHOD -65504 65504 ECU_ADDRESS_EXTENSION 0x2 BYTE_ORDER MSB_LAST /end CHARACTERISTIC
/begin CHARACTERISTIC _g_PL_AD_fw_Radar_1R1V_rpc_LocBypassingRunnable_LocBypassingRunnable_m_pad_ensRLocationsPort_par_out_local.TChangeableMemPool._._._m_arrayPool._0_._elem._m_LocationList._Item._60_._dvQly "" VALUE 0xB00107B4 __UByte_Value 0 NO_COMPU_METHOD 0 255 ECU_ADDRESS_EXTENSION 0x2 BYTE_ORDER MSB_LAST /end CHARACTERISTIC
/begin CHARACTERISTIC _g_PL_AD_fw_Radar_1R1V_rpc_LocBypassingRunnable_LocBypassingRunnable_m_pad_ensRLocationsPort_par_out_local.TChangeableMemPool._._._m_arrayPool._0_._elem._m_LocationList._Item._60_._idxAzimuthAmbiguityPeer "" VALUE 0xB00107B6 __UWord_Value 0 NO_COMPU_METHOD 0 65535 ECU_ADDRESS_EXTENSION 0x2 BYTE_ORDER MSB_LAST /end CHARACTERISTIC
/begin CHARACTERISTIC _g_PL_AD_fw_Radar_1R1V_rpc_LocBypassingRunnable_LocBypassingRunnable_m_pad_ensRLocationsPort_par_out_local.TChangeableMemPool._._._m_arrayPool._0_._elem._m_LocationList._Item._60_._measStatus "" VALUE 0xB00107B5 __UByte_Value 0 NO_COMPU_METHOD 0 255 ECU_ADDRESS_EXTENSION 0x2 BYTE_ORDER MSB_LAST /end CHARACTERISTIC
/begin CHARACTERISTIC _g_PL_AD_fw_Radar_1R1V_rpc_LocBypassingRunnable_LocBypassingRunnable_m_pad_ensRLocationsPort_par_out_local.TChangeableMemPool._._._m_arrayPool._0_._elem._m_LocationList._Item._60_._phi._m_value "" VALUE 0xB00107A8 __Float16_Value 0 NO_COMPU_METHOD -65504 65504 ECU_ADDRESS_EXTENSION 0x2 BYTE_ORDER MSB_LAST /end CHARACTERISTIC
/begin CHARACTERISTIC _g_PL_AD_fw_Radar_1R1V_rpc_LocBypassingRunnable_LocBypassingRunnable_m_pad_ensRLocationsPort_par_out_local.TChangeableMemPool._._._m_arrayPool._0_._elem._m_LocationList._Item._60_._phiQly "" VALUE 0xB00107AB __UByte_Value 0 NO_COMPU_METHOD 0 255 ECU_ADDRESS_EXTENSION 0x2 BYTE_ORDER MSB_LAST /end CHARACTERISTIC
/begin CHARACTERISTIC _g_PL_AD_fw_Radar_1R1V_rpc_LocBypassingRunnable_LocBypassingRunnable_m_pad_ensRLocationsPort_par_out_local.TChangeableMemPool._._._m_arrayPool._0_._elem._m_LocationList._Item._60_._phiVar._m_value "" VALUE 0xB00107AE __Float16_Value 0 NO_COMPU_METHOD -65504 65504 ECU_ADDRESS_EXTENSION 0x2 BYTE_ORDER MSB_LAST /end CHARACTERISTIC
/begin CHARACTERISTIC _g_PL_AD_fw_Radar_1R1V_rpc_LocBypassingRunnable_LocBypassingRunnable_m_pad_ensRLocationsPort_par_out_local.TChangeableMemPool._._._m_arrayPool._0_._elem._m_LocationList._Item._60_._theta._m_value "" VALUE 0xB00107A6 __Float16_Value 0 NO_COMPU_METHOD -65504 65504 ECU_ADDRESS_EXTENSION 0x2 BYTE_ORDER MSB_LAST /end CHARACTERISTIC
/begin CHARACTERISTIC _g_PL_AD_fw_Radar_1R1V_rpc_LocBypassingRunnable_LocBypassingRunnable_m_pad_ensRLocationsPort_par_out_local.TChangeableMemPool._._._m_arrayPool._0_._elem._m_LocationList._Item._60_._thetaQly "" VALUE 0xB00107AA __UByte_Value 0 NO_COMPU_METHOD 0 255 ECU_ADDRESS_EXTENSION 0x2 BYTE_ORDER MSB_LAST /end CHARACTERISTIC
/begin CHARACTERISTIC _g_PL_AD_fw_Radar_1R1V_rpc_LocBypassingRunnable_LocBypassingRunnable_m_pad_ensRLocationsPort_par_out_local.TChangeableMemPool._._._m_arrayPool._0_._elem._m_LocationList._Item._60_._thetaVar._m_value "" VALUE 0xB00107AC __Float16_Value 0 NO_COMPU_METHOD -65504 65504 ECU_ADDRESS_EXTENSION 0x2 BYTE_ORDER MSB_LAST /end CHARACTERISTIC
/begin CHARACTERISTIC _g_PL_AD_fw_Radar_1R1V_rpc_LocBypassingRunnable_LocBypassingRunnable_m_pad_ensRLocationsPort_par_out_local.TChangeableMemPool._._._m_arrayPool._0_._elem._m_LocationList._Item._60_._v "" VALUE 0xB001079C __Float32_Value 0 NO_COMPU_METHOD -3.4028234663852886E+38 3.4028234663852886E+38 ECU_ADDRESS_EXTENSION 0x2 BYTE_ORDER MSB_LAST /end CHARACTERISTIC
/begin CHARACTERISTIC _g_PL_AD_fw_Radar_1R1V_rpc_LocBypassingRunnable_LocBypassingRunnable_m_pad_ensRLocationsPort_par_out_local.TChangeableMemPool._._._m_arrayPool._0_._elem._m_LocationList._Item._60_._vVar._m_value "" VALUE 0xB00107A2 __Float16_Value 0 NO_COMPU_METHOD -65504 65504 ECU_ADDRESS_EXTENSION 0x2 BYTE_ORDER MSB_LAST /end CHARACTERISTIC
/begin CHARACTERISTIC _g_PL_AD_fw_Radar_1R1V_rpc_LocBypassingRunnable_LocBypassingRunnable_m_pad_ensRLocationsPort_par_out_local.TChangeableMemPool._._._m_arrayPool._0_._elem._m_LocationList._Item._61_._Rcs._m_value "" VALUE 0xB00107D0 __Float16_Value 0 NO_COMPU_METHOD -65504 65504 ECU_ADDRESS_EXTENSION 0x2 BYTE_ORDER MSB_LAST /end CHARACTERISTIC
/begin CHARACTERISTIC _g_PL_AD_fw_Radar_1R1V_rpc_LocBypassingRunnable_LocBypassingRunnable_m_pad_ensRLocationsPort_par_out_local.TChangeableMemPool._._._m_arrayPool._0_._elem._m_LocationList._Item._61_._Rssi._m_value "" VALUE 0xB00107D2 __Float16_Value 0 NO_COMPU_METHOD -65504 65504 ECU_ADDRESS_EXTENSION 0x2 BYTE_ORDER MSB_LAST /end CHARACTERISTIC
/begin CHARACTERISTIC _g_PL_AD_fw_Radar_1R1V_rpc_LocBypassingRunnable_LocBypassingRunnable_m_pad_ensRLocationsPort_par_out_local.TChangeableMemPool._._._m_arrayPool._0_._elem._m_LocationList._Item._61_._d "" VALUE 0xB00107B8 __Float32_Value 0 NO_COMPU_METHOD -3.4028234663852886E+38 3.4028234663852886E+38 ECU_ADDRESS_EXTENSION 0x2 BYTE_ORDER MSB_LAST /end CHARACTERISTIC
/begin CHARACTERISTIC _g_PL_AD_fw_Radar_1R1V_rpc_LocBypassingRunnable_LocBypassingRunnable_m_pad_ensRLocationsPort_par_out_local.TChangeableMemPool._._._m_arrayPool._0_._elem._m_LocationList._Item._61_._dVar._m_value "" VALUE 0xB00107C0 __Float16_Value 0 NO_COMPU_METHOD -65504 65504 ECU_ADDRESS_EXTENSION 0x2 BYTE_ORDER MSB_LAST /end CHARACTERISTIC
/begin CHARACTERISTIC _g_PL_AD_fw_Radar_1R1V_rpc_LocBypassingRunnable_LocBypassingRunnable_m_pad_ensRLocationsPort_par_out_local.TChangeableMemPool._._._m_arrayPool._0_._elem._m_LocationList._Item._61_._dvCov._m_value "" VALUE 0xB00107C4 __Float16_Value 0 NO_COMPU_METHOD -65504 65504 ECU_ADDRESS_EXTENSION 0x2 BYTE_ORDER MSB_LAST /end CHARACTERISTIC
/begin CHARACTERISTIC _g_PL_AD_fw_Radar_1R1V_rpc_LocBypassingRunnable_LocBypassingRunnable_m_pad_ensRLocationsPort_par_out_local.TChangeableMemPool._._._m_arrayPool._0_._elem._m_LocationList._Item._61_._dvQly "" VALUE 0xB00107D4 __UByte_Value 0 NO_COMPU_METHOD 0 255 ECU_ADDRESS_EXTENSION 0x2 BYTE_ORDER MSB_LAST /end CHARACTERISTIC
/begin CHARACTERISTIC _g_PL_AD_fw_Radar_1R1V_rpc_LocBypassingRunnable_LocBypassingRunnable_m_pad_ensRLocationsPort_par_out_local.TChangeableMemPool._._._m_arrayPool._0_._elem._m_LocationList._Item._61_._idxAzimuthAmbiguityPeer "" VALUE 0xB00107D6 __UWord_Value 0 NO_COMPU_METHOD 0 65535 ECU_ADDRESS_EXTENSION 0x2 BYTE_ORDER MSB_LAST /end CHARACTERISTIC
/begin CHARACTERISTIC _g_PL_AD_fw_Radar_1R1V_rpc_LocBypassingRunnable_LocBypassingRunnable_m_pad_ensRLocationsPort_par_out_local.TChangeableMemPool._._._m_arrayPool._0_._elem._m_LocationList._Item._61_._measStatus "" VALUE 0xB00107D5 __UByte_Value 0 NO_COMPU_METHOD 0 255 ECU_ADDRESS_EXTENSION 0x2 BYTE_ORDER MSB_LAST /end CHARACTERISTIC
/begin CHARACTERISTIC _g_PL_AD_fw_Radar_1R1V_rpc_LocBypassingRunnable_LocBypassingRunnable_m_pad_ensRLocationsPort_par_out_local.TChangeableMemPool._._._m_arrayPool._0_._elem._m_LocationList._Item._61_._phi._m_value "" VALUE 0xB00107C8 __Float16_Value 0 NO_COMPU_METHOD -65504 65504 ECU_ADDRESS_EXTENSION 0x2 BYTE_ORDER MSB_LAST /end CHARACTERISTIC
/begin CHARACTERISTIC _g_PL_AD_fw_Radar_1R1V_rpc_LocBypassingRunnable_LocBypassingRunnable_m_pad_ensRLocationsPort_par_out_local.TChangeableMemPool._._._m_arrayPool._0_._elem._m_LocationList._Item._61_._phiQly "" VALUE 0xB00107CB __UByte_Value 0 NO_COMPU_METHOD 0 255 ECU_ADDRESS_EXTENSION 0x2 BYTE_ORDER MSB_LAST /end CHARACTERISTIC
/begin CHARACTERISTIC _g_PL_AD_fw_Radar_1R1V_rpc_LocBypassingRunnable_LocBypassingRunnable_m_pad_ensRLocationsPort_par_out_local.TChangeableMemPool._._._m_arrayPool._0_._elem._m_LocationList._Item._61_._phiVar._m_value "" VALUE 0xB00107CE __Float16_Value 0 NO_COMPU_METHOD -65504 65504 ECU_ADDRESS_EXTENSION 0x2 BYTE_ORDER MSB_LAST /end CHARACTERISTIC
/begin CHARACTERISTIC _g_PL_AD_fw_Radar_1R1V_rpc_LocBypassingRunnable_LocBypassingRunnable_m_pad_ensRLocationsPort_par_out_local.TChangeableMemPool._._._m_arrayPool._0_._elem._m_LocationList._Item._61_._theta._m_value "" VALUE 0xB00107C6 __Float16_Value 0 NO_COMPU_METHOD -65504 65504 ECU_ADDRESS_EXTENSION 0x2 BYTE_ORDER MSB_LAST /end CHARACTERISTIC
/begin CHARACTERISTIC _g_PL_AD_fw_Radar_1R1V_rpc_LocBypassingRunnable_LocBypassingRunnable_m_pad_ensRLocationsPort_par_out_local.TChangeableMemPool._._._m_arrayPool._0_._elem._m_LocationList._Item._61_._thetaQly "" VALUE 0xB00107CA __UByte_Value 0 NO_COMPU_METHOD 0 255 ECU_ADDRESS_EXTENSION 0x2 BYTE_ORDER MSB_LAST /end CHARACTERISTIC
/begin CHARACTERISTIC _g_PL_AD_fw_Radar_1R1V_rpc_LocBypassingRunnable_LocBypassingRunnable_m_pad_ensRLocationsPort_par_out_local.TChangeableMemPool._._._m_arrayPool._0_._elem._m_LocationList._Item._61_._thetaVar._m_value "" VALUE 0xB00107CC __Float16_Value 0 NO_COMPU_METHOD -65504 65504 ECU_ADDRESS_EXTENSION 0x2 BYTE_ORDER MSB_LAST /end CHARACTERISTIC
/begin CHARACTERISTIC _g_PL_AD_fw_Radar_1R1V_rpc_LocBypassingRunnable_LocBypassingRunnable_m_pad_ensRLocationsPort_par_out_local.TChangeableMemPool._._._m_arrayPool._0_._elem._m_LocationList._Item._61_._v "" VALUE 0xB00107BC __Float32_Value 0 NO_COMPU_METHOD -3.4028234663852886E+38 3.4028234663852886E+38 ECU_ADDRESS_EXTENSION 0x2 BYTE_ORDER MSB_LAST /end CHARACTERISTIC
/begin CHARACTERISTIC _g_PL_AD_fw_Radar_1R1V_rpc_LocBypassingRunnable_LocBypassingRunnable_m_pad_ensRLocationsPort_par_out_local.TChangeableMemPool._._._m_arrayPool._0_._elem._m_LocationList._Item._61_._vVar._m_value "" VALUE 0xB00107C2 __Float16_Value 0 NO_COMPU_METHOD -65504 65504 ECU_ADDRESS_EXTENSION 0x2 BYTE_ORDER MSB_LAST /end CHARACTERISTIC
/begin CHARACTERISTIC _g_PL_AD_fw_Radar_1R1V_rpc_LocBypassingRunnable_LocBypassingRunnable_m_pad_ensRLocationsPort_par_out_local.TChangeableMemPool._._._m_arrayPool._0_._elem._m_LocationList._Item._62_._Rcs._m_value "" VALUE 0xB00107F0 __Float16_Value 0 NO_COMPU_METHOD -65504 65504 ECU_ADDRESS_EXTENSION 0x2 BYTE_ORDER MSB_LAST /end CHARACTERISTIC
/begin CHARACTERISTIC _g_PL_AD_fw_Radar_1R1V_rpc_LocBypassingRunnable_LocBypassingRunnable_m_pad_ensRLocationsPort_par_out_local.TChangeableMemPool._._._m_arrayPool._0_._elem._m_LocationList._Item._62_._Rssi._m_value "" VALUE 0xB00107F2 __Float16_Value 0 NO_COMPU_METHOD -65504 65504 ECU_ADDRESS_EXTENSION 0x2 BYTE_ORDER MSB_LAST /end CHARACTERISTIC
/begin CHARACTERISTIC _g_PL_AD_fw_Radar_1R1V_rpc_LocBypassingRunnable_LocBypassingRunnable_m_pad_ensRLocationsPort_par_out_local.TChangeableMemPool._._._m_arrayPool._0_._elem._m_LocationList._Item._62_._d "" VALUE 0xB00107D8 __Float32_Value 0 NO_COMPU_METHOD -3.4028234663852886E+38 3.4028234663852886E+38 ECU_ADDRESS_EXTENSION 0x2 BYTE_ORDER MSB_LAST /end CHARACTERISTIC
/begin CHARACTERISTIC _g_PL_AD_fw_Radar_1R1V_rpc_LocBypassingRunnable_LocBypassingRunnable_m_pad_ensRLocationsPort_par_out_local.TChangeableMemPool._._._m_arrayPool._0_._elem._m_LocationList._Item._62_._dVar._m_value "" VALUE 0xB00107E0 __Float16_Value 0 NO_COMPU_METHOD -65504 65504 ECU_ADDRESS_EXTENSION 0x2 BYTE_ORDER MSB_LAST /end CHARACTERISTIC
/begin CHARACTERISTIC _g_PL_AD_fw_Radar_1R1V_rpc_LocBypassingRunnable_LocBypassingRunnable_m_pad_ensRLocationsPort_par_out_local.TChangeableMemPool._._._m_arrayPool._0_._elem._m_LocationList._Item._62_._dvCov._m_value "" VALUE 0xB00107E4 __Float16_Value 0 NO_COMPU_METHOD -65504 65504 ECU_ADDRESS_EXTENSION 0x2 BYTE_ORDER MSB_LAST /end CHARACTERISTIC
/begin CHARACTERISTIC _g_PL_AD_fw_Radar_1R1V_rpc_LocBypassingRunnable_LocBypassingRunnable_m_pad_ensRLocationsPort_par_out_local.TChangeableMemPool._._._m_arrayPool._0_._elem._m_LocationList._Item._62_._dvQly "" VALUE 0xB00107F4 __UByte_Value 0 NO_COMPU_METHOD 0 255 ECU_ADDRESS_EXTENSION 0x2 BYTE_ORDER MSB_LAST /end CHARACTERISTIC
/begin CHARACTERISTIC _g_PL_AD_fw_Radar_1R1V_rpc_LocBypassingRunnable_LocBypassingRunnable_m_pad_ensRLocationsPort_par_out_local.TChangeableMemPool._._._m_arrayPool._0_._elem._m_LocationList._Item._62_._idxAzimuthAmbiguityPeer "" VALUE 0xB00107F6 __UWord_Value 0 NO_COMPU_METHOD 0 65535 ECU_ADDRESS_EXTENSION 0x2 BYTE_ORDER MSB_LAST /end CHARACTERISTIC
/begin CHARACTERISTIC _g_PL_AD_fw_Radar_1R1V_rpc_LocBypassingRunnable_LocBypassingRunnable_m_pad_ensRLocationsPort_par_out_local.TChangeableMemPool._._._m_arrayPool._0_._elem._m_LocationList._Item._62_._measStatus "" VALUE 0xB00107F5 __UByte_Value 0 NO_COMPU_METHOD 0 255 ECU_ADDRESS_EXTENSION 0x2 BYTE_ORDER MSB_LAST /end CHARACTERISTIC
/begin CHARACTERISTIC _g_PL_AD_fw_Radar_1R1V_rpc_LocBypassingRunnable_LocBypassingRunnable_m_pad_ensRLocationsPort_par_out_local.TChangeableMemPool._._._m_arrayPool._0_._elem._m_LocationList._Item._62_._phi._m_value "" VALUE 0xB00107E8 __Float16_Value 0 NO_COMPU_METHOD -65504 65504 ECU_ADDRESS_EXTENSION 0x2 BYTE_ORDER MSB_LAST /end CHARACTERISTIC
/begin CHARACTERISTIC _g_PL_AD_fw_Radar_1R1V_rpc_LocBypassingRunnable_LocBypassingRunnable_m_pad_ensRLocationsPort_par_out_local.TChangeableMemPool._._._m_arrayPool._0_._elem._m_LocationList._Item._62_._phiQly "" VALUE 0xB00107EB __UByte_Value 0 NO_COMPU_METHOD 0 255 ECU_ADDRESS_EXTENSION 0x2 BYTE_ORDER MSB_LAST /end CHARACTERISTIC
/begin CHARACTERISTIC _g_PL_AD_fw_Radar_1R1V_rpc_LocBypassingRunnable_LocBypassingRunnable_m_pad_ensRLocationsPort_par_out_local.TChangeableMemPool._._._m_arrayPool._0_._elem._m_LocationList._Item._62_._phiVar._m_value "" VALUE 0xB00107EE __Float16_Value 0 NO_COMPU_METHOD -65504 65504 ECU_ADDRESS_EXTENSION 0x2 BYTE_ORDER MSB_LAST /end CHARACTERISTIC
/begin CHARACTERISTIC _g_PL_AD_fw_Radar_1R1V_rpc_LocBypassingRunnable_LocBypassingRunnable_m_pad_ensRLocationsPort_par_out_local.TChangeableMemPool._._._m_arrayPool._0_._elem._m_LocationList._Item._62_._theta._m_value "" VALUE 0xB00107E6 __Float16_Value 0 NO_COMPU_METHOD -65504 65504 ECU_ADDRESS_EXTENSION 0x2 BYTE_ORDER MSB_LAST /end CHARACTERISTIC
/begin CHARACTERISTIC _g_PL_AD_fw_Radar_1R1V_rpc_LocBypassingRunnable_LocBypassingRunnable_m_pad_ensRLocationsPort_par_out_local.TChangeableMemPool._._._m_arrayPool._0_._elem._m_LocationList._Item._62_._thetaQly "" VALUE 0xB00107EA __UByte_Value 0 NO_COMPU_METHOD 0 255 ECU_ADDRESS_EXTENSION 0x2 BYTE_ORDER MSB_LAST /end CHARACTERISTIC
/begin CHARACTERISTIC _g_PL_AD_fw_Radar_1R1V_rpc_LocBypassingRunnable_LocBypassingRunnable_m_pad_ensRLocationsPort_par_out_local.TChangeableMemPool._._._m_arrayPool._0_._elem._m_LocationList._Item._62_._thetaVar._m_value "" VALUE 0xB00107EC __Float16_Value 0 NO_COMPU_METHOD -65504 65504 ECU_ADDRESS_EXTENSION 0x2 BYTE_ORDER MSB_LAST /end CHARACTERISTIC
/begin CHARACTERISTIC _g_PL_AD_fw_Radar_1R1V_rpc_LocBypassingRunnable_LocBypassingRunnable_m_pad_ensRLocationsPort_par_out_local.TChangeableMemPool._._._m_arrayPool._0_._elem._m_LocationList._Item._62_._v "" VALUE 0xB00107DC __Float32_Value 0 NO_COMPU_METHOD -3.4028234663852886E+38 3.4028234663852886E+38 ECU_ADDRESS_EXTENSION 0x2 BYTE_ORDER MSB_LAST /end CHARACTERISTIC
/begin CHARACTERISTIC _g_PL_AD_fw_Radar_1R1V_rpc_LocBypassingRunnable_LocBypassingRunnable_m_pad_ensRLocationsPort_par_out_local.TChangeableMemPool._._._m_arrayPool._0_._elem._m_LocationList._Item._62_._vVar._m_value "" VALUE 0xB00107E2 __Float16_Value 0 NO_COMPU_METHOD -65504 65504 ECU_ADDRESS_EXTENSION 0x2 BYTE_ORDER MSB_LAST /end CHARACTERISTIC
/begin CHARACTERISTIC _g_PL_AD_fw_Radar_1R1V_rpc_LocBypassingRunnable_LocBypassingRunnable_m_pad_ensRLocationsPort_par_out_local.TChangeableMemPool._._._m_arrayPool._0_._elem._m_LocationList._Item._63_._Rcs._m_value "" VALUE 0xB0010810 __Float16_Value 0 NO_COMPU_METHOD -65504 65504 ECU_ADDRESS_EXTENSION 0x2 BYTE_ORDER MSB_LAST /end CHARACTERISTIC
/begin CHARACTERISTIC _g_PL_AD_fw_Radar_1R1V_rpc_LocBypassingRunnable_LocBypassingRunnable_m_pad_ensRLocationsPort_par_out_local.TChangeableMemPool._._._m_arrayPool._0_._elem._m_LocationList._Item._63_._Rssi._m_value "" VALUE 0xB0010812 __Float16_Value 0 NO_COMPU_METHOD -65504 65504 ECU_ADDRESS_EXTENSION 0x2 BYTE_ORDER MSB_LAST /end CHARACTERISTIC
/begin CHARACTERISTIC _g_PL_AD_fw_Radar_1R1V_rpc_LocBypassingRunnable_LocBypassingRunnable_m_pad_ensRLocationsPort_par_out_local.TChangeableMemPool._._._m_arrayPool._0_._elem._m_LocationList._Item._63_._d "" VALUE 0xB00107F8 __Float32_Value 0 NO_COMPU_METHOD -3.4028234663852886E+38 3.4028234663852886E+38 ECU_ADDRESS_EXTENSION 0x2 BYTE_ORDER MSB_LAST /end CHARACTERISTIC
/begin CHARACTERISTIC _g_PL_AD_fw_Radar_1R1V_rpc_LocBypassingRunnable_LocBypassingRunnable_m_pad_ensRLocationsPort_par_out_local.TChangeableMemPool._._._m_arrayPool._0_._elem._m_LocationList._Item._63_._dVar._m_value "" VALUE 0xB0010800 __Float16_Value 0 NO_COMPU_METHOD -65504 65504 ECU_ADDRESS_EXTENSION 0x2 BYTE_ORDER MSB_LAST /end CHARACTERISTIC
/begin CHARACTERISTIC _g_PL_AD_fw_Radar_1R1V_rpc_LocBypassingRunnable_LocBypassingRunnable_m_pad_ensRLocationsPort_par_out_local.TChangeableMemPool._._._m_arrayPool._0_._elem._m_LocationList._Item._63_._dvCov._m_value "" VALUE 0xB0010804 __Float16_Value 0 NO_COMPU_METHOD -65504 65504 ECU_ADDRESS_EXTENSION 0x2 BYTE_ORDER MSB_LAST /end CHARACTERISTIC
/begin CHARACTERISTIC _g_PL_AD_fw_Radar_1R1V_rpc_LocBypassingRunnable_LocBypassingRunnable_m_pad_ensRLocationsPort_par_out_local.TChangeableMemPool._._._m_arrayPool._0_._elem._m_LocationList._Item._63_._dvQly "" VALUE 0xB0010814 __UByte_Value 0 NO_COMPU_METHOD 0 255 ECU_ADDRESS_EXTENSION 0x2 BYTE_ORDER MSB_LAST /end CHARACTERISTIC
/begin CHARACTERISTIC _g_PL_AD_fw_Radar_1R1V_rpc_LocBypassingRunnable_LocBypassingRunnable_m_pad_ensRLocationsPort_par_out_local.TChangeableMemPool._._._m_arrayPool._0_._elem._m_LocationList._Item._63_._idxAzimuthAmbiguityPeer "" VALUE 0xB0010816 __UWord_Value 0 NO_COMPU_METHOD 0 65535 ECU_ADDRESS_EXTENSION 0x2 BYTE_ORDER MSB_LAST /end CHARACTERISTIC
/begin CHARACTERISTIC _g_PL_AD_fw_Radar_1R1V_rpc_LocBypassingRunnable_LocBypassingRunnable_m_pad_ensRLocationsPort_par_out_local.TChangeableMemPool._._._m_arrayPool._0_._elem._m_LocationList._Item._63_._measStatus "" VALUE 0xB0010815 __UByte_Value 0 NO_COMPU_METHOD 0 255 ECU_ADDRESS_EXTENSION 0x2 BYTE_ORDER MSB_LAST /end CHARACTERISTIC
/begin CHARACTERISTIC _g_PL_AD_fw_Radar_1R1V_rpc_LocBypassingRunnable_LocBypassingRunnable_m_pad_ensRLocationsPort_par_out_local.TChangeableMemPool._._._m_arrayPool._0_._elem._m_LocationList._Item._63_._phi._m_value "" VALUE 0xB0010808 __Float16_Value 0 NO_COMPU_METHOD -65504 65504 ECU_ADDRESS_EXTENSION 0x2 BYTE_ORDER MSB_LAST /end CHARACTERISTIC
/begin CHARACTERISTIC _g_PL_AD_fw_Radar_1R1V_rpc_LocBypassingRunnable_LocBypassingRunnable_m_pad_ensRLocationsPort_par_out_local.TChangeableMemPool._._._m_arrayPool._0_._elem._m_LocationList._Item._63_._phiQly "" VALUE 0xB001080B __UByte_Value 0 NO_COMPU_METHOD 0 255 ECU_ADDRESS_EXTENSION 0x2 BYTE_ORDER MSB_LAST /end CHARACTERISTIC
/begin CHARACTERISTIC _g_PL_AD_fw_Radar_1R1V_rpc_LocBypassingRunnable_LocBypassingRunnable_m_pad_ensRLocationsPort_par_out_local.TChangeableMemPool._._._m_arrayPool._0_._elem._m_LocationList._Item._63_._phiVar._m_value "" VALUE 0xB001080E __Float16_Value 0 NO_COMPU_METHOD -65504 65504 ECU_ADDRESS_EXTENSION 0x2 BYTE_ORDER MSB_LAST /end CHARACTERISTIC
/begin CHARACTERISTIC _g_PL_AD_fw_Radar_1R1V_rpc_LocBypassingRunnable_LocBypassingRunnable_m_pad_ensRLocationsPort_par_out_local.TChangeableMemPool._._._m_arrayPool._0_._elem._m_LocationList._Item._63_._theta._m_value "" VALUE 0xB0010806 __Float16_Value 0 NO_COMPU_METHOD -65504 65504 ECU_ADDRESS_EXTENSION 0x2 BYTE_ORDER MSB_LAST /end CHARACTERISTIC
/begin CHARACTERISTIC _g_PL_AD_fw_Radar_1R1V_rpc_LocBypassingRunnable_LocBypassingRunnable_m_pad_ensRLocationsPort_par_out_local.TChangeableMemPool._._._m_arrayPool._0_._elem._m_LocationList._Item._63_._thetaQly "" VALUE 0xB001080A __UByte_Value 0 NO_COMPU_METHOD 0 255 ECU_ADDRESS_EXTENSION 0x2 BYTE_ORDER MSB_LAST /end CHARACTERISTIC
/begin CHARACTERISTIC _g_PL_AD_fw_Radar_1R1V_rpc_LocBypassingRunnable_LocBypassingRunnable_m_pad_ensRLocationsPort_par_out_local.TChangeableMemPool._._._m_arrayPool._0_._elem._m_LocationList._Item._63_._thetaVar._m_value "" VALUE 0xB001080C __Float16_Value 0 NO_COMPU_METHOD -65504 65504 ECU_ADDRESS_EXTENSION 0x2 BYTE_ORDER MSB_LAST /end CHARACTERISTIC
/begin CHARACTERISTIC _g_PL_AD_fw_Radar_1R1V_rpc_LocBypassingRunnable_LocBypassingRunnable_m_pad_ensRLocationsPort_par_out_local.TChangeableMemPool._._._m_arrayPool._0_._elem._m_LocationList._Item._63_._v "" VALUE 0xB00107FC __Float32_Value 0 NO_COMPU_METHOD -3.4028234663852886E+38 3.4028234663852886E+38 ECU_ADDRESS_EXTENSION 0x2 BYTE_ORDER MSB_LAST /end CHARACTERISTIC
/begin CHARACTERISTIC _g_PL_AD_fw_Radar_1R1V_rpc_LocBypassingRunnable_LocBypassingRunnable_m_pad_ensRLocationsPort_par_out_local.TChangeableMemPool._._._m_arrayPool._0_._elem._m_LocationList._Item._63_._vVar._m_value "" VALUE 0xB0010802 __Float16_Value 0 NO_COMPU_METHOD -65504 65504 ECU_ADDRESS_EXTENSION 0x2 BYTE_ORDER MSB_LAST /end CHARACTERISTIC
/begin CHARACTERISTIC _g_PL_AD_fw_Radar_1R1V_rpc_LocBypassingRunnable_LocBypassingRunnable_m_pad_ensRLocationsPort_par_out_local.TChangeableMemPool._._._m_arrayPool._0_._elem._m_LocationList._Item._64_._Rcs._m_value "" VALUE 0xB0010830 __Float16_Value 0 NO_COMPU_METHOD -65504 65504 ECU_ADDRESS_EXTENSION 0x2 BYTE_ORDER MSB_LAST /end CHARACTERISTIC
/begin CHARACTERISTIC _g_PL_AD_fw_Radar_1R1V_rpc_LocBypassingRunnable_LocBypassingRunnable_m_pad_ensRLocationsPort_par_out_local.TChangeableMemPool._._._m_arrayPool._0_._elem._m_LocationList._Item._64_._Rssi._m_value "" VALUE 0xB0010832 __Float16_Value 0 NO_COMPU_METHOD -65504 65504 ECU_ADDRESS_EXTENSION 0x2 BYTE_ORDER MSB_LAST /end CHARACTERISTIC
/begin CHARACTERISTIC _g_PL_AD_fw_Radar_1R1V_rpc_LocBypassingRunnable_LocBypassingRunnable_m_pad_ensRLocationsPort_par_out_local.TChangeableMemPool._._._m_arrayPool._0_._elem._m_LocationList._Item._64_._d "" VALUE 0xB0010818 __Float32_Value 0 NO_COMPU_METHOD -3.4028234663852886E+38 3.4028234663852886E+38 ECU_ADDRESS_EXTENSION 0x2 BYTE_ORDER MSB_LAST /end CHARACTERISTIC
/begin CHARACTERISTIC _g_PL_AD_fw_Radar_1R1V_rpc_LocBypassingRunnable_LocBypassingRunnable_m_pad_ensRLocationsPort_par_out_local.TChangeableMemPool._._._m_arrayPool._0_._elem._m_LocationList._Item._64_._dVar._m_value "" VALUE 0xB0010820 __Float16_Value 0 NO_COMPU_METHOD -65504 65504 ECU_ADDRESS_EXTENSION 0x2 BYTE_ORDER MSB_LAST /end CHARACTERISTIC
/begin CHARACTERISTIC _g_PL_AD_fw_Radar_1R1V_rpc_LocBypassingRunnable_LocBypassingRunnable_m_pad_ensRLocationsPort_par_out_local.TChangeableMemPool._._._m_arrayPool._0_._elem._m_LocationList._Item._64_._dvCov._m_value "" VALUE 0xB0010824 __Float16_Value 0 NO_COMPU_METHOD -65504 65504 ECU_ADDRESS_EXTENSION 0x2 BYTE_ORDER MSB_LAST /end CHARACTERISTIC
/begin CHARACTERISTIC _g_PL_AD_fw_Radar_1R1V_rpc_LocBypassingRunnable_LocBypassingRunnable_m_pad_ensRLocationsPort_par_out_local.TChangeableMemPool._._._m_arrayPool._0_._elem._m_LocationList._Item._64_._dvQly "" VALUE 0xB0010834 __UByte_Value 0 NO_COMPU_METHOD 0 255 ECU_ADDRESS_EXTENSION 0x2 BYTE_ORDER MSB_LAST /end CHARACTERISTIC
/begin CHARACTERISTIC _g_PL_AD_fw_Radar_1R1V_rpc_LocBypassingRunnable_LocBypassingRunnable_m_pad_ensRLocationsPort_par_out_local.TChangeableMemPool._._._m_arrayPool._0_._elem._m_LocationList._Item._64_._idxAzimuthAmbiguityPeer "" VALUE 0xB0010836 __UWord_Value 0 NO_COMPU_METHOD 0 65535 ECU_ADDRESS_EXTENSION 0x2 BYTE_ORDER MSB_LAST /end CHARACTERISTIC
/begin CHARACTERISTIC _g_PL_AD_fw_Radar_1R1V_rpc_LocBypassingRunnable_LocBypassingRunnable_m_pad_ensRLocationsPort_par_out_local.TChangeableMemPool._._._m_arrayPool._0_._elem._m_LocationList._Item._64_._measStatus "" VALUE 0xB0010835 __UByte_Value 0 NO_COMPU_METHOD 0 255 ECU_ADDRESS_EXTENSION 0x2 BYTE_ORDER MSB_LAST /end CHARACTERISTIC
/begin CHARACTERISTIC _g_PL_AD_fw_Radar_1R1V_rpc_LocBypassingRunnable_LocBypassingRunnable_m_pad_ensRLocationsPort_par_out_local.TChangeableMemPool._._._m_arrayPool._0_._elem._m_LocationList._Item._64_._phi._m_value "" VALUE 0xB0010828 __Float16_Value 0 NO_COMPU_METHOD -65504 65504 ECU_ADDRESS_EXTENSION 0x2 BYTE_ORDER MSB_LAST /end CHARACTERISTIC
/begin CHARACTERISTIC _g_PL_AD_fw_Radar_1R1V_rpc_LocBypassingRunnable_LocBypassingRunnable_m_pad_ensRLocationsPort_par_out_local.TChangeableMemPool._._._m_arrayPool._0_._elem._m_LocationList._Item._64_._phiQly "" VALUE 0xB001082B __UByte_Value 0 NO_COMPU_METHOD 0 255 ECU_ADDRESS_EXTENSION 0x2 BYTE_ORDER MSB_LAST /end CHARACTERISTIC
/begin CHARACTERISTIC _g_PL_AD_fw_Radar_1R1V_rpc_LocBypassingRunnable_LocBypassingRunnable_m_pad_ensRLocationsPort_par_out_local.TChangeableMemPool._._._m_arrayPool._0_._elem._m_LocationList._Item._64_._phiVar._m_value "" VALUE 0xB001082E __Float16_Value 0 NO_COMPU_METHOD -65504 65504 ECU_ADDRESS_EXTENSION 0x2 BYTE_ORDER MSB_LAST /end CHARACTERISTIC
/begin CHARACTERISTIC _g_PL_AD_fw_Radar_1R1V_rpc_LocBypassingRunnable_LocBypassingRunnable_m_pad_ensRLocationsPort_par_out_local.TChangeableMemPool._._._m_arrayPool._0_._elem._m_LocationList._Item._64_._theta._m_value "" VALUE 0xB0010826 __Float16_Value 0 NO_COMPU_METHOD -65504 65504 ECU_ADDRESS_EXTENSION 0x2 BYTE_ORDER MSB_LAST /end CHARACTERISTIC
/begin CHARACTERISTIC _g_PL_AD_fw_Radar_1R1V_rpc_LocBypassingRunnable_LocBypassingRunnable_m_pad_ensRLocationsPort_par_out_local.TChangeableMemPool._._._m_arrayPool._0_._elem._m_LocationList._Item._64_._thetaQly "" VALUE 0xB001082A __UByte_Value 0 NO_COMPU_METHOD 0 255 ECU_ADDRESS_EXTENSION 0x2 BYTE_ORDER MSB_LAST /end CHARACTERISTIC
/begin CHARACTERISTIC _g_PL_AD_fw_Radar_1R1V_rpc_LocBypassingRunnable_LocBypassingRunnable_m_pad_ensRLocationsPort_par_out_local.TChangeableMemPool._._._m_arrayPool._0_._elem._m_LocationList._Item._64_._thetaVar._m_value "" VALUE 0xB001082C __Float16_Value 0 NO_COMPU_METHOD -65504 65504 ECU_ADDRESS_EXTENSION 0x2 BYTE_ORDER MSB_LAST /end CHARACTERISTIC
/begin CHARACTERISTIC _g_PL_AD_fw_Radar_1R1V_rpc_LocBypassingRunnable_LocBypassingRunnable_m_pad_ensRLocationsPort_par_out_local.TChangeableMemPool._._._m_arrayPool._0_._elem._m_LocationList._Item._64_._v "" VALUE 0xB001081C __Float32_Value 0 NO_COMPU_METHOD -3.4028234663852886E+38 3.4028234663852886E+38 ECU_ADDRESS_EXTENSION 0x2 BYTE_ORDER MSB_LAST /end CHARACTERISTIC
/begin CHARACTERISTIC _g_PL_AD_fw_Radar_1R1V_rpc_LocBypassingRunnable_LocBypassingRunnable_m_pad_ensRLocationsPort_par_out_local.TChangeableMemPool._._._m_arrayPool._0_._elem._m_LocationList._Item._64_._vVar._m_value "" VALUE 0xB0010822 __Float16_Value 0 NO_COMPU_METHOD -65504 65504 ECU_ADDRESS_EXTENSION 0x2 BYTE_ORDER MSB_LAST /end CHARACTERISTIC
/begin CHARACTERISTIC _g_PL_AD_fw_Radar_1R1V_rpc_LocBypassingRunnable_LocBypassingRunnable_m_pad_ensRLocationsPort_par_out_local.TChangeableMemPool._._._m_arrayPool._0_._elem._m_LocationList._Item._65_._Rcs._m_value "" VALUE 0xB0010850 __Float16_Value 0 NO_COMPU_METHOD -65504 65504 ECU_ADDRESS_EXTENSION 0x2 BYTE_ORDER MSB_LAST /end CHARACTERISTIC
/begin CHARACTERISTIC _g_PL_AD_fw_Radar_1R1V_rpc_LocBypassingRunnable_LocBypassingRunnable_m_pad_ensRLocationsPort_par_out_local.TChangeableMemPool._._._m_arrayPool._0_._elem._m_LocationList._Item._65_._Rssi._m_value "" VALUE 0xB0010852 __Float16_Value 0 NO_COMPU_METHOD -65504 65504 ECU_ADDRESS_EXTENSION 0x2 BYTE_ORDER MSB_LAST /end CHARACTERISTIC
/begin CHARACTERISTIC _g_PL_AD_fw_Radar_1R1V_rpc_LocBypassingRunnable_LocBypassingRunnable_m_pad_ensRLocationsPort_par_out_local.TChangeableMemPool._._._m_arrayPool._0_._elem._m_LocationList._Item._65_._d "" VALUE 0xB0010838 __Float32_Value 0 NO_COMPU_METHOD -3.4028234663852886E+38 3.4028234663852886E+38 ECU_ADDRESS_EXTENSION 0x2 BYTE_ORDER MSB_LAST /end CHARACTERISTIC
/begin CHARACTERISTIC _g_PL_AD_fw_Radar_1R1V_rpc_LocBypassingRunnable_LocBypassingRunnable_m_pad_ensRLocationsPort_par_out_local.TChangeableMemPool._._._m_arrayPool._0_._elem._m_LocationList._Item._65_._dVar._m_value "" VALUE 0xB0010840 __Float16_Value 0 NO_COMPU_METHOD -65504 65504 ECU_ADDRESS_EXTENSION 0x2 BYTE_ORDER MSB_LAST /end CHARACTERISTIC
/begin CHARACTERISTIC _g_PL_AD_fw_Radar_1R1V_rpc_LocBypassingRunnable_LocBypassingRunnable_m_pad_ensRLocationsPort_par_out_local.TChangeableMemPool._._._m_arrayPool._0_._elem._m_LocationList._Item._65_._dvCov._m_value "" VALUE 0xB0010844 __Float16_Value 0 NO_COMPU_METHOD -65504 65504 ECU_ADDRESS_EXTENSION 0x2 BYTE_ORDER MSB_LAST /end CHARACTERISTIC
/begin CHARACTERISTIC _g_PL_AD_fw_Radar_1R1V_rpc_LocBypassingRunnable_LocBypassingRunnable_m_pad_ensRLocationsPort_par_out_local.TChangeableMemPool._._._m_arrayPool._0_._elem._m_LocationList._Item._65_._dvQly "" VALUE 0xB0010854 __UByte_Value 0 NO_COMPU_METHOD 0 255 ECU_ADDRESS_EXTENSION 0x2 BYTE_ORDER MSB_LAST /end CHARACTERISTIC
/begin CHARACTERISTIC _g_PL_AD_fw_Radar_1R1V_rpc_LocBypassingRunnable_LocBypassingRunnable_m_pad_ensRLocationsPort_par_out_local.TChangeableMemPool._._._m_arrayPool._0_._elem._m_LocationList._Item._65_._idxAzimuthAmbiguityPeer "" VALUE 0xB0010856 __UWord_Value 0 NO_COMPU_METHOD 0 65535 ECU_ADDRESS_EXTENSION 0x2 BYTE_ORDER MSB_LAST /end CHARACTERISTIC
/begin CHARACTERISTIC _g_PL_AD_fw_Radar_1R1V_rpc_LocBypassingRunnable_LocBypassingRunnable_m_pad_ensRLocationsPort_par_out_local.TChangeableMemPool._._._m_arrayPool._0_._elem._m_LocationList._Item._65_._measStatus "" VALUE 0xB0010855 __UByte_Value 0 NO_COMPU_METHOD 0 255 ECU_ADDRESS_EXTENSION 0x2 BYTE_ORDER MSB_LAST /end CHARACTERISTIC
/begin CHARACTERISTIC _g_PL_AD_fw_Radar_1R1V_rpc_LocBypassingRunnable_LocBypassingRunnable_m_pad_ensRLocationsPort_par_out_local.TChangeableMemPool._._._m_arrayPool._0_._elem._m_LocationList._Item._65_._phi._m_value "" VALUE 0xB0010848 __Float16_Value 0 NO_COMPU_METHOD -65504 65504 ECU_ADDRESS_EXTENSION 0x2 BYTE_ORDER MSB_LAST /end CHARACTERISTIC
/begin CHARACTERISTIC _g_PL_AD_fw_Radar_1R1V_rpc_LocBypassingRunnable_LocBypassingRunnable_m_pad_ensRLocationsPort_par_out_local.TChangeableMemPool._._._m_arrayPool._0_._elem._m_LocationList._Item._65_._phiQly "" VALUE 0xB001084B __UByte_Value 0 NO_COMPU_METHOD 0 255 ECU_ADDRESS_EXTENSION 0x2 BYTE_ORDER MSB_LAST /end CHARACTERISTIC
/begin CHARACTERISTIC _g_PL_AD_fw_Radar_1R1V_rpc_LocBypassingRunnable_LocBypassingRunnable_m_pad_ensRLocationsPort_par_out_local.TChangeableMemPool._._._m_arrayPool._0_._elem._m_LocationList._Item._65_._phiVar._m_value "" VALUE 0xB001084E __Float16_Value 0 NO_COMPU_METHOD -65504 65504 ECU_ADDRESS_EXTENSION 0x2 BYTE_ORDER MSB_LAST /end CHARACTERISTIC
/begin CHARACTERISTIC _g_PL_AD_fw_Radar_1R1V_rpc_LocBypassingRunnable_LocBypassingRunnable_m_pad_ensRLocationsPort_par_out_local.TChangeableMemPool._._._m_arrayPool._0_._elem._m_LocationList._Item._65_._theta._m_value "" VALUE 0xB0010846 __Float16_Value 0 NO_COMPU_METHOD -65504 65504 ECU_ADDRESS_EXTENSION 0x2 BYTE_ORDER MSB_LAST /end CHARACTERISTIC
/begin CHARACTERISTIC _g_PL_AD_fw_Radar_1R1V_rpc_LocBypassingRunnable_LocBypassingRunnable_m_pad_ensRLocationsPort_par_out_local.TChangeableMemPool._._._m_arrayPool._0_._elem._m_LocationList._Item._65_._thetaQly "" VALUE 0xB001084A __UByte_Value 0 NO_COMPU_METHOD 0 255 ECU_ADDRESS_EXTENSION 0x2 BYTE_ORDER MSB_LAST /end CHARACTERISTIC
/begin CHARACTERISTIC _g_PL_AD_fw_Radar_1R1V_rpc_LocBypassingRunnable_LocBypassingRunnable_m_pad_ensRLocationsPort_par_out_local.TChangeableMemPool._._._m_arrayPool._0_._elem._m_LocationList._Item._65_._thetaVar._m_value "" VALUE 0xB001084C __Float16_Value 0 NO_COMPU_METHOD -65504 65504 ECU_ADDRESS_EXTENSION 0x2 BYTE_ORDER MSB_LAST /end CHARACTERISTIC
/begin CHARACTERISTIC _g_PL_AD_fw_Radar_1R1V_rpc_LocBypassingRunnable_LocBypassingRunnable_m_pad_ensRLocationsPort_par_out_local.TChangeableMemPool._._._m_arrayPool._0_._elem._m_LocationList._Item._65_._v "" VALUE 0xB001083C __Float32_Value 0 NO_COMPU_METHOD -3.4028234663852886E+38 3.4028234663852886E+38 ECU_ADDRESS_EXTENSION 0x2 BYTE_ORDER MSB_LAST /end CHARACTERISTIC
/begin CHARACTERISTIC _g_PL_AD_fw_Radar_1R1V_rpc_LocBypassingRunnable_LocBypassingRunnable_m_pad_ensRLocationsPort_par_out_local.TChangeableMemPool._._._m_arrayPool._0_._elem._m_LocationList._Item._65_._vVar._m_value "" VALUE 0xB0010842 __Float16_Value 0 NO_COMPU_METHOD -65504 65504 ECU_ADDRESS_EXTENSION 0x2 BYTE_ORDER MSB_LAST /end CHARACTERISTIC
/begin CHARACTERISTIC _g_PL_AD_fw_Radar_1R1V_rpc_LocBypassingRunnable_LocBypassingRunnable_m_pad_ensRLocationsPort_par_out_local.TChangeableMemPool._._._m_arrayPool._0_._elem._m_LocationList._Item._66_._Rcs._m_value "" VALUE 0xB0010870 __Float16_Value 0 NO_COMPU_METHOD -65504 65504 ECU_ADDRESS_EXTENSION 0x2 BYTE_ORDER MSB_LAST /end CHARACTERISTIC
/begin CHARACTERISTIC _g_PL_AD_fw_Radar_1R1V_rpc_LocBypassingRunnable_LocBypassingRunnable_m_pad_ensRLocationsPort_par_out_local.TChangeableMemPool._._._m_arrayPool._0_._elem._m_LocationList._Item._66_._Rssi._m_value "" VALUE 0xB0010872 __Float16_Value 0 NO_COMPU_METHOD -65504 65504 ECU_ADDRESS_EXTENSION 0x2 BYTE_ORDER MSB_LAST /end CHARACTERISTIC
/begin CHARACTERISTIC _g_PL_AD_fw_Radar_1R1V_rpc_LocBypassingRunnable_LocBypassingRunnable_m_pad_ensRLocationsPort_par_out_local.TChangeableMemPool._._._m_arrayPool._0_._elem._m_LocationList._Item._66_._d "" VALUE 0xB0010858 __Float32_Value 0 NO_COMPU_METHOD -3.4028234663852886E+38 3.4028234663852886E+38 ECU_ADDRESS_EXTENSION 0x2 BYTE_ORDER MSB_LAST /end CHARACTERISTIC
/begin CHARACTERISTIC _g_PL_AD_fw_Radar_1R1V_rpc_LocBypassingRunnable_LocBypassingRunnable_m_pad_ensRLocationsPort_par_out_local.TChangeableMemPool._._._m_arrayPool._0_._elem._m_LocationList._Item._66_._dVar._m_value "" VALUE 0xB0010860 __Float16_Value 0 NO_COMPU_METHOD -65504 65504 ECU_ADDRESS_EXTENSION 0x2 BYTE_ORDER MSB_LAST /end CHARACTERISTIC
/begin CHARACTERISTIC _g_PL_AD_fw_Radar_1R1V_rpc_LocBypassingRunnable_LocBypassingRunnable_m_pad_ensRLocationsPort_par_out_local.TChangeableMemPool._._._m_arrayPool._0_._elem._m_LocationList._Item._66_._dvCov._m_value "" VALUE 0xB0010864 __Float16_Value 0 NO_COMPU_METHOD -65504 65504 ECU_ADDRESS_EXTENSION 0x2 BYTE_ORDER MSB_LAST /end CHARACTERISTIC
/begin CHARACTERISTIC _g_PL_AD_fw_Radar_1R1V_rpc_LocBypassingRunnable_LocBypassingRunnable_m_pad_ensRLocationsPort_par_out_local.TChangeableMemPool._._._m_arrayPool._0_._elem._m_LocationList._Item._66_._dvQly "" VALUE 0xB0010874 __UByte_Value 0 NO_COMPU_METHOD 0 255 ECU_ADDRESS_EXTENSION 0x2 BYTE_ORDER MSB_LAST /end CHARACTERISTIC
/begin CHARACTERISTIC _g_PL_AD_fw_Radar_1R1V_rpc_LocBypassingRunnable_LocBypassingRunnable_m_pad_ensRLocationsPort_par_out_local.TChangeableMemPool._._._m_arrayPool._0_._elem._m_LocationList._Item._66_._idxAzimuthAmbiguityPeer "" VALUE 0xB0010876 __UWord_Value 0 NO_COMPU_METHOD 0 65535 ECU_ADDRESS_EXTENSION 0x2 BYTE_ORDER MSB_LAST /end CHARACTERISTIC
/begin CHARACTERISTIC _g_PL_AD_fw_Radar_1R1V_rpc_LocBypassingRunnable_LocBypassingRunnable_m_pad_ensRLocationsPort_par_out_local.TChangeableMemPool._._._m_arrayPool._0_._elem._m_LocationList._Item._66_._measStatus "" VALUE 0xB0010875 __UByte_Value 0 NO_COMPU_METHOD 0 255 ECU_ADDRESS_EXTENSION 0x2 BYTE_ORDER MSB_LAST /end CHARACTERISTIC
/begin CHARACTERISTIC _g_PL_AD_fw_Radar_1R1V_rpc_LocBypassingRunnable_LocBypassingRunnable_m_pad_ensRLocationsPort_par_out_local.TChangeableMemPool._._._m_arrayPool._0_._elem._m_LocationList._Item._66_._phi._m_value "" VALUE 0xB0010868 __Float16_Value 0 NO_COMPU_METHOD -65504 65504 ECU_ADDRESS_EXTENSION 0x2 BYTE_ORDER MSB_LAST /end CHARACTERISTIC
/begin CHARACTERISTIC _g_PL_AD_fw_Radar_1R1V_rpc_LocBypassingRunnable_LocBypassingRunnable_m_pad_ensRLocationsPort_par_out_local.TChangeableMemPool._._._m_arrayPool._0_._elem._m_LocationList._Item._66_._phiQly "" VALUE 0xB001086B __UByte_Value 0 NO_COMPU_METHOD 0 255 ECU_ADDRESS_EXTENSION 0x2 BYTE_ORDER MSB_LAST /end CHARACTERISTIC
/begin CHARACTERISTIC _g_PL_AD_fw_Radar_1R1V_rpc_LocBypassingRunnable_LocBypassingRunnable_m_pad_ensRLocationsPort_par_out_local.TChangeableMemPool._._._m_arrayPool._0_._elem._m_LocationList._Item._66_._phiVar._m_value "" VALUE 0xB001086E __Float16_Value 0 NO_COMPU_METHOD -65504 65504 ECU_ADDRESS_EXTENSION 0x2 BYTE_ORDER MSB_LAST /end CHARACTERISTIC
/begin CHARACTERISTIC _g_PL_AD_fw_Radar_1R1V_rpc_LocBypassingRunnable_LocBypassingRunnable_m_pad_ensRLocationsPort_par_out_local.TChangeableMemPool._._._m_arrayPool._0_._elem._m_LocationList._Item._66_._theta._m_value "" VALUE 0xB0010866 __Float16_Value 0 NO_COMPU_METHOD -65504 65504 ECU_ADDRESS_EXTENSION 0x2 BYTE_ORDER MSB_LAST /end CHARACTERISTIC
/begin CHARACTERISTIC _g_PL_AD_fw_Radar_1R1V_rpc_LocBypassingRunnable_LocBypassingRunnable_m_pad_ensRLocationsPort_par_out_local.TChangeableMemPool._._._m_arrayPool._0_._elem._m_LocationList._Item._66_._thetaQly "" VALUE 0xB001086A __UByte_Value 0 NO_COMPU_METHOD 0 255 ECU_ADDRESS_EXTENSION 0x2 BYTE_ORDER MSB_LAST /end CHARACTERISTIC
/begin CHARACTERISTIC _g_PL_AD_fw_Radar_1R1V_rpc_LocBypassingRunnable_LocBypassingRunnable_m_pad_ensRLocationsPort_par_out_local.TChangeableMemPool._._._m_arrayPool._0_._elem._m_LocationList._Item._66_._thetaVar._m_value "" VALUE 0xB001086C __Float16_Value 0 NO_COMPU_METHOD -65504 65504 ECU_ADDRESS_EXTENSION 0x2 BYTE_ORDER MSB_LAST /end CHARACTERISTIC
/begin CHARACTERISTIC _g_PL_AD_fw_Radar_1R1V_rpc_LocBypassingRunnable_LocBypassingRunnable_m_pad_ensRLocationsPort_par_out_local.TChangeableMemPool._._._m_arrayPool._0_._elem._m_LocationList._Item._66_._v "" VALUE 0xB001085C __Float32_Value 0 NO_COMPU_METHOD -3.4028234663852886E+38 3.4028234663852886E+38 ECU_ADDRESS_EXTENSION 0x2 BYTE_ORDER MSB_LAST /end CHARACTERISTIC
/begin CHARACTERISTIC _g_PL_AD_fw_Radar_1R1V_rpc_LocBypassingRunnable_LocBypassingRunnable_m_pad_ensRLocationsPort_par_out_local.TChangeableMemPool._._._m_arrayPool._0_._elem._m_LocationList._Item._66_._vVar._m_value "" VALUE 0xB0010862 __Float16_Value 0 NO_COMPU_METHOD -65504 65504 ECU_ADDRESS_EXTENSION 0x2 BYTE_ORDER MSB_LAST /end CHARACTERISTIC
/begin CHARACTERISTIC _g_PL_AD_fw_Radar_1R1V_rpc_LocBypassingRunnable_LocBypassingRunnable_m_pad_ensRLocationsPort_par_out_local.TChangeableMemPool._._._m_arrayPool._0_._elem._m_LocationList._Item._67_._Rcs._m_value "" VALUE 0xB0010890 __Float16_Value 0 NO_COMPU_METHOD -65504 65504 ECU_ADDRESS_EXTENSION 0x2 BYTE_ORDER MSB_LAST /end CHARACTERISTIC
/begin CHARACTERISTIC _g_PL_AD_fw_Radar_1R1V_rpc_LocBypassingRunnable_LocBypassingRunnable_m_pad_ensRLocationsPort_par_out_local.TChangeableMemPool._._._m_arrayPool._0_._elem._m_LocationList._Item._67_._Rssi._m_value "" VALUE 0xB0010892 __Float16_Value 0 NO_COMPU_METHOD -65504 65504 ECU_ADDRESS_EXTENSION 0x2 BYTE_ORDER MSB_LAST /end CHARACTERISTIC
/begin CHARACTERISTIC _g_PL_AD_fw_Radar_1R1V_rpc_LocBypassingRunnable_LocBypassingRunnable_m_pad_ensRLocationsPort_par_out_local.TChangeableMemPool._._._m_arrayPool._0_._elem._m_LocationList._Item._67_._d "" VALUE 0xB0010878 __Float32_Value 0 NO_COMPU_METHOD -3.4028234663852886E+38 3.4028234663852886E+38 ECU_ADDRESS_EXTENSION 0x2 BYTE_ORDER MSB_LAST /end CHARACTERISTIC
/begin CHARACTERISTIC _g_PL_AD_fw_Radar_1R1V_rpc_LocBypassingRunnable_LocBypassingRunnable_m_pad_ensRLocationsPort_par_out_local.TChangeableMemPool._._._m_arrayPool._0_._elem._m_LocationList._Item._67_._dVar._m_value "" VALUE 0xB0010880 __Float16_Value 0 NO_COMPU_METHOD -65504 65504 ECU_ADDRESS_EXTENSION 0x2 BYTE_ORDER MSB_LAST /end CHARACTERISTIC
/begin CHARACTERISTIC _g_PL_AD_fw_Radar_1R1V_rpc_LocBypassingRunnable_LocBypassingRunnable_m_pad_ensRLocationsPort_par_out_local.TChangeableMemPool._._._m_arrayPool._0_._elem._m_LocationList._Item._67_._dvCov._m_value "" VALUE 0xB0010884 __Float16_Value 0 NO_COMPU_METHOD -65504 65504 ECU_ADDRESS_EXTENSION 0x2 BYTE_ORDER MSB_LAST /end CHARACTERISTIC
/begin CHARACTERISTIC _g_PL_AD_fw_Radar_1R1V_rpc_LocBypassingRunnable_LocBypassingRunnable_m_pad_ensRLocationsPort_par_out_local.TChangeableMemPool._._._m_arrayPool._0_._elem._m_LocationList._Item._67_._dvQly "" VALUE 0xB0010894 __UByte_Value 0 NO_COMPU_METHOD 0 255 ECU_ADDRESS_EXTENSION 0x2 BYTE_ORDER MSB_LAST /end CHARACTERISTIC
/begin CHARACTERISTIC _g_PL_AD_fw_Radar_1R1V_rpc_LocBypassingRunnable_LocBypassingRunnable_m_pad_ensRLocationsPort_par_out_local.TChangeableMemPool._._._m_arrayPool._0_._elem._m_LocationList._Item._67_._idxAzimuthAmbiguityPeer "" VALUE 0xB0010896 __UWord_Value 0 NO_COMPU_METHOD 0 65535 ECU_ADDRESS_EXTENSION 0x2 BYTE_ORDER MSB_LAST /end CHARACTERISTIC
/begin CHARACTERISTIC _g_PL_AD_fw_Radar_1R1V_rpc_LocBypassingRunnable_LocBypassingRunnable_m_pad_ensRLocationsPort_par_out_local.TChangeableMemPool._._._m_arrayPool._0_._elem._m_LocationList._Item._67_._measStatus "" VALUE 0xB0010895 __UByte_Value 0 NO_COMPU_METHOD 0 255 ECU_ADDRESS_EXTENSION 0x2 BYTE_ORDER MSB_LAST /end CHARACTERISTIC
/begin CHARACTERISTIC _g_PL_AD_fw_Radar_1R1V_rpc_LocBypassingRunnable_LocBypassingRunnable_m_pad_ensRLocationsPort_par_out_local.TChangeableMemPool._._._m_arrayPool._0_._elem._m_LocationList._Item._67_._phi._m_value "" VALUE 0xB0010888 __Float16_Value 0 NO_COMPU_METHOD -65504 65504 ECU_ADDRESS_EXTENSION 0x2 BYTE_ORDER MSB_LAST /end CHARACTERISTIC
/begin CHARACTERISTIC _g_PL_AD_fw_Radar_1R1V_rpc_LocBypassingRunnable_LocBypassingRunnable_m_pad_ensRLocationsPort_par_out_local.TChangeableMemPool._._._m_arrayPool._0_._elem._m_LocationList._Item._67_._phiQly "" VALUE 0xB001088B __UByte_Value 0 NO_COMPU_METHOD 0 255 ECU_ADDRESS_EXTENSION 0x2 BYTE_ORDER MSB_LAST /end CHARACTERISTIC
/begin CHARACTERISTIC _g_PL_AD_fw_Radar_1R1V_rpc_LocBypassingRunnable_LocBypassingRunnable_m_pad_ensRLocationsPort_par_out_local.TChangeableMemPool._._._m_arrayPool._0_._elem._m_LocationList._Item._67_._phiVar._m_value "" VALUE 0xB001088E __Float16_Value 0 NO_COMPU_METHOD -65504 65504 ECU_ADDRESS_EXTENSION 0x2 BYTE_ORDER MSB_LAST /end CHARACTERISTIC
/begin CHARACTERISTIC _g_PL_AD_fw_Radar_1R1V_rpc_LocBypassingRunnable_LocBypassingRunnable_m_pad_ensRLocationsPort_par_out_local.TChangeableMemPool._._._m_arrayPool._0_._elem._m_LocationList._Item._67_._theta._m_value "" VALUE 0xB0010886 __Float16_Value 0 NO_COMPU_METHOD -65504 65504 ECU_ADDRESS_EXTENSION 0x2 BYTE_ORDER MSB_LAST /end CHARACTERISTIC
/begin CHARACTERISTIC _g_PL_AD_fw_Radar_1R1V_rpc_LocBypassingRunnable_LocBypassingRunnable_m_pad_ensRLocationsPort_par_out_local.TChangeableMemPool._._._m_arrayPool._0_._elem._m_LocationList._Item._67_._thetaQly "" VALUE 0xB001088A __UByte_Value 0 NO_COMPU_METHOD 0 255 ECU_ADDRESS_EXTENSION 0x2 BYTE_ORDER MSB_LAST /end CHARACTERISTIC
/begin CHARACTERISTIC _g_PL_AD_fw_Radar_1R1V_rpc_LocBypassingRunnable_LocBypassingRunnable_m_pad_ensRLocationsPort_par_out_local.TChangeableMemPool._._._m_arrayPool._0_._elem._m_LocationList._Item._67_._thetaVar._m_value "" VALUE 0xB001088C __Float16_Value 0 NO_COMPU_METHOD -65504 65504 ECU_ADDRESS_EXTENSION 0x2 BYTE_ORDER MSB_LAST /end CHARACTERISTIC
/begin CHARACTERISTIC _g_PL_AD_fw_Radar_1R1V_rpc_LocBypassingRunnable_LocBypassingRunnable_m_pad_ensRLocationsPort_par_out_local.TChangeableMemPool._._._m_arrayPool._0_._elem._m_LocationList._Item._67_._v "" VALUE 0xB001087C __Float32_Value 0 NO_COMPU_METHOD -3.4028234663852886E+38 3.4028234663852886E+38 ECU_ADDRESS_EXTENSION 0x2 BYTE_ORDER MSB_LAST /end CHARACTERISTIC
/begin CHARACTERISTIC _g_PL_AD_fw_Radar_1R1V_rpc_LocBypassingRunnable_LocBypassingRunnable_m_pad_ensRLocationsPort_par_out_local.TChangeableMemPool._._._m_arrayPool._0_._elem._m_LocationList._Item._67_._vVar._m_value "" VALUE 0xB0010882 __Float16_Value 0 NO_COMPU_METHOD -65504 65504 ECU_ADDRESS_EXTENSION 0x2 BYTE_ORDER MSB_LAST /end CHARACTERISTIC
/begin CHARACTERISTIC _g_PL_AD_fw_Radar_1R1V_rpc_LocBypassingRunnable_LocBypassingRunnable_m_pad_ensRLocationsPort_par_out_local.TChangeableMemPool._._._m_arrayPool._0_._elem._m_LocationList._Item._68_._Rcs._m_value "" VALUE 0xB00108B0 __Float16_Value 0 NO_COMPU_METHOD -65504 65504 ECU_ADDRESS_EXTENSION 0x2 BYTE_ORDER MSB_LAST /end CHARACTERISTIC
/begin CHARACTERISTIC _g_PL_AD_fw_Radar_1R1V_rpc_LocBypassingRunnable_LocBypassingRunnable_m_pad_ensRLocationsPort_par_out_local.TChangeableMemPool._._._m_arrayPool._0_._elem._m_LocationList._Item._68_._Rssi._m_value "" VALUE 0xB00108B2 __Float16_Value 0 NO_COMPU_METHOD -65504 65504 ECU_ADDRESS_EXTENSION 0x2 BYTE_ORDER MSB_LAST /end CHARACTERISTIC
/begin CHARACTERISTIC _g_PL_AD_fw_Radar_1R1V_rpc_LocBypassingRunnable_LocBypassingRunnable_m_pad_ensRLocationsPort_par_out_local.TChangeableMemPool._._._m_arrayPool._0_._elem._m_LocationList._Item._68_._d "" VALUE 0xB0010898 __Float32_Value 0 NO_COMPU_METHOD -3.4028234663852886E+38 3.4028234663852886E+38 ECU_ADDRESS_EXTENSION 0x2 BYTE_ORDER MSB_LAST /end CHARACTERISTIC
/begin CHARACTERISTIC _g_PL_AD_fw_Radar_1R1V_rpc_LocBypassingRunnable_LocBypassingRunnable_m_pad_ensRLocationsPort_par_out_local.TChangeableMemPool._._._m_arrayPool._0_._elem._m_LocationList._Item._68_._dVar._m_value "" VALUE 0xB00108A0 __Float16_Value 0 NO_COMPU_METHOD -65504 65504 ECU_ADDRESS_EXTENSION 0x2 BYTE_ORDER MSB_LAST /end CHARACTERISTIC
/begin CHARACTERISTIC _g_PL_AD_fw_Radar_1R1V_rpc_LocBypassingRunnable_LocBypassingRunnable_m_pad_ensRLocationsPort_par_out_local.TChangeableMemPool._._._m_arrayPool._0_._elem._m_LocationList._Item._68_._dvCov._m_value "" VALUE 0xB00108A4 __Float16_Value 0 NO_COMPU_METHOD -65504 65504 ECU_ADDRESS_EXTENSION 0x2 BYTE_ORDER MSB_LAST /end CHARACTERISTIC
/begin CHARACTERISTIC _g_PL_AD_fw_Radar_1R1V_rpc_LocBypassingRunnable_LocBypassingRunnable_m_pad_ensRLocationsPort_par_out_local.TChangeableMemPool._._._m_arrayPool._0_._elem._m_LocationList._Item._68_._dvQly "" VALUE 0xB00108B4 __UByte_Value 0 NO_COMPU_METHOD 0 255 ECU_ADDRESS_EXTENSION 0x2 BYTE_ORDER MSB_LAST /end CHARACTERISTIC
/begin CHARACTERISTIC _g_PL_AD_fw_Radar_1R1V_rpc_LocBypassingRunnable_LocBypassingRunnable_m_pad_ensRLocationsPort_par_out_local.TChangeableMemPool._._._m_arrayPool._0_._elem._m_LocationList._Item._68_._idxAzimuthAmbiguityPeer "" VALUE 0xB00108B6 __UWord_Value 0 NO_COMPU_METHOD 0 65535 ECU_ADDRESS_EXTENSION 0x2 BYTE_ORDER MSB_LAST /end CHARACTERISTIC
/begin CHARACTERISTIC _g_PL_AD_fw_Radar_1R1V_rpc_LocBypassingRunnable_LocBypassingRunnable_m_pad_ensRLocationsPort_par_out_local.TChangeableMemPool._._._m_arrayPool._0_._elem._m_LocationList._Item._68_._measStatus "" VALUE 0xB00108B5 __UByte_Value 0 NO_COMPU_METHOD 0 255 ECU_ADDRESS_EXTENSION 0x2 BYTE_ORDER MSB_LAST /end CHARACTERISTIC
/begin CHARACTERISTIC _g_PL_AD_fw_Radar_1R1V_rpc_LocBypassingRunnable_LocBypassingRunnable_m_pad_ensRLocationsPort_par_out_local.TChangeableMemPool._._._m_arrayPool._0_._elem._m_LocationList._Item._68_._phi._m_value "" VALUE 0xB00108A8 __Float16_Value 0 NO_COMPU_METHOD -65504 65504 ECU_ADDRESS_EXTENSION 0x2 BYTE_ORDER MSB_LAST /end CHARACTERISTIC
/begin CHARACTERISTIC _g_PL_AD_fw_Radar_1R1V_rpc_LocBypassingRunnable_LocBypassingRunnable_m_pad_ensRLocationsPort_par_out_local.TChangeableMemPool._._._m_arrayPool._0_._elem._m_LocationList._Item._68_._phiQly "" VALUE 0xB00108AB __UByte_Value 0 NO_COMPU_METHOD 0 255 ECU_ADDRESS_EXTENSION 0x2 BYTE_ORDER MSB_LAST /end CHARACTERISTIC
/begin CHARACTERISTIC _g_PL_AD_fw_Radar_1R1V_rpc_LocBypassingRunnable_LocBypassingRunnable_m_pad_ensRLocationsPort_par_out_local.TChangeableMemPool._._._m_arrayPool._0_._elem._m_LocationList._Item._68_._phiVar._m_value "" VALUE 0xB00108AE __Float16_Value 0 NO_COMPU_METHOD -65504 65504 ECU_ADDRESS_EXTENSION 0x2 BYTE_ORDER MSB_LAST /end CHARACTERISTIC
/begin CHARACTERISTIC _g_PL_AD_fw_Radar_1R1V_rpc_LocBypassingRunnable_LocBypassingRunnable_m_pad_ensRLocationsPort_par_out_local.TChangeableMemPool._._._m_arrayPool._0_._elem._m_LocationList._Item._68_._theta._m_value "" VALUE 0xB00108A6 __Float16_Value 0 NO_COMPU_METHOD -65504 65504 ECU_ADDRESS_EXTENSION 0x2 BYTE_ORDER MSB_LAST /end CHARACTERISTIC
/begin CHARACTERISTIC _g_PL_AD_fw_Radar_1R1V_rpc_LocBypassingRunnable_LocBypassingRunnable_m_pad_ensRLocationsPort_par_out_local.TChangeableMemPool._._._m_arrayPool._0_._elem._m_LocationList._Item._68_._thetaQly "" VALUE 0xB00108AA __UByte_Value 0 NO_COMPU_METHOD 0 255 ECU_ADDRESS_EXTENSION 0x2 BYTE_ORDER MSB_LAST /end CHARACTERISTIC
/begin CHARACTERISTIC _g_PL_AD_fw_Radar_1R1V_rpc_LocBypassingRunnable_LocBypassingRunnable_m_pad_ensRLocationsPort_par_out_local.TChangeableMemPool._._._m_arrayPool._0_._elem._m_LocationList._Item._68_._thetaVar._m_value "" VALUE 0xB00108AC __Float16_Value 0 NO_COMPU_METHOD -65504 65504 ECU_ADDRESS_EXTENSION 0x2 BYTE_ORDER MSB_LAST /end CHARACTERISTIC
/begin CHARACTERISTIC _g_PL_AD_fw_Radar_1R1V_rpc_LocBypassingRunnable_LocBypassingRunnable_m_pad_ensRLocationsPort_par_out_local.TChangeableMemPool._._._m_arrayPool._0_._elem._m_LocationList._Item._68_._v "" VALUE 0xB001089C __Float32_Value 0 NO_COMPU_METHOD -3.4028234663852886E+38 3.4028234663852886E+38 ECU_ADDRESS_EXTENSION 0x2 BYTE_ORDER MSB_LAST /end CHARACTERISTIC
/begin CHARACTERISTIC _g_PL_AD_fw_Radar_1R1V_rpc_LocBypassingRunnable_LocBypassingRunnable_m_pad_ensRLocationsPort_par_out_local.TChangeableMemPool._._._m_arrayPool._0_._elem._m_LocationList._Item._68_._vVar._m_value "" VALUE 0xB00108A2 __Float16_Value 0 NO_COMPU_METHOD -65504 65504 ECU_ADDRESS_EXTENSION 0x2 BYTE_ORDER MSB_LAST /end CHARACTERISTIC
/begin CHARACTERISTIC _g_PL_AD_fw_Radar_1R1V_rpc_LocBypassingRunnable_LocBypassingRunnable_m_pad_ensRLocationsPort_par_out_local.TChangeableMemPool._._._m_arrayPool._0_._elem._m_LocationList._Item._69_._Rcs._m_value "" VALUE 0xB00108D0 __Float16_Value 0 NO_COMPU_METHOD -65504 65504 ECU_ADDRESS_EXTENSION 0x2 BYTE_ORDER MSB_LAST /end CHARACTERISTIC
/begin CHARACTERISTIC _g_PL_AD_fw_Radar_1R1V_rpc_LocBypassingRunnable_LocBypassingRunnable_m_pad_ensRLocationsPort_par_out_local.TChangeableMemPool._._._m_arrayPool._0_._elem._m_LocationList._Item._69_._Rssi._m_value "" VALUE 0xB00108D2 __Float16_Value 0 NO_COMPU_METHOD -65504 65504 ECU_ADDRESS_EXTENSION 0x2 BYTE_ORDER MSB_LAST /end CHARACTERISTIC
/begin CHARACTERISTIC _g_PL_AD_fw_Radar_1R1V_rpc_LocBypassingRunnable_LocBypassingRunnable_m_pad_ensRLocationsPort_par_out_local.TChangeableMemPool._._._m_arrayPool._0_._elem._m_LocationList._Item._69_._d "" VALUE 0xB00108B8 __Float32_Value 0 NO_COMPU_METHOD -3.4028234663852886E+38 3.4028234663852886E+38 ECU_ADDRESS_EXTENSION 0x2 BYTE_ORDER MSB_LAST /end CHARACTERISTIC
/begin CHARACTERISTIC _g_PL_AD_fw_Radar_1R1V_rpc_LocBypassingRunnable_LocBypassingRunnable_m_pad_ensRLocationsPort_par_out_local.TChangeableMemPool._._._m_arrayPool._0_._elem._m_LocationList._Item._69_._dVar._m_value "" VALUE 0xB00108C0 __Float16_Value 0 NO_COMPU_METHOD -65504 65504 ECU_ADDRESS_EXTENSION 0x2 BYTE_ORDER MSB_LAST /end CHARACTERISTIC
/begin CHARACTERISTIC _g_PL_AD_fw_Radar_1R1V_rpc_LocBypassingRunnable_LocBypassingRunnable_m_pad_ensRLocationsPort_par_out_local.TChangeableMemPool._._._m_arrayPool._0_._elem._m_LocationList._Item._69_._dvCov._m_value "" VALUE 0xB00108C4 __Float16_Value 0 NO_COMPU_METHOD -65504 65504 ECU_ADDRESS_EXTENSION 0x2 BYTE_ORDER MSB_LAST /end CHARACTERISTIC
/begin CHARACTERISTIC _g_PL_AD_fw_Radar_1R1V_rpc_LocBypassingRunnable_LocBypassingRunnable_m_pad_ensRLocationsPort_par_out_local.TChangeableMemPool._._._m_arrayPool._0_._elem._m_LocationList._Item._69_._dvQly "" VALUE 0xB00108D4 __UByte_Value 0 NO_COMPU_METHOD 0 255 ECU_ADDRESS_EXTENSION 0x2 BYTE_ORDER MSB_LAST /end CHARACTERISTIC
/begin CHARACTERISTIC _g_PL_AD_fw_Radar_1R1V_rpc_LocBypassingRunnable_LocBypassingRunnable_m_pad_ensRLocationsPort_par_out_local.TChangeableMemPool._._._m_arrayPool._0_._elem._m_LocationList._Item._69_._idxAzimuthAmbiguityPeer "" VALUE 0xB00108D6 __UWord_Value 0 NO_COMPU_METHOD 0 65535 ECU_ADDRESS_EXTENSION 0x2 BYTE_ORDER MSB_LAST /end CHARACTERISTIC
/begin CHARACTERISTIC _g_PL_AD_fw_Radar_1R1V_rpc_LocBypassingRunnable_LocBypassingRunnable_m_pad_ensRLocationsPort_par_out_local.TChangeableMemPool._._._m_arrayPool._0_._elem._m_LocationList._Item._69_._measStatus "" VALUE 0xB00108D5 __UByte_Value 0 NO_COMPU_METHOD 0 255 ECU_ADDRESS_EXTENSION 0x2 BYTE_ORDER MSB_LAST /end CHARACTERISTIC
/begin CHARACTERISTIC _g_PL_AD_fw_Radar_1R1V_rpc_LocBypassingRunnable_LocBypassingRunnable_m_pad_ensRLocationsPort_par_out_local.TChangeableMemPool._._._m_arrayPool._0_._elem._m_LocationList._Item._69_._phi._m_value "" VALUE 0xB00108C8 __Float16_Value 0 NO_COMPU_METHOD -65504 65504 ECU_ADDRESS_EXTENSION 0x2 BYTE_ORDER MSB_LAST /end CHARACTERISTIC
/begin CHARACTERISTIC _g_PL_AD_fw_Radar_1R1V_rpc_LocBypassingRunnable_LocBypassingRunnable_m_pad_ensRLocationsPort_par_out_local.TChangeableMemPool._._._m_arrayPool._0_._elem._m_LocationList._Item._69_._phiQly "" VALUE 0xB00108CB __UByte_Value 0 NO_COMPU_METHOD 0 255 ECU_ADDRESS_EXTENSION 0x2 BYTE_ORDER MSB_LAST /end CHARACTERISTIC
/begin CHARACTERISTIC _g_PL_AD_fw_Radar_1R1V_rpc_LocBypassingRunnable_LocBypassingRunnable_m_pad_ensRLocationsPort_par_out_local.TChangeableMemPool._._._m_arrayPool._0_._elem._m_LocationList._Item._69_._phiVar._m_value "" VALUE 0xB00108CE __Float16_Value 0 NO_COMPU_METHOD -65504 65504 ECU_ADDRESS_EXTENSION 0x2 BYTE_ORDER MSB_LAST /end CHARACTERISTIC
/begin CHARACTERISTIC _g_PL_AD_fw_Radar_1R1V_rpc_LocBypassingRunnable_LocBypassingRunnable_m_pad_ensRLocationsPort_par_out_local.TChangeableMemPool._._._m_arrayPool._0_._elem._m_LocationList._Item._69_._theta._m_value "" VALUE 0xB00108C6 __Float16_Value 0 NO_COMPU_METHOD -65504 65504 ECU_ADDRESS_EXTENSION 0x2 BYTE_ORDER MSB_LAST /end CHARACTERISTIC
/begin CHARACTERISTIC _g_PL_AD_fw_Radar_1R1V_rpc_LocBypassingRunnable_LocBypassingRunnable_m_pad_ensRLocationsPort_par_out_local.TChangeableMemPool._._._m_arrayPool._0_._elem._m_LocationList._Item._69_._thetaQly "" VALUE 0xB00108CA __UByte_Value 0 NO_COMPU_METHOD 0 255 ECU_ADDRESS_EXTENSION 0x2 BYTE_ORDER MSB_LAST /end CHARACTERISTIC
/begin CHARACTERISTIC _g_PL_AD_fw_Radar_1R1V_rpc_LocBypassingRunnable_LocBypassingRunnable_m_pad_ensRLocationsPort_par_out_local.TChangeableMemPool._._._m_arrayPool._0_._elem._m_LocationList._Item._69_._thetaVar._m_value "" VALUE 0xB00108CC __Float16_Value 0 NO_COMPU_METHOD -65504 65504 ECU_ADDRESS_EXTENSION 0x2 BYTE_ORDER MSB_LAST /end CHARACTERISTIC
/begin CHARACTERISTIC _g_PL_AD_fw_Radar_1R1V_rpc_LocBypassingRunnable_LocBypassingRunnable_m_pad_ensRLocationsPort_par_out_local.TChangeableMemPool._._._m_arrayPool._0_._elem._m_LocationList._Item._69_._v "" VALUE 0xB00108BC __Float32_Value 0 NO_COMPU_METHOD -3.4028234663852886E+38 3.4028234663852886E+38 ECU_ADDRESS_EXTENSION 0x2 BYTE_ORDER MSB_LAST /end CHARACTERISTIC
/begin CHARACTERISTIC _g_PL_AD_fw_Radar_1R1V_rpc_LocBypassingRunnable_LocBypassingRunnable_m_pad_ensRLocationsPort_par_out_local.TChangeableMemPool._._._m_arrayPool._0_._elem._m_LocationList._Item._69_._vVar._m_value "" VALUE 0xB00108C2 __Float16_Value 0 NO_COMPU_METHOD -65504 65504 ECU_ADDRESS_EXTENSION 0x2 BYTE_ORDER MSB_LAST /end CHARACTERISTIC
/begin CHARACTERISTIC _g_PL_AD_fw_Radar_1R1V_rpc_LocBypassingRunnable_LocBypassingRunnable_m_pad_ensRLocationsPort_par_out_local.TChangeableMemPool._._._m_arrayPool._0_._elem._m_LocationList._Item._6_._Rcs._m_value "" VALUE 0xB00100F0 __Float16_Value 0 NO_COMPU_METHOD -65504 65504 ECU_ADDRESS_EXTENSION 0x2 BYTE_ORDER MSB_LAST /end CHARACTERISTIC
/begin CHARACTERISTIC _g_PL_AD_fw_Radar_1R1V_rpc_LocBypassingRunnable_LocBypassingRunnable_m_pad_ensRLocationsPort_par_out_local.TChangeableMemPool._._._m_arrayPool._0_._elem._m_LocationList._Item._6_._Rssi._m_value "" VALUE 0xB00100F2 __Float16_Value 0 NO_COMPU_METHOD -65504 65504 ECU_ADDRESS_EXTENSION 0x2 BYTE_ORDER MSB_LAST /end CHARACTERISTIC
/begin CHARACTERISTIC _g_PL_AD_fw_Radar_1R1V_rpc_LocBypassingRunnable_LocBypassingRunnable_m_pad_ensRLocationsPort_par_out_local.TChangeableMemPool._._._m_arrayPool._0_._elem._m_LocationList._Item._6_._d "" VALUE 0xB00100D8 __Float32_Value 0 NO_COMPU_METHOD -3.4028234663852886E+38 3.4028234663852886E+38 ECU_ADDRESS_EXTENSION 0x2 BYTE_ORDER MSB_LAST /end CHARACTERISTIC
/begin CHARACTERISTIC _g_PL_AD_fw_Radar_1R1V_rpc_LocBypassingRunnable_LocBypassingRunnable_m_pad_ensRLocationsPort_par_out_local.TChangeableMemPool._._._m_arrayPool._0_._elem._m_LocationList._Item._6_._dVar._m_value "" VALUE 0xB00100E0 __Float16_Value 0 NO_COMPU_METHOD -65504 65504 ECU_ADDRESS_EXTENSION 0x2 BYTE_ORDER MSB_LAST /end CHARACTERISTIC
/begin CHARACTERISTIC _g_PL_AD_fw_Radar_1R1V_rpc_LocBypassingRunnable_LocBypassingRunnable_m_pad_ensRLocationsPort_par_out_local.TChangeableMemPool._._._m_arrayPool._0_._elem._m_LocationList._Item._6_._dvCov._m_value "" VALUE 0xB00100E4 __Float16_Value 0 NO_COMPU_METHOD -65504 65504 ECU_ADDRESS_EXTENSION 0x2 BYTE_ORDER MSB_LAST /end CHARACTERISTIC
/begin CHARACTERISTIC _g_PL_AD_fw_Radar_1R1V_rpc_LocBypassingRunnable_LocBypassingRunnable_m_pad_ensRLocationsPort_par_out_local.TChangeableMemPool._._._m_arrayPool._0_._elem._m_LocationList._Item._6_._dvQly "" VALUE 0xB00100F4 __UByte_Value 0 NO_COMPU_METHOD 0 255 ECU_ADDRESS_EXTENSION 0x2 BYTE_ORDER MSB_LAST /end CHARACTERISTIC
/begin CHARACTERISTIC _g_PL_AD_fw_Radar_1R1V_rpc_LocBypassingRunnable_LocBypassingRunnable_m_pad_ensRLocationsPort_par_out_local.TChangeableMemPool._._._m_arrayPool._0_._elem._m_LocationList._Item._6_._idxAzimuthAmbiguityPeer "" VALUE 0xB00100F6 __UWord_Value 0 NO_COMPU_METHOD 0 65535 ECU_ADDRESS_EXTENSION 0x2 BYTE_ORDER MSB_LAST /end CHARACTERISTIC
/begin CHARACTERISTIC _g_PL_AD_fw_Radar_1R1V_rpc_LocBypassingRunnable_LocBypassingRunnable_m_pad_ensRLocationsPort_par_out_local.TChangeableMemPool._._._m_arrayPool._0_._elem._m_LocationList._Item._6_._measStatus "" VALUE 0xB00100F5 __UByte_Value 0 NO_COMPU_METHOD 0 255 ECU_ADDRESS_EXTENSION 0x2 BYTE_ORDER MSB_LAST /end CHARACTERISTIC
/begin CHARACTERISTIC _g_PL_AD_fw_Radar_1R1V_rpc_LocBypassingRunnable_LocBypassingRunnable_m_pad_ensRLocationsPort_par_out_local.TChangeableMemPool._._._m_arrayPool._0_._elem._m_LocationList._Item._6_._phi._m_value "" VALUE 0xB00100E8 __Float16_Value 0 NO_COMPU_METHOD -65504 65504 ECU_ADDRESS_EXTENSION 0x2 BYTE_ORDER MSB_LAST /end CHARACTERISTIC
/begin CHARACTERISTIC _g_PL_AD_fw_Radar_1R1V_rpc_LocBypassingRunnable_LocBypassingRunnable_m_pad_ensRLocationsPort_par_out_local.TChangeableMemPool._._._m_arrayPool._0_._elem._m_LocationList._Item._6_._phiQly "" VALUE 0xB00100EB __UByte_Value 0 NO_COMPU_METHOD 0 255 ECU_ADDRESS_EXTENSION 0x2 BYTE_ORDER MSB_LAST /end CHARACTERISTIC
/begin CHARACTERISTIC _g_PL_AD_fw_Radar_1R1V_rpc_LocBypassingRunnable_LocBypassingRunnable_m_pad_ensRLocationsPort_par_out_local.TChangeableMemPool._._._m_arrayPool._0_._elem._m_LocationList._Item._6_._phiVar._m_value "" VALUE 0xB00100EE __Float16_Value 0 NO_COMPU_METHOD -65504 65504 ECU_ADDRESS_EXTENSION 0x2 BYTE_ORDER MSB_LAST /end CHARACTERISTIC
/begin CHARACTERISTIC _g_PL_AD_fw_Radar_1R1V_rpc_LocBypassingRunnable_LocBypassingRunnable_m_pad_ensRLocationsPort_par_out_local.TChangeableMemPool._._._m_arrayPool._0_._elem._m_LocationList._Item._6_._theta._m_value "" VALUE 0xB00100E6 __Float16_Value 0 NO_COMPU_METHOD -65504 65504 ECU_ADDRESS_EXTENSION 0x2 BYTE_ORDER MSB_LAST /end CHARACTERISTIC
/begin CHARACTERISTIC _g_PL_AD_fw_Radar_1R1V_rpc_LocBypassingRunnable_LocBypassingRunnable_m_pad_ensRLocationsPort_par_out_local.TChangeableMemPool._._._m_arrayPool._0_._elem._m_LocationList._Item._6_._thetaQly "" VALUE 0xB00100EA __UByte_Value 0 NO_COMPU_METHOD 0 255 ECU_ADDRESS_EXTENSION 0x2 BYTE_ORDER MSB_LAST /end CHARACTERISTIC
/begin CHARACTERISTIC _g_PL_AD_fw_Radar_1R1V_rpc_LocBypassingRunnable_LocBypassingRunnable_m_pad_ensRLocationsPort_par_out_local.TChangeableMemPool._._._m_arrayPool._0_._elem._m_LocationList._Item._6_._thetaVar._m_value "" VALUE 0xB00100EC __Float16_Value 0 NO_COMPU_METHOD -65504 65504 ECU_ADDRESS_EXTENSION 0x2 BYTE_ORDER MSB_LAST /end CHARACTERISTIC
/begin CHARACTERISTIC _g_PL_AD_fw_Radar_1R1V_rpc_LocBypassingRunnable_LocBypassingRunnable_m_pad_ensRLocationsPort_par_out_local.TChangeableMemPool._._._m_arrayPool._0_._elem._m_LocationList._Item._6_._v "" VALUE 0xB00100DC __Float32_Value 0 NO_COMPU_METHOD -3.4028234663852886E+38 3.4028234663852886E+38 ECU_ADDRESS_EXTENSION 0x2 BYTE_ORDER MSB_LAST /end CHARACTERISTIC
/begin CHARACTERISTIC _g_PL_AD_fw_Radar_1R1V_rpc_LocBypassingRunnable_LocBypassingRunnable_m_pad_ensRLocationsPort_par_out_local.TChangeableMemPool._._._m_arrayPool._0_._elem._m_LocationList._Item._6_._vVar._m_value "" VALUE 0xB00100E2 __Float16_Value 0 NO_COMPU_METHOD -65504 65504 ECU_ADDRESS_EXTENSION 0x2 BYTE_ORDER MSB_LAST /end CHARACTERISTIC
/begin CHARACTERISTIC _g_PL_AD_fw_Radar_1R1V_rpc_LocBypassingRunnable_LocBypassingRunnable_m_pad_ensRLocationsPort_par_out_local.TChangeableMemPool._._._m_arrayPool._0_._elem._m_LocationList._Item._70_._Rcs._m_value "" VALUE 0xB00108F0 __Float16_Value 0 NO_COMPU_METHOD -65504 65504 ECU_ADDRESS_EXTENSION 0x2 BYTE_ORDER MSB_LAST /end CHARACTERISTIC
/begin CHARACTERISTIC _g_PL_AD_fw_Radar_1R1V_rpc_LocBypassingRunnable_LocBypassingRunnable_m_pad_ensRLocationsPort_par_out_local.TChangeableMemPool._._._m_arrayPool._0_._elem._m_LocationList._Item._70_._Rssi._m_value "" VALUE 0xB00108F2 __Float16_Value 0 NO_COMPU_METHOD -65504 65504 ECU_ADDRESS_EXTENSION 0x2 BYTE_ORDER MSB_LAST /end CHARACTERISTIC
/begin CHARACTERISTIC _g_PL_AD_fw_Radar_1R1V_rpc_LocBypassingRunnable_LocBypassingRunnable_m_pad_ensRLocationsPort_par_out_local.TChangeableMemPool._._._m_arrayPool._0_._elem._m_LocationList._Item._70_._d "" VALUE 0xB00108D8 __Float32_Value 0 NO_COMPU_METHOD -3.4028234663852886E+38 3.4028234663852886E+38 ECU_ADDRESS_EXTENSION 0x2 BYTE_ORDER MSB_LAST /end CHARACTERISTIC
/begin CHARACTERISTIC _g_PL_AD_fw_Radar_1R1V_rpc_LocBypassingRunnable_LocBypassingRunnable_m_pad_ensRLocationsPort_par_out_local.TChangeableMemPool._._._m_arrayPool._0_._elem._m_LocationList._Item._70_._dVar._m_value "" VALUE 0xB00108E0 __Float16_Value 0 NO_COMPU_METHOD -65504 65504 ECU_ADDRESS_EXTENSION 0x2 BYTE_ORDER MSB_LAST /end CHARACTERISTIC
/begin CHARACTERISTIC _g_PL_AD_fw_Radar_1R1V_rpc_LocBypassingRunnable_LocBypassingRunnable_m_pad_ensRLocationsPort_par_out_local.TChangeableMemPool._._._m_arrayPool._0_._elem._m_LocationList._Item._70_._dvCov._m_value "" VALUE 0xB00108E4 __Float16_Value 0 NO_COMPU_METHOD -65504 65504 ECU_ADDRESS_EXTENSION 0x2 BYTE_ORDER MSB_LAST /end CHARACTERISTIC
/begin CHARACTERISTIC _g_PL_AD_fw_Radar_1R1V_rpc_LocBypassingRunnable_LocBypassingRunnable_m_pad_ensRLocationsPort_par_out_local.TChangeableMemPool._._._m_arrayPool._0_._elem._m_LocationList._Item._70_._dvQly "" VALUE 0xB00108F4 __UByte_Value 0 NO_COMPU_METHOD 0 255 ECU_ADDRESS_EXTENSION 0x2 BYTE_ORDER MSB_LAST /end CHARACTERISTIC
/begin CHARACTERISTIC _g_PL_AD_fw_Radar_1R1V_rpc_LocBypassingRunnable_LocBypassingRunnable_m_pad_ensRLocationsPort_par_out_local.TChangeableMemPool._._._m_arrayPool._0_._elem._m_LocationList._Item._70_._idxAzimuthAmbiguityPeer "" VALUE 0xB00108F6 __UWord_Value 0 NO_COMPU_METHOD 0 65535 ECU_ADDRESS_EXTENSION 0x2 BYTE_ORDER MSB_LAST /end CHARACTERISTIC
/begin CHARACTERISTIC _g_PL_AD_fw_Radar_1R1V_rpc_LocBypassingRunnable_LocBypassingRunnable_m_pad_ensRLocationsPort_par_out_local.TChangeableMemPool._._._m_arrayPool._0_._elem._m_LocationList._Item._70_._measStatus "" VALUE 0xB00108F5 __UByte_Value 0 NO_COMPU_METHOD 0 255 ECU_ADDRESS_EXTENSION 0x2 BYTE_ORDER MSB_LAST /end CHARACTERISTIC
/begin CHARACTERISTIC _g_PL_AD_fw_Radar_1R1V_rpc_LocBypassingRunnable_LocBypassingRunnable_m_pad_ensRLocationsPort_par_out_local.TChangeableMemPool._._._m_arrayPool._0_._elem._m_LocationList._Item._70_._phi._m_value "" VALUE 0xB00108E8 __Float16_Value 0 NO_COMPU_METHOD -65504 65504 ECU_ADDRESS_EXTENSION 0x2 BYTE_ORDER MSB_LAST /end CHARACTERISTIC
/begin CHARACTERISTIC _g_PL_AD_fw_Radar_1R1V_rpc_LocBypassingRunnable_LocBypassingRunnable_m_pad_ensRLocationsPort_par_out_local.TChangeableMemPool._._._m_arrayPool._0_._elem._m_LocationList._Item._70_._phiQly "" VALUE 0xB00108EB __UByte_Value 0 NO_COMPU_METHOD 0 255 ECU_ADDRESS_EXTENSION 0x2 BYTE_ORDER MSB_LAST /end CHARACTERISTIC
/begin CHARACTERISTIC _g_PL_AD_fw_Radar_1R1V_rpc_LocBypassingRunnable_LocBypassingRunnable_m_pad_ensRLocationsPort_par_out_local.TChangeableMemPool._._._m_arrayPool._0_._elem._m_LocationList._Item._70_._phiVar._m_value "" VALUE 0xB00108EE __Float16_Value 0 NO_COMPU_METHOD -65504 65504 ECU_ADDRESS_EXTENSION 0x2 BYTE_ORDER MSB_LAST /end CHARACTERISTIC
/begin CHARACTERISTIC _g_PL_AD_fw_Radar_1R1V_rpc_LocBypassingRunnable_LocBypassingRunnable_m_pad_ensRLocationsPort_par_out_local.TChangeableMemPool._._._m_arrayPool._0_._elem._m_LocationList._Item._70_._theta._m_value "" VALUE 0xB00108E6 __Float16_Value 0 NO_COMPU_METHOD -65504 65504 ECU_ADDRESS_EXTENSION 0x2 BYTE_ORDER MSB_LAST /end CHARACTERISTIC
/begin CHARACTERISTIC _g_PL_AD_fw_Radar_1R1V_rpc_LocBypassingRunnable_LocBypassingRunnable_m_pad_ensRLocationsPort_par_out_local.TChangeableMemPool._._._m_arrayPool._0_._elem._m_LocationList._Item._70_._thetaQly "" VALUE 0xB00108EA __UByte_Value 0 NO_COMPU_METHOD 0 255 ECU_ADDRESS_EXTENSION 0x2 BYTE_ORDER MSB_LAST /end CHARACTERISTIC
/begin CHARACTERISTIC _g_PL_AD_fw_Radar_1R1V_rpc_LocBypassingRunnable_LocBypassingRunnable_m_pad_ensRLocationsPort_par_out_local.TChangeableMemPool._._._m_arrayPool._0_._elem._m_LocationList._Item._70_._thetaVar._m_value "" VALUE 0xB00108EC __Float16_Value 0 NO_COMPU_METHOD -65504 65504 ECU_ADDRESS_EXTENSION 0x2 BYTE_ORDER MSB_LAST /end CHARACTERISTIC
/begin CHARACTERISTIC _g_PL_AD_fw_Radar_1R1V_rpc_LocBypassingRunnable_LocBypassingRunnable_m_pad_ensRLocationsPort_par_out_local.TChangeableMemPool._._._m_arrayPool._0_._elem._m_LocationList._Item._70_._v "" VALUE 0xB00108DC __Float32_Value 0 NO_COMPU_METHOD -3.4028234663852886E+38 3.4028234663852886E+38 ECU_ADDRESS_EXTENSION 0x2 BYTE_ORDER MSB_LAST /end CHARACTERISTIC
/begin CHARACTERISTIC _g_PL_AD_fw_Radar_1R1V_rpc_LocBypassingRunnable_LocBypassingRunnable_m_pad_ensRLocationsPort_par_out_local.TChangeableMemPool._._._m_arrayPool._0_._elem._m_LocationList._Item._70_._vVar._m_value "" VALUE 0xB00108E2 __Float16_Value 0 NO_COMPU_METHOD -65504 65504 ECU_ADDRESS_EXTENSION 0x2 BYTE_ORDER MSB_LAST /end CHARACTERISTIC
/begin CHARACTERISTIC _g_PL_AD_fw_Radar_1R1V_rpc_LocBypassingRunnable_LocBypassingRunnable_m_pad_ensRLocationsPort_par_out_local.TChangeableMemPool._._._m_arrayPool._0_._elem._m_LocationList._Item._71_._Rcs._m_value "" VALUE 0xB0010910 __Float16_Value 0 NO_COMPU_METHOD -65504 65504 ECU_ADDRESS_EXTENSION 0x2 BYTE_ORDER MSB_LAST /end CHARACTERISTIC
/begin CHARACTERISTIC _g_PL_AD_fw_Radar_1R1V_rpc_LocBypassingRunnable_LocBypassingRunnable_m_pad_ensRLocationsPort_par_out_local.TChangeableMemPool._._._m_arrayPool._0_._elem._m_LocationList._Item._71_._Rssi._m_value "" VALUE 0xB0010912 __Float16_Value 0 NO_COMPU_METHOD -65504 65504 ECU_ADDRESS_EXTENSION 0x2 BYTE_ORDER MSB_LAST /end CHARACTERISTIC
/begin CHARACTERISTIC _g_PL_AD_fw_Radar_1R1V_rpc_LocBypassingRunnable_LocBypassingRunnable_m_pad_ensRLocationsPort_par_out_local.TChangeableMemPool._._._m_arrayPool._0_._elem._m_LocationList._Item._71_._d "" VALUE 0xB00108F8 __Float32_Value 0 NO_COMPU_METHOD -3.4028234663852886E+38 3.4028234663852886E+38 ECU_ADDRESS_EXTENSION 0x2 BYTE_ORDER MSB_LAST /end CHARACTERISTIC
/begin CHARACTERISTIC _g_PL_AD_fw_Radar_1R1V_rpc_LocBypassingRunnable_LocBypassingRunnable_m_pad_ensRLocationsPort_par_out_local.TChangeableMemPool._._._m_arrayPool._0_._elem._m_LocationList._Item._71_._dVar._m_value "" VALUE 0xB0010900 __Float16_Value 0 NO_COMPU_METHOD -65504 65504 ECU_ADDRESS_EXTENSION 0x2 BYTE_ORDER MSB_LAST /end CHARACTERISTIC
/begin CHARACTERISTIC _g_PL_AD_fw_Radar_1R1V_rpc_LocBypassingRunnable_LocBypassingRunnable_m_pad_ensRLocationsPort_par_out_local.TChangeableMemPool._._._m_arrayPool._0_._elem._m_LocationList._Item._71_._dvCov._m_value "" VALUE 0xB0010904 __Float16_Value 0 NO_COMPU_METHOD -65504 65504 ECU_ADDRESS_EXTENSION 0x2 BYTE_ORDER MSB_LAST /end CHARACTERISTIC
/begin CHARACTERISTIC _g_PL_AD_fw_Radar_1R1V_rpc_LocBypassingRunnable_LocBypassingRunnable_m_pad_ensRLocationsPort_par_out_local.TChangeableMemPool._._._m_arrayPool._0_._elem._m_LocationList._Item._71_._dvQly "" VALUE 0xB0010914 __UByte_Value 0 NO_COMPU_METHOD 0 255 ECU_ADDRESS_EXTENSION 0x2 BYTE_ORDER MSB_LAST /end CHARACTERISTIC
/begin CHARACTERISTIC _g_PL_AD_fw_Radar_1R1V_rpc_LocBypassingRunnable_LocBypassingRunnable_m_pad_ensRLocationsPort_par_out_local.TChangeableMemPool._._._m_arrayPool._0_._elem._m_LocationList._Item._71_._idxAzimuthAmbiguityPeer "" VALUE 0xB0010916 __UWord_Value 0 NO_COMPU_METHOD 0 65535 ECU_ADDRESS_EXTENSION 0x2 BYTE_ORDER MSB_LAST /end CHARACTERISTIC
/begin CHARACTERISTIC _g_PL_AD_fw_Radar_1R1V_rpc_LocBypassingRunnable_LocBypassingRunnable_m_pad_ensRLocationsPort_par_out_local.TChangeableMemPool._._._m_arrayPool._0_._elem._m_LocationList._Item._71_._measStatus "" VALUE 0xB0010915 __UByte_Value 0 NO_COMPU_METHOD 0 255 ECU_ADDRESS_EXTENSION 0x2 BYTE_ORDER MSB_LAST /end CHARACTERISTIC
/begin CHARACTERISTIC _g_PL_AD_fw_Radar_1R1V_rpc_LocBypassingRunnable_LocBypassingRunnable_m_pad_ensRLocationsPort_par_out_local.TChangeableMemPool._._._m_arrayPool._0_._elem._m_LocationList._Item._71_._phi._m_value "" VALUE 0xB0010908 __Float16_Value 0 NO_COMPU_METHOD -65504 65504 ECU_ADDRESS_EXTENSION 0x2 BYTE_ORDER MSB_LAST /end CHARACTERISTIC
/begin CHARACTERISTIC _g_PL_AD_fw_Radar_1R1V_rpc_LocBypassingRunnable_LocBypassingRunnable_m_pad_ensRLocationsPort_par_out_local.TChangeableMemPool._._._m_arrayPool._0_._elem._m_LocationList._Item._71_._phiQly "" VALUE 0xB001090B __UByte_Value 0 NO_COMPU_METHOD 0 255 ECU_ADDRESS_EXTENSION 0x2 BYTE_ORDER MSB_LAST /end CHARACTERISTIC
/begin CHARACTERISTIC _g_PL_AD_fw_Radar_1R1V_rpc_LocBypassingRunnable_LocBypassingRunnable_m_pad_ensRLocationsPort_par_out_local.TChangeableMemPool._._._m_arrayPool._0_._elem._m_LocationList._Item._71_._phiVar._m_value "" VALUE 0xB001090E __Float16_Value 0 NO_COMPU_METHOD -65504 65504 ECU_ADDRESS_EXTENSION 0x2 BYTE_ORDER MSB_LAST /end CHARACTERISTIC
/begin CHARACTERISTIC _g_PL_AD_fw_Radar_1R1V_rpc_LocBypassingRunnable_LocBypassingRunnable_m_pad_ensRLocationsPort_par_out_local.TChangeableMemPool._._._m_arrayPool._0_._elem._m_LocationList._Item._71_._theta._m_value "" VALUE 0xB0010906 __Float16_Value 0 NO_COMPU_METHOD -65504 65504 ECU_ADDRESS_EXTENSION 0x2 BYTE_ORDER MSB_LAST /end CHARACTERISTIC
/begin CHARACTERISTIC _g_PL_AD_fw_Radar_1R1V_rpc_LocBypassingRunnable_LocBypassingRunnable_m_pad_ensRLocationsPort_par_out_local.TChangeableMemPool._._._m_arrayPool._0_._elem._m_LocationList._Item._71_._thetaQly "" VALUE 0xB001090A __UByte_Value 0 NO_COMPU_METHOD 0 255 ECU_ADDRESS_EXTENSION 0x2 BYTE_ORDER MSB_LAST /end CHARACTERISTIC
/begin CHARACTERISTIC _g_PL_AD_fw_Radar_1R1V_rpc_LocBypassingRunnable_LocBypassingRunnable_m_pad_ensRLocationsPort_par_out_local.TChangeableMemPool._._._m_arrayPool._0_._elem._m_LocationList._Item._71_._thetaVar._m_value "" VALUE 0xB001090C __Float16_Value 0 NO_COMPU_METHOD -65504 65504 ECU_ADDRESS_EXTENSION 0x2 BYTE_ORDER MSB_LAST /end CHARACTERISTIC
/begin CHARACTERISTIC _g_PL_AD_fw_Radar_1R1V_rpc_LocBypassingRunnable_LocBypassingRunnable_m_pad_ensRLocationsPort_par_out_local.TChangeableMemPool._._._m_arrayPool._0_._elem._m_LocationList._Item._71_._v "" VALUE 0xB00108FC __Float32_Value 0 NO_COMPU_METHOD -3.4028234663852886E+38 3.4028234663852886E+38 ECU_ADDRESS_EXTENSION 0x2 BYTE_ORDER MSB_LAST /end CHARACTERISTIC
/begin CHARACTERISTIC _g_PL_AD_fw_Radar_1R1V_rpc_LocBypassingRunnable_LocBypassingRunnable_m_pad_ensRLocationsPort_par_out_local.TChangeableMemPool._._._m_arrayPool._0_._elem._m_LocationList._Item._71_._vVar._m_value "" VALUE 0xB0010902 __Float16_Value 0 NO_COMPU_METHOD -65504 65504 ECU_ADDRESS_EXTENSION 0x2 BYTE_ORDER MSB_LAST /end CHARACTERISTIC
/begin CHARACTERISTIC _g_PL_AD_fw_Radar_1R1V_rpc_LocBypassingRunnable_LocBypassingRunnable_m_pad_ensRLocationsPort_par_out_local.TChangeableMemPool._._._m_arrayPool._0_._elem._m_LocationList._Item._72_._Rcs._m_value "" VALUE 0xB0010930 __Float16_Value 0 NO_COMPU_METHOD -65504 65504 ECU_ADDRESS_EXTENSION 0x2 BYTE_ORDER MSB_LAST /end CHARACTERISTIC
/begin CHARACTERISTIC _g_PL_AD_fw_Radar_1R1V_rpc_LocBypassingRunnable_LocBypassingRunnable_m_pad_ensRLocationsPort_par_out_local.TChangeableMemPool._._._m_arrayPool._0_._elem._m_LocationList._Item._72_._Rssi._m_value "" VALUE 0xB0010932 __Float16_Value 0 NO_COMPU_METHOD -65504 65504 ECU_ADDRESS_EXTENSION 0x2 BYTE_ORDER MSB_LAST /end CHARACTERISTIC
/begin CHARACTERISTIC _g_PL_AD_fw_Radar_1R1V_rpc_LocBypassingRunnable_LocBypassingRunnable_m_pad_ensRLocationsPort_par_out_local.TChangeableMemPool._._._m_arrayPool._0_._elem._m_LocationList._Item._72_._d "" VALUE 0xB0010918 __Float32_Value 0 NO_COMPU_METHOD -3.4028234663852886E+38 3.4028234663852886E+38 ECU_ADDRESS_EXTENSION 0x2 BYTE_ORDER MSB_LAST /end CHARACTERISTIC
/begin CHARACTERISTIC _g_PL_AD_fw_Radar_1R1V_rpc_LocBypassingRunnable_LocBypassingRunnable_m_pad_ensRLocationsPort_par_out_local.TChangeableMemPool._._._m_arrayPool._0_._elem._m_LocationList._Item._72_._dVar._m_value "" VALUE 0xB0010920 __Float16_Value 0 NO_COMPU_METHOD -65504 65504 ECU_ADDRESS_EXTENSION 0x2 BYTE_ORDER MSB_LAST /end CHARACTERISTIC
/begin CHARACTERISTIC _g_PL_AD_fw_Radar_1R1V_rpc_LocBypassingRunnable_LocBypassingRunnable_m_pad_ensRLocationsPort_par_out_local.TChangeableMemPool._._._m_arrayPool._0_._elem._m_LocationList._Item._72_._dvCov._m_value "" VALUE 0xB0010924 __Float16_Value 0 NO_COMPU_METHOD -65504 65504 ECU_ADDRESS_EXTENSION 0x2 BYTE_ORDER MSB_LAST /end CHARACTERISTIC
/begin CHARACTERISTIC _g_PL_AD_fw_Radar_1R1V_rpc_LocBypassingRunnable_LocBypassingRunnable_m_pad_ensRLocationsPort_par_out_local.TChangeableMemPool._._._m_arrayPool._0_._elem._m_LocationList._Item._72_._dvQly "" VALUE 0xB0010934 __UByte_Value 0 NO_COMPU_METHOD 0 255 ECU_ADDRESS_EXTENSION 0x2 BYTE_ORDER MSB_LAST /end CHARACTERISTIC
/begin CHARACTERISTIC _g_PL_AD_fw_Radar_1R1V_rpc_LocBypassingRunnable_LocBypassingRunnable_m_pad_ensRLocationsPort_par_out_local.TChangeableMemPool._._._m_arrayPool._0_._elem._m_LocationList._Item._72_._idxAzimuthAmbiguityPeer "" VALUE 0xB0010936 __UWord_Value 0 NO_COMPU_METHOD 0 65535 ECU_ADDRESS_EXTENSION 0x2 BYTE_ORDER MSB_LAST /end CHARACTERISTIC
/begin CHARACTERISTIC _g_PL_AD_fw_Radar_1R1V_rpc_LocBypassingRunnable_LocBypassingRunnable_m_pad_ensRLocationsPort_par_out_local.TChangeableMemPool._._._m_arrayPool._0_._elem._m_LocationList._Item._72_._measStatus "" VALUE 0xB0010935 __UByte_Value 0 NO_COMPU_METHOD 0 255 ECU_ADDRESS_EXTENSION 0x2 BYTE_ORDER MSB_LAST /end CHARACTERISTIC
/begin CHARACTERISTIC _g_PL_AD_fw_Radar_1R1V_rpc_LocBypassingRunnable_LocBypassingRunnable_m_pad_ensRLocationsPort_par_out_local.TChangeableMemPool._._._m_arrayPool._0_._elem._m_LocationList._Item._72_._phi._m_value "" VALUE 0xB0010928 __Float16_Value 0 NO_COMPU_METHOD -65504 65504 ECU_ADDRESS_EXTENSION 0x2 BYTE_ORDER MSB_LAST /end CHARACTERISTIC
/begin CHARACTERISTIC _g_PL_AD_fw_Radar_1R1V_rpc_LocBypassingRunnable_LocBypassingRunnable_m_pad_ensRLocationsPort_par_out_local.TChangeableMemPool._._._m_arrayPool._0_._elem._m_LocationList._Item._72_._phiQly "" VALUE 0xB001092B __UByte_Value 0 NO_COMPU_METHOD 0 255 ECU_ADDRESS_EXTENSION 0x2 BYTE_ORDER MSB_LAST /end CHARACTERISTIC
/begin CHARACTERISTIC _g_PL_AD_fw_Radar_1R1V_rpc_LocBypassingRunnable_LocBypassingRunnable_m_pad_ensRLocationsPort_par_out_local.TChangeableMemPool._._._m_arrayPool._0_._elem._m_LocationList._Item._72_._phiVar._m_value "" VALUE 0xB001092E __Float16_Value 0 NO_COMPU_METHOD -65504 65504 ECU_ADDRESS_EXTENSION 0x2 BYTE_ORDER MSB_LAST /end CHARACTERISTIC
/begin CHARACTERISTIC _g_PL_AD_fw_Radar_1R1V_rpc_LocBypassingRunnable_LocBypassingRunnable_m_pad_ensRLocationsPort_par_out_local.TChangeableMemPool._._._m_arrayPool._0_._elem._m_LocationList._Item._72_._theta._m_value "" VALUE 0xB0010926 __Float16_Value 0 NO_COMPU_METHOD -65504 65504 ECU_ADDRESS_EXTENSION 0x2 BYTE_ORDER MSB_LAST /end CHARACTERISTIC
/begin CHARACTERISTIC _g_PL_AD_fw_Radar_1R1V_rpc_LocBypassingRunnable_LocBypassingRunnable_m_pad_ensRLocationsPort_par_out_local.TChangeableMemPool._._._m_arrayPool._0_._elem._m_LocationList._Item._72_._thetaQly "" VALUE 0xB001092A __UByte_Value 0 NO_COMPU_METHOD 0 255 ECU_ADDRESS_EXTENSION 0x2 BYTE_ORDER MSB_LAST /end CHARACTERISTIC
/begin CHARACTERISTIC _g_PL_AD_fw_Radar_1R1V_rpc_LocBypassingRunnable_LocBypassingRunnable_m_pad_ensRLocationsPort_par_out_local.TChangeableMemPool._._._m_arrayPool._0_._elem._m_LocationList._Item._72_._thetaVar._m_value "" VALUE 0xB001092C __Float16_Value 0 NO_COMPU_METHOD -65504 65504 ECU_ADDRESS_EXTENSION 0x2 BYTE_ORDER MSB_LAST /end CHARACTERISTIC
/begin CHARACTERISTIC _g_PL_AD_fw_Radar_1R1V_rpc_LocBypassingRunnable_LocBypassingRunnable_m_pad_ensRLocationsPort_par_out_local.TChangeableMemPool._._._m_arrayPool._0_._elem._m_LocationList._Item._72_._v "" VALUE 0xB001091C __Float32_Value 0 NO_COMPU_METHOD -3.4028234663852886E+38 3.4028234663852886E+38 ECU_ADDRESS_EXTENSION 0x2 BYTE_ORDER MSB_LAST /end CHARACTERISTIC
/begin CHARACTERISTIC _g_PL_AD_fw_Radar_1R1V_rpc_LocBypassingRunnable_LocBypassingRunnable_m_pad_ensRLocationsPort_par_out_local.TChangeableMemPool._._._m_arrayPool._0_._elem._m_LocationList._Item._72_._vVar._m_value "" VALUE 0xB0010922 __Float16_Value 0 NO_COMPU_METHOD -65504 65504 ECU_ADDRESS_EXTENSION 0x2 BYTE_ORDER MSB_LAST /end CHARACTERISTIC
/begin CHARACTERISTIC _g_PL_AD_fw_Radar_1R1V_rpc_LocBypassingRunnable_LocBypassingRunnable_m_pad_ensRLocationsPort_par_out_local.TChangeableMemPool._._._m_arrayPool._0_._elem._m_LocationList._Item._73_._Rcs._m_value "" VALUE 0xB0010950 __Float16_Value 0 NO_COMPU_METHOD -65504 65504 ECU_ADDRESS_EXTENSION 0x2 BYTE_ORDER MSB_LAST /end CHARACTERISTIC
/begin CHARACTERISTIC _g_PL_AD_fw_Radar_1R1V_rpc_LocBypassingRunnable_LocBypassingRunnable_m_pad_ensRLocationsPort_par_out_local.TChangeableMemPool._._._m_arrayPool._0_._elem._m_LocationList._Item._73_._Rssi._m_value "" VALUE 0xB0010952 __Float16_Value 0 NO_COMPU_METHOD -65504 65504 ECU_ADDRESS_EXTENSION 0x2 BYTE_ORDER MSB_LAST /end CHARACTERISTIC
/begin CHARACTERISTIC _g_PL_AD_fw_Radar_1R1V_rpc_LocBypassingRunnable_LocBypassingRunnable_m_pad_ensRLocationsPort_par_out_local.TChangeableMemPool._._._m_arrayPool._0_._elem._m_LocationList._Item._73_._d "" VALUE 0xB0010938 __Float32_Value 0 NO_COMPU_METHOD -3.4028234663852886E+38 3.4028234663852886E+38 ECU_ADDRESS_EXTENSION 0x2 BYTE_ORDER MSB_LAST /end CHARACTERISTIC
/begin CHARACTERISTIC _g_PL_AD_fw_Radar_1R1V_rpc_LocBypassingRunnable_LocBypassingRunnable_m_pad_ensRLocationsPort_par_out_local.TChangeableMemPool._._._m_arrayPool._0_._elem._m_LocationList._Item._73_._dVar._m_value "" VALUE 0xB0010940 __Float16_Value 0 NO_COMPU_METHOD -65504 65504 ECU_ADDRESS_EXTENSION 0x2 BYTE_ORDER MSB_LAST /end CHARACTERISTIC
/begin CHARACTERISTIC _g_PL_AD_fw_Radar_1R1V_rpc_LocBypassingRunnable_LocBypassingRunnable_m_pad_ensRLocationsPort_par_out_local.TChangeableMemPool._._._m_arrayPool._0_._elem._m_LocationList._Item._73_._dvCov._m_value "" VALUE 0xB0010944 __Float16_Value 0 NO_COMPU_METHOD -65504 65504 ECU_ADDRESS_EXTENSION 0x2 BYTE_ORDER MSB_LAST /end CHARACTERISTIC
/begin CHARACTERISTIC _g_PL_AD_fw_Radar_1R1V_rpc_LocBypassingRunnable_LocBypassingRunnable_m_pad_ensRLocationsPort_par_out_local.TChangeableMemPool._._._m_arrayPool._0_._elem._m_LocationList._Item._73_._dvQly "" VALUE 0xB0010954 __UByte_Value 0 NO_COMPU_METHOD 0 255 ECU_ADDRESS_EXTENSION 0x2 BYTE_ORDER MSB_LAST /end CHARACTERISTIC
/begin CHARACTERISTIC _g_PL_AD_fw_Radar_1R1V_rpc_LocBypassingRunnable_LocBypassingRunnable_m_pad_ensRLocationsPort_par_out_local.TChangeableMemPool._._._m_arrayPool._0_._elem._m_LocationList._Item._73_._idxAzimuthAmbiguityPeer "" VALUE 0xB0010956 __UWord_Value 0 NO_COMPU_METHOD 0 65535 ECU_ADDRESS_EXTENSION 0x2 BYTE_ORDER MSB_LAST /end CHARACTERISTIC
/begin CHARACTERISTIC _g_PL_AD_fw_Radar_1R1V_rpc_LocBypassingRunnable_LocBypassingRunnable_m_pad_ensRLocationsPort_par_out_local.TChangeableMemPool._._._m_arrayPool._0_._elem._m_LocationList._Item._73_._measStatus "" VALUE 0xB0010955 __UByte_Value 0 NO_COMPU_METHOD 0 255 ECU_ADDRESS_EXTENSION 0x2 BYTE_ORDER MSB_LAST /end CHARACTERISTIC
/begin CHARACTERISTIC _g_PL_AD_fw_Radar_1R1V_rpc_LocBypassingRunnable_LocBypassingRunnable_m_pad_ensRLocationsPort_par_out_local.TChangeableMemPool._._._m_arrayPool._0_._elem._m_LocationList._Item._73_._phi._m_value "" VALUE 0xB0010948 __Float16_Value 0 NO_COMPU_METHOD -65504 65504 ECU_ADDRESS_EXTENSION 0x2 BYTE_ORDER MSB_LAST /end CHARACTERISTIC
/begin CHARACTERISTIC _g_PL_AD_fw_Radar_1R1V_rpc_LocBypassingRunnable_LocBypassingRunnable_m_pad_ensRLocationsPort_par_out_local.TChangeableMemPool._._._m_arrayPool._0_._elem._m_LocationList._Item._73_._phiQly "" VALUE 0xB001094B __UByte_Value 0 NO_COMPU_METHOD 0 255 ECU_ADDRESS_EXTENSION 0x2 BYTE_ORDER MSB_LAST /end CHARACTERISTIC
/begin CHARACTERISTIC _g_PL_AD_fw_Radar_1R1V_rpc_LocBypassingRunnable_LocBypassingRunnable_m_pad_ensRLocationsPort_par_out_local.TChangeableMemPool._._._m_arrayPool._0_._elem._m_LocationList._Item._73_._phiVar._m_value "" VALUE 0xB001094E __Float16_Value 0 NO_COMPU_METHOD -65504 65504 ECU_ADDRESS_EXTENSION 0x2 BYTE_ORDER MSB_LAST /end CHARACTERISTIC
/begin CHARACTERISTIC _g_PL_AD_fw_Radar_1R1V_rpc_LocBypassingRunnable_LocBypassingRunnable_m_pad_ensRLocationsPort_par_out_local.TChangeableMemPool._._._m_arrayPool._0_._elem._m_LocationList._Item._73_._theta._m_value "" VALUE 0xB0010946 __Float16_Value 0 NO_COMPU_METHOD -65504 65504 ECU_ADDRESS_EXTENSION 0x2 BYTE_ORDER MSB_LAST /end CHARACTERISTIC
/begin CHARACTERISTIC _g_PL_AD_fw_Radar_1R1V_rpc_LocBypassingRunnable_LocBypassingRunnable_m_pad_ensRLocationsPort_par_out_local.TChangeableMemPool._._._m_arrayPool._0_._elem._m_LocationList._Item._73_._thetaQly "" VALUE 0xB001094A __UByte_Value 0 NO_COMPU_METHOD 0 255 ECU_ADDRESS_EXTENSION 0x2 BYTE_ORDER MSB_LAST /end CHARACTERISTIC
/begin CHARACTERISTIC _g_PL_AD_fw_Radar_1R1V_rpc_LocBypassingRunnable_LocBypassingRunnable_m_pad_ensRLocationsPort_par_out_local.TChangeableMemPool._._._m_arrayPool._0_._elem._m_LocationList._Item._73_._thetaVar._m_value "" VALUE 0xB001094C __Float16_Value 0 NO_COMPU_METHOD -65504 65504 ECU_ADDRESS_EXTENSION 0x2 BYTE_ORDER MSB_LAST /end CHARACTERISTIC
/begin CHARACTERISTIC _g_PL_AD_fw_Radar_1R1V_rpc_LocBypassingRunnable_LocBypassingRunnable_m_pad_ensRLocationsPort_par_out_local.TChangeableMemPool._._._m_arrayPool._0_._elem._m_LocationList._Item._73_._v "" VALUE 0xB001093C __Float32_Value 0 NO_COMPU_METHOD -3.4028234663852886E+38 3.4028234663852886E+38 ECU_ADDRESS_EXTENSION 0x2 BYTE_ORDER MSB_LAST /end CHARACTERISTIC
/begin CHARACTERISTIC _g_PL_AD_fw_Radar_1R1V_rpc_LocBypassingRunnable_LocBypassingRunnable_m_pad_ensRLocationsPort_par_out_local.TChangeableMemPool._._._m_arrayPool._0_._elem._m_LocationList._Item._73_._vVar._m_value "" VALUE 0xB0010942 __Float16_Value 0 NO_COMPU_METHOD -65504 65504 ECU_ADDRESS_EXTENSION 0x2 BYTE_ORDER MSB_LAST /end CHARACTERISTIC
/begin CHARACTERISTIC _g_PL_AD_fw_Radar_1R1V_rpc_LocBypassingRunnable_LocBypassingRunnable_m_pad_ensRLocationsPort_par_out_local.TChangeableMemPool._._._m_arrayPool._0_._elem._m_LocationList._Item._74_._Rcs._m_value "" VALUE 0xB0010970 __Float16_Value 0 NO_COMPU_METHOD -65504 65504 ECU_ADDRESS_EXTENSION 0x2 BYTE_ORDER MSB_LAST /end CHARACTERISTIC
/begin CHARACTERISTIC _g_PL_AD_fw_Radar_1R1V_rpc_LocBypassingRunnable_LocBypassingRunnable_m_pad_ensRLocationsPort_par_out_local.TChangeableMemPool._._._m_arrayPool._0_._elem._m_LocationList._Item._74_._Rssi._m_value "" VALUE 0xB0010972 __Float16_Value 0 NO_COMPU_METHOD -65504 65504 ECU_ADDRESS_EXTENSION 0x2 BYTE_ORDER MSB_LAST /end CHARACTERISTIC
/begin CHARACTERISTIC _g_PL_AD_fw_Radar_1R1V_rpc_LocBypassingRunnable_LocBypassingRunnable_m_pad_ensRLocationsPort_par_out_local.TChangeableMemPool._._._m_arrayPool._0_._elem._m_LocationList._Item._74_._d "" VALUE 0xB0010958 __Float32_Value 0 NO_COMPU_METHOD -3.4028234663852886E+38 3.4028234663852886E+38 ECU_ADDRESS_EXTENSION 0x2 BYTE_ORDER MSB_LAST /end CHARACTERISTIC
/begin CHARACTERISTIC _g_PL_AD_fw_Radar_1R1V_rpc_LocBypassingRunnable_LocBypassingRunnable_m_pad_ensRLocationsPort_par_out_local.TChangeableMemPool._._._m_arrayPool._0_._elem._m_LocationList._Item._74_._dVar._m_value "" VALUE 0xB0010960 __Float16_Value 0 NO_COMPU_METHOD -65504 65504 ECU_ADDRESS_EXTENSION 0x2 BYTE_ORDER MSB_LAST /end CHARACTERISTIC
/begin CHARACTERISTIC _g_PL_AD_fw_Radar_1R1V_rpc_LocBypassingRunnable_LocBypassingRunnable_m_pad_ensRLocationsPort_par_out_local.TChangeableMemPool._._._m_arrayPool._0_._elem._m_LocationList._Item._74_._dvCov._m_value "" VALUE 0xB0010964 __Float16_Value 0 NO_COMPU_METHOD -65504 65504 ECU_ADDRESS_EXTENSION 0x2 BYTE_ORDER MSB_LAST /end CHARACTERISTIC
/begin CHARACTERISTIC _g_PL_AD_fw_Radar_1R1V_rpc_LocBypassingRunnable_LocBypassingRunnable_m_pad_ensRLocationsPort_par_out_local.TChangeableMemPool._._._m_arrayPool._0_._elem._m_LocationList._Item._74_._dvQly "" VALUE 0xB0010974 __UByte_Value 0 NO_COMPU_METHOD 0 255 ECU_ADDRESS_EXTENSION 0x2 BYTE_ORDER MSB_LAST /end CHARACTERISTIC
/begin CHARACTERISTIC _g_PL_AD_fw_Radar_1R1V_rpc_LocBypassingRunnable_LocBypassingRunnable_m_pad_ensRLocationsPort_par_out_local.TChangeableMemPool._._._m_arrayPool._0_._elem._m_LocationList._Item._74_._idxAzimuthAmbiguityPeer "" VALUE 0xB0010976 __UWord_Value 0 NO_COMPU_METHOD 0 65535 ECU_ADDRESS_EXTENSION 0x2 BYTE_ORDER MSB_LAST /end CHARACTERISTIC
/begin CHARACTERISTIC _g_PL_AD_fw_Radar_1R1V_rpc_LocBypassingRunnable_LocBypassingRunnable_m_pad_ensRLocationsPort_par_out_local.TChangeableMemPool._._._m_arrayPool._0_._elem._m_LocationList._Item._74_._measStatus "" VALUE 0xB0010975 __UByte_Value 0 NO_COMPU_METHOD 0 255 ECU_ADDRESS_EXTENSION 0x2 BYTE_ORDER MSB_LAST /end CHARACTERISTIC
/begin CHARACTERISTIC _g_PL_AD_fw_Radar_1R1V_rpc_LocBypassingRunnable_LocBypassingRunnable_m_pad_ensRLocationsPort_par_out_local.TChangeableMemPool._._._m_arrayPool._0_._elem._m_LocationList._Item._74_._phi._m_value "" VALUE 0xB0010968 __Float16_Value 0 NO_COMPU_METHOD -65504 65504 ECU_ADDRESS_EXTENSION 0x2 BYTE_ORDER MSB_LAST /end CHARACTERISTIC
/begin CHARACTERISTIC _g_PL_AD_fw_Radar_1R1V_rpc_LocBypassingRunnable_LocBypassingRunnable_m_pad_ensRLocationsPort_par_out_local.TChangeableMemPool._._._m_arrayPool._0_._elem._m_LocationList._Item._74_._phiQly "" VALUE 0xB001096B __UByte_Value 0 NO_COMPU_METHOD 0 255 ECU_ADDRESS_EXTENSION 0x2 BYTE_ORDER MSB_LAST /end CHARACTERISTIC
/begin CHARACTERISTIC _g_PL_AD_fw_Radar_1R1V_rpc_LocBypassingRunnable_LocBypassingRunnable_m_pad_ensRLocationsPort_par_out_local.TChangeableMemPool._._._m_arrayPool._0_._elem._m_LocationList._Item._74_._phiVar._m_value "" VALUE 0xB001096E __Float16_Value 0 NO_COMPU_METHOD -65504 65504 ECU_ADDRESS_EXTENSION 0x2 BYTE_ORDER MSB_LAST /end CHARACTERISTIC
/begin CHARACTERISTIC _g_PL_AD_fw_Radar_1R1V_rpc_LocBypassingRunnable_LocBypassingRunnable_m_pad_ensRLocationsPort_par_out_local.TChangeableMemPool._._._m_arrayPool._0_._elem._m_LocationList._Item._74_._theta._m_value "" VALUE 0xB0010966 __Float16_Value 0 NO_COMPU_METHOD -65504 65504 ECU_ADDRESS_EXTENSION 0x2 BYTE_ORDER MSB_LAST /end CHARACTERISTIC
/begin CHARACTERISTIC _g_PL_AD_fw_Radar_1R1V_rpc_LocBypassingRunnable_LocBypassingRunnable_m_pad_ensRLocationsPort_par_out_local.TChangeableMemPool._._._m_arrayPool._0_._elem._m_LocationList._Item._74_._thetaQly "" VALUE 0xB001096A __UByte_Value 0 NO_COMPU_METHOD 0 255 ECU_ADDRESS_EXTENSION 0x2 BYTE_ORDER MSB_LAST /end CHARACTERISTIC
/begin CHARACTERISTIC _g_PL_AD_fw_Radar_1R1V_rpc_LocBypassingRunnable_LocBypassingRunnable_m_pad_ensRLocationsPort_par_out_local.TChangeableMemPool._._._m_arrayPool._0_._elem._m_LocationList._Item._74_._thetaVar._m_value "" VALUE 0xB001096C __Float16_Value 0 NO_COMPU_METHOD -65504 65504 ECU_ADDRESS_EXTENSION 0x2 BYTE_ORDER MSB_LAST /end CHARACTERISTIC
/begin CHARACTERISTIC _g_PL_AD_fw_Radar_1R1V_rpc_LocBypassingRunnable_LocBypassingRunnable_m_pad_ensRLocationsPort_par_out_local.TChangeableMemPool._._._m_arrayPool._0_._elem._m_LocationList._Item._74_._v "" VALUE 0xB001095C __Float32_Value 0 NO_COMPU_METHOD -3.4028234663852886E+38 3.4028234663852886E+38 ECU_ADDRESS_EXTENSION 0x2 BYTE_ORDER MSB_LAST /end CHARACTERISTIC
/begin CHARACTERISTIC _g_PL_AD_fw_Radar_1R1V_rpc_LocBypassingRunnable_LocBypassingRunnable_m_pad_ensRLocationsPort_par_out_local.TChangeableMemPool._._._m_arrayPool._0_._elem._m_LocationList._Item._74_._vVar._m_value "" VALUE 0xB0010962 __Float16_Value 0 NO_COMPU_METHOD -65504 65504 ECU_ADDRESS_EXTENSION 0x2 BYTE_ORDER MSB_LAST /end CHARACTERISTIC
/begin CHARACTERISTIC _g_PL_AD_fw_Radar_1R1V_rpc_LocBypassingRunnable_LocBypassingRunnable_m_pad_ensRLocationsPort_par_out_local.TChangeableMemPool._._._m_arrayPool._0_._elem._m_LocationList._Item._75_._Rcs._m_value "" VALUE 0xB0010990 __Float16_Value 0 NO_COMPU_METHOD -65504 65504 ECU_ADDRESS_EXTENSION 0x2 BYTE_ORDER MSB_LAST /end CHARACTERISTIC
/begin CHARACTERISTIC _g_PL_AD_fw_Radar_1R1V_rpc_LocBypassingRunnable_LocBypassingRunnable_m_pad_ensRLocationsPort_par_out_local.TChangeableMemPool._._._m_arrayPool._0_._elem._m_LocationList._Item._75_._Rssi._m_value "" VALUE 0xB0010992 __Float16_Value 0 NO_COMPU_METHOD -65504 65504 ECU_ADDRESS_EXTENSION 0x2 BYTE_ORDER MSB_LAST /end CHARACTERISTIC
/begin CHARACTERISTIC _g_PL_AD_fw_Radar_1R1V_rpc_LocBypassingRunnable_LocBypassingRunnable_m_pad_ensRLocationsPort_par_out_local.TChangeableMemPool._._._m_arrayPool._0_._elem._m_LocationList._Item._75_._d "" VALUE 0xB0010978 __Float32_Value 0 NO_COMPU_METHOD -3.4028234663852886E+38 3.4028234663852886E+38 ECU_ADDRESS_EXTENSION 0x2 BYTE_ORDER MSB_LAST /end CHARACTERISTIC
/begin CHARACTERISTIC _g_PL_AD_fw_Radar_1R1V_rpc_LocBypassingRunnable_LocBypassingRunnable_m_pad_ensRLocationsPort_par_out_local.TChangeableMemPool._._._m_arrayPool._0_._elem._m_LocationList._Item._75_._dVar._m_value "" VALUE 0xB0010980 __Float16_Value 0 NO_COMPU_METHOD -65504 65504 ECU_ADDRESS_EXTENSION 0x2 BYTE_ORDER MSB_LAST /end CHARACTERISTIC
/begin CHARACTERISTIC _g_PL_AD_fw_Radar_1R1V_rpc_LocBypassingRunnable_LocBypassingRunnable_m_pad_ensRLocationsPort_par_out_local.TChangeableMemPool._._._m_arrayPool._0_._elem._m_LocationList._Item._75_._dvCov._m_value "" VALUE 0xB0010984 __Float16_Value 0 NO_COMPU_METHOD -65504 65504 ECU_ADDRESS_EXTENSION 0x2 BYTE_ORDER MSB_LAST /end CHARACTERISTIC
/begin CHARACTERISTIC _g_PL_AD_fw_Radar_1R1V_rpc_LocBypassingRunnable_LocBypassingRunnable_m_pad_ensRLocationsPort_par_out_local.TChangeableMemPool._._._m_arrayPool._0_._elem._m_LocationList._Item._75_._dvQly "" VALUE 0xB0010994 __UByte_Value 0 NO_COMPU_METHOD 0 255 ECU_ADDRESS_EXTENSION 0x2 BYTE_ORDER MSB_LAST /end CHARACTERISTIC
/begin CHARACTERISTIC _g_PL_AD_fw_Radar_1R1V_rpc_LocBypassingRunnable_LocBypassingRunnable_m_pad_ensRLocationsPort_par_out_local.TChangeableMemPool._._._m_arrayPool._0_._elem._m_LocationList._Item._75_._idxAzimuthAmbiguityPeer "" VALUE 0xB0010996 __UWord_Value 0 NO_COMPU_METHOD 0 65535 ECU_ADDRESS_EXTENSION 0x2 BYTE_ORDER MSB_LAST /end CHARACTERISTIC
/begin CHARACTERISTIC _g_PL_AD_fw_Radar_1R1V_rpc_LocBypassingRunnable_LocBypassingRunnable_m_pad_ensRLocationsPort_par_out_local.TChangeableMemPool._._._m_arrayPool._0_._elem._m_LocationList._Item._75_._measStatus "" VALUE 0xB0010995 __UByte_Value 0 NO_COMPU_METHOD 0 255 ECU_ADDRESS_EXTENSION 0x2 BYTE_ORDER MSB_LAST /end CHARACTERISTIC
/begin CHARACTERISTIC _g_PL_AD_fw_Radar_1R1V_rpc_LocBypassingRunnable_LocBypassingRunnable_m_pad_ensRLocationsPort_par_out_local.TChangeableMemPool._._._m_arrayPool._0_._elem._m_LocationList._Item._75_._phi._m_value "" VALUE 0xB0010988 __Float16_Value 0 NO_COMPU_METHOD -65504 65504 ECU_ADDRESS_EXTENSION 0x2 BYTE_ORDER MSB_LAST /end CHARACTERISTIC
/begin CHARACTERISTIC _g_PL_AD_fw_Radar_1R1V_rpc_LocBypassingRunnable_LocBypassingRunnable_m_pad_ensRLocationsPort_par_out_local.TChangeableMemPool._._._m_arrayPool._0_._elem._m_LocationList._Item._75_._phiQly "" VALUE 0xB001098B __UByte_Value 0 NO_COMPU_METHOD 0 255 ECU_ADDRESS_EXTENSION 0x2 BYTE_ORDER MSB_LAST /end CHARACTERISTIC
/begin CHARACTERISTIC _g_PL_AD_fw_Radar_1R1V_rpc_LocBypassingRunnable_LocBypassingRunnable_m_pad_ensRLocationsPort_par_out_local.TChangeableMemPool._._._m_arrayPool._0_._elem._m_LocationList._Item._75_._phiVar._m_value "" VALUE 0xB001098E __Float16_Value 0 NO_COMPU_METHOD -65504 65504 ECU_ADDRESS_EXTENSION 0x2 BYTE_ORDER MSB_LAST /end CHARACTERISTIC
/begin CHARACTERISTIC _g_PL_AD_fw_Radar_1R1V_rpc_LocBypassingRunnable_LocBypassingRunnable_m_pad_ensRLocationsPort_par_out_local.TChangeableMemPool._._._m_arrayPool._0_._elem._m_LocationList._Item._75_._theta._m_value "" VALUE 0xB0010986 __Float16_Value 0 NO_COMPU_METHOD -65504 65504 ECU_ADDRESS_EXTENSION 0x2 BYTE_ORDER MSB_LAST /end CHARACTERISTIC
/begin CHARACTERISTIC _g_PL_AD_fw_Radar_1R1V_rpc_LocBypassingRunnable_LocBypassingRunnable_m_pad_ensRLocationsPort_par_out_local.TChangeableMemPool._._._m_arrayPool._0_._elem._m_LocationList._Item._75_._thetaQly "" VALUE 0xB001098A __UByte_Value 0 NO_COMPU_METHOD 0 255 ECU_ADDRESS_EXTENSION 0x2 BYTE_ORDER MSB_LAST /end CHARACTERISTIC
/begin CHARACTERISTIC _g_PL_AD_fw_Radar_1R1V_rpc_LocBypassingRunnable_LocBypassingRunnable_m_pad_ensRLocationsPort_par_out_local.TChangeableMemPool._._._m_arrayPool._0_._elem._m_LocationList._Item._75_._thetaVar._m_value "" VALUE 0xB001098C __Float16_Value 0 NO_COMPU_METHOD -65504 65504 ECU_ADDRESS_EXTENSION 0x2 BYTE_ORDER MSB_LAST /end CHARACTERISTIC
/begin CHARACTERISTIC _g_PL_AD_fw_Radar_1R1V_rpc_LocBypassingRunnable_LocBypassingRunnable_m_pad_ensRLocationsPort_par_out_local.TChangeableMemPool._._._m_arrayPool._0_._elem._m_LocationList._Item._75_._v "" VALUE 0xB001097C __Float32_Value 0 NO_COMPU_METHOD -3.4028234663852886E+38 3.4028234663852886E+38 ECU_ADDRESS_EXTENSION 0x2 BYTE_ORDER MSB_LAST /end CHARACTERISTIC
/begin CHARACTERISTIC _g_PL_AD_fw_Radar_1R1V_rpc_LocBypassingRunnable_LocBypassingRunnable_m_pad_ensRLocationsPort_par_out_local.TChangeableMemPool._._._m_arrayPool._0_._elem._m_LocationList._Item._75_._vVar._m_value "" VALUE 0xB0010982 __Float16_Value 0 NO_COMPU_METHOD -65504 65504 ECU_ADDRESS_EXTENSION 0x2 BYTE_ORDER MSB_LAST /end CHARACTERISTIC
/begin CHARACTERISTIC _g_PL_AD_fw_Radar_1R1V_rpc_LocBypassingRunnable_LocBypassingRunnable_m_pad_ensRLocationsPort_par_out_local.TChangeableMemPool._._._m_arrayPool._0_._elem._m_LocationList._Item._76_._Rcs._m_value "" VALUE 0xB00109B0 __Float16_Value 0 NO_COMPU_METHOD -65504 65504 ECU_ADDRESS_EXTENSION 0x2 BYTE_ORDER MSB_LAST /end CHARACTERISTIC
/begin CHARACTERISTIC _g_PL_AD_fw_Radar_1R1V_rpc_LocBypassingRunnable_LocBypassingRunnable_m_pad_ensRLocationsPort_par_out_local.TChangeableMemPool._._._m_arrayPool._0_._elem._m_LocationList._Item._76_._Rssi._m_value "" VALUE 0xB00109B2 __Float16_Value 0 NO_COMPU_METHOD -65504 65504 ECU_ADDRESS_EXTENSION 0x2 BYTE_ORDER MSB_LAST /end CHARACTERISTIC
/begin CHARACTERISTIC _g_PL_AD_fw_Radar_1R1V_rpc_LocBypassingRunnable_LocBypassingRunnable_m_pad_ensRLocationsPort_par_out_local.TChangeableMemPool._._._m_arrayPool._0_._elem._m_LocationList._Item._76_._d "" VALUE 0xB0010998 __Float32_Value 0 NO_COMPU_METHOD -3.4028234663852886E+38 3.4028234663852886E+38 ECU_ADDRESS_EXTENSION 0x2 BYTE_ORDER MSB_LAST /end CHARACTERISTIC
/begin CHARACTERISTIC _g_PL_AD_fw_Radar_1R1V_rpc_LocBypassingRunnable_LocBypassingRunnable_m_pad_ensRLocationsPort_par_out_local.TChangeableMemPool._._._m_arrayPool._0_._elem._m_LocationList._Item._76_._dVar._m_value "" VALUE 0xB00109A0 __Float16_Value 0 NO_COMPU_METHOD -65504 65504 ECU_ADDRESS_EXTENSION 0x2 BYTE_ORDER MSB_LAST /end CHARACTERISTIC
/begin CHARACTERISTIC _g_PL_AD_fw_Radar_1R1V_rpc_LocBypassingRunnable_LocBypassingRunnable_m_pad_ensRLocationsPort_par_out_local.TChangeableMemPool._._._m_arrayPool._0_._elem._m_LocationList._Item._76_._dvCov._m_value "" VALUE 0xB00109A4 __Float16_Value 0 NO_COMPU_METHOD -65504 65504 ECU_ADDRESS_EXTENSION 0x2 BYTE_ORDER MSB_LAST /end CHARACTERISTIC
/begin CHARACTERISTIC _g_PL_AD_fw_Radar_1R1V_rpc_LocBypassingRunnable_LocBypassingRunnable_m_pad_ensRLocationsPort_par_out_local.TChangeableMemPool._._._m_arrayPool._0_._elem._m_LocationList._Item._76_._dvQly "" VALUE 0xB00109B4 __UByte_Value 0 NO_COMPU_METHOD 0 255 ECU_ADDRESS_EXTENSION 0x2 BYTE_ORDER MSB_LAST /end CHARACTERISTIC
/begin CHARACTERISTIC _g_PL_AD_fw_Radar_1R1V_rpc_LocBypassingRunnable_LocBypassingRunnable_m_pad_ensRLocationsPort_par_out_local.TChangeableMemPool._._._m_arrayPool._0_._elem._m_LocationList._Item._76_._idxAzimuthAmbiguityPeer "" VALUE 0xB00109B6 __UWord_Value 0 NO_COMPU_METHOD 0 65535 ECU_ADDRESS_EXTENSION 0x2 BYTE_ORDER MSB_LAST /end CHARACTERISTIC
/begin CHARACTERISTIC _g_PL_AD_fw_Radar_1R1V_rpc_LocBypassingRunnable_LocBypassingRunnable_m_pad_ensRLocationsPort_par_out_local.TChangeableMemPool._._._m_arrayPool._0_._elem._m_LocationList._Item._76_._measStatus "" VALUE 0xB00109B5 __UByte_Value 0 NO_COMPU_METHOD 0 255 ECU_ADDRESS_EXTENSION 0x2 BYTE_ORDER MSB_LAST /end CHARACTERISTIC
/begin CHARACTERISTIC _g_PL_AD_fw_Radar_1R1V_rpc_LocBypassingRunnable_LocBypassingRunnable_m_pad_ensRLocationsPort_par_out_local.TChangeableMemPool._._._m_arrayPool._0_._elem._m_LocationList._Item._76_._phi._m_value "" VALUE 0xB00109A8 __Float16_Value 0 NO_COMPU_METHOD -65504 65504 ECU_ADDRESS_EXTENSION 0x2 BYTE_ORDER MSB_LAST /end CHARACTERISTIC
/begin CHARACTERISTIC _g_PL_AD_fw_Radar_1R1V_rpc_LocBypassingRunnable_LocBypassingRunnable_m_pad_ensRLocationsPort_par_out_local.TChangeableMemPool._._._m_arrayPool._0_._elem._m_LocationList._Item._76_._phiQly "" VALUE 0xB00109AB __UByte_Value 0 NO_COMPU_METHOD 0 255 ECU_ADDRESS_EXTENSION 0x2 BYTE_ORDER MSB_LAST /end CHARACTERISTIC
/begin CHARACTERISTIC _g_PL_AD_fw_Radar_1R1V_rpc_LocBypassingRunnable_LocBypassingRunnable_m_pad_ensRLocationsPort_par_out_local.TChangeableMemPool._._._m_arrayPool._0_._elem._m_LocationList._Item._76_._phiVar._m_value "" VALUE 0xB00109AE __Float16_Value 0 NO_COMPU_METHOD -65504 65504 ECU_ADDRESS_EXTENSION 0x2 BYTE_ORDER MSB_LAST /end CHARACTERISTIC
/begin CHARACTERISTIC _g_PL_AD_fw_Radar_1R1V_rpc_LocBypassingRunnable_LocBypassingRunnable_m_pad_ensRLocationsPort_par_out_local.TChangeableMemPool._._._m_arrayPool._0_._elem._m_LocationList._Item._76_._theta._m_value "" VALUE 0xB00109A6 __Float16_Value 0 NO_COMPU_METHOD -65504 65504 ECU_ADDRESS_EXTENSION 0x2 BYTE_ORDER MSB_LAST /end CHARACTERISTIC
/begin CHARACTERISTIC _g_PL_AD_fw_Radar_1R1V_rpc_LocBypassingRunnable_LocBypassingRunnable_m_pad_ensRLocationsPort_par_out_local.TChangeableMemPool._._._m_arrayPool._0_._elem._m_LocationList._Item._76_._thetaQly "" VALUE 0xB00109AA __UByte_Value 0 NO_COMPU_METHOD 0 255 ECU_ADDRESS_EXTENSION 0x2 BYTE_ORDER MSB_LAST /end CHARACTERISTIC
/begin CHARACTERISTIC _g_PL_AD_fw_Radar_1R1V_rpc_LocBypassingRunnable_LocBypassingRunnable_m_pad_ensRLocationsPort_par_out_local.TChangeableMemPool._._._m_arrayPool._0_._elem._m_LocationList._Item._76_._thetaVar._m_value "" VALUE 0xB00109AC __Float16_Value 0 NO_COMPU_METHOD -65504 65504 ECU_ADDRESS_EXTENSION 0x2 BYTE_ORDER MSB_LAST /end CHARACTERISTIC
/begin CHARACTERISTIC _g_PL_AD_fw_Radar_1R1V_rpc_LocBypassingRunnable_LocBypassingRunnable_m_pad_ensRLocationsPort_par_out_local.TChangeableMemPool._._._m_arrayPool._0_._elem._m_LocationList._Item._76_._v "" VALUE 0xB001099C __Float32_Value 0 NO_COMPU_METHOD -3.4028234663852886E+38 3.4028234663852886E+38 ECU_ADDRESS_EXTENSION 0x2 BYTE_ORDER MSB_LAST /end CHARACTERISTIC
/begin CHARACTERISTIC _g_PL_AD_fw_Radar_1R1V_rpc_LocBypassingRunnable_LocBypassingRunnable_m_pad_ensRLocationsPort_par_out_local.TChangeableMemPool._._._m_arrayPool._0_._elem._m_LocationList._Item._76_._vVar._m_value "" VALUE 0xB00109A2 __Float16_Value 0 NO_COMPU_METHOD -65504 65504 ECU_ADDRESS_EXTENSION 0x2 BYTE_ORDER MSB_LAST /end CHARACTERISTIC
/begin CHARACTERISTIC _g_PL_AD_fw_Radar_1R1V_rpc_LocBypassingRunnable_LocBypassingRunnable_m_pad_ensRLocationsPort_par_out_local.TChangeableMemPool._._._m_arrayPool._0_._elem._m_LocationList._Item._77_._Rcs._m_value "" VALUE 0xB00109D0 __Float16_Value 0 NO_COMPU_METHOD -65504 65504 ECU_ADDRESS_EXTENSION 0x2 BYTE_ORDER MSB_LAST /end CHARACTERISTIC
/begin COMPU_METHOD _g_DACore_SIT_RunnableLmfAndOlr_RunnableLmfAndOlr._m_LmfAndOlr._m_drivingDirection._m_drivingDirectionData._m_value._2_._m_drivingDirection.CONVERSION "@@@@RuleName created by CANape" TAB_VERB "%.0" "" COMPU_TAB_REF _g_DACore_SIT_RunnableLmfAndOlr_RunnableLmfAndOlr._m_LmfAndOlr._m_drivingDirection._m_drivingDirectionData._m_value._2_._m_drivingDirection.CONVERSION /end COMPU_METHOD
/begin COMPU_METHOD _g_DACore_SIT_RunnableTiplTurnCoDriver_RunnableTiplTurnCoDriver_m_evaluatedBehaviors_out_local.TMemPool._._._m_pool._m_values._0_._elem._m_evalBehaviorList._m_value._0_._m_rpCalcResultList._m_value._0_._m_reactionPatterns._m_value._0_._m_behaviorSpecification._m_systemCapability.CONVERSION "@@@@RuleName created by CANape" TAB_VERB "%.0" "" COMPU_TAB_REF _g_DACore_SIT_RunnableTiplTurnCoDriver_RunnableTiplTurnCoDriver_m_evaluatedBehaviors_out_local.TMemPool._._._m_pool._m_values._0_._elem._m_evalBehaviorList._m_value._0_._m_rpCalcResultList._m_value._0_._m_reactionPatterns._m_value._0_._m_behaviorSpecification._m_systemCapability.CONVERSION /end COMPU_METHOD
/begin COMPU_METHOD _g_DACore_SIT_RunnableTiplTurnCoDriver_RunnableTiplTurnCoDriver_m_evaluatedBehaviors_out_local.TMemPool._._._m_pool._m_values._0_._elem._m_evalBehaviorList._m_value._0_._m_rpCalcResultList._m_value._0_._m_reactionPatterns._m_value._0_._m_corridor._m_dynamicRedBorders._m_memory._m_values._3_._m_vertexType.CONVERSION "@@@@RuleName created by CANape" TAB_VERB "%.0" "" COMPU_TAB_REF _g_DACore_SIT_RunnableTiplTurnCoDriver_RunnableTiplTurnCoDriver_m_evaluatedBehaviors_out_local.TMemPool._._._m_pool._m_values._0_._elem._m_evalBehaviorList._m_value._0_._m_rpCalcResultList._m_value._0_._m_reactionPatterns._m_value._0_._m_corridor._m_dynamicRedBorders._m_memory._m_values._3_._m_vertexType.CONVERSION /end COMPU_METHOD
/begin COMPU_METHOD _g_DACore_SIT_RunnableTiplTurnCoDriver_RunnableTiplTurnCoDriver_m_evaluatedBehaviors_out_local.TMemPool._._._m_pool._m_values._0_._elem._m_evalBehaviorList._m_value._0_._m_rpCalcResultList._m_value._0_._m_reactionPatterns._m_value._0_._m_corridor._m_guidanceConfiguration._m_drivingModeLongitudinal.CONVERSION "@@@@RuleName created by CANape" TAB_VERB "%.0" "" COMPU_TAB_REF _g_DACore_SIT_RunnableTiplTurnCoDriver_RunnableTiplTurnCoDriver_m_evaluatedBehaviors_out_local.TMemPool._._._m_pool._m_values._0_._elem._m_evalBehaviorList._m_value._0_._m_rpCalcResultList._m_value._0_._m_reactionPatterns._m_value._0_._m_corridor._m_guidanceConfiguration._m_drivingModeLongitudinal.CONVERSION /end COMPU_METHOD
/begin COMPU_METHOD _g_DACore_SIT_RunnableTiplTurnCoDriver_RunnableTiplTurnCoDriver_m_evaluatedBehaviors_out_local.TMemPool._._._m_pool._m_values._0_._elem._m_evalBehaviorList._m_value._0_._m_rpCalcResultList._m_value._0_._m_reactionPatterns._m_value._0_._m_corridor._m_guidanceConfiguration._m_longitudinalMotionType.CONVERSION "@@@@RuleName created by CANape" TAB_VERB "%.0" "" COMPU_TAB_REF _g_DACore_SIT_RunnableTiplTurnCoDriver_RunnableTiplTurnCoDriver_m_evaluatedBehaviors_out_local.TMemPool._._._m_pool._m_values._0_._elem._m_evalBehaviorList._m_value._0_._m_rpCalcResultList._m_value._0_._m_reactionPatterns._m_value._0_._m_corridor._m_guidanceConfiguration._m_longitudinalMotionType.CONVERSION /end COMPU_METHOD
/begin COMPU_METHOD _g_DACore_SIT_RunnableTiplTurnCoDriver_RunnableTiplTurnCoDriver_m_evaluatedBehaviors_out_local.TMemPool._._._m_pool._m_values._0_._elem._m_evalBehaviorList._m_value._0_._m_rpCalcResultList._m_value._0_._m_reactionPatterns._m_value._0_._m_corridor._m_guidanceConfiguration._m_speedLimiter.CONVERSION "@@@@RuleName created by CANape" TAB_VERB "%.0" "" COMPU_TAB_REF _g_DACore_SIT_RunnableTiplTurnCoDriver_RunnableTiplTurnCoDriver_m_evaluatedBehaviors_out_local.TMemPool._._._m_pool._m_values._0_._elem._m_evalBehaviorList._m_value._0_._m_rpCalcResultList._m_value._0_._m_reactionPatterns._m_value._0_._m_corridor._m_guidanceConfiguration._m_speedLimiter.CONVERSION /end COMPU_METHOD
/begin COMPU_METHOD _g_DACore_SIT_RunnableTiplTurnCoDriver_RunnableTiplTurnCoDriver_m_evaluatedBehaviors_out_local.TMemPool._._._m_pool._m_values._0_._elem._m_evalBehaviorList._m_value._0_._m_rpCalcResultList._m_value._0_._m_reactionPatterns._m_value._0_._m_corridor._m_guidanceConfiguration._m_stationaryHoldMode.CONVERSION "@@@@RuleName created by CANape" TAB_VERB "%.0" "" COMPU_TAB_REF _g_DACore_SIT_RunnableTiplTurnCoDriver_RunnableTiplTurnCoDriver_m_evaluatedBehaviors_out_local.TMemPool._._._m_pool._m_values._0_._elem._m_evalBehaviorList._m_value._0_._m_rpCalcResultList._m_value._0_._m_reactionPatterns._m_value._0_._m_corridor._m_guidanceConfiguration._m_stationaryHoldMode.CONVERSION /end COMPU_METHOD
/begin COMPU_METHOD _g_DACore_SIT_RunnableTiplTurnCoDriver_RunnableTiplTurnCoDriver_m_evaluatedBehaviors_out_local.TMemPool._._._m_pool._m_values._0_._elem._m_evalBehaviorList._m_value._0_._m_rpCalcResultList._m_value._0_._m_reactionPatterns._m_value._0_._m_degreeOfAssistanceLongitudinal.CONVERSION "@@@@RuleName created by CANape" TAB_VERB "%.0" "" COMPU_TAB_REF _g_DACore_SIT_RunnableTiplTurnCoDriver_RunnableTiplTurnCoDriver_m_evaluatedBehaviors_out_local.TMemPool._._._m_pool._m_values._0_._elem._m_evalBehaviorList._m_value._0_._m_rpCalcResultList._m_value._0_._m_reactionPatterns._m_value._0_._m_degreeOfAssistanceLongitudinal.CONVERSION /end COMPU_METHOD
/begin COMPU_METHOD _g_DACore_SIT_RunnableTiplTurnCoDriver_RunnableTiplTurnCoDriver_m_evaluatedBehaviors_out_local.TMemPool._._._m_pool._m_values._0_._elem._m_evalBehaviorList._m_value._0_._m_rpCalcResultList._m_value._0_._m_reactionPatterns._m_value._0_._m_reactionPatternType.CONVERSION "@@@@RuleName created by CANape" TAB_VERB "%.0" "" COMPU_TAB_REF _g_DACore_SIT_RunnableTiplTurnCoDriver_RunnableTiplTurnCoDriver_m_evaluatedBehaviors_out_local.TMemPool._._._m_pool._m_values._0_._elem._m_evalBehaviorList._m_value._0_._m_rpCalcResultList._m_value._0_._m_reactionPatterns._m_value._0_._m_reactionPatternType.CONVERSION /end COMPU_METHOD
/begin COMPU_METHOD _g_DACore_SIT_RunnableTiplTurnCoDriver_RunnableTiplTurnCoDriver_m_introspection_out_local.TMemPool._._._m_pool._m_values._0_._elem._m_relevantBehaviorAttributes._m_value._0_._m_behaviorRestrictions._m_value._3_._m_restrictionType.CONVERSION "@@@@RuleName created by CANape" TAB_VERB "%.0" "" COMPU_TAB_REF _g_DACore_SIT_RunnableTiplTurnCoDriver_RunnableTiplTurnCoDriver_m_introspection_out_local.TMemPool._._._m_pool._m_values._0_._elem._m_relevantBehaviorAttributes._m_value._0_._m_behaviorRestrictions._m_value._3_._m_restrictionType.CONVERSION /end COMPU_METHOD
/begin COMPU_METHOD _g_DACore_SIT_RunnableTrafficRules_RunnableTrafficRules._m_controllerTrafficContextAnnotatedLanes._m_tcalContainer._m_trafficContexts.TList._._m_nodeAlloc._m_memPool._m_storage._m_vals._v1._7_._m_value._m_class.CONVERSION "@@@@RuleName created by CANape" TAB_VERB "%.0" "" COMPU_TAB_REF _g_DACore_SIT_RunnableTrafficRules_RunnableTrafficRules._m_controllerTrafficContextAnnotatedLanes._m_tcalContainer._m_trafficContexts.TList._._m_nodeAlloc._m_memPool._m_storage._m_vals._v1._7_._m_value._m_class.CONVERSION /end COMPU_METHOD
/begin COMPU_METHOD _g_DACore_SIT_RunnableTrafficRules_RunnableTrafficRules._m_controllerTrafficRules._m_ruleContainer._m_rules.TList._._m_nodeAlloc._m_memPool._m_storage._m_vals._v1._9_._m_value.TrafficRule._._m_ruleClass.CONVERSION "@@@@RuleName created by CANape" TAB_VERB "%.0" "" COMPU_TAB_REF _g_DACore_SIT_RunnableTrafficRules_RunnableTrafficRules._m_controllerTrafficRules._m_ruleContainer._m_rules.TList._._m_nodeAlloc._m_memPool._m_storage._m_vals._v1._9_._m_value.TrafficRule._._m_ruleClass.CONVERSION /end COMPU_METHOD
/begin COMPU_METHOD _g_DACore_SIT_RunnableTrafficRules_RunnableTrafficRules._m_controllerTrafficRules._m_ruleContainer._m_rules.TList._._m_nodeAlloc._m_memPool._m_storage._m_vals._v1._9_._m_value.TrafficRule._._m_type.CONVERSION "@@@@RuleName created by CANape" TAB_VERB "%.0" "" COMPU_TAB_REF _g_DACore_SIT_RunnableTrafficRules_RunnableTrafficRules._m_controllerTrafficRules._m_ruleContainer._m_rules.TList._._m_nodeAlloc._m_memPool._m_storage._m_vals._v1._9_._m_value.TrafficRule._._m_type.CONVERSION /end COMPU_METHOD
/begin COMPU_METHOD _g_DACore_SIT_RunnableTrafficRules_RunnableTrafficRules._m_controllerTrafficRules._m_ruleContainer._m_rules.TList._._m_nodeAlloc._m_memPool._m_storage._m_vals._v1._9_._m_value._m_cancelationType.CONVERSION "@@@@RuleName created by CANape" TAB_VERB "%.0" "" COMPU_TAB_REF _g_DACore_SIT_RunnableTrafficRules_RunnableTrafficRules._m_controllerTrafficRules._m_ruleContainer._m_rules.TList._._m_nodeAlloc._m_memPool._m_storage._m_vals._v1._9_._m_value._m_cancelationType.CONVERSION /end COMPU_METHOD
/begin COMPU_METHOD _g_triggerC1Runnable.TExtensionSystemTime._._m_systemTime._m_status.CONVERSION "@@@@RuleName created by CANape" TAB_VERB "%.0" "" COMPU_TAB_REF _g_triggerC1Runnable.TExtensionSystemTime._._m_systemTime._m_status.CONVERSION /end COMPU_METHOD
/begin COMPU_METHOD _mbist_MTURegisters_cast._0_._MBISTSEL_e.CONVERSION "enumeration table" TAB_VERB "%.0" "" COMPU_TAB_REF _mbist_MTURegisters_cast._0_._MBISTSEL_e.CONVERSION /end COMPU_METHOD
/begin COMPU_METHOD _mon_config_cast._0_._depmonitem_en.CONVERSION "enumeration table" TAB_VERB "%.0" "" COMPU_TAB_REF _mon_config_cast._0_._depmonitem_en.CONVERSION /end COMPU_METHOD
/begin COMPU_METHOD _mon_config_cast._0_._type_en.CONVERSION "@@@@RuleName created by CANape" TAB_VERB "%.0" "" COMPU_TAB_REF _mon_config_cast._0_._type_en.CONVERSION /end COMPU_METHOD
/begin COMPU_METHOD _mon_filteredstatus_aen._0_.CONVERSION "enumeration table" TAB_VERB "%.0" "" COMPU_TAB_REF _mon_filteredstatus_aen._0_.CONVERSION /end COMPU_METHOD
/begin COMPU_METHOD _mon_status_aen._0_.CONVERSION "@@@@RuleName created by CANape" TAB_VERB "%.0" "" COMPU_TAB_REF _mon_status_aen._0_.CONVERSION /end COMPU_METHOD
/begin COMPU_METHOD _rbInterruptHandler_DebugInfoSample_st._UnintendedInterruptIndex_en.CONVERSION "enumeration table" TAB_VERB "%.0" "" COMPU_TAB_REF _rbInterruptHandler_DebugInfoSample_st._UnintendedInterruptIndex_en.CONVERSION /end COMPU_METHOD
/begin COMPU_METHOD _rbInterruptHandler_StoreDebugInfoState_en.CONVERSION "enumeration table" TAB_VERB "%.0" "" COMPU_TAB_REF _rbInterruptHandler_StoreDebugInfoState_en.CONVERSION /end COMPU_METHOD
/begin COMPU_METHOD _rbModeMgr_ActiveSystemMode_en.CONVERSION "enumeration table" TAB_VERB "%.0" "" COMPU_TAB_REF _rbModeMgr_ActiveSystemMode_en.CONVERSION /end COMPU_METHOD
/begin COMPU_METHOD _rbResetHandler_ResetState_en.CONVERSION "enumeration table" TAB_VERB "%.0" "" COMPU_TAB_REF _rbResetHandler_ResetState_en.CONVERSION /end COMPU_METHOD
/begin COMPU_METHOD _rbResetHandler_ResetType_en.CONVERSION "enumeration table" TAB_VERB "%.0" "" COMPU_TAB_REF _rbResetHandler_ResetType_en.CONVERSION /end COMPU_METHOD
/begin COMPU_METHOD _rbSftMon_CoreClkMainState_en.CONVERSION "enumeration table" TAB_VERB "%.0" "" COMPU_TAB_REF _rbSftMon_CoreClkMainState_en.CONVERSION /end COMPU_METHOD
/begin COMPU_METHOD _rbSftMon_CoreClkTestStatus_en.CONVERSION "enumeration table" TAB_VERB "%.0" "" COMPU_TAB_REF _rbSftMon_CoreClkTestStatus_en.CONVERSION /end COMPU_METHOD
/begin COMPU_METHOD _rbSftMon_CoreVoltageMainState_en.CONVERSION "enumeration table" TAB_VERB "%.0" "" COMPU_TAB_REF _rbSftMon_CoreVoltageMainState_en.CONVERSION /end COMPU_METHOD
/begin COMPU_METHOD _rbSftMon_StackStatus_aen._0_.CONVERSION "enumeration table" TAB_VERB "%.0" "" COMPU_TAB_REF _rbSftMon_StackStatus_aen._0_.CONVERSION /end COMPU_METHOD
/begin COMPU_METHOD _rbSftMon_coreClkRunningIndex_en.CONVERSION "enumeration table" TAB_VERB "%.0" "" COMPU_TAB_REF _rbSftMon_coreClkRunningIndex_en.CONVERSION /end COMPU_METHOD
/begin COMPU_METHOD _rbSftMon_coreClkTest_st._0_._SubState_en.CONVERSION "enumeration table" TAB_VERB "%.0" "" COMPU_TAB_REF _rbSftMon_coreClkTest_st._0_._SubState_en.CONVERSION /end COMPU_METHOD
/begin COMPU_METHOD _rb_Sbst_CustSlice_en.CONVERSION "enumeration table" TAB_VERB "%.0" "" COMPU_TAB_REF _rb_Sbst_CustSlice_en.CONVERSION /end COMPU_METHOD
/begin COMPU_METHOD _rba_Can_Status_ast._9_._NodeStatus_st._Can_IPType_en.CONVERSION "@@@@RuleName created by CANape" TAB_VERB "%.0" "" COMPU_TAB_REF _rba_Can_Status_ast._9_._NodeStatus_st._Can_IPType_en.CONVERSION /end COMPU_METHOD
/begin COMPU_METHOD _rba_Can_Status_ast._9_._RequestedState_en.CONVERSION "@@@@RuleName created by CANape" TAB_VERB "%.0" "" COMPU_TAB_REF _rba_Can_Status_ast._9_._RequestedState_en.CONVERSION /end COMPU_METHOD
/begin COMPU_METHOD _rba_Dma_Driver_ast._9_._chStatus_en.CONVERSION "@@@@RuleName created by CANape" TAB_VERB "%.0" "" COMPU_TAB_REF _rba_Dma_Driver_ast._9_._chStatus_en.CONVERSION /end COMPU_METHOD
/begin COMPU_METHOD _rba_Emm_Cfg_IndivRTCfg_acst._0_._rba_Emm_Cfg_RTId_en.CONVERSION "@@@@RuleName created by CANape" TAB_VERB "%.0" "" COMPU_TAB_REF _rba_Emm_Cfg_IndivRTCfg_acst._0_._rba_Emm_Cfg_RTId_en.CONVERSION /end COMPU_METHOD
/begin COMPU_METHOD _rba_FeeFs2_Prv_AllocBackground_st._state_en.CONVERSION "@@@@RuleName created by CANape" TAB_VERB "%.0" "" COMPU_TAB_REF _rba_FeeFs2_Prv_AllocBackground_st._state_en.CONVERSION /end COMPU_METHOD
/begin COMPU_METHOD _rba_FeeFs2_Prv_AllocErase_st._state_en.CONVERSION "@@@@RuleName created by CANape" TAB_VERB "%.0" "" COMPU_TAB_REF _rba_FeeFs2_Prv_AllocErase_st._state_en.CONVERSION /end COMPU_METHOD
/begin COMPU_METHOD _rba_FeeFs2_Prv_AllocMallocDat_st._state_en.CONVERSION "@@@@RuleName created by CANape" TAB_VERB "%.0" "" COMPU_TAB_REF _rba_FeeFs2_Prv_AllocMallocDat_st._state_en.CONVERSION /end COMPU_METHOD
/begin COMPU_METHOD _rba_FeeFs2_Prv_AllocMallocFat_st._state_en.CONVERSION "@@@@RuleName created by CANape" TAB_VERB "%.0" "" COMPU_TAB_REF _rba_FeeFs2_Prv_AllocMallocFat_st._state_en.CONVERSION /end COMPU_METHOD
/begin COMPU_METHOD _rba_FeeFs2_Prv_DatCopy_st._state_en.CONVERSION "enumeration table" TAB_VERB "%.0" "" COMPU_TAB_REF _rba_FeeFs2_Prv_DatCopy_st._state_en.CONVERSION /end COMPU_METHOD
/begin COMPU_METHOD _rba_FeeFs2_Prv_DatCopy_st._state_en.CONVERSION0 "@@@@RuleName created by CANape" TAB_VERB "%.0" "" COMPU_TAB_REF _rba_FeeFs2_Prv_DatCopy_st._state_en.CONVERSION0 /end COMPU_METHOD
/begin COMPU_METHOD _rba_FeeFs2_Prv_DatUnlinkSector_st._state_en.CONVERSION "enumeration table" TAB_VERB "%.0" "" COMPU_TAB_REF _rba_FeeFs2_Prv_DatUnlinkSector_st._state_en.CONVERSION /end COMPU_METHOD
/begin COMPU_METHOD _rba_FeeFs2_Prv_DatUnlinkSector_st._state_en.CONVERSION0 "@@@@RuleName created by CANape" TAB_VERB "%.0" "" COMPU_TAB_REF _rba_FeeFs2_Prv_DatUnlinkSector_st._state_en.CONVERSION0 /end COMPU_METHOD
/begin COMPU_METHOD _rba_FeeFs2_Prv_DatWrap_st._func_en.CONVERSION "enumeration table" TAB_VERB "%.0" "" COMPU_TAB_REF _rba_FeeFs2_Prv_DatWrap_st._func_en.CONVERSION /end COMPU_METHOD
/begin COMPU_METHOD _rba_FeeFs2_Prv_DatWrap_st._func_en.CONVERSION0 "@@@@RuleName created by CANape" TAB_VERB "%.0" "" COMPU_TAB_REF _rba_FeeFs2_Prv_DatWrap_st._func_en.CONVERSION0 /end COMPU_METHOD
/begin COMPU_METHOD _rba_FeeFs2_Prv_DatWrap_st._state_en.CONVERSION "enumeration table" TAB_VERB "%.0" "" COMPU_TAB_REF _rba_FeeFs2_Prv_DatWrap_st._state_en.CONVERSION /end COMPU_METHOD
/begin COMPU_METHOD _rba_FeeFs2_Prv_DatWrap_st._state_en.CONVERSION0 "@@@@RuleName created by CANape" TAB_VERB "%.0" "" COMPU_TAB_REF _rba_FeeFs2_Prv_DatWrap_st._state_en.CONVERSION0 /end COMPU_METHOD
/begin COMPU_METHOD _rba_FeeFs2_Prv_DatWrite_st._state_en.CONVERSION "enumeration table" TAB_VERB "%.0" "" COMPU_TAB_REF _rba_FeeFs2_Prv_DatWrite_st._state_en.CONVERSION /end COMPU_METHOD
/begin COMPU_METHOD _rba_FeeFs2_Prv_DatWrite_st._state_en.CONVERSION0 "@@@@RuleName created by CANape" TAB_VERB "%.0" "" COMPU_TAB_REF _rba_FeeFs2_Prv_DatWrite_st._state_en.CONVERSION0 /end COMPU_METHOD
/begin COMPU_METHOD _rba_FeeFs2_Prv_FatCacheBuild_st._state_en.CONVERSION "enumeration table" TAB_VERB "%.0" "" COMPU_TAB_REF _rba_FeeFs2_Prv_FatCacheBuild_st._state_en.CONVERSION /end COMPU_METHOD
/begin COMPU_METHOD _rba_FeeFs2_Prv_FatCacheBuild_st._state_en.CONVERSION0 "@@@@RuleName created by CANape" TAB_VERB "%.0" "" COMPU_TAB_REF _rba_FeeFs2_Prv_FatCacheBuild_st._state_en.CONVERSION0 /end COMPU_METHOD
/begin COMPU_METHOD _rba_FeeFs2_Prv_FatCache_st._mode_en.CONVERSION "enumeration table" TAB_VERB "%.0" "" COMPU_TAB_REF _rba_FeeFs2_Prv_FatCache_st._mode_en.CONVERSION /end COMPU_METHOD
/begin COMPU_METHOD _rba_FeeFs2_Prv_FatCache_st._mode_en.CONVERSION0 "@@@@RuleName created by CANape" TAB_VERB "%.0" "" COMPU_TAB_REF _rba_FeeFs2_Prv_FatCache_st._mode_en.CONVERSION0 /end COMPU_METHOD
/begin COMPU_METHOD _rba_FeeFs2_Prv_FatEntry2Fls_st._state_en.CONVERSION "enumeration table" TAB_VERB "%.0" "" COMPU_TAB_REF _rba_FeeFs2_Prv_FatEntry2Fls_st._state_en.CONVERSION /end COMPU_METHOD
/begin COMPU_METHOD _rba_FeeFs2_Prv_FatEntry2Fls_st._state_en.CONVERSION0 "@@@@RuleName created by CANape" TAB_VERB "%.0" "" COMPU_TAB_REF _rba_FeeFs2_Prv_FatEntry2Fls_st._state_en.CONVERSION0 /end COMPU_METHOD
/begin COMPU_METHOD _rba_FeeFs2_Prv_FatFinalize_st._state_en.CONVERSION "enumeration table" TAB_VERB "%.0" "" COMPU_TAB_REF _rba_FeeFs2_Prv_FatFinalize_st._state_en.CONVERSION /end COMPU_METHOD
/begin COMPU_METHOD _rba_FeeFs2_Prv_FatFinalize_st._state_en.CONVERSION0 "@@@@RuleName created by CANape" TAB_VERB "%.0" "" COMPU_TAB_REF _rba_FeeFs2_Prv_FatFinalize_st._state_en.CONVERSION0 /end COMPU_METHOD
/begin COMPU_METHOD _rba_FeeFs2_Prv_FatGetLatestByAdr_st._state_en.CONVERSION "enumeration table" TAB_VERB "%.0" "" COMPU_TAB_REF _rba_FeeFs2_Prv_FatGetLatestByAdr_st._state_en.CONVERSION /end COMPU_METHOD
/begin COMPU_METHOD _rba_FeeFs2_Prv_FatGetLatestByAdr_st._state_en.CONVERSION0 "@@@@RuleName created by CANape" TAB_VERB "%.0" "" COMPU_TAB_REF _rba_FeeFs2_Prv_FatGetLatestByAdr_st._state_en.CONVERSION0 /end COMPU_METHOD
/begin COMPU_METHOD _rba_FeeFs2_Prv_FatGetLatestById_st._state_en.CONVERSION "enumeration table" TAB_VERB "%.0" "" COMPU_TAB_REF _rba_FeeFs2_Prv_FatGetLatestById_st._state_en.CONVERSION /end COMPU_METHOD
/begin COMPU_METHOD _rba_FeeFs2_Prv_FatGetLatestById_st._state_en.CONVERSION0 "@@@@RuleName created by CANape" TAB_VERB "%.0" "" COMPU_TAB_REF _rba_FeeFs2_Prv_FatGetLatestById_st._state_en.CONVERSION0 /end COMPU_METHOD
/begin COMPU_METHOD _rba_FeeFs2_Prv_FatMigrate_st._state_en.CONVERSION "enumeration table" TAB_VERB "%.0" "" COMPU_TAB_REF _rba_FeeFs2_Prv_FatMigrate_st._state_en.CONVERSION /end COMPU_METHOD
/begin COMPU_METHOD _rba_FeeFs2_Prv_FatMigrate_st._state_en.CONVERSION0 "@@@@RuleName created by CANape" TAB_VERB "%.0" "" COMPU_TAB_REF _rba_FeeFs2_Prv_FatMigrate_st._state_en.CONVERSION0 /end COMPU_METHOD
/begin COMPU_METHOD _rba_FeeFs2_Prv_FatWrite_st._state_en.CONVERSION "enumeration table" TAB_VERB "%.0" "" COMPU_TAB_REF _rba_FeeFs2_Prv_FatWrite_st._state_en.CONVERSION /end COMPU_METHOD
/begin COMPU_METHOD _rba_FeeFs2_Prv_FatWrite_st._state_en.CONVERSION0 "@@@@RuleName created by CANape" TAB_VERB "%.0" "" COMPU_TAB_REF _rba_FeeFs2_Prv_FatWrite_st._state_en.CONVERSION0 /end COMPU_METHOD
/begin COMPU_METHOD _rba_FeeFs2_Prv_InvalidateBlock_st._state_en.CONVERSION "@@@@RuleName created by CANape" TAB_VERB "%.0" "" COMPU_TAB_REF _rba_FeeFs2_Prv_InvalidateBlock_st._state_en.CONVERSION /end COMPU_METHOD
/begin COMPU_METHOD _rba_FeeFs2_Prv_Read_st._state_en.CONVERSION "@@@@RuleName created by CANape" TAB_VERB "%.0" "" COMPU_TAB_REF _rba_FeeFs2_Prv_Read_st._state_en.CONVERSION /end COMPU_METHOD
/begin COMPU_METHOD _rba_FeeFs2_Prv_SectorErase_st._formerWorkingState_en.CONVERSION "@@@@RuleName created by CANape" TAB_VERB "%.0" "" COMPU_TAB_REF _rba_FeeFs2_Prv_SectorErase_st._formerWorkingState_en.CONVERSION /end COMPU_METHOD
/begin COMPU_VTAB_RANGE _g_DACore_SIT_RunnableLmfAndOlr_RunnableLmfAndOlr._m_LmfAndOlr._m_drivingDirection._m_drivingDirectionData._m_value._2_._m_drivingDirection.CONVERSION "@@@@RuleName created by CANape" 3 0 0 "unknown" 1 1 "synchronous" 2 2 "oncoming" DEFAULT_VALUE "" /end COMPU_VTAB_RANGE
/begin COMPU_VTAB_RANGE _g_DACore_SIT_RunnableTiplTurnCoDriver_RunnableTiplTurnCoDriver_m_evaluatedBehaviors_out_local.TMemPool._._._m_pool._m_values._0_._elem._m_evalBehaviorList._m_value._0_._m_rpCalcResultList._m_value._0_._m_reactionPatterns._m_value._0_._m_behaviorSpecification._m_systemCapability.CONVERSION "@@@@RuleName created by CANape" 11 0 0 "undefined" 1 1 "laneDriving" 2 2 "forwardCollisionWarning" 3 3 "emergencyBrake" 4 4 "partialBrake" 5 5 "immediateBrake" 6 6 "emergencyBrakeAssist" 20 20 "laneChangeLeft" 21 21 "laneChangeRight" 22 22 "laneDepartureWarning" 23 23 "returnToLane" DEFAULT_VALUE "" /end COMPU_VTAB_RANGE
/begin COMPU_VTAB_RANGE _g_DACore_SIT_RunnableTiplTurnCoDriver_RunnableTiplTurnCoDriver_m_evaluatedBehaviors_out_local.TMemPool._._._m_pool._m_values._0_._elem._m_evalBehaviorList._m_value._0_._m_rpCalcResultList._m_value._0_._m_reactionPatterns._m_value._0_._m_corridor._m_dynamicRedBorders._m_memory._m_values._3_._m_vertexType.CONVERSION "@@@@RuleName created by CANape" 6 0 0 "rightFront" 1 1 "leftFront" 2 2 "rightRear" 3 3 "leftRear" 4 4 "blockedFront" 5 5 "blockedRear" DEFAULT_VALUE "" /end COMPU_VTAB_RANGE
/begin COMPU_VTAB_RANGE _g_DACore_SIT_RunnableTiplTurnCoDriver_RunnableTiplTurnCoDriver_m_evaluatedBehaviors_out_local.TMemPool._._._m_pool._m_values._0_._elem._m_evalBehaviorList._m_value._0_._m_rpCalcResultList._m_value._0_._m_reactionPatterns._m_value._0_._m_corridor._m_guidanceConfiguration._m_drivingModeLongitudinal.CONVERSION "@@@@RuleName created by CANape" 3 0 0 "normal" 1 1 "eco" 2 2 "dynamic" DEFAULT_VALUE "" /end COMPU_VTAB_RANGE
/begin COMPU_VTAB_RANGE _g_DACore_SIT_RunnableTiplTurnCoDriver_RunnableTiplTurnCoDriver_m_evaluatedBehaviors_out_local.TMemPool._._._m_pool._m_values._0_._elem._m_evalBehaviorList._m_value._0_._m_rpCalcResultList._m_value._0_._m_reactionPatterns._m_value._0_._m_corridor._m_guidanceConfiguration._m_longitudinalMotionType.CONVERSION "@@@@RuleName created by CANape" 2 0 0 "comfort" 1 1 "emergency" DEFAULT_VALUE "" /end COMPU_VTAB_RANGE
/begin COMPU_VTAB_RANGE _g_DACore_SIT_RunnableTiplTurnCoDriver_RunnableTiplTurnCoDriver_m_evaluatedBehaviors_out_local.TMemPool._._._m_pool._m_values._0_._elem._m_evalBehaviorList._m_value._0_._m_rpCalcResultList._m_value._0_._m_reactionPatterns._m_value._0_._m_corridor._m_guidanceConfiguration._m_speedLimiter.CONVERSION "@@@@RuleName created by CANape" 3 0 0 "off" 1 1 "standby" 2 2 "on" DEFAULT_VALUE "" /end COMPU_VTAB_RANGE
/begin COMPU_VTAB_RANGE _g_DACore_SIT_RunnableTiplTurnCoDriver_RunnableTiplTurnCoDriver_m_evaluatedBehaviors_out_local.TMemPool._._._m_pool._m_values._0_._elem._m_evalBehaviorList._m_value._0_._m_rpCalcResultList._m_value._0_._m_reactionPatterns._m_value._0_._m_corridor._m_guidanceConfiguration._m_stationaryHoldMode.CONVERSION "@@@@RuleName created by CANape" 2 0 0 "normal" 1 1 "secure" DEFAULT_VALUE "" /end COMPU_VTAB_RANGE
/begin COMPU_VTAB_RANGE _g_DACore_SIT_RunnableTiplTurnCoDriver_RunnableTiplTurnCoDriver_m_evaluatedBehaviors_out_local.TMemPool._._._m_pool._m_values._0_._elem._m_evalBehaviorList._m_value._0_._m_rpCalcResultList._m_value._0_._m_reactionPatterns._m_value._0_._m_degreeOfAssistanceLongitudinal.CONVERSION "@@@@RuleName created by CANape" 5 0 0 "none" 1 1 "warning" 2 2 "driverCorrecting" 3 3 "assisting" 4 4 "autonomous" DEFAULT_VALUE "" /end COMPU_VTAB_RANGE
/begin COMPU_VTAB_RANGE _g_DACore_SIT_RunnableTiplTurnCoDriver_RunnableTiplTurnCoDriver_m_evaluatedBehaviors_out_local.TMemPool._._._m_pool._m_values._0_._elem._m_evalBehaviorList._m_value._0_._m_rpCalcResultList._m_value._0_._m_reactionPatterns._m_value._0_._m_reactionPatternType.CONVERSION "@@@@RuleName created by CANape" 7 0 0 "undefined" 1 1 "laneDriving" 2 2 "laneChange" 3 3 "emergencyBrake" 4 4 "immediateBrake" 5 5 "returnToLane" 6 6 "activeWarning" DEFAULT_VALUE "" /end COMPU_VTAB_RANGE
/begin COMPU_VTAB_RANGE _g_DACore_SIT_RunnableTiplTurnCoDriver_RunnableTiplTurnCoDriver_m_introspection_out_local.TMemPool._._._m_pool._m_values._0_._elem._m_relevantBehaviorAttributes._m_value._0_._m_behaviorRestrictions._m_value._3_._m_restrictionType.CONVERSION "@@@@RuleName created by CANape" 4 0 0 "NONE" 1 1 "OBJECT" 2 2 "BORDER_LEFT" 3 3 "BORDER_RIGHT" DEFAULT_VALUE "" /end COMPU_VTAB_RANGE
/begin COMPU_VTAB_RANGE _g_DACore_SIT_RunnableTrafficRules_RunnableTrafficRules._m_controllerTrafficContextAnnotatedLanes._m_tcalContainer._m_trafficContexts.TList._._m_nodeAlloc._m_memPool._m_storage._m_vals._v1._7_._m_value._m_class.CONVERSION "@@@@RuleName created by CANape" 3 0 0 "unknown" 1 1 "contextFromRoadSign" 2 2 "contextFromMapData" DEFAULT_VALUE "" /end COMPU_VTAB_RANGE
/begin COMPU_VTAB_RANGE _g_DACore_SIT_RunnableTrafficRules_RunnableTrafficRules._m_controllerTrafficRules._m_ruleContainer._m_rules.TList._._m_nodeAlloc._m_memPool._m_storage._m_vals._v1._9_._m_value.TrafficRule._._m_ruleClass.CONVERSION "@@@@RuleName created by CANape" 5 0 0 "RC_UNKNOWN" 1 1 "RC_FROM_ROAD_SIGN" 2 2 "RC_DEFAULT_SPEED_LIMIT" 3 3 "RC_TRAFFIC_CONTEXT" 4 4 "RC_FROM_MAP_DATA" DEFAULT_VALUE "" /end COMPU_VTAB_RANGE
/begin COMPU_VTAB_RANGE _g_DACore_SIT_RunnableTrafficRules_RunnableTrafficRules._m_controllerTrafficRules._m_ruleContainer._m_rules.TList._._m_nodeAlloc._m_memPool._m_storage._m_vals._v1._9_._m_value.TrafficRule._._m_type.CONVERSION "@@@@RuleName created by CANape" 76 0 0 "TRT_INVALID" 100 100 "TRT_SPEED_LIMIT" 101 101 "TRT_SPEED_ADVICE" 102 102 "TRT_SPEED_MINIMUM" 200 200 "TRT_NO_PASSING" 300 300 "TRT_PAY_ATTENTION_DANGER" 301 301 "TRT_PAY_ATTENTION_CURVE_LEFT" 302 302 "TRT_PAY_ATTENTION_CURVE_RIGHT" 303 303 "TRT_PAY_ATTENTION_DOUBLE_CURVE_LEFT" 304 304 "TRT_PAY_ATTENTION_DOUBLE_CURVE_RIGHT" 305 305 "TRT_PAY_ATTENTION_TRAIN" 306 306 "TRT_PAY_ATTENTION_JAM" 307 307 "TRT_PAY_ATTENTION_ROAD_WORKS" 308 308 "TRT_PAY_ATTENTION_SLOPE_DOWN" 309 309 "TRT_PAY_ATTENTION_SLOPE_UP" 310 310 "TRT_PAY_ATTENTION_CONSTRICTION" 311 311 "TRT_PAY_ATTENTION_CONSTRICTION_LEFT" 312 312 "TRT_PAY_ATTENTION_CONSTRICTION_RIGHT" 313 313 "TRT_PAY_ATTENTION_PEDESTRIANS" 314 314 "TRT_PAY_ATTENTION_KIDS" 315 315 "TRT_PAY_ATTENTION_BIKES" 316 316 "TRT_PAY_ATTENTION_SKIDDING" 317 317 "TRT_PAY_ATTENTION_ROUNDABOUT" 318 318 "TRT_PAY_ATTENTION_WILD_ANIMAL" 319 319 "TRT_PAY_ATTENTION_CATTLE" 320 320 "TRT_PAY_ATTENTION_FROGS" 321 321 "TRT_PAY_ATTENTION_BUS" 322 322 "TRT_PAY_ATTENTION_WIND" 323 323 "TRT_PAY_ATTENTION_SNOW" 324 324 "TRT_PAY_ATTENTION_PEDESTRIAN_CROSSING" 325 325 "TRT_PAY_ATTENTION_HUMP" 326 326 "TRT_PAY_ATTENTION_ROCK" 327 327 "TRT_PAY_ATTENTION_LOW_TREE" 328 328 "TRT_PAY_ATTENTION_GRAVEL" 329 329 "TRT_PAY_ATTENTION_TWO_WAY" 330 330 "TRT_PAY_ATTENTION_LIGHTS" 331 331 "TRT_PAY_ATTENTION_PLANE" 332 332 "TRT_PAY_ATTENTION_RIDER" 333 333 "TRT_PAY_ATTENTION_DRAWBRIDGE" 334 334 "TRT_PAY_ATTENTION_PIER" 335 335 "TRT_PAY_ATTENTION_JUNCTION" 336 336 "TRT_PAY_ATTENTION_CRASH_RISK" 337 337 "TRT_PAY_ATTENTION_ACCIDENT" 338 338 "TRT_PAY_ATTENTION_SMOKE" 339 339 "TRT_PAY_ATTENTION_OIL_TRAIL" 340 340 "TRT_PAY_ATTENTION_DIRTY_ROAD" 341 341 "TRT_PAY_ATTENTION_ROAD_DAMAGE" 342 342 "TRT_PAY_ATTENTION_RUTS" 343 343 "TRT_PAY_ATTENTION_SOFT_SHOULDER" 344 344 "TRT_PAY_ATTENTION_CUSTOMS" 345 345 "TRT_PAY_ATTENTION_DEAD_END" 346 346 "TRT_PAY_ATTENTION_POLLUTION" 400 400 "TRT_NO_ENTRY" 401 401 "TRT_NO_ENTRY_ONE_WAY" 500 500 "TRT_RIGHT_OF_WAY" 501 501 "TRT_RIGHT_OF_WAY_NEXT_CROSSING" 502 502 "TRT_GIVE_RIGHT_OF_WAY_NEXT_CROSSING" 503 503 "TRT_YIELD_TO_RIGHT_NEXT_CROSSING" 504 504 "TRT_YIELD_TO_LEFT_NEXT_CROSSING" 505 505 "TRT_STOP_AND_YIELD" 600 600 "TRT_DIRECTION_ONLY_STRAIGHT" 601 601 "TRT_DIRECTION_ONLY_RIGHT" 602 602 "TRT_DIRECTION_ONLY_LEFT" 603 603 "TRT_DIRECTION_ONLY_STRAIGHT_OR_LEFT" 604 604 "TRT_DIRECTION_ONLY_STRAIGHT_OR_RIGHT" 605 605 "TRT_DIRECTION_ONLY_LEFT_OR_RIGHT" 606 606 "TRT_NO_UTURN" 700 700 "TRT_NO_PARKING" 701 701 "TRT_NO_STOPPING" 702 702 "TRT_NO_STOPPING_ON_SHOULDER" 800 800 "TRT_ORDER_KEEP_DISTANCE" 801 801 "TRT_ORDER_ZEBRA_CROSSING" 802 802 "TRT_ORDER_UMWELT_ZONE" 803 803 "TRT_ORDER_TURN_LIGHTS_ON" 804 804 "TRT_ORDER_TURN_LIGHTS_OFF" 805 805 "TRT_ORDER_ONE_WAY_STREET" DEFAULT_VALUE "" /end COMPU_VTAB_RANGE
/begin COMPU_VTAB_RANGE _g_DACore_SIT_RunnableTrafficRules_RunnableTrafficRules._m_controllerTrafficRules._m_ruleContainer._m_rules.TList._._m_nodeAlloc._m_memPool._m_storage._m_vals._v1._9_._m_value._m_cancelationType.CONVERSION "@@@@RuleName created by CANape" 7 0 0 "CT_NONE" 1 1 "CT_ALL" 2 2 "CT_SPEED_LIMIT" 3 3 "CT_SPEED_ADVICE" 4 4 "CT_SPEED_MINIMUM" 5 5 "CT_NO_PASSING" 6 6 "CT_RIGHT_OF_WAY" DEFAULT_VALUE "" /end COMPU_VTAB_RANGE
/begin COMPU_VTAB_RANGE _g_triggerC1Runnable.TExtensionSystemTime._._m_systemTime._m_status.CONVERSION "@@@@RuleName created by CANape" 3 1 1 "OK" 2 2 "ERROR" 3 3 "IMPRECISE" DEFAULT_VALUE "" /end COMPU_VTAB_RANGE
/begin COMPU_VTAB _mbist_MTURegisters_cast._0_._MBISTSEL_e.CONVERSION "enumeration table" TAB_VERB 97 0 "mbist_CPU0DMEM_e" 1 "mbist_CPU0DTAG_e" 2 "mbist_CPU0PMEM_e" 3 "mbist_CPU0PTAG_e" 4 "mbist_CPU0DLMUSTBY_e" 5 "mbist_CPU1DMEM_e" 6 "mbist_CPU1DTAG_e" 7 "mbist_CPU1PMEM_e" 8 "mbist_CPU1PTAG_e" 9 "mbist_CPU1DLMUSTBY_e" 10 "mbist_CPU2DMEM_e" 11 "mbist_CPU2DTAG_e" 12 "mbist_CPU2PMEM_e" 13 "mbist_CPU2PTAG_e" 14 "mbist_CPU2DLMU_e" 15 "mbist_CPU3DMEM_e" 16 "mbist_CPU3DTAG_e" 17 "mbist_CPU3PMEM_e" 18 "mbist_CPU3PTAG_e" 19 "mbist_CPU3DLMU_e" 20 "mbist_CPU4DMEM_e" 21 "mbist_CPU4DTAG_e" 22 "mbist_CPU4PMEM_e" 23 "mbist_CPU4PTAG_e" 24 "mbist_CPU4DLMU_e" 25 "mbist_CPU5DMEM_e" 26 "mbist_CPU5DTAG_e" 27 "mbist_CPU5PMEM_e" 28 "mbist_CPU5PTAG_e" 29 "mbist_CPU5DLMU_e" 30 "mbist_LMU00_e" 31 "mbist_LMU10_e" 32 "mbist_LMU20_e" 33 "mbist_Reserved0_e" 34 "mbist_CPU0DMEM1_e" 35 "mbist_CPU1DMEM1_e" 36 "mbist_Reserved1_e" 37 "mbist_Reserved2_e" 38 "mbist_DAM0_e" 39 "mbist_DAM1_e" 40 "mbist_Reserved3_e" 41 "mbist_SADMA_e" 42 "mbist_Reserved4_e" 43 "mbist_MCDS_e" 44 "mbist_EMEM0_e" 45 "mbist_EMEM1_e" 46 "mbist_EMEM2_e" 47 "mbist_EMEM3_e" 48 "mbist_EMEMXTM_e" 49 "mbist_SPUBUFFER0_e" 50 "mbist_SPUBUFFER1_e" 51 "mbist_SPUCONFIG0_e" 52 "mbist_SPUCONFIG1_e" 53 "mbist_GTMFIFO_e" 54 "mbist_GTMMCS0SLOW_e" 55 "mbist_GTMMCS0FAST_e" 56 "mbist_GTMMCS1SLOW_e" 57 "mbist_GTMMCS1FAST_e" 58 "mbist_GTMDPLL1A_e" 59 "mbist_GTMDPLL1BC_e" 60 "mbist_GTMDPLL2_e" 61 "mbist_Reserved5_e" 62 "mbist_MCAN10_e" 63 "mbist_MCAN20_e" 64 "mbist_MCAN21_e" 65 "mbist_PSI5_e" 66 "mbist_ERAYOBF0_e" 67 "mbist_ERAYOBF1_e" 68 "mbist_ERAYTBFIBF0_e" 69 "mbist_ERAYTBFIBF1_e" 70 "mbist_ERAYMBF0_e" 71 "mbist_ERAYMBF1_e" 72 "mbist_Reserved6_e" 73 "mbist_Reserved7_e" 74 "mbist_Reserved8_e" 75 "mbist_Reserved9_e" 76 "mbist_Reserved10_e" 77 "mbist_SCRXRAM_e" 78 "mbist_SCRRAMINT_e" 79 "mbist_Reserved11_e" 80 "mbist_Reserved12_e" 81 "mbist_Reserved13_e" 82 "mbist_GIGETHRXRAM_e" 83 "mbist_GIGETHTXRAM_e" 84 "mbist_SDMMCRAM_e" 85 "mbist_HSPDMRAM_e" 86 "mbist_Reserved14_e" 87 "mbist_Reserved15_e" 88 "mbist_SPUFFT00_e" 89 "mbist_SPUFFT01_e" 90 "mbist_SPUFFT10_e" 91 "mbist_SPUFFT11_e" 92 "mbist_SPUFFT20_e" 93 "mbist_SPUFFT21_e" 94 "mbist_SPUFFT30_e" 95 "mbist_SPUFFT31_e" 96 "mbist_MaxSSH_e" /end COMPU_VTAB
/begin COMPU_VTAB _mon_config_cast._0_._depmonitem_en.CONVERSION "enumeration table" TAB_VERB 10 0 "MON_ITEM_ADCVOLTAGEPLAUSI_E" 1 "MON_ITEM_VBATOVERVOLTAGE_E" 2 "MON_ITEM_VBATUNDERVOLTAGE_E" 3 "MON_ITEM_ADCTEMPERATUREPLAUSI_E" 4 "MON_ITEM_ECUTEMPERATURERANGE_E" 5 "MON_ITEM_ECUTEMPERATUREDEFECT_E" 6 "MON_ITEM_UCTEMPERATURERANGE_E" 7 "MON_ITEM_UCTEMPERATUREDEFECT_E" 8 "MON_ITEM_SYSTEMPERATUREPLAUSI_E" 9 "MON_ENDOFITEMS_E" /end COMPU_VTAB
/begin COMPU_VTAB_RANGE _mon_config_cast._0_._type_en.CONVERSION "@@@@RuleName created by CANape" 7 0 0 "MON_TYPE_SIMPLEUNDERTHRESHOLD_E" 1 1 "MON_TYPE_SIMPLEOVERTHRESHOLD_E" 2 2 "MON_TYPE_SIMPLEUNDEROVERTHRESHOLD_E" 3 3 "MON_TYPE_HYSTERESISUNDERTHRESHOLD_E" 4 4 "MON_TYPE_HYSTERESISOVERTHRESHOLD_E" 5 5 "MON_TYPE_HYSTERESISUNDEROVERTHRESHOLD_E" 6 6 "MON_TYPE_DIRECTREPORTING_E" DEFAULT_VALUE "" /end COMPU_VTAB_RANGE
/begin COMPU_VTAB _mon_filteredstatus_aen._0_.CONVERSION "enumeration table" TAB_VERB 5 0 "MON_STATUS_PASS_E" 1 "MON_STATUS_PREPASS_E" 2 "MON_STATUS_PREFAIL_E" 3 "MON_STATUS_FAIL_E" 4 "MON_STATUS_DEFAULT_E" /end COMPU_VTAB
/begin COMPU_VTAB_RANGE _mon_status_aen._0_.CONVERSION "@@@@RuleName created by CANape" 5 0 0 "MON_STATUS_DEFAULT_E" 1 1 "MON_STATUS_PASS_E" 2 2 "MON_STATUS_PREPASS_E" 3 3 "MON_STATUS_PREFAIL_E" 4 4 "MON_STATUS_FAIL_E" DEFAULT_VALUE "" /end COMPU_VTAB_RANGE
/begin COMPU_VTAB _rbInterruptHandler_DebugInfoSample_st._UnintendedInterruptIndex_en.CONVERSION "enumeration table" TAB_VERB 8 0 "RBINTERRUPTHANDLER_INTERRUPT_DEFAULT_E" 1 "RBINTERRUPTHANDLER_INTERRUPT_DMA0ERROR_E" 2 "RBINTERRUPTHANDLER_INTERRUPT_DMACH7_E" 3 "RBINTERRUPTHANDLER_INTERRUPT_DMACH10_E" 4 "RBINTERRUPTHANDLER_INTERRUPT_CAN0INT00_E" 5 "RBINTERRUPTHANDLER_INTERRUPT_CAN1INT00_E" 6 "RBINTERRUPTHANDLER_INTERRUPT_CAN2INT00_E" 7 "RBINTERRUPTHANDLER_ENDOFLISTOFINTERRUPTS_E" /end COMPU_VTAB
/begin COMPU_VTAB _rbInterruptHandler_StoreDebugInfoState_en.CONVERSION "enumeration table" TAB_VERB 3 0 "RBINTERRUPTHANDLER_STOREDEBUGINFO_CHECKFORNEWWRITEREQUEST_E" 1 "RBINTERRUPTHANDLER_STOREDEBUGINFO_REQUESTNVMWRITE_E" 2 "RBINTERRUPTHANDLER_STOREDEBUGINFO_POLLNVMWRITESTATUS_E" /end COMPU_VTAB
/begin COMPU_VTAB _rbModeMgr_ActiveSystemMode_en.CONVERSION "enumeration table" TAB_VERB 12 0 "RBMODEMGR_SYSTEMMODE_DEFAULT_E" 1 "RBMODEMGR_SYSTEMMODE_STARTUP_MAIN_E" 2 "RBMODEMGR_SYSTEMMODE_STARTUP_ECUM_NORMAL_E" 3 "RBMODEMGR_SYSTEMMODE_STARTUP_ECUM_SAFEIRR_E" 4 "RBMODEMGR_SYSTEMMODE_STARTUP_ECUM_PRODUCTION_E" 5 "RBMODEMGR_SYSTEMMODE_STARTUP_CYCLIC_NORMAL_E" 6 "RBMODEMGR_SYSTEMMODE_STARTUP_CYCLIC_SAFEIRR_E" 7 "RBMODEMGR_SYSTEMMODE_STARTUP_CYCLIC_PRODUCTION_E" 8 "RBMODEMGR_SYSTEMMODE_RUN_E" 9 "RBMODEMGR_SYSTEMMODE_SAFEIRR_E" 10 "RBMODEMGR_SYSTEMMODE_PRODUCTION_E" 11 "RBMODEMGR_SYSTEMMODE_SHUTDOWN_E" /end COMPU_VTAB
/begin COMPU_VTAB _rbResetHandler_ResetState_en.CONVERSION "enumeration table" TAB_VERB 4 0 "RBRESETHANDLER_RESETSTATE_WAITFORRESETREQUEST_E" 1 "RBRESETHANDLER_RESETSTATE_WAITFORSHUTDOWNCOMPLETION_E" 2 "RBRESETHANDLER_RESETSTATE_NOTIFYSLAVEDEVICES_E" 3 "RBRESETHANDLER_RESETSTATE_ISSUERESET_E" /end COMPU_VTAB
/begin COMPU_VTAB _rbResetHandler_ResetType_en.CONVERSION "enumeration table" TAB_VERB 2 0 "RBRESETHANDLER_RESETTYPE_SOFTWARERESET_E" 1 "RBRESETHANDLER_RESETTYPE_APPLICATIONRESET_E" /end COMPU_VTAB
/begin COMPU_VTAB _rbSftMon_CoreClkMainState_en.CONVERSION "enumeration table" TAB_VERB 4 0 "RBSFTMON_CORECLK_MAINSTATE_ENABLETEST_E" 1 "RBSFTMON_CORECLK_MAINSTATE_TESTTRIGGER_E" 2 "RBSFTMON_CORECLK_MAINSTATE_DTCHANDLING_E" 3 "RBSFTMON_CORECLK_MAINSTATE_TESTEND_E" /end COMPU_VTAB
/begin COMPU_VTAB _rbSftMon_CoreClkTestStatus_en.CONVERSION "enumeration table" TAB_VERB 3 0 "RBSFTMON_CORECLK_STATUS_PENDING_E" 1 "RBSFTMON_CORECLK_STATUS_FAILED_E" 2 "RBSFTMON_CORECLK_STATUS_PASSED_E" /end COMPU_VTAB
/begin COMPU_VTAB _rbSftMon_CoreVoltageMainState_en.CONVERSION "enumeration table" TAB_VERB 3 0 "RBSFTMON_COREVOLTAGE_IDLE_E" 1 "RBSFTMON_COREVOLTAGE_TRIGGERTEST_E" 2 "RBSFTMON_COREVOLTAGE_EVALUATE_E" /end COMPU_VTAB
/begin COMPU_VTAB _rbSftMon_StackStatus_aen._0_.CONVERSION "enumeration table" TAB_VERB 3 0 "RBSFTMON_STACKSTATUS_PASS_E" 1 "RBSFTMON_STACKSTATUS_FAIL_E" 2 "RBSFTMON_STACKSTATUS_PREFAIL_E" /end COMPU_VTAB
/begin COMPU_VTAB _rbSftMon_coreClkRunningIndex_en.CONVERSION "enumeration table" TAB_VERB 6 0 "RBSFTMON_CORECLK_LIST_SYSTEMFPLL0_E" 1 "RBSFTMON_CORECLK_LIST_PHASEFPLL1_E" 2 "RBSFTMON_CORECLK_LIST_PHASEFPLL2_E" 3 "RBSFTMON_CORECLK_LIST_EXTENDEDSPB_E" 4 "RBSFTMON_CORECLK_LIST_BACKUP_E" 5 "RBSFTMON_CORECLK_LIST_END_E" /end COMPU_VTAB
/begin COMPU_VTAB _rbSftMon_coreClkTest_st._0_._SubState_en.CONVERSION "enumeration table" TAB_VERB 6 0 "RBSFTMON_CORECLK_SUBSTATE_START_E" 1 "RBSFTMON_CORECLK_SUBSTATE_TRIGGERTESTING_E" 2 "RBSFTMON_CORECLK_SUBSTATE_WAITFORTESTRESULT_E" 3 "RBSFTMON_CORECLK_SUBSTATE_CLEARTHEREQUEST_E" 4 "RBSFTMON_CORECLK_SUBSTATE_CLEARTHEALARM_E" 5 "RBSFTMON_CORECLK_SUBSTATE_IDLE_E" /end COMPU_VTAB
/begin COMPU_VTAB _rb_Sbst_CustSlice_en.CONVERSION "enumeration table" TAB_VERB 10 0 "rb_Sbst_Slice0_e" 1 "rb_Sbst_Slice1_e" 2 "rb_Sbst_Slice2_e" 3 "rb_Sbst_Slice3_e" 4 "rb_Sbst_Slice4_e" 5 "rb_Sbst_Slice5_e" 6 "rb_Sbst_Slice6_e" 7 "rb_Sbst_Slice7_e" 8 "rb_Sbst_Result_e" 9 "rb_Sbst_MaxSlice_e" /end COMPU_VTAB
/begin COMPU_VTAB_RANGE _rba_Can_Status_ast._9_._NodeStatus_st._Can_IPType_en.CONVERSION "@@@@RuleName created by CANape" 7 0 0 "MCAN" 1 1 "MULTICAN" 2 2 "DCAN" 3 3 "AFCAN" 4 4 "ZYNQCAN" 5 5 "RSCAN" 6 6 "FLEXCAN" DEFAULT_VALUE "" /end COMPU_VTAB_RANGE
/begin COMPU_VTAB_RANGE _rba_Can_Status_ast._9_._RequestedState_en.CONVERSION "@@@@RuleName created by CANape" 5 0 0 "CANIF_CS_UNINIT" 1 1 "CANIF_CS_STOPPED" 2 2 "CANIF_CS_STARTED" 3 3 "CANIF_CS_SLEEP" 4 4 "CANIF_CS_MAXMODE" DEFAULT_VALUE "" /end COMPU_VTAB_RANGE
/begin COMPU_VTAB_RANGE _rba_Dma_Driver_ast._9_._chStatus_en.CONVERSION "@@@@RuleName created by CANape" 3 0 0 "RBA_DMA_IDLE" 1 1 "RBA_DMA_READY" 2 2 "RBA_DMA_BUSY" DEFAULT_VALUE "" /end COMPU_VTAB_RANGE
/begin COMPU_VTAB_RANGE _rba_Emm_Cfg_IndivRTCfg_acst._0_._rba_Emm_Cfg_RTId_en.CONVERSION "@@@@RuleName created by CANape" 3 0 0 "rba_Emm_Prv_RT0_e" 1 1 "rba_Emm_Prv_RT1_e" 2 2 "rba_Emm_Prv_NumofRT_e" DEFAULT_VALUE "" /end COMPU_VTAB_RANGE
/begin COMPU_VTAB_RANGE _rba_FeeFs2_Prv_AllocBackground_st._state_en.CONVERSION "@@@@RuleName created by CANape" 3 0 0 "RBA_FEEFS2_PRV_ALLOC_BACKGROUND_IDLE_E" 1 1 "RBA_FEEFS2_PRV_ALLOC_BACKGROUND_ERASE_E" 2 2 "RBA_FEEFS2_PRV_ALLOC_BACKGROUND_SOFTREORG_E" DEFAULT_VALUE "" /end COMPU_VTAB_RANGE
/begin COMPU_VTAB_RANGE _rba_FeeFs2_Prv_AllocErase_st._state_en.CONVERSION "@@@@RuleName created by CANape" 5 0 0 "RBA_FEEFS2_PRV_ALLOC_ERASE_INIT_E" 1 1 "RBA_FEEFS2_PRV_ALLOC_ERASE_RDY4ERASE_E" 2 2 "RBA_FEEFS2_PRV_ALLOC_ERASE_FATPREPARE_E" 3 3 "RBA_FEEFS2_PRV_ALLOC_ERASE_DAT_E" 4 4 "RBA_FEEFS2_PRV_ALLOC_ERASE_FINAL_E" DEFAULT_VALUE "" /end COMPU_VTAB_RANGE
/begin COMPU_VTAB_RANGE _rba_FeeFs2_Prv_AllocMallocDat_st._state_en.CONVERSION "@@@@RuleName created by CANape" 11 0 0 "RBA_FEEFS2_PRV_ALLOC_MALLOCDAT_IDLE_E" 1 1 "RBA_FEEFS2_PRV_ALLOC_MALLOCDAT_INIT_E" 2 2 "RBA_FEEFS2_PRV_ALLOC_MALLOCDAT_MALLOCFAT_E" 3 3 "RBA_FEEFS2_PRV_ALLOC_MALLOCDAT_CREATEERASED_E" 4 4 "RBA_FEEFS2_PRV_ALLOC_MALLOCDAT_CREATEDAT_E" 5 5 "RBA_FEEFS2_PRV_ALLOC_MALLOCDAT_GETNEXTBLOCK_E" 6 6 "RBA_FEEFS2_PRV_ALLOC_MALLOCDAT_DATWRITE_E" 7 7 "RBA_FEEFS2_PRV_ALLOC_MALLOCDAT_FATWRITE_E" 8 8 "RBA_FEEFS2_PRV_ALLOC_MALLOCDAT_FINALIZEFAT_E" 9 9 "RBA_FEEFS2_PRV_ALLOC_MALLOCDAT_UNLINKDAT_E" 10 10 "RBA_FEEFS2_PRV_ALLOC_MALLOCDAT_FINAL_E" DEFAULT_VALUE "" /end COMPU_VTAB_RANGE
/begin COMPU_VTAB_RANGE _rba_FeeFs2_Prv_AllocMallocFat_st._state_en.CONVERSION "@@@@RuleName created by CANape" 8 0 0 "RBA_FEEFS2_PRV_ALLOC_MALLOCFAT_IDLE_E" 1 1 "RBA_FEEFS2_PRV_ALLOC_MALLOCFAT_INIT_E" 2 2 "RBA_FEEFS2_PRV_ALLOC_MALLOCFAT_GETERASED_E" 3 3 "RBA_FEEFS2_PRV_ALLOC_MALLOCFAT_SETFATPREPARE_E" 4 4 "RBA_FEEFS2_PRV_ALLOC_MALLOCFAT_MIGRATE_E" 5 5 "RBA_FEEFS2_PRV_ALLOC_MALLOCFAT_SETFATACTIVE_E" 6 6 "RBA_FEEFS2_PRV_ALLOC_MALLOCFAT_SETRDY4ERASE_E" 7 7 "RBA_FEEFS2_PRV_ALLOC_MALLOCFAT_FINAL_E" DEFAULT_VALUE "" /end COMPU_VTAB_RANGE
/begin COMPU_VTAB_RANGE _rba_FeeFs2_Prv_DatCopy_st._state_en.CONVERSION "" 5 0 0 "RBA_FEEFS2_PRV_DAT_COPY_IDLE_E" 1 1 "RBA_FEEFS2_PRV_DAT_COPY_INIT_E" 2 2 "RBA_FEEFS2_PRV_DAT_COPY_READ_E" 3 3 "RBA_FEEFS2_PRV_DAT_COPY_WRITE_E" 4 4 "RBA_FEEFS2_PRV_DAT_COPY_FINAL_E" DEFAULT_VALUE "" /end COMPU_VTAB_RANGE
/begin COMPU_VTAB_RANGE _rba_FeeFs2_Prv_DatCopy_st._state_en.CONVERSION0 "@@@@RuleName created by CANape" 5 0 0 "RBA_FEEFS2_PRV_DAT_COPY_IDLE_E" 1 1 "RBA_FEEFS2_PRV_DAT_COPY_INIT_E" 2 2 "RBA_FEEFS2_PRV_DAT_COPY_READ_E" 3 3 "RBA_FEEFS2_PRV_DAT_COPY_WRITE_E" 4 4 "RBA_FEEFS2_PRV_DAT_COPY_FINAL_E" DEFAULT_VALUE "" /end COMPU_VTAB_RANGE
/begin COMPU_VTAB_RANGE _rba_FeeFs2_Prv_DatUnlinkSector_st._state_en.CONVERSION "" 3 0 0 "RBA_FEEFS2_PRV_DAT_UNLINKSECTOR_IDLE_E" 1 1 "RBA_FEEFS2_PRV_DAT_UNLINKSECTOR_INIT_E" 2 2 "RBA_FEEFS2_PRV_DAT_UNLINKSECTOR_BUSY_E" DEFAULT_VALUE "" /end COMPU_VTAB_RANGE
/begin COMPU_VTAB_RANGE _rba_FeeFs2_Prv_DatUnlinkSector_st._state_en.CONVERSION0 "@@@@RuleName created by CANape" 3 0 0 "RBA_FEEFS2_PRV_DAT_UNLINKSECTOR_IDLE_E" 1 1 "RBA_FEEFS2_PRV_DAT_UNLINKSECTOR_INIT_E" 2 2 "RBA_FEEFS2_PRV_DAT_UNLINKSECTOR_BUSY_E" DEFAULT_VALUE "" /end COMPU_VTAB_RANGE
/begin COMPU_VTAB_RANGE _rba_FeeFs2_Prv_DatWrap_st._func_en.CONVERSION "" 5 0 0 "RBA_FEEFS2_PRV_DAT_FUNC_READ_E" 1 1 "RBA_FEEFS2_PRV_DAT_FUNC_WRITE_E" 2 2 "RBA_FEEFS2_PRV_DAT_FUNC_COMPARE_E" 3 3 "RBA_FEEFS2_PRV_DAT_FUNC_BLANKCHECK_E" 4 4 "RBA_FEEFS2_PRV_DAT_FUNC_CRC_E" DEFAULT_VALUE "" /end COMPU_VTAB_RANGE
/begin COMPU_VTAB_RANGE _rba_FeeFs2_Prv_DatWrap_st._func_en.CONVERSION0 "@@@@RuleName created by CANape" 5 0 0 "RBA_FEEFS2_PRV_DAT_FUNC_READ_E" 1 1 "RBA_FEEFS2_PRV_DAT_FUNC_WRITE_E" 2 2 "RBA_FEEFS2_PRV_DAT_FUNC_COMPARE_E" 3 3 "RBA_FEEFS2_PRV_DAT_FUNC_BLANKCHECK_E" 4 4 "RBA_FEEFS2_PRV_DAT_FUNC_CRC_E" DEFAULT_VALUE "" /end COMPU_VTAB_RANGE
/begin COMPU_VTAB_RANGE _rba_FeeFs2_Prv_DatWrap_st._state_en.CONVERSION "" 4 0 0 "RBA_FEEFS2_PRV_DAT_WRAP_IDLE_E" 1 1 "RBA_FEEFS2_PRV_DAT_WRAP_INIT_E" 2 2 "RBA_FEEFS2_PRV_DAT_WRAP_ACT_E" 3 3 "RBA_FEEFS2_PRV_DAT_WRAP_FINAL_E" DEFAULT_VALUE "" /end COMPU_VTAB_RANGE
/begin COMPU_VTAB_RANGE _rba_FeeFs2_Prv_DatWrap_st._state_en.CONVERSION0 "@@@@RuleName created by CANape" 4 0 0 "RBA_FEEFS2_PRV_DAT_WRAP_IDLE_E" 1 1 "RBA_FEEFS2_PRV_DAT_WRAP_INIT_E" 2 2 "RBA_FEEFS2_PRV_DAT_WRAP_ACT_E" 3 3 "RBA_FEEFS2_PRV_DAT_WRAP_FINAL_E" DEFAULT_VALUE "" /end COMPU_VTAB_RANGE
/begin COMPU_VTAB_RANGE _rba_FeeFs2_Prv_DatWrite_st._state_en.CONVERSION "" 7 0 0 "RBA_FEEFS2_PRV_DAT_WRITE_IDLE_E" 1 1 "RBA_FEEFS2_PRV_DAT_WRITE_INIT_E" 2 2 "RBA_FEEFS2_PRV_DAT_WRITE_WRITING_E" 3 3 "RBA_FEEFS2_PRV_DAT_WRITE_SAFEDATA_E" 4 4 "RBA_FEEFS2_PRV_DAT_WRITE_SETWLDFC_E" 5 5 "RBA_FEEFS2_PRV_DAT_WRITE_FINDEOD_E" 6 6 "RBA_FEEFS2_PRV_DAT_WRITE_FINAL_E" DEFAULT_VALUE "" /end COMPU_VTAB_RANGE
/begin COMPU_VTAB_RANGE _rba_FeeFs2_Prv_DatWrite_st._state_en.CONVERSION0 "@@@@RuleName created by CANape" 7 0 0 "RBA_FEEFS2_PRV_DAT_WRITE_IDLE_E" 1 1 "RBA_FEEFS2_PRV_DAT_WRITE_INIT_E" 2 2 "RBA_FEEFS2_PRV_DAT_WRITE_WRITING_E" 3 3 "RBA_FEEFS2_PRV_DAT_WRITE_SAFEDATA_E" 4 4 "RBA_FEEFS2_PRV_DAT_WRITE_SETWLDFC_E" 5 5 "RBA_FEEFS2_PRV_DAT_WRITE_FINDEOD_E" 6 6 "RBA_FEEFS2_PRV_DAT_WRITE_FINAL_E" DEFAULT_VALUE "" /end COMPU_VTAB_RANGE
/begin COMPU_VTAB_RANGE _rba_FeeFs2_Prv_FatCacheBuild_st._state_en.CONVERSION "" 2 0 0 "RBA_FEEFS2_PRV_FAT_CACHEBUILD_IDLE_E" 1 1 "RBA_FEEFS2_PRV_FAT_CACHEBUILD_BUSY_E" DEFAULT_VALUE "" /end COMPU_VTAB_RANGE
/begin COMPU_VTAB_RANGE _rba_FeeFs2_Prv_FatCacheBuild_st._state_en.CONVERSION0 "@@@@RuleName created by CANape" 2 0 0 "RBA_FEEFS2_PRV_FAT_CACHEBUILD_IDLE_E" 1 1 "RBA_FEEFS2_PRV_FAT_CACHEBUILD_BUSY_E" DEFAULT_VALUE "" /end COMPU_VTAB_RANGE
/begin COMPU_VTAB_RANGE _rba_FeeFs2_Prv_FatCache_st._mode_en.CONVERSION "" 3 0 0 "RBA_FEEFS2_PRV_FAT_CACHEMODE_UNDEF_E" 1 1 "RBA_FEEFS2_PRV_FAT_CACHEMODE_GETLATESTBYID_E" 2 2 "RBA_FEEFS2_PRV_FAT_CACHEMODE_GETLATESTBYADR_E" DEFAULT_VALUE "" /end COMPU_VTAB_RANGE
/begin COMPU_VTAB_RANGE _rba_FeeFs2_Prv_FatCache_st._mode_en.CONVERSION0 "@@@@RuleName created by CANape" 3 0 0 "RBA_FEEFS2_PRV_FAT_CACHEMODE_UNDEF_E" 1 1 "RBA_FEEFS2_PRV_FAT_CACHEMODE_GETLATESTBYID_E" 2 2 "RBA_FEEFS2_PRV_FAT_CACHEMODE_GETLATESTBYADR_E" DEFAULT_VALUE "" /end COMPU_VTAB_RANGE
/begin COMPU_VTAB_RANGE _rba_FeeFs2_Prv_FatEntry2Fls_st._state_en.CONVERSION "" 5 0 0 "RBA_FEEFS2_PRV_FAT_ENTRY2FLS_IDLE_E" 1 1 "RBA_FEEFS2_PRV_FAT_ENTRY2FLS_INIT_E" 2 2 "RBA_FEEFS2_PRV_FAT_ENTRY2FLS_WRITE_E" 3 3 "RBA_FEEFS2_PRV_FAT_ENTRY2FLS_WLERR_E" 4 4 "RBA_FEEFS2_PRV_FAT_ENTRY2FLS_FINAL_E" DEFAULT_VALUE "" /end COMPU_VTAB_RANGE
/begin COMPU_VTAB_RANGE _rba_FeeFs2_Prv_FatEntry2Fls_st._state_en.CONVERSION0 "@@@@RuleName created by CANape" 5 0 0 "RBA_FEEFS2_PRV_FAT_ENTRY2FLS_IDLE_E" 1 1 "RBA_FEEFS2_PRV_FAT_ENTRY2FLS_INIT_E" 2 2 "RBA_FEEFS2_PRV_FAT_ENTRY2FLS_WRITE_E" 3 3 "RBA_FEEFS2_PRV_FAT_ENTRY2FLS_WLERR_E" 4 4 "RBA_FEEFS2_PRV_FAT_ENTRY2FLS_FINAL_E" DEFAULT_VALUE "" /end COMPU_VTAB_RANGE
/begin COMPU_VTAB_RANGE _rba_FeeFs2_Prv_FatFinalize_st._state_en.CONVERSION "" 4 0 0 "RBA_FEEFS2_PRV_FAT_FINALIZE_INIT_E" 1 1 "RBA_FEEFS2_PRV_FAT_FINALIZE_BLANKCHECK_E" 2 2 "RBA_FEEFS2_PRV_FAT_FINALIZE_SHREDDER_E" 3 3 "RBA_FEEFS2_PRV_FAT_FINALIZE_FINAL_E" DEFAULT_VALUE "" /end COMPU_VTAB_RANGE
/begin COMPU_VTAB_RANGE _rba_FeeFs2_Prv_FatFinalize_st._state_en.CONVERSION0 "@@@@RuleName created by CANape" 4 0 0 "RBA_FEEFS2_PRV_FAT_FINALIZE_INIT_E" 1 1 "RBA_FEEFS2_PRV_FAT_FINALIZE_BLANKCHECK_E" 2 2 "RBA_FEEFS2_PRV_FAT_FINALIZE_SHREDDER_E" 3 3 "RBA_FEEFS2_PRV_FAT_FINALIZE_FINAL_E" DEFAULT_VALUE "" /end COMPU_VTAB_RANGE
/begin COMPU_VTAB_RANGE _rba_FeeFs2_Prv_FatGetLatestByAdr_st._state_en.CONVERSION "" 7 0 0 "RBA_FEEFS2_PRV_FAT_GETLATESTBYADR_IDLE_E" 1 1 "RBA_FEEFS2_PRV_FAT_GETLATESTBYADR_INIT_E" 2 2 "RBA_FEEFS2_PRV_FAT_GETLATESTBYADR_FILLCACHE_E" 3 3 "RBA_FEEFS2_PRV_FAT_GETLATESTBYADR_FILTERCACHE_E" 4 4 "RBA_FEEFS2_PRV_FAT_GETLATESTBYADR_VERIFY_E" 5 5 "RBA_FEEFS2_PRV_FAT_GETLATESTBYADR_CACHEBUILD_E" 6 6 "RBA_FEEFS2_PRV_FAT_GETLATESTBYADR_FINAL_E" DEFAULT_VALUE "" /end COMPU_VTAB_RANGE
/begin COMPU_VTAB_RANGE _rba_FeeFs2_Prv_FatGetLatestByAdr_st._state_en.CONVERSION0 "@@@@RuleName created by CANape" 7 0 0 "RBA_FEEFS2_PRV_FAT_GETLATESTBYADR_IDLE_E" 1 1 "RBA_FEEFS2_PRV_FAT_GETLATESTBYADR_INIT_E" 2 2 "RBA_FEEFS2_PRV_FAT_GETLATESTBYADR_FILLCACHE_E" 3 3 "RBA_FEEFS2_PRV_FAT_GETLATESTBYADR_FILTERCACHE_E" 4 4 "RBA_FEEFS2_PRV_FAT_GETLATESTBYADR_VERIFY_E" 5 5 "RBA_FEEFS2_PRV_FAT_GETLATESTBYADR_CACHEBUILD_E" 6 6 "RBA_FEEFS2_PRV_FAT_GETLATESTBYADR_FINAL_E" DEFAULT_VALUE "" /end COMPU_VTAB_RANGE
/begin COMPU_VTAB_RANGE _rba_FeeFs2_Prv_FatGetLatestById_st._state_en.CONVERSION "" 6 0 0 "RBA_FEEFS2_PRV_FAT_GETLATESTBYID_IDLE_E" 1 1 "RBA_FEEFS2_PRV_FAT_GETLATESTBYID_INIT_E" 2 2 "RBA_FEEFS2_PRV_FAT_GETLATESTBYID_CACHEBUILD_E" 3 3 "RBA_FEEFS2_PRV_FAT_GETLATESTBYID_SCAN_E" 4 4 "RBA_FEEFS2_PRV_FAT_GETLATESTBYID_VERIFY_E" 5 5 "RBA_FEEFS2_PRV_FAT_GETLATESTBYID_FINAL_E" DEFAULT_VALUE "" /end COMPU_VTAB_RANGE
/begin COMPU_VTAB_RANGE _rba_FeeFs2_Prv_FatGetLatestById_st._state_en.CONVERSION0 "@@@@RuleName created by CANape" 6 0 0 "RBA_FEEFS2_PRV_FAT_GETLATESTBYID_IDLE_E" 1 1 "RBA_FEEFS2_PRV_FAT_GETLATESTBYID_INIT_E" 2 2 "RBA_FEEFS2_PRV_FAT_GETLATESTBYID_CACHEBUILD_E" 3 3 "RBA_FEEFS2_PRV_FAT_GETLATESTBYID_SCAN_E" 4 4 "RBA_FEEFS2_PRV_FAT_GETLATESTBYID_VERIFY_E" 5 5 "RBA_FEEFS2_PRV_FAT_GETLATESTBYID_FINAL_E" DEFAULT_VALUE "" /end COMPU_VTAB_RANGE
/begin COMPU_VTAB_RANGE _rba_FeeFs2_Prv_FatMigrate_st._state_en.CONVERSION "" 6 0 0 "RBA_FEEFS2_PRV_FAT_MIGRATE_IDLE_E" 1 1 "RBA_FEEFS2_PRV_FAT_MIGRATE_INIT_E" 2 2 "RBA_FEEFS2_PRV_FAT_MIGRATE_GETBLOCK_E" 3 3 "RBA_FEEFS2_PRV_FAT_MIGRATE_WRITE_E" 4 4 "RBA_FEEFS2_PRV_FAT_MIGRATE_CACHEBUILD_E" 5 5 "RBA_FEEFS2_PRV_FAT_MIGRATE_FINAL_E" DEFAULT_VALUE "" /end COMPU_VTAB_RANGE
/begin COMPU_VTAB_RANGE _rba_FeeFs2_Prv_FatMigrate_st._state_en.CONVERSION0 "@@@@RuleName created by CANape" 6 0 0 "RBA_FEEFS2_PRV_FAT_MIGRATE_IDLE_E" 1 1 "RBA_FEEFS2_PRV_FAT_MIGRATE_INIT_E" 2 2 "RBA_FEEFS2_PRV_FAT_MIGRATE_GETBLOCK_E" 3 3 "RBA_FEEFS2_PRV_FAT_MIGRATE_WRITE_E" 4 4 "RBA_FEEFS2_PRV_FAT_MIGRATE_CACHEBUILD_E" 5 5 "RBA_FEEFS2_PRV_FAT_MIGRATE_FINAL_E" DEFAULT_VALUE "" /end COMPU_VTAB_RANGE
/begin COMPU_VTAB_RANGE _rba_FeeFs2_Prv_FatWrite_st._state_en.CONVERSION "" 3 0 0 "RBA_FEEFS2_PRV_FAT_FATWRITE_IDLE_E" 1 1 "RBA_FEEFS2_PRV_FAT_FATWRITE_INIT_E" 2 2 "RBA_FEEFS2_PRV_FAT_FATWRITE_WRITING_E" DEFAULT_VALUE "" /end COMPU_VTAB_RANGE
/begin COMPU_VTAB_RANGE _rba_FeeFs2_Prv_FatWrite_st._state_en.CONVERSION0 "@@@@RuleName created by CANape" 3 0 0 "RBA_FEEFS2_PRV_FAT_FATWRITE_IDLE_E" 1 1 "RBA_FEEFS2_PRV_FAT_FATWRITE_INIT_E" 2 2 "RBA_FEEFS2_PRV_FAT_FATWRITE_WRITING_E" DEFAULT_VALUE "" /end COMPU_VTAB_RANGE
/begin COMPU_VTAB_RANGE _rba_FeeFs2_Prv_InvalidateBlock_st._state_en.CONVERSION "@@@@RuleName created by CANape" 6 0 0 "RBA_FEEFS2_PRV_INVALIDATEBLOCK_IDLE_E" 1 1 "RBA_FEEFS2_PRV_INVALIDATEBLOCK_INIT_E" 2 2 "RBA_FEEFS2_PRV_INVALIDATEBLOCK_GETLATEST_E" 3 3 "RBA_FEEFS2_PRV_INVALIDATEBLOCK_MALLOCFAT_E" 4 4 "RBA_FEEFS2_PRV_INVALIDATEBLOCK_FATWRITE_E" 5 5 "RBA_FEEFS2_PRV_INVALIDATEBLOCK_FINAL_E" DEFAULT_VALUE "" /end COMPU_VTAB_RANGE
/begin COMPU_VTAB_RANGE _rba_FeeFs2_Prv_Read_st._state_en.CONVERSION "@@@@RuleName created by CANape" 5 0 0 "RBA_FEEFS2_PRV_READ_IDLE_E" 1 1 "RBA_FEEFS2_PRV_READ_INIT_E" 2 2 "RBA_FEEFS2_PRV_READ_GETLATEST_E" 3 3 "RBA_FEEFS2_PRV_READ_READING_E" 4 4 "RBA_FEEFS2_PRV_READ_FINAL_E" DEFAULT_VALUE "" /end COMPU_VTAB_RANGE
/begin COMPU_VTAB_RANGE _rba_FeeFs2_Prv_SectorErase_st._formerWorkingState_en.CONVERSION "@@@@RuleName created by CANape" 9 0 0 "FEE_RB_IDLE_E" 1 1 "FEE_RB_WRITE_MODE_E" 2 2 "FEE_RB_READ_MODE_E" 3 3 "FEE_RB_INVALIDATE_MODE_E" 4 4 "FEE_RB_MAINTAIN_MODE_E" 5 5 "FEE_RB_SOFT_SECTOR_REORG_MODE_E" 6 6 "FEE_RB_HARD_SECTOR_REORG_MODE_E" 7 7 "FEE_RB_SECTOR_ERASE_E" 8 8 "FEE_RB_STOPMODE_E" DEFAULT_VALUE "" /end COMPU_VTAB_RANGE
/begin RECORD_LAYOUT __Float16_Value FNC_VALUES 1 FLOAT16_IEEE ROW_DIR DIRECT /end RECORD_LAYOUT
/begin RECORD_LAYOUT __Float32_Value FNC_VALUES 1 FLOAT32_IEEE ROW_DIR DIRECT /end RECORD_LAYOUT
/begin RECORD_LAYOUT __UByte_Value FNC_VALUES 1 UBYTE ROW_DIR DIRECT /end RECORD_LAYOUT
/begin RECORD_LAYOUT __UWord_Value FNC_VALUES 1 UWORD ROW_DIR DIRECT /end RECORD_LAYOUT
/end MODULE
/end PROJECT
