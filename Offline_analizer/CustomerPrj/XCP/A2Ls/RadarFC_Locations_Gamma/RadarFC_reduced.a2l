ASAP2_VERSION 1 71
/begin PROJECT RADAR_GEN5 ""
/begin HEADER "" VERSION "TO_BE_FILLED" /end HEADER
/begin MODULE RADAR_GEN5 ""
/begin MOD_COMMON "" ALIGNMENT_BYTE 1 ALIGNMENT_WORD 2 ALIGNMENT_LONG 4 ALIGNMENT_FLOAT16_IEEE 2 ALIGNMENT_FLOAT32_IEEE 4 ALIGNMENT_FLOAT64_IEEE 4 ALIGNMENT_INT64 4 /end MOD_COMMON
/begin CHARACTERISTIC _g_PL_AD_fw_Radar_1R1V_rpc_LocBypassingRunnable_LocBypassingRunnable_m_pad_ensRLocationsPort_par_out_local.TChangeableMemPool._._._m_arrayPool._0_._elem._m_LocationList._Item._119_._thetaQly "" VALUE 0xB0010F0A __UByte_Value 0 NO_COMPU_METHOD 0 255 ECU_ADDRESS_EXTENSION 0x2 BYTE_ORDER MSB_LAST /end CHARACTERISTIC
/begin CHARACTERISTIC _g_PL_AD_fw_Radar_1R1V_rpc_LocBypassingRunnable_LocBypassingRunnable_m_pad_ensRLocationsPort_par_out_local.TChangeableMemPool._._._m_arrayPool._0_._elem._m_LocationList._Item._119_._thetaVar._m_value "" VALUE 0xB0010F0C __Float16_Value 0 NO_COMPU_METHOD -65504 65504 ECU_ADDRESS_EXTENSION 0x2 BYTE_ORDER MSB_LAST /end CHARACTERISTIC
/begin CHARACTERISTIC _g_PL_AD_fw_Radar_1R1V_rpc_LocBypassingRunnable_LocBypassingRunnable_m_pad_ensRLocationsPort_par_out_local.TChangeableMemPool._._._m_arrayPool._0_._elem._m_LocationList._Item._119_._v "" VALUE 0xB0010EFC __Float32_Value 0 NO_COMPU_METHOD -3.4028234663852886E+38 3.4028234663852886E+38 ECU_ADDRESS_EXTENSION 0x2 BYTE_ORDER MSB_LAST /end CHARACTERISTIC
/begin CHARACTERISTIC _g_PL_AD_fw_Radar_1R1V_rpc_LocBypassingRunnable_LocBypassingRunnable_m_pad_ensRLocationsPort_par_out_local.TChangeableMemPool._._._m_arrayPool._0_._elem._m_LocationList._Item._119_._vVar._m_value "" VALUE 0xB0010F02 __Float16_Value 0 NO_COMPU_METHOD -65504 65504 ECU_ADDRESS_EXTENSION 0x2 BYTE_ORDER MSB_LAST /end CHARACTERISTIC
/begin CHARACTERISTIC _g_PL_AD_fw_Radar_1R1V_rpc_LocBypassingRunnable_LocBypassingRunnable_m_pad_ensRLocationsPort_par_out_local.TChangeableMemPool._._._m_arrayPool._0_._elem._m_LocationList._Item._11_._Rcs._m_value "" VALUE 0xB0010190 __Float16_Value 0 NO_COMPU_METHOD -65504 65504 ECU_ADDRESS_EXTENSION 0x2 BYTE_ORDER MSB_LAST /end CHARACTERISTIC
/begin CHARACTERISTIC _g_PL_AD_fw_Radar_1R1V_rpc_LocBypassingRunnable_LocBypassingRunnable_m_pad_ensRLocationsPort_par_out_local.TChangeableMemPool._._._m_arrayPool._0_._elem._m_LocationList._Item._11_._Rssi._m_value "" VALUE 0xB0010192 __Float16_Value 0 NO_COMPU_METHOD -65504 65504 ECU_ADDRESS_EXTENSION 0x2 BYTE_ORDER MSB_LAST /end CHARACTERISTIC
/begin CHARACTERISTIC _g_PL_AD_fw_Radar_1R1V_rpc_LocBypassingRunnable_LocBypassingRunnable_m_pad_ensRLocationsPort_par_out_local.TChangeableMemPool._._._m_arrayPool._0_._elem._m_LocationList._Item._11_._d "" VALUE 0xB0010178 __Float32_Value 0 NO_COMPU_METHOD -3.4028234663852886E+38 3.4028234663852886E+38 ECU_ADDRESS_EXTENSION 0x2 BYTE_ORDER MSB_LAST /end CHARACTERISTIC
/begin CHARACTERISTIC _g_PL_AD_fw_Radar_1R1V_rpc_LocBypassingRunnable_LocBypassingRunnable_m_pad_ensRLocationsPort_par_out_local.TChangeableMemPool._._._m_arrayPool._0_._elem._m_LocationList._Item._11_._dVar._m_value "" VALUE 0xB0010180 __Float16_Value 0 NO_COMPU_METHOD -65504 65504 ECU_ADDRESS_EXTENSION 0x2 BYTE_ORDER MSB_LAST /end CHARACTERISTIC
/begin CHARACTERISTIC _g_PL_AD_fw_Radar_1R1V_rpc_LocBypassingRunnable_LocBypassingRunnable_m_pad_ensRLocationsPort_par_out_local.TChangeableMemPool._._._m_arrayPool._0_._elem._m_LocationList._Item._11_._dvCov._m_value "" VALUE 0xB0010184 __Float16_Value 0 NO_COMPU_METHOD -65504 65504 ECU_ADDRESS_EXTENSION 0x2 BYTE_ORDER MSB_LAST /end CHARACTERISTIC
/begin CHARACTERISTIC _g_PL_AD_fw_Radar_1R1V_rpc_LocBypassingRunnable_LocBypassingRunnable_m_pad_ensRLocationsPort_par_out_local.TChangeableMemPool._._._m_arrayPool._0_._elem._m_LocationList._Item._11_._dvQly "" VALUE 0xB0010194 __UByte_Value 0 NO_COMPU_METHOD 0 255 ECU_ADDRESS_EXTENSION 0x2 BYTE_ORDER MSB_LAST /end CHARACTERISTIC
/begin CHARACTERISTIC _g_PL_AD_fw_Radar_1R1V_rpc_LocBypassingRunnable_LocBypassingRunnable_m_pad_ensRLocationsPort_par_out_local.TChangeableMemPool._._._m_arrayPool._0_._elem._m_LocationList._Item._11_._idxAzimuthAmbiguityPeer "" VALUE 0xB0010196 __UWord_Value 0 NO_COMPU_METHOD 0 65535 ECU_ADDRESS_EXTENSION 0x2 BYTE_ORDER MSB_LAST /end CHARACTERISTIC
/begin CHARACTERISTIC _g_PL_AD_fw_Radar_1R1V_rpc_LocBypassingRunnable_LocBypassingRunnable_m_pad_ensRLocationsPort_par_out_local.TChangeableMemPool._._._m_arrayPool._0_._elem._m_LocationList._Item._11_._measStatus "" VALUE 0xB0010195 __UByte_Value 0 NO_COMPU_METHOD 0 255 ECU_ADDRESS_EXTENSION 0x2 BYTE_ORDER MSB_LAST /end CHARACTERISTIC
/begin CHARACTERISTIC _g_PL_AD_fw_Radar_1R1V_rpc_LocBypassingRunnable_LocBypassingRunnable_m_pad_ensRLocationsPort_par_out_local.TChangeableMemPool._._._m_arrayPool._0_._elem._m_LocationList._Item._11_._phi._m_value "" VALUE 0xB0010188 __Float16_Value 0 NO_COMPU_METHOD -65504 65504 ECU_ADDRESS_EXTENSION 0x2 BYTE_ORDER MSB_LAST /end CHARACTERISTIC
/begin CHARACTERISTIC _g_PL_AD_fw_Radar_1R1V_rpc_LocBypassingRunnable_LocBypassingRunnable_m_pad_ensRLocationsPort_par_out_local.TChangeableMemPool._._._m_arrayPool._0_._elem._m_LocationList._Item._11_._phiQly "" VALUE 0xB001018B __UByte_Value 0 NO_COMPU_METHOD 0 255 ECU_ADDRESS_EXTENSION 0x2 BYTE_ORDER MSB_LAST /end CHARACTERISTIC
/begin CHARACTERISTIC _g_PL_AD_fw_Radar_1R1V_rpc_LocBypassingRunnable_LocBypassingRunnable_m_pad_ensRLocationsPort_par_out_local.TChangeableMemPool._._._m_arrayPool._0_._elem._m_LocationList._Item._11_._phiVar._m_value "" VALUE 0xB001018E __Float16_Value 0 NO_COMPU_METHOD -65504 65504 ECU_ADDRESS_EXTENSION 0x2 BYTE_ORDER MSB_LAST /end CHARACTERISTIC
/begin CHARACTERISTIC _g_PL_AD_fw_Radar_1R1V_rpc_LocBypassingRunnable_LocBypassingRunnable_m_pad_ensRLocationsPort_par_out_local.TChangeableMemPool._._._m_arrayPool._0_._elem._m_LocationList._Item._11_._theta._m_value "" VALUE 0xB0010186 __Float16_Value 0 NO_COMPU_METHOD -65504 65504 ECU_ADDRESS_EXTENSION 0x2 BYTE_ORDER MSB_LAST /end CHARACTERISTIC
/begin CHARACTERISTIC _g_PL_AD_fw_Radar_1R1V_rpc_LocBypassingRunnable_LocBypassingRunnable_m_pad_ensRLocationsPort_par_out_local.TChangeableMemPool._._._m_arrayPool._0_._elem._m_LocationList._Item._11_._thetaQly "" VALUE 0xB001018A __UByte_Value 0 NO_COMPU_METHOD 0 255 ECU_ADDRESS_EXTENSION 0x2 BYTE_ORDER MSB_LAST /end CHARACTERISTIC
/begin CHARACTERISTIC _g_PL_AD_fw_Radar_1R1V_rpc_LocBypassingRunnable_LocBypassingRunnable_m_pad_ensRLocationsPort_par_out_local.TChangeableMemPool._._._m_arrayPool._0_._elem._m_LocationList._Item._11_._thetaVar._m_value "" VALUE 0xB001018C __Float16_Value 0 NO_COMPU_METHOD -65504 65504 ECU_ADDRESS_EXTENSION 0x2 BYTE_ORDER MSB_LAST /end CHARACTERISTIC
/begin CHARACTERISTIC _g_PL_AD_fw_Radar_1R1V_rpc_LocBypassingRunnable_LocBypassingRunnable_m_pad_ensRLocationsPort_par_out_local.TChangeableMemPool._._._m_arrayPool._0_._elem._m_LocationList._Item._11_._v "" VALUE 0xB001017C __Float32_Value 0 NO_COMPU_METHOD -3.4028234663852886E+38 3.4028234663852886E+38 ECU_ADDRESS_EXTENSION 0x2 BYTE_ORDER MSB_LAST /end CHARACTERISTIC
/begin CHARACTERISTIC _g_PL_AD_fw_Radar_1R1V_rpc_LocBypassingRunnable_LocBypassingRunnable_m_pad_ensRLocationsPort_par_out_local.TChangeableMemPool._._._m_arrayPool._0_._elem._m_LocationList._Item._11_._vVar._m_value "" VALUE 0xB0010182 __Float16_Value 0 NO_COMPU_METHOD -65504 65504 ECU_ADDRESS_EXTENSION 0x2 BYTE_ORDER MSB_LAST /end CHARACTERISTIC
/begin CHARACTERISTIC _g_PL_AD_fw_Radar_1R1V_rpc_LocBypassingRunnable_LocBypassingRunnable_m_pad_ensRLocationsPort_par_out_local.TChangeableMemPool._._._m_arrayPool._0_._elem._m_LocationList._Item._120_._Rcs._m_value "" VALUE 0xB0010F30 __Float16_Value 0 NO_COMPU_METHOD -65504 65504 ECU_ADDRESS_EXTENSION 0x2 BYTE_ORDER MSB_LAST /end CHARACTERISTIC
/begin CHARACTERISTIC _g_PL_AD_fw_Radar_1R1V_rpc_LocBypassingRunnable_LocBypassingRunnable_m_pad_ensRLocationsPort_par_out_local.TChangeableMemPool._._._m_arrayPool._0_._elem._m_LocationList._Item._120_._Rssi._m_value "" VALUE 0xB0010F32 __Float16_Value 0 NO_COMPU_METHOD -65504 65504 ECU_ADDRESS_EXTENSION 0x2 BYTE_ORDER MSB_LAST /end CHARACTERISTIC
/begin CHARACTERISTIC _g_PL_AD_fw_Radar_1R1V_rpc_LocBypassingRunnable_LocBypassingRunnable_m_pad_ensRLocationsPort_par_out_local.TChangeableMemPool._._._m_arrayPool._0_._elem._m_LocationList._Item._120_._d "" VALUE 0xB0010F18 __Float32_Value 0 NO_COMPU_METHOD -3.4028234663852886E+38 3.4028234663852886E+38 ECU_ADDRESS_EXTENSION 0x2 BYTE_ORDER MSB_LAST /end CHARACTERISTIC
/begin CHARACTERISTIC _g_PL_AD_fw_Radar_1R1V_rpc_LocBypassingRunnable_LocBypassingRunnable_m_pad_ensRLocationsPort_par_out_local.TChangeableMemPool._._._m_arrayPool._0_._elem._m_LocationList._Item._120_._dVar._m_value "" VALUE 0xB0010F20 __Float16_Value 0 NO_COMPU_METHOD -65504 65504 ECU_ADDRESS_EXTENSION 0x2 BYTE_ORDER MSB_LAST /end CHARACTERISTIC
/begin CHARACTERISTIC _g_PL_AD_fw_Radar_1R1V_rpc_LocBypassingRunnable_LocBypassingRunnable_m_pad_ensRLocationsPort_par_out_local.TChangeableMemPool._._._m_arrayPool._0_._elem._m_LocationList._Item._120_._dvCov._m_value "" VALUE 0xB0010F24 __Float16_Value 0 NO_COMPU_METHOD -65504 65504 ECU_ADDRESS_EXTENSION 0x2 BYTE_ORDER MSB_LAST /end CHARACTERISTIC
/begin CHARACTERISTIC _g_PL_AD_fw_Radar_1R1V_rpc_LocBypassingRunnable_LocBypassingRunnable_m_pad_ensRLocationsPort_par_out_local.TChangeableMemPool._._._m_arrayPool._0_._elem._m_LocationList._Item._120_._dvQly "" VALUE 0xB0010F34 __UByte_Value 0 NO_COMPU_METHOD 0 255 ECU_ADDRESS_EXTENSION 0x2 BYTE_ORDER MSB_LAST /end CHARACTERISTIC
/begin CHARACTERISTIC _g_PL_AD_fw_Radar_1R1V_rpc_LocBypassingRunnable_LocBypassingRunnable_m_pad_ensRLocationsPort_par_out_local.TChangeableMemPool._._._m_arrayPool._0_._elem._m_LocationList._Item._120_._idxAzimuthAmbiguityPeer "" VALUE 0xB0010F36 __UWord_Value 0 NO_COMPU_METHOD 0 65535 ECU_ADDRESS_EXTENSION 0x2 BYTE_ORDER MSB_LAST /end CHARACTERISTIC
/begin CHARACTERISTIC _g_PL_AD_fw_Radar_1R1V_rpc_LocBypassingRunnable_LocBypassingRunnable_m_pad_ensRLocationsPort_par_out_local.TChangeableMemPool._._._m_arrayPool._0_._elem._m_LocationList._Item._120_._measStatus "" VALUE 0xB0010F35 __UByte_Value 0 NO_COMPU_METHOD 0 255 ECU_ADDRESS_EXTENSION 0x2 BYTE_ORDER MSB_LAST /end CHARACTERISTIC
/begin CHARACTERISTIC _g_PL_AD_fw_Radar_1R1V_rpc_LocBypassingRunnable_LocBypassingRunnable_m_pad_ensRLocationsPort_par_out_local.TChangeableMemPool._._._m_arrayPool._0_._elem._m_LocationList._Item._120_._phi._m_value "" VALUE 0xB0010F28 __Float16_Value 0 NO_COMPU_METHOD -65504 65504 ECU_ADDRESS_EXTENSION 0x2 BYTE_ORDER MSB_LAST /end CHARACTERISTIC
/begin CHARACTERISTIC _g_PL_AD_fw_Radar_1R1V_rpc_LocBypassingRunnable_LocBypassingRunnable_m_pad_ensRLocationsPort_par_out_local.TChangeableMemPool._._._m_arrayPool._0_._elem._m_LocationList._Item._120_._phiQly "" VALUE 0xB0010F2B __UByte_Value 0 NO_COMPU_METHOD 0 255 ECU_ADDRESS_EXTENSION 0x2 BYTE_ORDER MSB_LAST /end CHARACTERISTIC
/begin CHARACTERISTIC _g_PL_AD_fw_Radar_1R1V_rpc_LocBypassingRunnable_LocBypassingRunnable_m_pad_ensRLocationsPort_par_out_local.TChangeableMemPool._._._m_arrayPool._0_._elem._m_LocationList._Item._120_._phiVar._m_value "" VALUE 0xB0010F2E __Float16_Value 0 NO_COMPU_METHOD -65504 65504 ECU_ADDRESS_EXTENSION 0x2 BYTE_ORDER MSB_LAST /end CHARACTERISTIC
/begin CHARACTERISTIC _g_PL_AD_fw_Radar_1R1V_rpc_LocBypassingRunnable_LocBypassingRunnable_m_pad_ensRLocationsPort_par_out_local.TChangeableMemPool._._._m_arrayPool._0_._elem._m_LocationList._Item._120_._theta._m_value "" VALUE 0xB0010F26 __Float16_Value 0 NO_COMPU_METHOD -65504 65504 ECU_ADDRESS_EXTENSION 0x2 BYTE_ORDER MSB_LAST /end CHARACTERISTIC
/begin CHARACTERISTIC _g_PL_AD_fw_Radar_1R1V_rpc_LocBypassingRunnable_LocBypassingRunnable_m_pad_ensRLocationsPort_par_out_local.TChangeableMemPool._._._m_arrayPool._0_._elem._m_LocationList._Item._120_._thetaQly "" VALUE 0xB0010F2A __UByte_Value 0 NO_COMPU_METHOD 0 255 ECU_ADDRESS_EXTENSION 0x2 BYTE_ORDER MSB_LAST /end CHARACTERISTIC
/begin CHARACTERISTIC _g_PL_AD_fw_Radar_1R1V_rpc_LocBypassingRunnable_LocBypassingRunnable_m_pad_ensRLocationsPort_par_out_local.TChangeableMemPool._._._m_arrayPool._0_._elem._m_LocationList._Item._120_._thetaVar._m_value "" VALUE 0xB0010F2C __Float16_Value 0 NO_COMPU_METHOD -65504 65504 ECU_ADDRESS_EXTENSION 0x2 BYTE_ORDER MSB_LAST /end CHARACTERISTIC
/begin CHARACTERISTIC _g_PL_AD_fw_Radar_1R1V_rpc_LocBypassingRunnable_LocBypassingRunnable_m_pad_ensRLocationsPort_par_out_local.TChangeableMemPool._._._m_arrayPool._0_._elem._m_LocationList._Item._120_._v "" VALUE 0xB0010F1C __Float32_Value 0 NO_COMPU_METHOD -3.4028234663852886E+38 3.4028234663852886E+38 ECU_ADDRESS_EXTENSION 0x2 BYTE_ORDER MSB_LAST /end CHARACTERISTIC
/begin CHARACTERISTIC _g_PL_AD_fw_Radar_1R1V_rpc_LocBypassingRunnable_LocBypassingRunnable_m_pad_ensRLocationsPort_par_out_local.TChangeableMemPool._._._m_arrayPool._0_._elem._m_LocationList._Item._120_._vVar._m_value "" VALUE 0xB0010F22 __Float16_Value 0 NO_COMPU_METHOD -65504 65504 ECU_ADDRESS_EXTENSION 0x2 BYTE_ORDER MSB_LAST /end CHARACTERISTIC
/begin CHARACTERISTIC _g_PL_AD_fw_Radar_1R1V_rpc_LocBypassingRunnable_LocBypassingRunnable_m_pad_ensRLocationsPort_par_out_local.TChangeableMemPool._._._m_arrayPool._0_._elem._m_LocationList._Item._121_._Rcs._m_value "" VALUE 0xB0010F50 __Float16_Value 0 NO_COMPU_METHOD -65504 65504 ECU_ADDRESS_EXTENSION 0x2 BYTE_ORDER MSB_LAST /end CHARACTERISTIC
/begin CHARACTERISTIC _g_PL_AD_fw_Radar_1R1V_rpc_LocBypassingRunnable_LocBypassingRunnable_m_pad_ensRLocationsPort_par_out_local.TChangeableMemPool._._._m_arrayPool._0_._elem._m_LocationList._Item._121_._Rssi._m_value "" VALUE 0xB0010F52 __Float16_Value 0 NO_COMPU_METHOD -65504 65504 ECU_ADDRESS_EXTENSION 0x2 BYTE_ORDER MSB_LAST /end CHARACTERISTIC
/begin CHARACTERISTIC _g_PL_AD_fw_Radar_1R1V_rpc_LocBypassingRunnable_LocBypassingRunnable_m_pad_ensRLocationsPort_par_out_local.TChangeableMemPool._._._m_arrayPool._0_._elem._m_LocationList._Item._121_._d "" VALUE 0xB0010F38 __Float32_Value 0 NO_COMPU_METHOD -3.4028234663852886E+38 3.4028234663852886E+38 ECU_ADDRESS_EXTENSION 0x2 BYTE_ORDER MSB_LAST /end CHARACTERISTIC
/begin CHARACTERISTIC _g_PL_AD_fw_Radar_1R1V_rpc_LocBypassingRunnable_LocBypassingRunnable_m_pad_ensRLocationsPort_par_out_local.TChangeableMemPool._._._m_arrayPool._0_._elem._m_LocationList._Item._121_._dVar._m_value "" VALUE 0xB0010F40 __Float16_Value 0 NO_COMPU_METHOD -65504 65504 ECU_ADDRESS_EXTENSION 0x2 BYTE_ORDER MSB_LAST /end CHARACTERISTIC
/begin CHARACTERISTIC _g_PL_AD_fw_Radar_1R1V_rpc_LocBypassingRunnable_LocBypassingRunnable_m_pad_ensRLocationsPort_par_out_local.TChangeableMemPool._._._m_arrayPool._0_._elem._m_LocationList._Item._121_._dvCov._m_value "" VALUE 0xB0010F44 __Float16_Value 0 NO_COMPU_METHOD -65504 65504 ECU_ADDRESS_EXTENSION 0x2 BYTE_ORDER MSB_LAST /end CHARACTERISTIC
/begin CHARACTERISTIC _g_PL_AD_fw_Radar_1R1V_rpc_LocBypassingRunnable_LocBypassingRunnable_m_pad_ensRLocationsPort_par_out_local.TChangeableMemPool._._._m_arrayPool._0_._elem._m_LocationList._Item._121_._dvQly "" VALUE 0xB0010F54 __UByte_Value 0 NO_COMPU_METHOD 0 255 ECU_ADDRESS_EXTENSION 0x2 BYTE_ORDER MSB_LAST /end CHARACTERISTIC
/begin CHARACTERISTIC _g_PL_AD_fw_Radar_1R1V_rpc_LocBypassingRunnable_LocBypassingRunnable_m_pad_ensRLocationsPort_par_out_local.TChangeableMemPool._._._m_arrayPool._0_._elem._m_LocationList._Item._121_._idxAzimuthAmbiguityPeer "" VALUE 0xB0010F56 __UWord_Value 0 NO_COMPU_METHOD 0 65535 ECU_ADDRESS_EXTENSION 0x2 BYTE_ORDER MSB_LAST /end CHARACTERISTIC
/begin CHARACTERISTIC _g_PL_AD_fw_Radar_1R1V_rpc_LocBypassingRunnable_LocBypassingRunnable_m_pad_ensRLocationsPort_par_out_local.TChangeableMemPool._._._m_arrayPool._0_._elem._m_LocationList._Item._121_._measStatus "" VALUE 0xB0010F55 __UByte_Value 0 NO_COMPU_METHOD 0 255 ECU_ADDRESS_EXTENSION 0x2 BYTE_ORDER MSB_LAST /end CHARACTERISTIC
/begin CHARACTERISTIC _g_PL_AD_fw_Radar_1R1V_rpc_LocBypassingRunnable_LocBypassingRunnable_m_pad_ensRLocationsPort_par_out_local.TChangeableMemPool._._._m_arrayPool._0_._elem._m_LocationList._Item._121_._phi._m_value "" VALUE 0xB0010F48 __Float16_Value 0 NO_COMPU_METHOD -65504 65504 ECU_ADDRESS_EXTENSION 0x2 BYTE_ORDER MSB_LAST /end CHARACTERISTIC
/begin CHARACTERISTIC _g_PL_AD_fw_Radar_1R1V_rpc_LocBypassingRunnable_LocBypassingRunnable_m_pad_ensRLocationsPort_par_out_local.TChangeableMemPool._._._m_arrayPool._0_._elem._m_LocationList._Item._121_._phiQly "" VALUE 0xB0010F4B __UByte_Value 0 NO_COMPU_METHOD 0 255 ECU_ADDRESS_EXTENSION 0x2 BYTE_ORDER MSB_LAST /end CHARACTERISTIC
/begin CHARACTERISTIC _g_PL_AD_fw_Radar_1R1V_rpc_LocBypassingRunnable_LocBypassingRunnable_m_pad_ensRLocationsPort_par_out_local.TChangeableMemPool._._._m_arrayPool._0_._elem._m_LocationList._Item._121_._phiVar._m_value "" VALUE 0xB0010F4E __Float16_Value 0 NO_COMPU_METHOD -65504 65504 ECU_ADDRESS_EXTENSION 0x2 BYTE_ORDER MSB_LAST /end CHARACTERISTIC
/begin CHARACTERISTIC _g_PL_AD_fw_Radar_1R1V_rpc_LocBypassingRunnable_LocBypassingRunnable_m_pad_ensRLocationsPort_par_out_local.TChangeableMemPool._._._m_arrayPool._0_._elem._m_LocationList._Item._121_._theta._m_value "" VALUE 0xB0010F46 __Float16_Value 0 NO_COMPU_METHOD -65504 65504 ECU_ADDRESS_EXTENSION 0x2 BYTE_ORDER MSB_LAST /end CHARACTERISTIC
/begin CHARACTERISTIC _g_PL_AD_fw_Radar_1R1V_rpc_LocBypassingRunnable_LocBypassingRunnable_m_pad_ensRLocationsPort_par_out_local.TChangeableMemPool._._._m_arrayPool._0_._elem._m_LocationList._Item._121_._thetaQly "" VALUE 0xB0010F4A __UByte_Value 0 NO_COMPU_METHOD 0 255 ECU_ADDRESS_EXTENSION 0x2 BYTE_ORDER MSB_LAST /end CHARACTERISTIC
/begin CHARACTERISTIC _g_PL_AD_fw_Radar_1R1V_rpc_LocBypassingRunnable_LocBypassingRunnable_m_pad_ensRLocationsPort_par_out_local.TChangeableMemPool._._._m_arrayPool._0_._elem._m_LocationList._Item._121_._thetaVar._m_value "" VALUE 0xB0010F4C __Float16_Value 0 NO_COMPU_METHOD -65504 65504 ECU_ADDRESS_EXTENSION 0x2 BYTE_ORDER MSB_LAST /end CHARACTERISTIC
/begin CHARACTERISTIC _g_PL_AD_fw_Radar_1R1V_rpc_LocBypassingRunnable_LocBypassingRunnable_m_pad_ensRLocationsPort_par_out_local.TChangeableMemPool._._._m_arrayPool._0_._elem._m_LocationList._Item._121_._v "" VALUE 0xB0010F3C __Float32_Value 0 NO_COMPU_METHOD -3.4028234663852886E+38 3.4028234663852886E+38 ECU_ADDRESS_EXTENSION 0x2 BYTE_ORDER MSB_LAST /end CHARACTERISTIC
/begin CHARACTERISTIC _g_PL_AD_fw_Radar_1R1V_rpc_LocBypassingRunnable_LocBypassingRunnable_m_pad_ensRLocationsPort_par_out_local.TChangeableMemPool._._._m_arrayPool._0_._elem._m_LocationList._Item._121_._vVar._m_value "" VALUE 0xB0010F42 __Float16_Value 0 NO_COMPU_METHOD -65504 65504 ECU_ADDRESS_EXTENSION 0x2 BYTE_ORDER MSB_LAST /end CHARACTERISTIC
/begin CHARACTERISTIC _g_PL_AD_fw_Radar_1R1V_rpc_LocBypassingRunnable_LocBypassingRunnable_m_pad_ensRLocationsPort_par_out_local.TChangeableMemPool._._._m_arrayPool._0_._elem._m_LocationList._Item._122_._Rcs._m_value "" VALUE 0xB0010F70 __Float16_Value 0 NO_COMPU_METHOD -65504 65504 ECU_ADDRESS_EXTENSION 0x2 BYTE_ORDER MSB_LAST /end CHARACTERISTIC
/begin CHARACTERISTIC _g_PL_AD_fw_Radar_1R1V_rpc_LocBypassingRunnable_LocBypassingRunnable_m_pad_ensRLocationsPort_par_out_local.TChangeableMemPool._._._m_arrayPool._0_._elem._m_LocationList._Item._122_._Rssi._m_value "" VALUE 0xB0010F72 __Float16_Value 0 NO_COMPU_METHOD -65504 65504 ECU_ADDRESS_EXTENSION 0x2 BYTE_ORDER MSB_LAST /end CHARACTERISTIC
/begin CHARACTERISTIC _g_PL_AD_fw_Radar_1R1V_rpc_LocBypassingRunnable_LocBypassingRunnable_m_pad_ensRLocationsPort_par_out_local.TChangeableMemPool._._._m_arrayPool._0_._elem._m_LocationList._Item._122_._d "" VALUE 0xB0010F58 __Float32_Value 0 NO_COMPU_METHOD -3.4028234663852886E+38 3.4028234663852886E+38 ECU_ADDRESS_EXTENSION 0x2 BYTE_ORDER MSB_LAST /end CHARACTERISTIC
/begin CHARACTERISTIC _g_PL_AD_fw_Radar_1R1V_rpc_LocBypassingRunnable_LocBypassingRunnable_m_pad_ensRLocationsPort_par_out_local.TChangeableMemPool._._._m_arrayPool._0_._elem._m_LocationList._Item._122_._dVar._m_value "" VALUE 0xB0010F60 __Float16_Value 0 NO_COMPU_METHOD -65504 65504 ECU_ADDRESS_EXTENSION 0x2 BYTE_ORDER MSB_LAST /end CHARACTERISTIC
/begin CHARACTERISTIC _g_PL_AD_fw_Radar_1R1V_rpc_LocBypassingRunnable_LocBypassingRunnable_m_pad_ensRLocationsPort_par_out_local.TChangeableMemPool._._._m_arrayPool._0_._elem._m_LocationList._Item._122_._dvCov._m_value "" VALUE 0xB0010F64 __Float16_Value 0 NO_COMPU_METHOD -65504 65504 ECU_ADDRESS_EXTENSION 0x2 BYTE_ORDER MSB_LAST /end CHARACTERISTIC
/begin CHARACTERISTIC _g_PL_AD_fw_Radar_1R1V_rpc_LocBypassingRunnable_LocBypassingRunnable_m_pad_ensRLocationsPort_par_out_local.TChangeableMemPool._._._m_arrayPool._0_._elem._m_LocationList._Item._122_._dvQly "" VALUE 0xB0010F74 __UByte_Value 0 NO_COMPU_METHOD 0 255 ECU_ADDRESS_EXTENSION 0x2 BYTE_ORDER MSB_LAST /end CHARACTERISTIC
/begin CHARACTERISTIC _g_PL_AD_fw_Radar_1R1V_rpc_LocBypassingRunnable_LocBypassingRunnable_m_pad_ensRLocationsPort_par_out_local.TChangeableMemPool._._._m_arrayPool._0_._elem._m_LocationList._Item._122_._idxAzimuthAmbiguityPeer "" VALUE 0xB0010F76 __UWord_Value 0 NO_COMPU_METHOD 0 65535 ECU_ADDRESS_EXTENSION 0x2 BYTE_ORDER MSB_LAST /end CHARACTERISTIC
/begin CHARACTERISTIC _g_PL_AD_fw_Radar_1R1V_rpc_LocBypassingRunnable_LocBypassingRunnable_m_pad_ensRLocationsPort_par_out_local.TChangeableMemPool._._._m_arrayPool._0_._elem._m_LocationList._Item._122_._measStatus "" VALUE 0xB0010F75 __UByte_Value 0 NO_COMPU_METHOD 0 255 ECU_ADDRESS_EXTENSION 0x2 BYTE_ORDER MSB_LAST /end CHARACTERISTIC
/begin CHARACTERISTIC _g_PL_AD_fw_Radar_1R1V_rpc_LocBypassingRunnable_LocBypassingRunnable_m_pad_ensRLocationsPort_par_out_local.TChangeableMemPool._._._m_arrayPool._0_._elem._m_LocationList._Item._122_._phi._m_value "" VALUE 0xB0010F68 __Float16_Value 0 NO_COMPU_METHOD -65504 65504 ECU_ADDRESS_EXTENSION 0x2 BYTE_ORDER MSB_LAST /end CHARACTERISTIC
/begin CHARACTERISTIC _g_PL_AD_fw_Radar_1R1V_rpc_LocBypassingRunnable_LocBypassingRunnable_m_pad_ensRLocationsPort_par_out_local.TChangeableMemPool._._._m_arrayPool._0_._elem._m_LocationList._Item._122_._phiQly "" VALUE 0xB0010F6B __UByte_Value 0 NO_COMPU_METHOD 0 255 ECU_ADDRESS_EXTENSION 0x2 BYTE_ORDER MSB_LAST /end CHARACTERISTIC
/begin CHARACTERISTIC _g_PL_AD_fw_Radar_1R1V_rpc_LocBypassingRunnable_LocBypassingRunnable_m_pad_ensRLocationsPort_par_out_local.TChangeableMemPool._._._m_arrayPool._0_._elem._m_LocationList._Item._122_._phiVar._m_value "" VALUE 0xB0010F6E __Float16_Value 0 NO_COMPU_METHOD -65504 65504 ECU_ADDRESS_EXTENSION 0x2 BYTE_ORDER MSB_LAST /end CHARACTERISTIC
/begin CHARACTERISTIC _g_PL_AD_fw_Radar_1R1V_rpc_LocBypassingRunnable_LocBypassingRunnable_m_pad_ensRLocationsPort_par_out_local.TChangeableMemPool._._._m_arrayPool._0_._elem._m_LocationList._Item._122_._theta._m_value "" VALUE 0xB0010F66 __Float16_Value 0 NO_COMPU_METHOD -65504 65504 ECU_ADDRESS_EXTENSION 0x2 BYTE_ORDER MSB_LAST /end CHARACTERISTIC
/begin CHARACTERISTIC _g_PL_AD_fw_Radar_1R1V_rpc_LocBypassingRunnable_LocBypassingRunnable_m_pad_ensRLocationsPort_par_out_local.TChangeableMemPool._._._m_arrayPool._0_._elem._m_LocationList._Item._122_._thetaQly "" VALUE 0xB0010F6A __UByte_Value 0 NO_COMPU_METHOD 0 255 ECU_ADDRESS_EXTENSION 0x2 BYTE_ORDER MSB_LAST /end CHARACTERISTIC
/begin CHARACTERISTIC _g_PL_AD_fw_Radar_1R1V_rpc_LocBypassingRunnable_LocBypassingRunnable_m_pad_ensRLocationsPort_par_out_local.TChangeableMemPool._._._m_arrayPool._0_._elem._m_LocationList._Item._122_._thetaVar._m_value "" VALUE 0xB0010F6C __Float16_Value 0 NO_COMPU_METHOD -65504 65504 ECU_ADDRESS_EXTENSION 0x2 BYTE_ORDER MSB_LAST /end CHARACTERISTIC
/begin CHARACTERISTIC _g_PL_AD_fw_Radar_1R1V_rpc_LocBypassingRunnable_LocBypassingRunnable_m_pad_ensRLocationsPort_par_out_local.TChangeableMemPool._._._m_arrayPool._0_._elem._m_LocationList._Item._122_._v "" VALUE 0xB0010F5C __Float32_Value 0 NO_COMPU_METHOD -3.4028234663852886E+38 3.4028234663852886E+38 ECU_ADDRESS_EXTENSION 0x2 BYTE_ORDER MSB_LAST /end CHARACTERISTIC
/begin CHARACTERISTIC _g_PL_AD_fw_Radar_1R1V_rpc_LocBypassingRunnable_LocBypassingRunnable_m_pad_ensRLocationsPort_par_out_local.TChangeableMemPool._._._m_arrayPool._0_._elem._m_LocationList._Item._122_._vVar._m_value "" VALUE 0xB0010F62 __Float16_Value 0 NO_COMPU_METHOD -65504 65504 ECU_ADDRESS_EXTENSION 0x2 BYTE_ORDER MSB_LAST /end CHARACTERISTIC
/begin CHARACTERISTIC _g_PL_AD_fw_Radar_1R1V_rpc_LocBypassingRunnable_LocBypassingRunnable_m_pad_ensRLocationsPort_par_out_local.TChangeableMemPool._._._m_arrayPool._0_._elem._m_LocationList._Item._123_._Rcs._m_value "" VALUE 0xB0010F90 __Float16_Value 0 NO_COMPU_METHOD -65504 65504 ECU_ADDRESS_EXTENSION 0x2 BYTE_ORDER MSB_LAST /end CHARACTERISTIC
/begin CHARACTERISTIC _g_PL_AD_fw_Radar_1R1V_rpc_LocBypassingRunnable_LocBypassingRunnable_m_pad_ensRLocationsPort_par_out_local.TChangeableMemPool._._._m_arrayPool._0_._elem._m_LocationList._Item._123_._Rssi._m_value "" VALUE 0xB0010F92 __Float16_Value 0 NO_COMPU_METHOD -65504 65504 ECU_ADDRESS_EXTENSION 0x2 BYTE_ORDER MSB_LAST /end CHARACTERISTIC
/begin CHARACTERISTIC _g_PL_AD_fw_Radar_1R1V_rpc_LocBypassingRunnable_LocBypassingRunnable_m_pad_ensRLocationsPort_par_out_local.TChangeableMemPool._._._m_arrayPool._0_._elem._m_LocationList._Item._123_._d "" VALUE 0xB0010F78 __Float32_Value 0 NO_COMPU_METHOD -3.4028234663852886E+38 3.4028234663852886E+38 ECU_ADDRESS_EXTENSION 0x2 BYTE_ORDER MSB_LAST /end CHARACTERISTIC
/begin CHARACTERISTIC _g_PL_AD_fw_Radar_1R1V_rpc_LocBypassingRunnable_LocBypassingRunnable_m_pad_ensRLocationsPort_par_out_local.TChangeableMemPool._._._m_arrayPool._0_._elem._m_LocationList._Item._123_._dVar._m_value "" VALUE 0xB0010F80 __Float16_Value 0 NO_COMPU_METHOD -65504 65504 ECU_ADDRESS_EXTENSION 0x2 BYTE_ORDER MSB_LAST /end CHARACTERISTIC
/begin CHARACTERISTIC _g_PL_AD_fw_Radar_1R1V_rpc_LocBypassingRunnable_LocBypassingRunnable_m_pad_ensRLocationsPort_par_out_local.TChangeableMemPool._._._m_arrayPool._0_._elem._m_LocationList._Item._123_._dvCov._m_value "" VALUE 0xB0010F84 __Float16_Value 0 NO_COMPU_METHOD -65504 65504 ECU_ADDRESS_EXTENSION 0x2 BYTE_ORDER MSB_LAST /end CHARACTERISTIC
/begin CHARACTERISTIC _g_PL_AD_fw_Radar_1R1V_rpc_LocBypassingRunnable_LocBypassingRunnable_m_pad_ensRLocationsPort_par_out_local.TChangeableMemPool._._._m_arrayPool._0_._elem._m_LocationList._Item._123_._dvQly "" VALUE 0xB0010F94 __UByte_Value 0 NO_COMPU_METHOD 0 255 ECU_ADDRESS_EXTENSION 0x2 BYTE_ORDER MSB_LAST /end CHARACTERISTIC
/begin CHARACTERISTIC _g_PL_AD_fw_Radar_1R1V_rpc_LocBypassingRunnable_LocBypassingRunnable_m_pad_ensRLocationsPort_par_out_local.TChangeableMemPool._._._m_arrayPool._0_._elem._m_LocationList._Item._123_._idxAzimuthAmbiguityPeer "" VALUE 0xB0010F96 __UWord_Value 0 NO_COMPU_METHOD 0 65535 ECU_ADDRESS_EXTENSION 0x2 BYTE_ORDER MSB_LAST /end CHARACTERISTIC
/begin CHARACTERISTIC _g_PL_AD_fw_Radar_1R1V_rpc_LocBypassingRunnable_LocBypassingRunnable_m_pad_ensRLocationsPort_par_out_local.TChangeableMemPool._._._m_arrayPool._0_._elem._m_LocationList._Item._123_._measStatus "" VALUE 0xB0010F95 __UByte_Value 0 NO_COMPU_METHOD 0 255 ECU_ADDRESS_EXTENSION 0x2 BYTE_ORDER MSB_LAST /end CHARACTERISTIC
/begin CHARACTERISTIC _g_PL_AD_fw_Radar_1R1V_rpc_LocBypassingRunnable_LocBypassingRunnable_m_pad_ensRLocationsPort_par_out_local.TChangeableMemPool._._._m_arrayPool._0_._elem._m_LocationList._Item._123_._phi._m_value "" VALUE 0xB0010F88 __Float16_Value 0 NO_COMPU_METHOD -65504 65504 ECU_ADDRESS_EXTENSION 0x2 BYTE_ORDER MSB_LAST /end CHARACTERISTIC
/begin CHARACTERISTIC _g_PL_AD_fw_Radar_1R1V_rpc_LocBypassingRunnable_LocBypassingRunnable_m_pad_ensRLocationsPort_par_out_local.TChangeableMemPool._._._m_arrayPool._0_._elem._m_LocationList._Item._123_._phiQly "" VALUE 0xB0010F8B __UByte_Value 0 NO_COMPU_METHOD 0 255 ECU_ADDRESS_EXTENSION 0x2 BYTE_ORDER MSB_LAST /end CHARACTERISTIC
/begin CHARACTERISTIC _g_PL_AD_fw_Radar_1R1V_rpc_LocBypassingRunnable_LocBypassingRunnable_m_pad_ensRLocationsPort_par_out_local.TChangeableMemPool._._._m_arrayPool._0_._elem._m_LocationList._Item._123_._phiVar._m_value "" VALUE 0xB0010F8E __Float16_Value 0 NO_COMPU_METHOD -65504 65504 ECU_ADDRESS_EXTENSION 0x2 BYTE_ORDER MSB_LAST /end CHARACTERISTIC
/begin CHARACTERISTIC _g_PL_AD_fw_Radar_1R1V_rpc_LocBypassingRunnable_LocBypassingRunnable_m_pad_ensRLocationsPort_par_out_local.TChangeableMemPool._._._m_arrayPool._0_._elem._m_LocationList._Item._123_._theta._m_value "" VALUE 0xB0010F86 __Float16_Value 0 NO_COMPU_METHOD -65504 65504 ECU_ADDRESS_EXTENSION 0x2 BYTE_ORDER MSB_LAST /end CHARACTERISTIC
/begin CHARACTERISTIC _g_PL_AD_fw_Radar_1R1V_rpc_LocBypassingRunnable_LocBypassingRunnable_m_pad_ensRLocationsPort_par_out_local.TChangeableMemPool._._._m_arrayPool._0_._elem._m_LocationList._Item._123_._thetaQly "" VALUE 0xB0010F8A __UByte_Value 0 NO_COMPU_METHOD 0 255 ECU_ADDRESS_EXTENSION 0x2 BYTE_ORDER MSB_LAST /end CHARACTERISTIC
/begin CHARACTERISTIC _g_PL_AD_fw_Radar_1R1V_rpc_LocBypassingRunnable_LocBypassingRunnable_m_pad_ensRLocationsPort_par_out_local.TChangeableMemPool._._._m_arrayPool._0_._elem._m_LocationList._Item._123_._thetaVar._m_value "" VALUE 0xB0010F8C __Float16_Value 0 NO_COMPU_METHOD -65504 65504 ECU_ADDRESS_EXTENSION 0x2 BYTE_ORDER MSB_LAST /end CHARACTERISTIC
/begin CHARACTERISTIC _g_PL_AD_fw_Radar_1R1V_rpc_LocBypassingRunnable_LocBypassingRunnable_m_pad_ensRLocationsPort_par_out_local.TChangeableMemPool._._._m_arrayPool._0_._elem._m_LocationList._Item._123_._v "" VALUE 0xB0010F7C __Float32_Value 0 NO_COMPU_METHOD -3.4028234663852886E+38 3.4028234663852886E+38 ECU_ADDRESS_EXTENSION 0x2 BYTE_ORDER MSB_LAST /end CHARACTERISTIC
/begin CHARACTERISTIC _g_PL_AD_fw_Radar_1R1V_rpc_LocBypassingRunnable_LocBypassingRunnable_m_pad_ensRLocationsPort_par_out_local.TChangeableMemPool._._._m_arrayPool._0_._elem._m_LocationList._Item._123_._vVar._m_value "" VALUE 0xB0010F82 __Float16_Value 0 NO_COMPU_METHOD -65504 65504 ECU_ADDRESS_EXTENSION 0x2 BYTE_ORDER MSB_LAST /end CHARACTERISTIC
/begin CHARACTERISTIC _g_PL_AD_fw_Radar_1R1V_rpc_LocBypassingRunnable_LocBypassingRunnable_m_pad_ensRLocationsPort_par_out_local.TChangeableMemPool._._._m_arrayPool._0_._elem._m_LocationList._Item._124_._Rcs._m_value "" VALUE 0xB0010FB0 __Float16_Value 0 NO_COMPU_METHOD -65504 65504 ECU_ADDRESS_EXTENSION 0x2 BYTE_ORDER MSB_LAST /end CHARACTERISTIC
/begin CHARACTERISTIC _g_PL_AD_fw_Radar_1R1V_rpc_LocBypassingRunnable_LocBypassingRunnable_m_pad_ensRLocationsPort_par_out_local.TChangeableMemPool._._._m_arrayPool._0_._elem._m_LocationList._Item._124_._Rssi._m_value "" VALUE 0xB0010FB2 __Float16_Value 0 NO_COMPU_METHOD -65504 65504 ECU_ADDRESS_EXTENSION 0x2 BYTE_ORDER MSB_LAST /end CHARACTERISTIC
/begin CHARACTERISTIC _g_PL_AD_fw_Radar_1R1V_rpc_LocBypassingRunnable_LocBypassingRunnable_m_pad_ensRLocationsPort_par_out_local.TChangeableMemPool._._._m_arrayPool._0_._elem._m_LocationList._Item._124_._d "" VALUE 0xB0010F98 __Float32_Value 0 NO_COMPU_METHOD -3.4028234663852886E+38 3.4028234663852886E+38 ECU_ADDRESS_EXTENSION 0x2 BYTE_ORDER MSB_LAST /end CHARACTERISTIC
/begin CHARACTERISTIC _g_PL_AD_fw_Radar_1R1V_rpc_LocBypassingRunnable_LocBypassingRunnable_m_pad_ensRLocationsPort_par_out_local.TChangeableMemPool._._._m_arrayPool._0_._elem._m_LocationList._Item._124_._dVar._m_value "" VALUE 0xB0010FA0 __Float16_Value 0 NO_COMPU_METHOD -65504 65504 ECU_ADDRESS_EXTENSION 0x2 BYTE_ORDER MSB_LAST /end CHARACTERISTIC
/begin CHARACTERISTIC _g_PL_AD_fw_Radar_1R1V_rpc_LocBypassingRunnable_LocBypassingRunnable_m_pad_ensRLocationsPort_par_out_local.TChangeableMemPool._._._m_arrayPool._0_._elem._m_LocationList._Item._124_._dvCov._m_value "" VALUE 0xB0010FA4 __Float16_Value 0 NO_COMPU_METHOD -65504 65504 ECU_ADDRESS_EXTENSION 0x2 BYTE_ORDER MSB_LAST /end CHARACTERISTIC
/begin CHARACTERISTIC _g_PL_AD_fw_Radar_1R1V_rpc_LocBypassingRunnable_LocBypassingRunnable_m_pad_ensRLocationsPort_par_out_local.TChangeableMemPool._._._m_arrayPool._0_._elem._m_LocationList._Item._124_._dvQly "" VALUE 0xB0010FB4 __UByte_Value 0 NO_COMPU_METHOD 0 255 ECU_ADDRESS_EXTENSION 0x2 BYTE_ORDER MSB_LAST /end CHARACTERISTIC
/begin CHARACTERISTIC _g_PL_AD_fw_Radar_1R1V_rpc_LocBypassingRunnable_LocBypassingRunnable_m_pad_ensRLocationsPort_par_out_local.TChangeableMemPool._._._m_arrayPool._0_._elem._m_LocationList._Item._124_._idxAzimuthAmbiguityPeer "" VALUE 0xB0010FB6 __UWord_Value 0 NO_COMPU_METHOD 0 65535 ECU_ADDRESS_EXTENSION 0x2 BYTE_ORDER MSB_LAST /end CHARACTERISTIC
/begin CHARACTERISTIC _g_PL_AD_fw_Radar_1R1V_rpc_LocBypassingRunnable_LocBypassingRunnable_m_pad_ensRLocationsPort_par_out_local.TChangeableMemPool._._._m_arrayPool._0_._elem._m_LocationList._Item._124_._measStatus "" VALUE 0xB0010FB5 __UByte_Value 0 NO_COMPU_METHOD 0 255 ECU_ADDRESS_EXTENSION 0x2 BYTE_ORDER MSB_LAST /end CHARACTERISTIC
/begin CHARACTERISTIC _g_PL_AD_fw_Radar_1R1V_rpc_LocBypassingRunnable_LocBypassingRunnable_m_pad_ensRLocationsPort_par_out_local.TChangeableMemPool._._._m_arrayPool._0_._elem._m_LocationList._Item._124_._phi._m_value "" VALUE 0xB0010FA8 __Float16_Value 0 NO_COMPU_METHOD -65504 65504 ECU_ADDRESS_EXTENSION 0x2 BYTE_ORDER MSB_LAST /end CHARACTERISTIC
/begin CHARACTERISTIC _g_PL_AD_fw_Radar_1R1V_rpc_LocBypassingRunnable_LocBypassingRunnable_m_pad_ensRLocationsPort_par_out_local.TChangeableMemPool._._._m_arrayPool._0_._elem._m_LocationList._Item._124_._phiQly "" VALUE 0xB0010FAB __UByte_Value 0 NO_COMPU_METHOD 0 255 ECU_ADDRESS_EXTENSION 0x2 BYTE_ORDER MSB_LAST /end CHARACTERISTIC
/begin CHARACTERISTIC _g_PL_AD_fw_Radar_1R1V_rpc_LocBypassingRunnable_LocBypassingRunnable_m_pad_ensRLocationsPort_par_out_local.TChangeableMemPool._._._m_arrayPool._0_._elem._m_LocationList._Item._124_._phiVar._m_value "" VALUE 0xB0010FAE __Float16_Value 0 NO_COMPU_METHOD -65504 65504 ECU_ADDRESS_EXTENSION 0x2 BYTE_ORDER MSB_LAST /end CHARACTERISTIC
/begin CHARACTERISTIC _g_PL_AD_fw_Radar_1R1V_rpc_LocBypassingRunnable_LocBypassingRunnable_m_pad_ensRLocationsPort_par_out_local.TChangeableMemPool._._._m_arrayPool._0_._elem._m_LocationList._Item._124_._theta._m_value "" VALUE 0xB0010FA6 __Float16_Value 0 NO_COMPU_METHOD -65504 65504 ECU_ADDRESS_EXTENSION 0x2 BYTE_ORDER MSB_LAST /end CHARACTERISTIC
/begin CHARACTERISTIC _g_PL_AD_fw_Radar_1R1V_rpc_LocBypassingRunnable_LocBypassingRunnable_m_pad_ensRLocationsPort_par_out_local.TChangeableMemPool._._._m_arrayPool._0_._elem._m_LocationList._Item._124_._thetaQly "" VALUE 0xB0010FAA __UByte_Value 0 NO_COMPU_METHOD 0 255 ECU_ADDRESS_EXTENSION 0x2 BYTE_ORDER MSB_LAST /end CHARACTERISTIC
/begin CHARACTERISTIC _g_PL_AD_fw_Radar_1R1V_rpc_LocBypassingRunnable_LocBypassingRunnable_m_pad_ensRLocationsPort_par_out_local.TChangeableMemPool._._._m_arrayPool._0_._elem._m_LocationList._Item._124_._thetaVar._m_value "" VALUE 0xB0010FAC __Float16_Value 0 NO_COMPU_METHOD -65504 65504 ECU_ADDRESS_EXTENSION 0x2 BYTE_ORDER MSB_LAST /end CHARACTERISTIC
/begin CHARACTERISTIC _g_PL_AD_fw_Radar_1R1V_rpc_LocBypassingRunnable_LocBypassingRunnable_m_pad_ensRLocationsPort_par_out_local.TChangeableMemPool._._._m_arrayPool._0_._elem._m_LocationList._Item._124_._v "" VALUE 0xB0010F9C __Float32_Value 0 NO_COMPU_METHOD -3.4028234663852886E+38 3.4028234663852886E+38 ECU_ADDRESS_EXTENSION 0x2 BYTE_ORDER MSB_LAST /end CHARACTERISTIC
/begin CHARACTERISTIC _g_PL_AD_fw_Radar_1R1V_rpc_LocBypassingRunnable_LocBypassingRunnable_m_pad_ensRLocationsPort_par_out_local.TChangeableMemPool._._._m_arrayPool._0_._elem._m_LocationList._Item._124_._vVar._m_value "" VALUE 0xB0010FA2 __Float16_Value 0 NO_COMPU_METHOD -65504 65504 ECU_ADDRESS_EXTENSION 0x2 BYTE_ORDER MSB_LAST /end CHARACTERISTIC
/begin CHARACTERISTIC _g_PL_AD_fw_Radar_1R1V_rpc_LocBypassingRunnable_LocBypassingRunnable_m_pad_ensRLocationsPort_par_out_local.TChangeableMemPool._._._m_arrayPool._0_._elem._m_LocationList._Item._125_._Rcs._m_value "" VALUE 0xB0010FD0 __Float16_Value 0 NO_COMPU_METHOD -65504 65504 ECU_ADDRESS_EXTENSION 0x2 BYTE_ORDER MSB_LAST /end CHARACTERISTIC
/begin CHARACTERISTIC _g_PL_AD_fw_Radar_1R1V_rpc_LocBypassingRunnable_LocBypassingRunnable_m_pad_ensRLocationsPort_par_out_local.TChangeableMemPool._._._m_arrayPool._0_._elem._m_LocationList._Item._125_._Rssi._m_value "" VALUE 0xB0010FD2 __Float16_Value 0 NO_COMPU_METHOD -65504 65504 ECU_ADDRESS_EXTENSION 0x2 BYTE_ORDER MSB_LAST /end CHARACTERISTIC
/begin CHARACTERISTIC _g_PL_AD_fw_Radar_1R1V_rpc_LocBypassingRunnable_LocBypassingRunnable_m_pad_ensRLocationsPort_par_out_local.TChangeableMemPool._._._m_arrayPool._0_._elem._m_LocationList._Item._125_._d "" VALUE 0xB0010FB8 __Float32_Value 0 NO_COMPU_METHOD -3.4028234663852886E+38 3.4028234663852886E+38 ECU_ADDRESS_EXTENSION 0x2 BYTE_ORDER MSB_LAST /end CHARACTERISTIC
/begin CHARACTERISTIC _g_PL_AD_fw_Radar_1R1V_rpc_LocBypassingRunnable_LocBypassingRunnable_m_pad_ensRLocationsPort_par_out_local.TChangeableMemPool._._._m_arrayPool._0_._elem._m_LocationList._Item._125_._dVar._m_value "" VALUE 0xB0010FC0 __Float16_Value 0 NO_COMPU_METHOD -65504 65504 ECU_ADDRESS_EXTENSION 0x2 BYTE_ORDER MSB_LAST /end CHARACTERISTIC
/begin CHARACTERISTIC _g_PL_AD_fw_Radar_1R1V_rpc_LocBypassingRunnable_LocBypassingRunnable_m_pad_ensRLocationsPort_par_out_local.TChangeableMemPool._._._m_arrayPool._0_._elem._m_LocationList._Item._125_._dvCov._m_value "" VALUE 0xB0010FC4 __Float16_Value 0 NO_COMPU_METHOD -65504 65504 ECU_ADDRESS_EXTENSION 0x2 BYTE_ORDER MSB_LAST /end CHARACTERISTIC
/begin CHARACTERISTIC _g_PL_AD_fw_Radar_1R1V_rpc_LocBypassingRunnable_LocBypassingRunnable_m_pad_ensRLocationsPort_par_out_local.TChangeableMemPool._._._m_arrayPool._0_._elem._m_LocationList._Item._125_._dvQly "" VALUE 0xB0010FD4 __UByte_Value 0 NO_COMPU_METHOD 0 255 ECU_ADDRESS_EXTENSION 0x2 BYTE_ORDER MSB_LAST /end CHARACTERISTIC
/begin CHARACTERISTIC _g_PL_AD_fw_Radar_1R1V_rpc_LocBypassingRunnable_LocBypassingRunnable_m_pad_ensRLocationsPort_par_out_local.TChangeableMemPool._._._m_arrayPool._0_._elem._m_LocationList._Item._125_._idxAzimuthAmbiguityPeer "" VALUE 0xB0010FD6 __UWord_Value 0 NO_COMPU_METHOD 0 65535 ECU_ADDRESS_EXTENSION 0x2 BYTE_ORDER MSB_LAST /end CHARACTERISTIC
/begin CHARACTERISTIC _g_PL_AD_fw_Radar_1R1V_rpc_LocBypassingRunnable_LocBypassingRunnable_m_pad_ensRLocationsPort_par_out_local.TChangeableMemPool._._._m_arrayPool._0_._elem._m_LocationList._Item._125_._measStatus "" VALUE 0xB0010FD5 __UByte_Value 0 NO_COMPU_METHOD 0 255 ECU_ADDRESS_EXTENSION 0x2 BYTE_ORDER MSB_LAST /end CHARACTERISTIC
/begin CHARACTERISTIC _g_PL_AD_fw_Radar_1R1V_rpc_LocBypassingRunnable_LocBypassingRunnable_m_pad_ensRLocationsPort_par_out_local.TChangeableMemPool._._._m_arrayPool._0_._elem._m_LocationList._Item._125_._phi._m_value "" VALUE 0xB0010FC8 __Float16_Value 0 NO_COMPU_METHOD -65504 65504 ECU_ADDRESS_EXTENSION 0x2 BYTE_ORDER MSB_LAST /end CHARACTERISTIC
/begin CHARACTERISTIC _g_PL_AD_fw_Radar_1R1V_rpc_LocBypassingRunnable_LocBypassingRunnable_m_pad_ensRLocationsPort_par_out_local.TChangeableMemPool._._._m_arrayPool._0_._elem._m_LocationList._Item._125_._phiQly "" VALUE 0xB0010FCB __UByte_Value 0 NO_COMPU_METHOD 0 255 ECU_ADDRESS_EXTENSION 0x2 BYTE_ORDER MSB_LAST /end CHARACTERISTIC
/begin CHARACTERISTIC _g_PL_AD_fw_Radar_1R1V_rpc_LocBypassingRunnable_LocBypassingRunnable_m_pad_ensRLocationsPort_par_out_local.TChangeableMemPool._._._m_arrayPool._0_._elem._m_LocationList._Item._125_._phiVar._m_value "" VALUE 0xB0010FCE __Float16_Value 0 NO_COMPU_METHOD -65504 65504 ECU_ADDRESS_EXTENSION 0x2 BYTE_ORDER MSB_LAST /end CHARACTERISTIC
/begin CHARACTERISTIC _g_PL_AD_fw_Radar_1R1V_rpc_LocBypassingRunnable_LocBypassingRunnable_m_pad_ensRLocationsPort_par_out_local.TChangeableMemPool._._._m_arrayPool._0_._elem._m_LocationList._Item._125_._theta._m_value "" VALUE 0xB0010FC6 __Float16_Value 0 NO_COMPU_METHOD -65504 65504 ECU_ADDRESS_EXTENSION 0x2 BYTE_ORDER MSB_LAST /end CHARACTERISTIC
/begin CHARACTERISTIC _g_PL_AD_fw_Radar_1R1V_rpc_LocBypassingRunnable_LocBypassingRunnable_m_pad_ensRLocationsPort_par_out_local.TChangeableMemPool._._._m_arrayPool._0_._elem._m_LocationList._Item._125_._thetaQly "" VALUE 0xB0010FCA __UByte_Value 0 NO_COMPU_METHOD 0 255 ECU_ADDRESS_EXTENSION 0x2 BYTE_ORDER MSB_LAST /end CHARACTERISTIC
/begin CHARACTERISTIC _g_PL_AD_fw_Radar_1R1V_rpc_LocBypassingRunnable_LocBypassingRunnable_m_pad_ensRLocationsPort_par_out_local.TChangeableMemPool._._._m_arrayPool._0_._elem._m_LocationList._Item._125_._thetaVar._m_value "" VALUE 0xB0010FCC __Float16_Value 0 NO_COMPU_METHOD -65504 65504 ECU_ADDRESS_EXTENSION 0x2 BYTE_ORDER MSB_LAST /end CHARACTERISTIC
/begin CHARACTERISTIC _g_PL_AD_fw_Radar_1R1V_rpc_LocBypassingRunnable_LocBypassingRunnable_m_pad_ensRLocationsPort_par_out_local.TChangeableMemPool._._._m_arrayPool._0_._elem._m_LocationList._Item._125_._v "" VALUE 0xB0010FBC __Float32_Value 0 NO_COMPU_METHOD -3.4028234663852886E+38 3.4028234663852886E+38 ECU_ADDRESS_EXTENSION 0x2 BYTE_ORDER MSB_LAST /end CHARACTERISTIC
/begin CHARACTERISTIC _g_PL_AD_fw_Radar_1R1V_rpc_LocBypassingRunnable_LocBypassingRunnable_m_pad_ensRLocationsPort_par_out_local.TChangeableMemPool._._._m_arrayPool._0_._elem._m_LocationList._Item._125_._vVar._m_value "" VALUE 0xB0010FC2 __Float16_Value 0 NO_COMPU_METHOD -65504 65504 ECU_ADDRESS_EXTENSION 0x2 BYTE_ORDER MSB_LAST /end CHARACTERISTIC
/begin CHARACTERISTIC _g_PL_AD_fw_Radar_1R1V_rpc_LocBypassingRunnable_LocBypassingRunnable_m_pad_ensRLocationsPort_par_out_local.TChangeableMemPool._._._m_arrayPool._0_._elem._m_LocationList._Item._126_._Rcs._m_value "" VALUE 0xB0010FF0 __Float16_Value 0 NO_COMPU_METHOD -65504 65504 ECU_ADDRESS_EXTENSION 0x2 BYTE_ORDER MSB_LAST /end CHARACTERISTIC
/begin CHARACTERISTIC _g_PL_AD_fw_Radar_1R1V_rpc_LocBypassingRunnable_LocBypassingRunnable_m_pad_ensRLocationsPort_par_out_local.TChangeableMemPool._._._m_arrayPool._0_._elem._m_LocationList._Item._126_._Rssi._m_value "" VALUE 0xB0010FF2 __Float16_Value 0 NO_COMPU_METHOD -65504 65504 ECU_ADDRESS_EXTENSION 0x2 BYTE_ORDER MSB_LAST /end CHARACTERISTIC
/begin CHARACTERISTIC _g_PL_AD_fw_Radar_1R1V_rpc_LocBypassingRunnable_LocBypassingRunnable_m_pad_ensRLocationsPort_par_out_local.TChangeableMemPool._._._m_arrayPool._0_._elem._m_LocationList._Item._126_._d "" VALUE 0xB0010FD8 __Float32_Value 0 NO_COMPU_METHOD -3.4028234663852886E+38 3.4028234663852886E+38 ECU_ADDRESS_EXTENSION 0x2 BYTE_ORDER MSB_LAST /end CHARACTERISTIC
/begin CHARACTERISTIC _g_PL_AD_fw_Radar_1R1V_rpc_LocBypassingRunnable_LocBypassingRunnable_m_pad_ensRLocationsPort_par_out_local.TChangeableMemPool._._._m_arrayPool._0_._elem._m_LocationList._Item._126_._dVar._m_value "" VALUE 0xB0010FE0 __Float16_Value 0 NO_COMPU_METHOD -65504 65504 ECU_ADDRESS_EXTENSION 0x2 BYTE_ORDER MSB_LAST /end CHARACTERISTIC
/begin CHARACTERISTIC _g_PL_AD_fw_Radar_1R1V_rpc_LocBypassingRunnable_LocBypassingRunnable_m_pad_ensRLocationsPort_par_out_local.TChangeableMemPool._._._m_arrayPool._0_._elem._m_LocationList._Item._126_._dvCov._m_value "" VALUE 0xB0010FE4 __Float16_Value 0 NO_COMPU_METHOD -65504 65504 ECU_ADDRESS_EXTENSION 0x2 BYTE_ORDER MSB_LAST /end CHARACTERISTIC
/begin CHARACTERISTIC _g_PL_AD_fw_Radar_1R1V_rpc_LocBypassingRunnable_LocBypassingRunnable_m_pad_ensRLocationsPort_par_out_local.TChangeableMemPool._._._m_arrayPool._0_._elem._m_LocationList._Item._126_._dvQly "" VALUE 0xB0010FF4 __UByte_Value 0 NO_COMPU_METHOD 0 255 ECU_ADDRESS_EXTENSION 0x2 BYTE_ORDER MSB_LAST /end CHARACTERISTIC
/begin CHARACTERISTIC _g_PL_AD_fw_Radar_1R1V_rpc_LocBypassingRunnable_LocBypassingRunnable_m_pad_ensRLocationsPort_par_out_local.TChangeableMemPool._._._m_arrayPool._0_._elem._m_LocationList._Item._126_._idxAzimuthAmbiguityPeer "" VALUE 0xB0010FF6 __UWord_Value 0 NO_COMPU_METHOD 0 65535 ECU_ADDRESS_EXTENSION 0x2 BYTE_ORDER MSB_LAST /end CHARACTERISTIC
/begin CHARACTERISTIC _g_PL_AD_fw_Radar_1R1V_rpc_LocBypassingRunnable_LocBypassingRunnable_m_pad_ensRLocationsPort_par_out_local.TChangeableMemPool._._._m_arrayPool._0_._elem._m_LocationList._Item._126_._measStatus "" VALUE 0xB0010FF5 __UByte_Value 0 NO_COMPU_METHOD 0 255 ECU_ADDRESS_EXTENSION 0x2 BYTE_ORDER MSB_LAST /end CHARACTERISTIC
/begin CHARACTERISTIC _g_PL_AD_fw_Radar_1R1V_rpc_LocBypassingRunnable_LocBypassingRunnable_m_pad_ensRLocationsPort_par_out_local.TChangeableMemPool._._._m_arrayPool._0_._elem._m_LocationList._Item._126_._phi._m_value "" VALUE 0xB0010FE8 __Float16_Value 0 NO_COMPU_METHOD -65504 65504 ECU_ADDRESS_EXTENSION 0x2 BYTE_ORDER MSB_LAST /end CHARACTERISTIC
/begin CHARACTERISTIC _g_PL_AD_fw_Radar_1R1V_rpc_LocBypassingRunnable_LocBypassingRunnable_m_pad_ensRLocationsPort_par_out_local.TChangeableMemPool._._._m_arrayPool._0_._elem._m_LocationList._Item._126_._phiQly "" VALUE 0xB0010FEB __UByte_Value 0 NO_COMPU_METHOD 0 255 ECU_ADDRESS_EXTENSION 0x2 BYTE_ORDER MSB_LAST /end CHARACTERISTIC
/begin CHARACTERISTIC _g_PL_AD_fw_Radar_1R1V_rpc_LocBypassingRunnable_LocBypassingRunnable_m_pad_ensRLocationsPort_par_out_local.TChangeableMemPool._._._m_arrayPool._0_._elem._m_LocationList._Item._126_._phiVar._m_value "" VALUE 0xB0010FEE __Float16_Value 0 NO_COMPU_METHOD -65504 65504 ECU_ADDRESS_EXTENSION 0x2 BYTE_ORDER MSB_LAST /end CHARACTERISTIC
/begin CHARACTERISTIC _g_PL_AD_fw_Radar_1R1V_rpc_LocBypassingRunnable_LocBypassingRunnable_m_pad_ensRLocationsPort_par_out_local.TChangeableMemPool._._._m_arrayPool._0_._elem._m_LocationList._Item._126_._theta._m_value "" VALUE 0xB0010FE6 __Float16_Value 0 NO_COMPU_METHOD -65504 65504 ECU_ADDRESS_EXTENSION 0x2 BYTE_ORDER MSB_LAST /end CHARACTERISTIC
/begin CHARACTERISTIC _g_PL_AD_fw_Radar_1R1V_rpc_LocBypassingRunnable_LocBypassingRunnable_m_pad_ensRLocationsPort_par_out_local.TChangeableMemPool._._._m_arrayPool._0_._elem._m_LocationList._Item._126_._thetaQly "" VALUE 0xB0010FEA __UByte_Value 0 NO_COMPU_METHOD 0 255 ECU_ADDRESS_EXTENSION 0x2 BYTE_ORDER MSB_LAST /end CHARACTERISTIC
/begin CHARACTERISTIC _g_PL_AD_fw_Radar_1R1V_rpc_LocBypassingRunnable_LocBypassingRunnable_m_pad_ensRLocationsPort_par_out_local.TChangeableMemPool._._._m_arrayPool._0_._elem._m_LocationList._Item._126_._thetaVar._m_value "" VALUE 0xB0010FEC __Float16_Value 0 NO_COMPU_METHOD -65504 65504 ECU_ADDRESS_EXTENSION 0x2 BYTE_ORDER MSB_LAST /end CHARACTERISTIC
/begin CHARACTERISTIC _g_PL_AD_fw_Radar_1R1V_rpc_LocBypassingRunnable_LocBypassingRunnable_m_pad_ensRLocationsPort_par_out_local.TChangeableMemPool._._._m_arrayPool._0_._elem._m_LocationList._Item._126_._v "" VALUE 0xB0010FDC __Float32_Value 0 NO_COMPU_METHOD -3.4028234663852886E+38 3.4028234663852886E+38 ECU_ADDRESS_EXTENSION 0x2 BYTE_ORDER MSB_LAST /end CHARACTERISTIC
/begin CHARACTERISTIC _g_PL_AD_fw_Radar_1R1V_rpc_LocBypassingRunnable_LocBypassingRunnable_m_pad_ensRLocationsPort_par_out_local.TChangeableMemPool._._._m_arrayPool._0_._elem._m_LocationList._Item._126_._vVar._m_value "" VALUE 0xB0010FE2 __Float16_Value 0 NO_COMPU_METHOD -65504 65504 ECU_ADDRESS_EXTENSION 0x2 BYTE_ORDER MSB_LAST /end CHARACTERISTIC
/begin CHARACTERISTIC _g_PL_AD_fw_Radar_1R1V_rpc_LocBypassingRunnable_LocBypassingRunnable_m_pad_ensRLocationsPort_par_out_local.TChangeableMemPool._._._m_arrayPool._0_._elem._m_LocationList._Item._127_._Rcs._m_value "" VALUE 0xB0011010 __Float16_Value 0 NO_COMPU_METHOD -65504 65504 ECU_ADDRESS_EXTENSION 0x2 BYTE_ORDER MSB_LAST /end CHARACTERISTIC
/begin CHARACTERISTIC _g_PL_AD_fw_Radar_1R1V_rpc_LocBypassingRunnable_LocBypassingRunnable_m_pad_ensRLocationsPort_par_out_local.TChangeableMemPool._._._m_arrayPool._0_._elem._m_LocationList._Item._127_._Rssi._m_value "" VALUE 0xB0011012 __Float16_Value 0 NO_COMPU_METHOD -65504 65504 ECU_ADDRESS_EXTENSION 0x2 BYTE_ORDER MSB_LAST /end CHARACTERISTIC
/begin CHARACTERISTIC _g_PL_AD_fw_Radar_1R1V_rpc_LocBypassingRunnable_LocBypassingRunnable_m_pad_ensRLocationsPort_par_out_local.TChangeableMemPool._._._m_arrayPool._0_._elem._m_LocationList._Item._127_._d "" VALUE 0xB0010FF8 __Float32_Value 0 NO_COMPU_METHOD -3.4028234663852886E+38 3.4028234663852886E+38 ECU_ADDRESS_EXTENSION 0x2 BYTE_ORDER MSB_LAST /end CHARACTERISTIC
/begin CHARACTERISTIC _g_PL_AD_fw_Radar_1R1V_rpc_LocBypassingRunnable_LocBypassingRunnable_m_pad_ensRLocationsPort_par_out_local.TChangeableMemPool._._._m_arrayPool._0_._elem._m_LocationList._Item._127_._dVar._m_value "" VALUE 0xB0011000 __Float16_Value 0 NO_COMPU_METHOD -65504 65504 ECU_ADDRESS_EXTENSION 0x2 BYTE_ORDER MSB_LAST /end CHARACTERISTIC
/begin CHARACTERISTIC _g_PL_AD_fw_Radar_1R1V_rpc_LocBypassingRunnable_LocBypassingRunnable_m_pad_ensRLocationsPort_par_out_local.TChangeableMemPool._._._m_arrayPool._0_._elem._m_LocationList._Item._127_._dvCov._m_value "" VALUE 0xB0011004 __Float16_Value 0 NO_COMPU_METHOD -65504 65504 ECU_ADDRESS_EXTENSION 0x2 BYTE_ORDER MSB_LAST /end CHARACTERISTIC
/begin CHARACTERISTIC _g_PL_AD_fw_Radar_1R1V_rpc_LocBypassingRunnable_LocBypassingRunnable_m_pad_ensRLocationsPort_par_out_local.TChangeableMemPool._._._m_arrayPool._0_._elem._m_LocationList._Item._127_._dvQly "" VALUE 0xB0011014 __UByte_Value 0 NO_COMPU_METHOD 0 255 ECU_ADDRESS_EXTENSION 0x2 BYTE_ORDER MSB_LAST /end CHARACTERISTIC
/begin CHARACTERISTIC _g_PL_AD_fw_Radar_1R1V_rpc_LocBypassingRunnable_LocBypassingRunnable_m_pad_ensRLocationsPort_par_out_local.TChangeableMemPool._._._m_arrayPool._0_._elem._m_LocationList._Item._127_._idxAzimuthAmbiguityPeer "" VALUE 0xB0011016 __UWord_Value 0 NO_COMPU_METHOD 0 65535 ECU_ADDRESS_EXTENSION 0x2 BYTE_ORDER MSB_LAST /end CHARACTERISTIC
/begin CHARACTERISTIC _g_PL_AD_fw_Radar_1R1V_rpc_LocBypassingRunnable_LocBypassingRunnable_m_pad_ensRLocationsPort_par_out_local.TChangeableMemPool._._._m_arrayPool._0_._elem._m_LocationList._Item._127_._measStatus "" VALUE 0xB0011015 __UByte_Value 0 NO_COMPU_METHOD 0 255 ECU_ADDRESS_EXTENSION 0x2 BYTE_ORDER MSB_LAST /end CHARACTERISTIC
/begin CHARACTERISTIC _g_PL_AD_fw_Radar_1R1V_rpc_LocBypassingRunnable_LocBypassingRunnable_m_pad_ensRLocationsPort_par_out_local.TChangeableMemPool._._._m_arrayPool._0_._elem._m_LocationList._Item._127_._phi._m_value "" VALUE 0xB0011008 __Float16_Value 0 NO_COMPU_METHOD -65504 65504 ECU_ADDRESS_EXTENSION 0x2 BYTE_ORDER MSB_LAST /end CHARACTERISTIC
/begin CHARACTERISTIC _g_PL_AD_fw_Radar_1R1V_rpc_LocBypassingRunnable_LocBypassingRunnable_m_pad_ensRLocationsPort_par_out_local.TChangeableMemPool._._._m_arrayPool._0_._elem._m_LocationList._Item._127_._phiQly "" VALUE 0xB001100B __UByte_Value 0 NO_COMPU_METHOD 0 255 ECU_ADDRESS_EXTENSION 0x2 BYTE_ORDER MSB_LAST /end CHARACTERISTIC
/begin CHARACTERISTIC _g_PL_AD_fw_Radar_1R1V_rpc_LocBypassingRunnable_LocBypassingRunnable_m_pad_ensRLocationsPort_par_out_local.TChangeableMemPool._._._m_arrayPool._0_._elem._m_LocationList._Item._127_._phiVar._m_value "" VALUE 0xB001100E __Float16_Value 0 NO_COMPU_METHOD -65504 65504 ECU_ADDRESS_EXTENSION 0x2 BYTE_ORDER MSB_LAST /end CHARACTERISTIC
/begin CHARACTERISTIC _g_PL_AD_fw_Radar_1R1V_rpc_LocBypassingRunnable_LocBypassingRunnable_m_pad_ensRLocationsPort_par_out_local.TChangeableMemPool._._._m_arrayPool._0_._elem._m_LocationList._Item._127_._theta._m_value "" VALUE 0xB0011006 __Float16_Value 0 NO_COMPU_METHOD -65504 65504 ECU_ADDRESS_EXTENSION 0x2 BYTE_ORDER MSB_LAST /end CHARACTERISTIC
/begin CHARACTERISTIC _g_PL_AD_fw_Radar_1R1V_rpc_LocBypassingRunnable_LocBypassingRunnable_m_pad_ensRLocationsPort_par_out_local.TChangeableMemPool._._._m_arrayPool._0_._elem._m_LocationList._Item._127_._thetaQly "" VALUE 0xB001100A __UByte_Value 0 NO_COMPU_METHOD 0 255 ECU_ADDRESS_EXTENSION 0x2 BYTE_ORDER MSB_LAST /end CHARACTERISTIC
/begin CHARACTERISTIC _g_PL_AD_fw_Radar_1R1V_rpc_LocBypassingRunnable_LocBypassingRunnable_m_pad_ensRLocationsPort_par_out_local.TChangeableMemPool._._._m_arrayPool._0_._elem._m_LocationList._Item._127_._thetaVar._m_value "" VALUE 0xB001100C __Float16_Value 0 NO_COMPU_METHOD -65504 65504 ECU_ADDRESS_EXTENSION 0x2 BYTE_ORDER MSB_LAST /end CHARACTERISTIC
/begin CHARACTERISTIC _g_PL_AD_fw_Radar_1R1V_rpc_LocBypassingRunnable_LocBypassingRunnable_m_pad_ensRLocationsPort_par_out_local.TChangeableMemPool._._._m_arrayPool._0_._elem._m_LocationList._Item._127_._v "" VALUE 0xB0010FFC __Float32_Value 0 NO_COMPU_METHOD -3.4028234663852886E+38 3.4028234663852886E+38 ECU_ADDRESS_EXTENSION 0x2 BYTE_ORDER MSB_LAST /end CHARACTERISTIC
/begin CHARACTERISTIC _g_PL_AD_fw_Radar_1R1V_rpc_LocBypassingRunnable_LocBypassingRunnable_m_pad_ensRLocationsPort_par_out_local.TChangeableMemPool._._._m_arrayPool._0_._elem._m_LocationList._Item._127_._vVar._m_value "" VALUE 0xB0011002 __Float16_Value 0 NO_COMPU_METHOD -65504 65504 ECU_ADDRESS_EXTENSION 0x2 BYTE_ORDER MSB_LAST /end CHARACTERISTIC
/begin CHARACTERISTIC _g_PL_AD_fw_Radar_1R1V_rpc_LocBypassingRunnable_LocBypassingRunnable_m_pad_ensRLocationsPort_par_out_local.TChangeableMemPool._._._m_arrayPool._0_._elem._m_LocationList._Item._128_._Rcs._m_value "" VALUE 0xB0011030 __Float16_Value 0 NO_COMPU_METHOD -65504 65504 ECU_ADDRESS_EXTENSION 0x2 BYTE_ORDER MSB_LAST /end CHARACTERISTIC
/begin CHARACTERISTIC _g_PL_AD_fw_Radar_1R1V_rpc_LocBypassingRunnable_LocBypassingRunnable_m_pad_ensRLocationsPort_par_out_local.TChangeableMemPool._._._m_arrayPool._0_._elem._m_LocationList._Item._128_._Rssi._m_value "" VALUE 0xB0011032 __Float16_Value 0 NO_COMPU_METHOD -65504 65504 ECU_ADDRESS_EXTENSION 0x2 BYTE_ORDER MSB_LAST /end CHARACTERISTIC
/begin CHARACTERISTIC _g_PL_AD_fw_Radar_1R1V_rpc_LocBypassingRunnable_LocBypassingRunnable_m_pad_ensRLocationsPort_par_out_local.TChangeableMemPool._._._m_arrayPool._0_._elem._m_LocationList._Item._128_._d "" VALUE 0xB0011018 __Float32_Value 0 NO_COMPU_METHOD -3.4028234663852886E+38 3.4028234663852886E+38 ECU_ADDRESS_EXTENSION 0x2 BYTE_ORDER MSB_LAST /end CHARACTERISTIC
/begin CHARACTERISTIC _g_PL_AD_fw_Radar_1R1V_rpc_LocBypassingRunnable_LocBypassingRunnable_m_pad_ensRLocationsPort_par_out_local.TChangeableMemPool._._._m_arrayPool._0_._elem._m_LocationList._Item._128_._dVar._m_value "" VALUE 0xB0011020 __Float16_Value 0 NO_COMPU_METHOD -65504 65504 ECU_ADDRESS_EXTENSION 0x2 BYTE_ORDER MSB_LAST /end CHARACTERISTIC
/begin CHARACTERISTIC _g_PL_AD_fw_Radar_1R1V_rpc_LocBypassingRunnable_LocBypassingRunnable_m_pad_ensRLocationsPort_par_out_local.TChangeableMemPool._._._m_arrayPool._0_._elem._m_LocationList._Item._128_._dvCov._m_value "" VALUE 0xB0011024 __Float16_Value 0 NO_COMPU_METHOD -65504 65504 ECU_ADDRESS_EXTENSION 0x2 BYTE_ORDER MSB_LAST /end CHARACTERISTIC
/begin CHARACTERISTIC _g_PL_AD_fw_Radar_1R1V_rpc_LocBypassingRunnable_LocBypassingRunnable_m_pad_ensRLocationsPort_par_out_local.TChangeableMemPool._._._m_arrayPool._0_._elem._m_LocationList._Item._128_._dvQly "" VALUE 0xB0011034 __UByte_Value 0 NO_COMPU_METHOD 0 255 ECU_ADDRESS_EXTENSION 0x2 BYTE_ORDER MSB_LAST /end CHARACTERISTIC
/begin CHARACTERISTIC _g_PL_AD_fw_Radar_1R1V_rpc_LocBypassingRunnable_LocBypassingRunnable_m_pad_ensRLocationsPort_par_out_local.TChangeableMemPool._._._m_arrayPool._0_._elem._m_LocationList._Item._128_._idxAzimuthAmbiguityPeer "" VALUE 0xB0011036 __UWord_Value 0 NO_COMPU_METHOD 0 65535 ECU_ADDRESS_EXTENSION 0x2 BYTE_ORDER MSB_LAST /end CHARACTERISTIC
/begin CHARACTERISTIC _g_PL_AD_fw_Radar_1R1V_rpc_LocBypassingRunnable_LocBypassingRunnable_m_pad_ensRLocationsPort_par_out_local.TChangeableMemPool._._._m_arrayPool._0_._elem._m_LocationList._Item._128_._measStatus "" VALUE 0xB0011035 __UByte_Value 0 NO_COMPU_METHOD 0 255 ECU_ADDRESS_EXTENSION 0x2 BYTE_ORDER MSB_LAST /end CHARACTERISTIC
/begin CHARACTERISTIC _g_PL_AD_fw_Radar_1R1V_rpc_LocBypassingRunnable_LocBypassingRunnable_m_pad_ensRLocationsPort_par_out_local.TChangeableMemPool._._._m_arrayPool._0_._elem._m_LocationList._Item._128_._phi._m_value "" VALUE 0xB0011028 __Float16_Value 0 NO_COMPU_METHOD -65504 65504 ECU_ADDRESS_EXTENSION 0x2 BYTE_ORDER MSB_LAST /end CHARACTERISTIC
/begin CHARACTERISTIC _g_PL_AD_fw_Radar_1R1V_rpc_LocBypassingRunnable_LocBypassingRunnable_m_pad_ensRLocationsPort_par_out_local.TChangeableMemPool._._._m_arrayPool._0_._elem._m_LocationList._Item._128_._phiQly "" VALUE 0xB001102B __UByte_Value 0 NO_COMPU_METHOD 0 255 ECU_ADDRESS_EXTENSION 0x2 BYTE_ORDER MSB_LAST /end CHARACTERISTIC
/begin CHARACTERISTIC _g_PL_AD_fw_Radar_1R1V_rpc_LocBypassingRunnable_LocBypassingRunnable_m_pad_ensRLocationsPort_par_out_local.TChangeableMemPool._._._m_arrayPool._0_._elem._m_LocationList._Item._128_._phiVar._m_value "" VALUE 0xB001102E __Float16_Value 0 NO_COMPU_METHOD -65504 65504 ECU_ADDRESS_EXTENSION 0x2 BYTE_ORDER MSB_LAST /end CHARACTERISTIC
/begin CHARACTERISTIC _g_PL_AD_fw_Radar_1R1V_rpc_LocBypassingRunnable_LocBypassingRunnable_m_pad_ensRLocationsPort_par_out_local.TChangeableMemPool._._._m_arrayPool._0_._elem._m_LocationList._Item._128_._theta._m_value "" VALUE 0xB0011026 __Float16_Value 0 NO_COMPU_METHOD -65504 65504 ECU_ADDRESS_EXTENSION 0x2 BYTE_ORDER MSB_LAST /end CHARACTERISTIC
/begin CHARACTERISTIC _g_PL_AD_fw_Radar_1R1V_rpc_LocBypassingRunnable_LocBypassingRunnable_m_pad_ensRLocationsPort_par_out_local.TChangeableMemPool._._._m_arrayPool._0_._elem._m_LocationList._Item._128_._thetaQly "" VALUE 0xB001102A __UByte_Value 0 NO_COMPU_METHOD 0 255 ECU_ADDRESS_EXTENSION 0x2 BYTE_ORDER MSB_LAST /end CHARACTERISTIC
/begin CHARACTERISTIC _g_PL_AD_fw_Radar_1R1V_rpc_LocBypassingRunnable_LocBypassingRunnable_m_pad_ensRLocationsPort_par_out_local.TChangeableMemPool._._._m_arrayPool._0_._elem._m_LocationList._Item._128_._thetaVar._m_value "" VALUE 0xB001102C __Float16_Value 0 NO_COMPU_METHOD -65504 65504 ECU_ADDRESS_EXTENSION 0x2 BYTE_ORDER MSB_LAST /end CHARACTERISTIC
/begin CHARACTERISTIC _g_PL_AD_fw_Radar_1R1V_rpc_LocBypassingRunnable_LocBypassingRunnable_m_pad_ensRLocationsPort_par_out_local.TChangeableMemPool._._._m_arrayPool._0_._elem._m_LocationList._Item._128_._v "" VALUE 0xB001101C __Float32_Value 0 NO_COMPU_METHOD -3.4028234663852886E+38 3.4028234663852886E+38 ECU_ADDRESS_EXTENSION 0x2 BYTE_ORDER MSB_LAST /end CHARACTERISTIC
/begin CHARACTERISTIC _g_PL_AD_fw_Radar_1R1V_rpc_LocBypassingRunnable_LocBypassingRunnable_m_pad_ensRLocationsPort_par_out_local.TChangeableMemPool._._._m_arrayPool._0_._elem._m_LocationList._Item._128_._vVar._m_value "" VALUE 0xB0011022 __Float16_Value 0 NO_COMPU_METHOD -65504 65504 ECU_ADDRESS_EXTENSION 0x2 BYTE_ORDER MSB_LAST /end CHARACTERISTIC
/begin CHARACTERISTIC _g_PL_AD_fw_Radar_1R1V_rpc_LocBypassingRunnable_LocBypassingRunnable_m_pad_ensRLocationsPort_par_out_local.TChangeableMemPool._._._m_arrayPool._0_._elem._m_LocationList._Item._129_._Rcs._m_value "" VALUE 0xB0011050 __Float16_Value 0 NO_COMPU_METHOD -65504 65504 ECU_ADDRESS_EXTENSION 0x2 BYTE_ORDER MSB_LAST /end CHARACTERISTIC
/begin CHARACTERISTIC _g_PL_AD_fw_Radar_1R1V_rpc_LocBypassingRunnable_LocBypassingRunnable_m_pad_ensRLocationsPort_par_out_local.TChangeableMemPool._._._m_arrayPool._0_._elem._m_LocationList._Item._129_._Rssi._m_value "" VALUE 0xB0011052 __Float16_Value 0 NO_COMPU_METHOD -65504 65504 ECU_ADDRESS_EXTENSION 0x2 BYTE_ORDER MSB_LAST /end CHARACTERISTIC
/begin CHARACTERISTIC _g_PL_AD_fw_Radar_1R1V_rpc_LocBypassingRunnable_LocBypassingRunnable_m_pad_ensRLocationsPort_par_out_local.TChangeableMemPool._._._m_arrayPool._0_._elem._m_LocationList._Item._129_._d "" VALUE 0xB0011038 __Float32_Value 0 NO_COMPU_METHOD -3.4028234663852886E+38 3.4028234663852886E+38 ECU_ADDRESS_EXTENSION 0x2 BYTE_ORDER MSB_LAST /end CHARACTERISTIC
/begin CHARACTERISTIC _g_PL_AD_fw_Radar_1R1V_rpc_LocBypassingRunnable_LocBypassingRunnable_m_pad_ensRLocationsPort_par_out_local.TChangeableMemPool._._._m_arrayPool._0_._elem._m_LocationList._Item._129_._dVar._m_value "" VALUE 0xB0011040 __Float16_Value 0 NO_COMPU_METHOD -65504 65504 ECU_ADDRESS_EXTENSION 0x2 BYTE_ORDER MSB_LAST /end CHARACTERISTIC
/begin CHARACTERISTIC _g_PL_AD_fw_Radar_1R1V_rpc_LocBypassingRunnable_LocBypassingRunnable_m_pad_ensRLocationsPort_par_out_local.TChangeableMemPool._._._m_arrayPool._0_._elem._m_LocationList._Item._129_._dvCov._m_value "" VALUE 0xB0011044 __Float16_Value 0 NO_COMPU_METHOD -65504 65504 ECU_ADDRESS_EXTENSION 0x2 BYTE_ORDER MSB_LAST /end CHARACTERISTIC
/begin CHARACTERISTIC _g_PL_AD_fw_Radar_1R1V_rpc_LocBypassingRunnable_LocBypassingRunnable_m_pad_ensRLocationsPort_par_out_local.TChangeableMemPool._._._m_arrayPool._0_._elem._m_LocationList._Item._129_._dvQly "" VALUE 0xB0011054 __UByte_Value 0 NO_COMPU_METHOD 0 255 ECU_ADDRESS_EXTENSION 0x2 BYTE_ORDER MSB_LAST /end CHARACTERISTIC
/begin CHARACTERISTIC _g_PL_AD_fw_Radar_1R1V_rpc_LocBypassingRunnable_LocBypassingRunnable_m_pad_ensRLocationsPort_par_out_local.TChangeableMemPool._._._m_arrayPool._0_._elem._m_LocationList._Item._129_._idxAzimuthAmbiguityPeer "" VALUE 0xB0011056 __UWord_Value 0 NO_COMPU_METHOD 0 65535 ECU_ADDRESS_EXTENSION 0x2 BYTE_ORDER MSB_LAST /end CHARACTERISTIC
/begin CHARACTERISTIC _g_PL_AD_fw_Radar_1R1V_rpc_LocBypassingRunnable_LocBypassingRunnable_m_pad_ensRLocationsPort_par_out_local.TChangeableMemPool._._._m_arrayPool._0_._elem._m_LocationList._Item._129_._measStatus "" VALUE 0xB0011055 __UByte_Value 0 NO_COMPU_METHOD 0 255 ECU_ADDRESS_EXTENSION 0x2 BYTE_ORDER MSB_LAST /end CHARACTERISTIC
/begin CHARACTERISTIC _g_PL_AD_fw_Radar_1R1V_rpc_LocBypassingRunnable_LocBypassingRunnable_m_pad_ensRLocationsPort_par_out_local.TChangeableMemPool._._._m_arrayPool._0_._elem._m_LocationList._Item._129_._phi._m_value "" VALUE 0xB0011048 __Float16_Value 0 NO_COMPU_METHOD -65504 65504 ECU_ADDRESS_EXTENSION 0x2 BYTE_ORDER MSB_LAST /end CHARACTERISTIC
/begin CHARACTERISTIC _g_PL_AD_fw_Radar_1R1V_rpc_LocBypassingRunnable_LocBypassingRunnable_m_pad_ensRLocationsPort_par_out_local.TChangeableMemPool._._._m_arrayPool._0_._elem._m_LocationList._Item._129_._phiQly "" VALUE 0xB001104B __UByte_Value 0 NO_COMPU_METHOD 0 255 ECU_ADDRESS_EXTENSION 0x2 BYTE_ORDER MSB_LAST /end CHARACTERISTIC
/begin CHARACTERISTIC _g_PL_AD_fw_Radar_1R1V_rpc_LocBypassingRunnable_LocBypassingRunnable_m_pad_ensRLocationsPort_par_out_local.TChangeableMemPool._._._m_arrayPool._0_._elem._m_LocationList._Item._129_._phiVar._m_value "" VALUE 0xB001104E __Float16_Value 0 NO_COMPU_METHOD -65504 65504 ECU_ADDRESS_EXTENSION 0x2 BYTE_ORDER MSB_LAST /end CHARACTERISTIC
/begin CHARACTERISTIC _g_PL_AD_fw_Radar_1R1V_rpc_LocBypassingRunnable_LocBypassingRunnable_m_pad_ensRLocationsPort_par_out_local.TChangeableMemPool._._._m_arrayPool._0_._elem._m_LocationList._Item._129_._theta._m_value "" VALUE 0xB0011046 __Float16_Value 0 NO_COMPU_METHOD -65504 65504 ECU_ADDRESS_EXTENSION 0x2 BYTE_ORDER MSB_LAST /end CHARACTERISTIC
/begin CHARACTERISTIC _g_PL_AD_fw_Radar_1R1V_rpc_LocBypassingRunnable_LocBypassingRunnable_m_pad_ensRLocationsPort_par_out_local.TChangeableMemPool._._._m_arrayPool._0_._elem._m_LocationList._Item._129_._thetaQly "" VALUE 0xB001104A __UByte_Value 0 NO_COMPU_METHOD 0 255 ECU_ADDRESS_EXTENSION 0x2 BYTE_ORDER MSB_LAST /end CHARACTERISTIC
/begin CHARACTERISTIC _g_PL_AD_fw_Radar_1R1V_rpc_LocBypassingRunnable_LocBypassingRunnable_m_pad_ensRLocationsPort_par_out_local.TChangeableMemPool._._._m_arrayPool._0_._elem._m_LocationList._Item._129_._thetaVar._m_value "" VALUE 0xB001104C __Float16_Value 0 NO_COMPU_METHOD -65504 65504 ECU_ADDRESS_EXTENSION 0x2 BYTE_ORDER MSB_LAST /end CHARACTERISTIC
/begin CHARACTERISTIC _g_PL_AD_fw_Radar_1R1V_rpc_LocBypassingRunnable_LocBypassingRunnable_m_pad_ensRLocationsPort_par_out_local.TChangeableMemPool._._._m_arrayPool._0_._elem._m_LocationList._Item._129_._v "" VALUE 0xB001103C __Float32_Value 0 NO_COMPU_METHOD -3.4028234663852886E+38 3.4028234663852886E+38 ECU_ADDRESS_EXTENSION 0x2 BYTE_ORDER MSB_LAST /end CHARACTERISTIC
/begin CHARACTERISTIC _g_PL_AD_fw_Radar_1R1V_rpc_LocBypassingRunnable_LocBypassingRunnable_m_pad_ensRLocationsPort_par_out_local.TChangeableMemPool._._._m_arrayPool._0_._elem._m_LocationList._Item._129_._vVar._m_value "" VALUE 0xB0011042 __Float16_Value 0 NO_COMPU_METHOD -65504 65504 ECU_ADDRESS_EXTENSION 0x2 BYTE_ORDER MSB_LAST /end CHARACTERISTIC
/begin CHARACTERISTIC _g_PL_AD_fw_Radar_1R1V_rpc_LocBypassingRunnable_LocBypassingRunnable_m_pad_ensRLocationsPort_par_out_local.TChangeableMemPool._._._m_arrayPool._0_._elem._m_LocationList._Item._12_._Rcs._m_value "" VALUE 0xB00101B0 __Float16_Value 0 NO_COMPU_METHOD -65504 65504 ECU_ADDRESS_EXTENSION 0x2 BYTE_ORDER MSB_LAST /end CHARACTERISTIC
/begin CHARACTERISTIC _g_PL_AD_fw_Radar_1R1V_rpc_LocBypassingRunnable_LocBypassingRunnable_m_pad_ensRLocationsPort_par_out_local.TChangeableMemPool._._._m_arrayPool._0_._elem._m_LocationList._Item._12_._Rssi._m_value "" VALUE 0xB00101B2 __Float16_Value 0 NO_COMPU_METHOD -65504 65504 ECU_ADDRESS_EXTENSION 0x2 BYTE_ORDER MSB_LAST /end CHARACTERISTIC
/begin CHARACTERISTIC _g_PL_AD_fw_Radar_1R1V_rpc_LocBypassingRunnable_LocBypassingRunnable_m_pad_ensRLocationsPort_par_out_local.TChangeableMemPool._._._m_arrayPool._0_._elem._m_LocationList._Item._12_._d "" VALUE 0xB0010198 __Float32_Value 0 NO_COMPU_METHOD -3.4028234663852886E+38 3.4028234663852886E+38 ECU_ADDRESS_EXTENSION 0x2 BYTE_ORDER MSB_LAST /end CHARACTERISTIC
/begin CHARACTERISTIC _g_PL_AD_fw_Radar_1R1V_rpc_LocBypassingRunnable_LocBypassingRunnable_m_pad_ensRLocationsPort_par_out_local.TChangeableMemPool._._._m_arrayPool._0_._elem._m_LocationList._Item._12_._dVar._m_value "" VALUE 0xB00101A0 __Float16_Value 0 NO_COMPU_METHOD -65504 65504 ECU_ADDRESS_EXTENSION 0x2 BYTE_ORDER MSB_LAST /end CHARACTERISTIC
/begin CHARACTERISTIC _g_PL_AD_fw_Radar_1R1V_rpc_LocBypassingRunnable_LocBypassingRunnable_m_pad_ensRLocationsPort_par_out_local.TChangeableMemPool._._._m_arrayPool._0_._elem._m_LocationList._Item._12_._dvCov._m_value "" VALUE 0xB00101A4 __Float16_Value 0 NO_COMPU_METHOD -65504 65504 ECU_ADDRESS_EXTENSION 0x2 BYTE_ORDER MSB_LAST /end CHARACTERISTIC
/begin CHARACTERISTIC _g_PL_AD_fw_Radar_1R1V_rpc_LocBypassingRunnable_LocBypassingRunnable_m_pad_ensRLocationsPort_par_out_local.TChangeableMemPool._._._m_arrayPool._0_._elem._m_LocationList._Item._12_._dvQly "" VALUE 0xB00101B4 __UByte_Value 0 NO_COMPU_METHOD 0 255 ECU_ADDRESS_EXTENSION 0x2 BYTE_ORDER MSB_LAST /end CHARACTERISTIC
/begin CHARACTERISTIC _g_PL_AD_fw_Radar_1R1V_rpc_LocBypassingRunnable_LocBypassingRunnable_m_pad_ensRLocationsPort_par_out_local.TChangeableMemPool._._._m_arrayPool._0_._elem._m_LocationList._Item._12_._idxAzimuthAmbiguityPeer "" VALUE 0xB00101B6 __UWord_Value 0 NO_COMPU_METHOD 0 65535 ECU_ADDRESS_EXTENSION 0x2 BYTE_ORDER MSB_LAST /end CHARACTERISTIC
/begin CHARACTERISTIC _g_PL_AD_fw_Radar_1R1V_rpc_LocBypassingRunnable_LocBypassingRunnable_m_pad_ensRLocationsPort_par_out_local.TChangeableMemPool._._._m_arrayPool._0_._elem._m_LocationList._Item._12_._measStatus "" VALUE 0xB00101B5 __UByte_Value 0 NO_COMPU_METHOD 0 255 ECU_ADDRESS_EXTENSION 0x2 BYTE_ORDER MSB_LAST /end CHARACTERISTIC
/begin CHARACTERISTIC _g_PL_AD_fw_Radar_1R1V_rpc_LocBypassingRunnable_LocBypassingRunnable_m_pad_ensRLocationsPort_par_out_local.TChangeableMemPool._._._m_arrayPool._0_._elem._m_LocationList._Item._12_._phi._m_value "" VALUE 0xB00101A8 __Float16_Value 0 NO_COMPU_METHOD -65504 65504 ECU_ADDRESS_EXTENSION 0x2 BYTE_ORDER MSB_LAST /end CHARACTERISTIC
/begin CHARACTERISTIC _g_PL_AD_fw_Radar_1R1V_rpc_LocBypassingRunnable_LocBypassingRunnable_m_pad_ensRLocationsPort_par_out_local.TChangeableMemPool._._._m_arrayPool._0_._elem._m_LocationList._Item._12_._phiQly "" VALUE 0xB00101AB __UByte_Value 0 NO_COMPU_METHOD 0 255 ECU_ADDRESS_EXTENSION 0x2 BYTE_ORDER MSB_LAST /end CHARACTERISTIC
/begin CHARACTERISTIC _g_PL_AD_fw_Radar_1R1V_rpc_LocBypassingRunnable_LocBypassingRunnable_m_pad_ensRLocationsPort_par_out_local.TChangeableMemPool._._._m_arrayPool._0_._elem._m_LocationList._Item._12_._phiVar._m_value "" VALUE 0xB00101AE __Float16_Value 0 NO_COMPU_METHOD -65504 65504 ECU_ADDRESS_EXTENSION 0x2 BYTE_ORDER MSB_LAST /end CHARACTERISTIC
/begin CHARACTERISTIC _g_PL_AD_fw_Radar_1R1V_rpc_LocBypassingRunnable_LocBypassingRunnable_m_pad_ensRLocationsPort_par_out_local.TChangeableMemPool._._._m_arrayPool._0_._elem._m_LocationList._Item._12_._theta._m_value "" VALUE 0xB00101A6 __Float16_Value 0 NO_COMPU_METHOD -65504 65504 ECU_ADDRESS_EXTENSION 0x2 BYTE_ORDER MSB_LAST /end CHARACTERISTIC
/begin CHARACTERISTIC _g_PL_AD_fw_Radar_1R1V_rpc_LocBypassingRunnable_LocBypassingRunnable_m_pad_ensRLocationsPort_par_out_local.TChangeableMemPool._._._m_arrayPool._0_._elem._m_LocationList._Item._12_._thetaQly "" VALUE 0xB00101AA __UByte_Value 0 NO_COMPU_METHOD 0 255 ECU_ADDRESS_EXTENSION 0x2 BYTE_ORDER MSB_LAST /end CHARACTERISTIC
/begin CHARACTERISTIC _g_PL_AD_fw_Radar_1R1V_rpc_LocBypassingRunnable_LocBypassingRunnable_m_pad_ensRLocationsPort_par_out_local.TChangeableMemPool._._._m_arrayPool._0_._elem._m_LocationList._Item._12_._thetaVar._m_value "" VALUE 0xB00101AC __Float16_Value 0 NO_COMPU_METHOD -65504 65504 ECU_ADDRESS_EXTENSION 0x2 BYTE_ORDER MSB_LAST /end CHARACTERISTIC
/begin CHARACTERISTIC _g_PL_AD_fw_Radar_1R1V_rpc_LocBypassingRunnable_LocBypassingRunnable_m_pad_ensRLocationsPort_par_out_local.TChangeableMemPool._._._m_arrayPool._0_._elem._m_LocationList._Item._12_._v "" VALUE 0xB001019C __Float32_Value 0 NO_COMPU_METHOD -3.4028234663852886E+38 3.4028234663852886E+38 ECU_ADDRESS_EXTENSION 0x2 BYTE_ORDER MSB_LAST /end CHARACTERISTIC
/begin CHARACTERISTIC _g_PL_AD_fw_Radar_1R1V_rpc_LocBypassingRunnable_LocBypassingRunnable_m_pad_ensRLocationsPort_par_out_local.TChangeableMemPool._._._m_arrayPool._0_._elem._m_LocationList._Item._12_._vVar._m_value "" VALUE 0xB00101A2 __Float16_Value 0 NO_COMPU_METHOD -65504 65504 ECU_ADDRESS_EXTENSION 0x2 BYTE_ORDER MSB_LAST /end CHARACTERISTIC
/begin CHARACTERISTIC _g_PL_AD_fw_Radar_1R1V_rpc_LocBypassingRunnable_LocBypassingRunnable_m_pad_ensRLocationsPort_par_out_local.TChangeableMemPool._._._m_arrayPool._0_._elem._m_LocationList._Item._130_._Rcs._m_value "" VALUE 0xB0011070 __Float16_Value 0 NO_COMPU_METHOD -65504 65504 ECU_ADDRESS_EXTENSION 0x2 BYTE_ORDER MSB_LAST /end CHARACTERISTIC
/begin CHARACTERISTIC _g_PL_AD_fw_Radar_1R1V_rpc_LocBypassingRunnable_LocBypassingRunnable_m_pad_ensRLocationsPort_par_out_local.TChangeableMemPool._._._m_arrayPool._0_._elem._m_LocationList._Item._130_._Rssi._m_value "" VALUE 0xB0011072 __Float16_Value 0 NO_COMPU_METHOD -65504 65504 ECU_ADDRESS_EXTENSION 0x2 BYTE_ORDER MSB_LAST /end CHARACTERISTIC
/begin CHARACTERISTIC _g_PL_AD_fw_Radar_1R1V_rpc_LocBypassingRunnable_LocBypassingRunnable_m_pad_ensRLocationsPort_par_out_local.TChangeableMemPool._._._m_arrayPool._0_._elem._m_LocationList._Item._130_._d "" VALUE 0xB0011058 __Float32_Value 0 NO_COMPU_METHOD -3.4028234663852886E+38 3.4028234663852886E+38 ECU_ADDRESS_EXTENSION 0x2 BYTE_ORDER MSB_LAST /end CHARACTERISTIC
/begin CHARACTERISTIC _g_PL_AD_fw_Radar_1R1V_rpc_LocBypassingRunnable_LocBypassingRunnable_m_pad_ensRLocationsPort_par_out_local.TChangeableMemPool._._._m_arrayPool._0_._elem._m_LocationList._Item._130_._dVar._m_value "" VALUE 0xB0011060 __Float16_Value 0 NO_COMPU_METHOD -65504 65504 ECU_ADDRESS_EXTENSION 0x2 BYTE_ORDER MSB_LAST /end CHARACTERISTIC
/begin CHARACTERISTIC _g_PL_AD_fw_Radar_1R1V_rpc_LocBypassingRunnable_LocBypassingRunnable_m_pad_ensRLocationsPort_par_out_local.TChangeableMemPool._._._m_arrayPool._0_._elem._m_LocationList._Item._130_._dvCov._m_value "" VALUE 0xB0011064 __Float16_Value 0 NO_COMPU_METHOD -65504 65504 ECU_ADDRESS_EXTENSION 0x2 BYTE_ORDER MSB_LAST /end CHARACTERISTIC
/begin CHARACTERISTIC _g_PL_AD_fw_Radar_1R1V_rpc_LocBypassingRunnable_LocBypassingRunnable_m_pad_ensRLocationsPort_par_out_local.TChangeableMemPool._._._m_arrayPool._0_._elem._m_LocationList._Item._130_._dvQly "" VALUE 0xB0011074 __UByte_Value 0 NO_COMPU_METHOD 0 255 ECU_ADDRESS_EXTENSION 0x2 BYTE_ORDER MSB_LAST /end CHARACTERISTIC
/begin CHARACTERISTIC _g_PL_AD_fw_Radar_1R1V_rpc_LocBypassingRunnable_LocBypassingRunnable_m_pad_ensRLocationsPort_par_out_local.TChangeableMemPool._._._m_arrayPool._0_._elem._m_LocationList._Item._130_._idxAzimuthAmbiguityPeer "" VALUE 0xB0011076 __UWord_Value 0 NO_COMPU_METHOD 0 65535 ECU_ADDRESS_EXTENSION 0x2 BYTE_ORDER MSB_LAST /end CHARACTERISTIC
/begin CHARACTERISTIC _g_PL_AD_fw_Radar_1R1V_rpc_LocBypassingRunnable_LocBypassingRunnable_m_pad_ensRLocationsPort_par_out_local.TChangeableMemPool._._._m_arrayPool._0_._elem._m_LocationList._Item._130_._measStatus "" VALUE 0xB0011075 __UByte_Value 0 NO_COMPU_METHOD 0 255 ECU_ADDRESS_EXTENSION 0x2 BYTE_ORDER MSB_LAST /end CHARACTERISTIC
/begin CHARACTERISTIC _g_PL_AD_fw_Radar_1R1V_rpc_LocBypassingRunnable_LocBypassingRunnable_m_pad_ensRLocationsPort_par_out_local.TChangeableMemPool._._._m_arrayPool._0_._elem._m_LocationList._Item._130_._phi._m_value "" VALUE 0xB0011068 __Float16_Value 0 NO_COMPU_METHOD -65504 65504 ECU_ADDRESS_EXTENSION 0x2 BYTE_ORDER MSB_LAST /end CHARACTERISTIC
/begin CHARACTERISTIC _g_PL_AD_fw_Radar_1R1V_rpc_LocBypassingRunnable_LocBypassingRunnable_m_pad_ensRLocationsPort_par_out_local.TChangeableMemPool._._._m_arrayPool._0_._elem._m_LocationList._Item._130_._phiQly "" VALUE 0xB001106B __UByte_Value 0 NO_COMPU_METHOD 0 255 ECU_ADDRESS_EXTENSION 0x2 BYTE_ORDER MSB_LAST /end CHARACTERISTIC
/begin CHARACTERISTIC _g_PL_AD_fw_Radar_1R1V_rpc_LocBypassingRunnable_LocBypassingRunnable_m_pad_ensRLocationsPort_par_out_local.TChangeableMemPool._._._m_arrayPool._0_._elem._m_LocationList._Item._130_._phiVar._m_value "" VALUE 0xB001106E __Float16_Value 0 NO_COMPU_METHOD -65504 65504 ECU_ADDRESS_EXTENSION 0x2 BYTE_ORDER MSB_LAST /end CHARACTERISTIC
/begin CHARACTERISTIC _g_PL_AD_fw_Radar_1R1V_rpc_LocBypassingRunnable_LocBypassingRunnable_m_pad_ensRLocationsPort_par_out_local.TChangeableMemPool._._._m_arrayPool._0_._elem._m_LocationList._Item._130_._theta._m_value "" VALUE 0xB0011066 __Float16_Value 0 NO_COMPU_METHOD -65504 65504 ECU_ADDRESS_EXTENSION 0x2 BYTE_ORDER MSB_LAST /end CHARACTERISTIC
/begin CHARACTERISTIC _g_PL_AD_fw_Radar_1R1V_rpc_LocBypassingRunnable_LocBypassingRunnable_m_pad_ensRLocationsPort_par_out_local.TChangeableMemPool._._._m_arrayPool._0_._elem._m_LocationList._Item._130_._thetaQly "" VALUE 0xB001106A __UByte_Value 0 NO_COMPU_METHOD 0 255 ECU_ADDRESS_EXTENSION 0x2 BYTE_ORDER MSB_LAST /end CHARACTERISTIC
/begin CHARACTERISTIC _g_PL_AD_fw_Radar_1R1V_rpc_LocBypassingRunnable_LocBypassingRunnable_m_pad_ensRLocationsPort_par_out_local.TChangeableMemPool._._._m_arrayPool._0_._elem._m_LocationList._Item._130_._thetaVar._m_value "" VALUE 0xB001106C __Float16_Value 0 NO_COMPU_METHOD -65504 65504 ECU_ADDRESS_EXTENSION 0x2 BYTE_ORDER MSB_LAST /end CHARACTERISTIC
/begin CHARACTERISTIC _g_PL_AD_fw_Radar_1R1V_rpc_LocBypassingRunnable_LocBypassingRunnable_m_pad_ensRLocationsPort_par_out_local.TChangeableMemPool._._._m_arrayPool._0_._elem._m_LocationList._Item._130_._v "" VALUE 0xB001105C __Float32_Value 0 NO_COMPU_METHOD -3.4028234663852886E+38 3.4028234663852886E+38 ECU_ADDRESS_EXTENSION 0x2 BYTE_ORDER MSB_LAST /end CHARACTERISTIC
/begin CHARACTERISTIC _g_PL_AD_fw_Radar_1R1V_rpc_LocBypassingRunnable_LocBypassingRunnable_m_pad_ensRLocationsPort_par_out_local.TChangeableMemPool._._._m_arrayPool._0_._elem._m_LocationList._Item._130_._vVar._m_value "" VALUE 0xB0011062 __Float16_Value 0 NO_COMPU_METHOD -65504 65504 ECU_ADDRESS_EXTENSION 0x2 BYTE_ORDER MSB_LAST /end CHARACTERISTIC
/begin CHARACTERISTIC _g_PL_AD_fw_Radar_1R1V_rpc_LocBypassingRunnable_LocBypassingRunnable_m_pad_ensRLocationsPort_par_out_local.TChangeableMemPool._._._m_arrayPool._0_._elem._m_LocationList._Item._131_._Rcs._m_value "" VALUE 0xB0011090 __Float16_Value 0 NO_COMPU_METHOD -65504 65504 ECU_ADDRESS_EXTENSION 0x2 BYTE_ORDER MSB_LAST /end CHARACTERISTIC
/begin CHARACTERISTIC _g_PL_AD_fw_Radar_1R1V_rpc_LocBypassingRunnable_LocBypassingRunnable_m_pad_ensRLocationsPort_par_out_local.TChangeableMemPool._._._m_arrayPool._0_._elem._m_LocationList._Item._131_._Rssi._m_value "" VALUE 0xB0011092 __Float16_Value 0 NO_COMPU_METHOD -65504 65504 ECU_ADDRESS_EXTENSION 0x2 BYTE_ORDER MSB_LAST /end CHARACTERISTIC
/begin CHARACTERISTIC _g_PL_AD_fw_Radar_1R1V_rpc_LocBypassingRunnable_LocBypassingRunnable_m_pad_ensRLocationsPort_par_out_local.TChangeableMemPool._._._m_arrayPool._0_._elem._m_LocationList._Item._131_._d "" VALUE 0xB0011078 __Float32_Value 0 NO_COMPU_METHOD -3.4028234663852886E+38 3.4028234663852886E+38 ECU_ADDRESS_EXTENSION 0x2 BYTE_ORDER MSB_LAST /end CHARACTERISTIC
/begin CHARACTERISTIC _g_PL_AD_fw_Radar_1R1V_rpc_LocBypassingRunnable_LocBypassingRunnable_m_pad_ensRLocationsPort_par_out_local.TChangeableMemPool._._._m_arrayPool._0_._elem._m_LocationList._Item._131_._dVar._m_value "" VALUE 0xB0011080 __Float16_Value 0 NO_COMPU_METHOD -65504 65504 ECU_ADDRESS_EXTENSION 0x2 BYTE_ORDER MSB_LAST /end CHARACTERISTIC
/begin CHARACTERISTIC _g_PL_AD_fw_Radar_1R1V_rpc_LocBypassingRunnable_LocBypassingRunnable_m_pad_ensRLocationsPort_par_out_local.TChangeableMemPool._._._m_arrayPool._0_._elem._m_LocationList._Item._131_._dvCov._m_value "" VALUE 0xB0011084 __Float16_Value 0 NO_COMPU_METHOD -65504 65504 ECU_ADDRESS_EXTENSION 0x2 BYTE_ORDER MSB_LAST /end CHARACTERISTIC
/begin CHARACTERISTIC _g_PL_AD_fw_Radar_1R1V_rpc_LocBypassingRunnable_LocBypassingRunnable_m_pad_ensRLocationsPort_par_out_local.TChangeableMemPool._._._m_arrayPool._0_._elem._m_LocationList._Item._131_._dvQly "" VALUE 0xB0011094 __UByte_Value 0 NO_COMPU_METHOD 0 255 ECU_ADDRESS_EXTENSION 0x2 BYTE_ORDER MSB_LAST /end CHARACTERISTIC
/begin CHARACTERISTIC _g_PL_AD_fw_Radar_1R1V_rpc_LocBypassingRunnable_LocBypassingRunnable_m_pad_ensRLocationsPort_par_out_local.TChangeableMemPool._._._m_arrayPool._0_._elem._m_LocationList._Item._131_._idxAzimuthAmbiguityPeer "" VALUE 0xB0011096 __UWord_Value 0 NO_COMPU_METHOD 0 65535 ECU_ADDRESS_EXTENSION 0x2 BYTE_ORDER MSB_LAST /end CHARACTERISTIC
/begin CHARACTERISTIC _g_PL_AD_fw_Radar_1R1V_rpc_LocBypassingRunnable_LocBypassingRunnable_m_pad_ensRLocationsPort_par_out_local.TChangeableMemPool._._._m_arrayPool._0_._elem._m_LocationList._Item._131_._measStatus "" VALUE 0xB0011095 __UByte_Value 0 NO_COMPU_METHOD 0 255 ECU_ADDRESS_EXTENSION 0x2 BYTE_ORDER MSB_LAST /end CHARACTERISTIC
/begin CHARACTERISTIC _g_PL_AD_fw_Radar_1R1V_rpc_LocBypassingRunnable_LocBypassingRunnable_m_pad_ensRLocationsPort_par_out_local.TChangeableMemPool._._._m_arrayPool._0_._elem._m_LocationList._Item._131_._phi._m_value "" VALUE 0xB0011088 __Float16_Value 0 NO_COMPU_METHOD -65504 65504 ECU_ADDRESS_EXTENSION 0x2 BYTE_ORDER MSB_LAST /end CHARACTERISTIC
/begin CHARACTERISTIC _g_PL_AD_fw_Radar_1R1V_rpc_LocBypassingRunnable_LocBypassingRunnable_m_pad_ensRLocationsPort_par_out_local.TChangeableMemPool._._._m_arrayPool._0_._elem._m_LocationList._Item._131_._phiQly "" VALUE 0xB001108B __UByte_Value 0 NO_COMPU_METHOD 0 255 ECU_ADDRESS_EXTENSION 0x2 BYTE_ORDER MSB_LAST /end CHARACTERISTIC
/begin CHARACTERISTIC _g_PL_AD_fw_Radar_1R1V_rpc_LocBypassingRunnable_LocBypassingRunnable_m_pad_ensRLocationsPort_par_out_local.TChangeableMemPool._._._m_arrayPool._0_._elem._m_LocationList._Item._131_._phiVar._m_value "" VALUE 0xB001108E __Float16_Value 0 NO_COMPU_METHOD -65504 65504 ECU_ADDRESS_EXTENSION 0x2 BYTE_ORDER MSB_LAST /end CHARACTERISTIC
/begin CHARACTERISTIC _g_PL_AD_fw_Radar_1R1V_rpc_LocBypassingRunnable_LocBypassingRunnable_m_pad_ensRLocationsPort_par_out_local.TChangeableMemPool._._._m_arrayPool._0_._elem._m_LocationList._Item._131_._theta._m_value "" VALUE 0xB0011086 __Float16_Value 0 NO_COMPU_METHOD -65504 65504 ECU_ADDRESS_EXTENSION 0x2 BYTE_ORDER MSB_LAST /end CHARACTERISTIC
/begin CHARACTERISTIC _g_PL_AD_fw_Radar_1R1V_rpc_LocBypassingRunnable_LocBypassingRunnable_m_pad_ensRLocationsPort_par_out_local.TChangeableMemPool._._._m_arrayPool._0_._elem._m_LocationList._Item._131_._thetaQly "" VALUE 0xB001108A __UByte_Value 0 NO_COMPU_METHOD 0 255 ECU_ADDRESS_EXTENSION 0x2 BYTE_ORDER MSB_LAST /end CHARACTERISTIC
/begin CHARACTERISTIC _g_PL_AD_fw_Radar_1R1V_rpc_LocBypassingRunnable_LocBypassingRunnable_m_pad_ensRLocationsPort_par_out_local.TChangeableMemPool._._._m_arrayPool._0_._elem._m_LocationList._Item._131_._thetaVar._m_value "" VALUE 0xB001108C __Float16_Value 0 NO_COMPU_METHOD -65504 65504 ECU_ADDRESS_EXTENSION 0x2 BYTE_ORDER MSB_LAST /end CHARACTERISTIC
/begin CHARACTERISTIC _g_PL_AD_fw_Radar_1R1V_rpc_LocBypassingRunnable_LocBypassingRunnable_m_pad_ensRLocationsPort_par_out_local.TChangeableMemPool._._._m_arrayPool._0_._elem._m_LocationList._Item._131_._v "" VALUE 0xB001107C __Float32_Value 0 NO_COMPU_METHOD -3.4028234663852886E+38 3.4028234663852886E+38 ECU_ADDRESS_EXTENSION 0x2 BYTE_ORDER MSB_LAST /end CHARACTERISTIC
/begin CHARACTERISTIC _g_PL_AD_fw_Radar_1R1V_rpc_LocBypassingRunnable_LocBypassingRunnable_m_pad_ensRLocationsPort_par_out_local.TChangeableMemPool._._._m_arrayPool._0_._elem._m_LocationList._Item._131_._vVar._m_value "" VALUE 0xB0011082 __Float16_Value 0 NO_COMPU_METHOD -65504 65504 ECU_ADDRESS_EXTENSION 0x2 BYTE_ORDER MSB_LAST /end CHARACTERISTIC
/begin CHARACTERISTIC _g_PL_AD_fw_Radar_1R1V_rpc_LocBypassingRunnable_LocBypassingRunnable_m_pad_ensRLocationsPort_par_out_local.TChangeableMemPool._._._m_arrayPool._0_._elem._m_LocationList._Item._132_._Rcs._m_value "" VALUE 0xB00110B0 __Float16_Value 0 NO_COMPU_METHOD -65504 65504 ECU_ADDRESS_EXTENSION 0x2 BYTE_ORDER MSB_LAST /end CHARACTERISTIC
/begin CHARACTERISTIC _g_PL_AD_fw_Radar_1R1V_rpc_LocBypassingRunnable_LocBypassingRunnable_m_pad_ensRLocationsPort_par_out_local.TChangeableMemPool._._._m_arrayPool._0_._elem._m_LocationList._Item._132_._Rssi._m_value "" VALUE 0xB00110B2 __Float16_Value 0 NO_COMPU_METHOD -65504 65504 ECU_ADDRESS_EXTENSION 0x2 BYTE_ORDER MSB_LAST /end CHARACTERISTIC
/begin CHARACTERISTIC _g_PL_AD_fw_Radar_1R1V_rpc_LocBypassingRunnable_LocBypassingRunnable_m_pad_ensRLocationsPort_par_out_local.TChangeableMemPool._._._m_arrayPool._0_._elem._m_LocationList._Item._132_._d "" VALUE 0xB0011098 __Float32_Value 0 NO_COMPU_METHOD -3.4028234663852886E+38 3.4028234663852886E+38 ECU_ADDRESS_EXTENSION 0x2 BYTE_ORDER MSB_LAST /end CHARACTERISTIC
/begin CHARACTERISTIC _g_PL_AD_fw_Radar_1R1V_rpc_LocBypassingRunnable_LocBypassingRunnable_m_pad_ensRLocationsPort_par_out_local.TChangeableMemPool._._._m_arrayPool._0_._elem._m_LocationList._Item._132_._dVar._m_value "" VALUE 0xB00110A0 __Float16_Value 0 NO_COMPU_METHOD -65504 65504 ECU_ADDRESS_EXTENSION 0x2 BYTE_ORDER MSB_LAST /end CHARACTERISTIC
/begin CHARACTERISTIC _g_PL_AD_fw_Radar_1R1V_rpc_LocBypassingRunnable_LocBypassingRunnable_m_pad_ensRLocationsPort_par_out_local.TChangeableMemPool._._._m_arrayPool._0_._elem._m_LocationList._Item._132_._dvCov._m_value "" VALUE 0xB00110A4 __Float16_Value 0 NO_COMPU_METHOD -65504 65504 ECU_ADDRESS_EXTENSION 0x2 BYTE_ORDER MSB_LAST /end CHARACTERISTIC
/begin CHARACTERISTIC _g_PL_AD_fw_Radar_1R1V_rpc_LocBypassingRunnable_LocBypassingRunnable_m_pad_ensRLocationsPort_par_out_local.TChangeableMemPool._._._m_arrayPool._0_._elem._m_LocationList._Item._132_._dvQly "" VALUE 0xB00110B4 __UByte_Value 0 NO_COMPU_METHOD 0 255 ECU_ADDRESS_EXTENSION 0x2 BYTE_ORDER MSB_LAST /end CHARACTERISTIC
/begin CHARACTERISTIC _g_PL_AD_fw_Radar_1R1V_rpc_LocBypassingRunnable_LocBypassingRunnable_m_pad_ensRLocationsPort_par_out_local.TChangeableMemPool._._._m_arrayPool._0_._elem._m_LocationList._Item._132_._idxAzimuthAmbiguityPeer "" VALUE 0xB00110B6 __UWord_Value 0 NO_COMPU_METHOD 0 65535 ECU_ADDRESS_EXTENSION 0x2 BYTE_ORDER MSB_LAST /end CHARACTERISTIC
/begin CHARACTERISTIC _g_PL_AD_fw_Radar_1R1V_rpc_LocBypassingRunnable_LocBypassingRunnable_m_pad_ensRLocationsPort_par_out_local.TChangeableMemPool._._._m_arrayPool._0_._elem._m_LocationList._Item._132_._measStatus "" VALUE 0xB00110B5 __UByte_Value 0 NO_COMPU_METHOD 0 255 ECU_ADDRESS_EXTENSION 0x2 BYTE_ORDER MSB_LAST /end CHARACTERISTIC
/begin CHARACTERISTIC _g_PL_AD_fw_Radar_1R1V_rpc_LocBypassingRunnable_LocBypassingRunnable_m_pad_ensRLocationsPort_par_out_local.TChangeableMemPool._._._m_arrayPool._0_._elem._m_LocationList._Item._132_._phi._m_value "" VALUE 0xB00110A8 __Float16_Value 0 NO_COMPU_METHOD -65504 65504 ECU_ADDRESS_EXTENSION 0x2 BYTE_ORDER MSB_LAST /end CHARACTERISTIC
/begin CHARACTERISTIC _g_PL_AD_fw_Radar_1R1V_rpc_LocBypassingRunnable_LocBypassingRunnable_m_pad_ensRLocationsPort_par_out_local.TChangeableMemPool._._._m_arrayPool._0_._elem._m_LocationList._Item._132_._phiQly "" VALUE 0xB00110AB __UByte_Value 0 NO_COMPU_METHOD 0 255 ECU_ADDRESS_EXTENSION 0x2 BYTE_ORDER MSB_LAST /end CHARACTERISTIC
/begin CHARACTERISTIC _g_PL_AD_fw_Radar_1R1V_rpc_LocBypassingRunnable_LocBypassingRunnable_m_pad_ensRLocationsPort_par_out_local.TChangeableMemPool._._._m_arrayPool._0_._elem._m_LocationList._Item._132_._phiVar._m_value "" VALUE 0xB00110AE __Float16_Value 0 NO_COMPU_METHOD -65504 65504 ECU_ADDRESS_EXTENSION 0x2 BYTE_ORDER MSB_LAST /end CHARACTERISTIC
/begin CHARACTERISTIC _g_PL_AD_fw_Radar_1R1V_rpc_LocBypassingRunnable_LocBypassingRunnable_m_pad_ensRLocationsPort_par_out_local.TChangeableMemPool._._._m_arrayPool._0_._elem._m_LocationList._Item._132_._theta._m_value "" VALUE 0xB00110A6 __Float16_Value 0 NO_COMPU_METHOD -65504 65504 ECU_ADDRESS_EXTENSION 0x2 BYTE_ORDER MSB_LAST /end CHARACTERISTIC
/begin CHARACTERISTIC _g_PL_AD_fw_Radar_1R1V_rpc_LocBypassingRunnable_LocBypassingRunnable_m_pad_ensRLocationsPort_par_out_local.TChangeableMemPool._._._m_arrayPool._0_._elem._m_LocationList._Item._132_._thetaQly "" VALUE 0xB00110AA __UByte_Value 0 NO_COMPU_METHOD 0 255 ECU_ADDRESS_EXTENSION 0x2 BYTE_ORDER MSB_LAST /end CHARACTERISTIC
/begin CHARACTERISTIC _g_PL_AD_fw_Radar_1R1V_rpc_LocBypassingRunnable_LocBypassingRunnable_m_pad_ensRLocationsPort_par_out_local.TChangeableMemPool._._._m_arrayPool._0_._elem._m_LocationList._Item._132_._thetaVar._m_value "" VALUE 0xB00110AC __Float16_Value 0 NO_COMPU_METHOD -65504 65504 ECU_ADDRESS_EXTENSION 0x2 BYTE_ORDER MSB_LAST /end CHARACTERISTIC
/begin CHARACTERISTIC _g_PL_AD_fw_Radar_1R1V_rpc_LocBypassingRunnable_LocBypassingRunnable_m_pad_ensRLocationsPort_par_out_local.TChangeableMemPool._._._m_arrayPool._0_._elem._m_LocationList._Item._132_._v "" VALUE 0xB001109C __Float32_Value 0 NO_COMPU_METHOD -3.4028234663852886E+38 3.4028234663852886E+38 ECU_ADDRESS_EXTENSION 0x2 BYTE_ORDER MSB_LAST /end CHARACTERISTIC
/begin CHARACTERISTIC _g_PL_AD_fw_Radar_1R1V_rpc_LocBypassingRunnable_LocBypassingRunnable_m_pad_ensRLocationsPort_par_out_local.TChangeableMemPool._._._m_arrayPool._0_._elem._m_LocationList._Item._132_._vVar._m_value "" VALUE 0xB00110A2 __Float16_Value 0 NO_COMPU_METHOD -65504 65504 ECU_ADDRESS_EXTENSION 0x2 BYTE_ORDER MSB_LAST /end CHARACTERISTIC
/begin CHARACTERISTIC _g_PL_AD_fw_Radar_1R1V_rpc_LocBypassingRunnable_LocBypassingRunnable_m_pad_ensRLocationsPort_par_out_local.TChangeableMemPool._._._m_arrayPool._0_._elem._m_LocationList._Item._133_._Rcs._m_value "" VALUE 0xB00110D0 __Float16_Value 0 NO_COMPU_METHOD -65504 65504 ECU_ADDRESS_EXTENSION 0x2 BYTE_ORDER MSB_LAST /end CHARACTERISTIC
/begin CHARACTERISTIC _g_PL_AD_fw_Radar_1R1V_rpc_LocBypassingRunnable_LocBypassingRunnable_m_pad_ensRLocationsPort_par_out_local.TChangeableMemPool._._._m_arrayPool._0_._elem._m_LocationList._Item._133_._Rssi._m_value "" VALUE 0xB00110D2 __Float16_Value 0 NO_COMPU_METHOD -65504 65504 ECU_ADDRESS_EXTENSION 0x2 BYTE_ORDER MSB_LAST /end CHARACTERISTIC
/begin CHARACTERISTIC _g_PL_AD_fw_Radar_1R1V_rpc_LocBypassingRunnable_LocBypassingRunnable_m_pad_ensRLocationsPort_par_out_local.TChangeableMemPool._._._m_arrayPool._0_._elem._m_LocationList._Item._133_._d "" VALUE 0xB00110B8 __Float32_Value 0 NO_COMPU_METHOD -3.4028234663852886E+38 3.4028234663852886E+38 ECU_ADDRESS_EXTENSION 0x2 BYTE_ORDER MSB_LAST /end CHARACTERISTIC
/begin CHARACTERISTIC _g_PL_AD_fw_Radar_1R1V_rpc_LocBypassingRunnable_LocBypassingRunnable_m_pad_ensRLocationsPort_par_out_local.TChangeableMemPool._._._m_arrayPool._0_._elem._m_LocationList._Item._133_._dVar._m_value "" VALUE 0xB00110C0 __Float16_Value 0 NO_COMPU_METHOD -65504 65504 ECU_ADDRESS_EXTENSION 0x2 BYTE_ORDER MSB_LAST /end CHARACTERISTIC
/begin CHARACTERISTIC _g_PL_AD_fw_Radar_1R1V_rpc_LocBypassingRunnable_LocBypassingRunnable_m_pad_ensRLocationsPort_par_out_local.TChangeableMemPool._._._m_arrayPool._0_._elem._m_LocationList._Item._133_._dvCov._m_value "" VALUE 0xB00110C4 __Float16_Value 0 NO_COMPU_METHOD -65504 65504 ECU_ADDRESS_EXTENSION 0x2 BYTE_ORDER MSB_LAST /end CHARACTERISTIC
/begin CHARACTERISTIC _g_PL_AD_fw_Radar_1R1V_rpc_LocBypassingRunnable_LocBypassingRunnable_m_pad_ensRLocationsPort_par_out_local.TChangeableMemPool._._._m_arrayPool._0_._elem._m_LocationList._Item._133_._dvQly "" VALUE 0xB00110D4 __UByte_Value 0 NO_COMPU_METHOD 0 255 ECU_ADDRESS_EXTENSION 0x2 BYTE_ORDER MSB_LAST /end CHARACTERISTIC
/begin CHARACTERISTIC _g_PL_AD_fw_Radar_1R1V_rpc_LocBypassingRunnable_LocBypassingRunnable_m_pad_ensRLocationsPort_par_out_local.TChangeableMemPool._._._m_arrayPool._0_._elem._m_LocationList._Item._133_._idxAzimuthAmbiguityPeer "" VALUE 0xB00110D6 __UWord_Value 0 NO_COMPU_METHOD 0 65535 ECU_ADDRESS_EXTENSION 0x2 BYTE_ORDER MSB_LAST /end CHARACTERISTIC
/begin CHARACTERISTIC _g_PL_AD_fw_Radar_1R1V_rpc_LocBypassingRunnable_LocBypassingRunnable_m_pad_ensRLocationsPort_par_out_local.TChangeableMemPool._._._m_arrayPool._0_._elem._m_LocationList._Item._133_._measStatus "" VALUE 0xB00110D5 __UByte_Value 0 NO_COMPU_METHOD 0 255 ECU_ADDRESS_EXTENSION 0x2 BYTE_ORDER MSB_LAST /end CHARACTERISTIC
/begin CHARACTERISTIC _g_PL_AD_fw_Radar_1R1V_rpc_LocBypassingRunnable_LocBypassingRunnable_m_pad_ensRLocationsPort_par_out_local.TChangeableMemPool._._._m_arrayPool._0_._elem._m_LocationList._Item._133_._phi._m_value "" VALUE 0xB00110C8 __Float16_Value 0 NO_COMPU_METHOD -65504 65504 ECU_ADDRESS_EXTENSION 0x2 BYTE_ORDER MSB_LAST /end CHARACTERISTIC
/begin CHARACTERISTIC _g_PL_AD_fw_Radar_1R1V_rpc_LocBypassingRunnable_LocBypassingRunnable_m_pad_ensRLocationsPort_par_out_local.TChangeableMemPool._._._m_arrayPool._0_._elem._m_LocationList._Item._133_._phiQly "" VALUE 0xB00110CB __UByte_Value 0 NO_COMPU_METHOD 0 255 ECU_ADDRESS_EXTENSION 0x2 BYTE_ORDER MSB_LAST /end CHARACTERISTIC
/begin CHARACTERISTIC _g_PL_AD_fw_Radar_1R1V_rpc_LocBypassingRunnable_LocBypassingRunnable_m_pad_ensRLocationsPort_par_out_local.TChangeableMemPool._._._m_arrayPool._0_._elem._m_LocationList._Item._133_._phiVar._m_value "" VALUE 0xB00110CE __Float16_Value 0 NO_COMPU_METHOD -65504 65504 ECU_ADDRESS_EXTENSION 0x2 BYTE_ORDER MSB_LAST /end CHARACTERISTIC
/begin CHARACTERISTIC _g_PL_AD_fw_Radar_1R1V_rpc_LocBypassingRunnable_LocBypassingRunnable_m_pad_ensRLocationsPort_par_out_local.TChangeableMemPool._._._m_arrayPool._0_._elem._m_LocationList._Item._133_._theta._m_value "" VALUE 0xB00110C6 __Float16_Value 0 NO_COMPU_METHOD -65504 65504 ECU_ADDRESS_EXTENSION 0x2 BYTE_ORDER MSB_LAST /end CHARACTERISTIC
/begin CHARACTERISTIC _g_PL_AD_fw_Radar_1R1V_rpc_LocBypassingRunnable_LocBypassingRunnable_m_pad_ensRLocationsPort_par_out_local.TChangeableMemPool._._._m_arrayPool._0_._elem._m_LocationList._Item._133_._thetaQly "" VALUE 0xB00110CA __UByte_Value 0 NO_COMPU_METHOD 0 255 ECU_ADDRESS_EXTENSION 0x2 BYTE_ORDER MSB_LAST /end CHARACTERISTIC
/begin CHARACTERISTIC _g_PL_AD_fw_Radar_1R1V_rpc_LocBypassingRunnable_LocBypassingRunnable_m_pad_ensRLocationsPort_par_out_local.TChangeableMemPool._._._m_arrayPool._0_._elem._m_LocationList._Item._133_._thetaVar._m_value "" VALUE 0xB00110CC __Float16_Value 0 NO_COMPU_METHOD -65504 65504 ECU_ADDRESS_EXTENSION 0x2 BYTE_ORDER MSB_LAST /end CHARACTERISTIC
/begin CHARACTERISTIC _g_PL_AD_fw_Radar_1R1V_rpc_LocBypassingRunnable_LocBypassingRunnable_m_pad_ensRLocationsPort_par_out_local.TChangeableMemPool._._._m_arrayPool._0_._elem._m_LocationList._Item._133_._v "" VALUE 0xB00110BC __Float32_Value 0 NO_COMPU_METHOD -3.4028234663852886E+38 3.4028234663852886E+38 ECU_ADDRESS_EXTENSION 0x2 BYTE_ORDER MSB_LAST /end CHARACTERISTIC
/begin CHARACTERISTIC _g_PL_AD_fw_Radar_1R1V_rpc_LocBypassingRunnable_LocBypassingRunnable_m_pad_ensRLocationsPort_par_out_local.TChangeableMemPool._._._m_arrayPool._0_._elem._m_LocationList._Item._133_._vVar._m_value "" VALUE 0xB00110C2 __Float16_Value 0 NO_COMPU_METHOD -65504 65504 ECU_ADDRESS_EXTENSION 0x2 BYTE_ORDER MSB_LAST /end CHARACTERISTIC
/begin CHARACTERISTIC _g_PL_AD_fw_Radar_1R1V_rpc_LocBypassingRunnable_LocBypassingRunnable_m_pad_ensRLocationsPort_par_out_local.TChangeableMemPool._._._m_arrayPool._0_._elem._m_LocationList._Item._134_._Rcs._m_value "" VALUE 0xB00110F0 __Float16_Value 0 NO_COMPU_METHOD -65504 65504 ECU_ADDRESS_EXTENSION 0x2 BYTE_ORDER MSB_LAST /end CHARACTERISTIC
/begin CHARACTERISTIC _g_PL_AD_fw_Radar_1R1V_rpc_LocBypassingRunnable_LocBypassingRunnable_m_pad_ensRLocationsPort_par_out_local.TChangeableMemPool._._._m_arrayPool._0_._elem._m_LocationList._Item._134_._Rssi._m_value "" VALUE 0xB00110F2 __Float16_Value 0 NO_COMPU_METHOD -65504 65504 ECU_ADDRESS_EXTENSION 0x2 BYTE_ORDER MSB_LAST /end CHARACTERISTIC
/begin CHARACTERISTIC _g_PL_AD_fw_Radar_1R1V_rpc_LocBypassingRunnable_LocBypassingRunnable_m_pad_ensRLocationsPort_par_out_local.TChangeableMemPool._._._m_arrayPool._0_._elem._m_LocationList._Item._134_._d "" VALUE 0xB00110D8 __Float32_Value 0 NO_COMPU_METHOD -3.4028234663852886E+38 3.4028234663852886E+38 ECU_ADDRESS_EXTENSION 0x2 BYTE_ORDER MSB_LAST /end CHARACTERISTIC
/begin CHARACTERISTIC _g_PL_AD_fw_Radar_1R1V_rpc_LocBypassingRunnable_LocBypassingRunnable_m_pad_ensRLocationsPort_par_out_local.TChangeableMemPool._._._m_arrayPool._0_._elem._m_LocationList._Item._134_._dVar._m_value "" VALUE 0xB00110E0 __Float16_Value 0 NO_COMPU_METHOD -65504 65504 ECU_ADDRESS_EXTENSION 0x2 BYTE_ORDER MSB_LAST /end CHARACTERISTIC
/begin CHARACTERISTIC _g_PL_AD_fw_Radar_1R1V_rpc_LocBypassingRunnable_LocBypassingRunnable_m_pad_ensRLocationsPort_par_out_local.TChangeableMemPool._._._m_arrayPool._0_._elem._m_LocationList._Item._134_._dvCov._m_value "" VALUE 0xB00110E4 __Float16_Value 0 NO_COMPU_METHOD -65504 65504 ECU_ADDRESS_EXTENSION 0x2 BYTE_ORDER MSB_LAST /end CHARACTERISTIC
/begin CHARACTERISTIC _g_PL_AD_fw_Radar_1R1V_rpc_LocBypassingRunnable_LocBypassingRunnable_m_pad_ensRLocationsPort_par_out_local.TChangeableMemPool._._._m_arrayPool._0_._elem._m_LocationList._Item._134_._dvQly "" VALUE 0xB00110F4 __UByte_Value 0 NO_COMPU_METHOD 0 255 ECU_ADDRESS_EXTENSION 0x2 BYTE_ORDER MSB_LAST /end CHARACTERISTIC
/begin CHARACTERISTIC _g_PL_AD_fw_Radar_1R1V_rpc_LocBypassingRunnable_LocBypassingRunnable_m_pad_ensRLocationsPort_par_out_local.TChangeableMemPool._._._m_arrayPool._0_._elem._m_LocationList._Item._134_._idxAzimuthAmbiguityPeer "" VALUE 0xB00110F6 __UWord_Value 0 NO_COMPU_METHOD 0 65535 ECU_ADDRESS_EXTENSION 0x2 BYTE_ORDER MSB_LAST /end CHARACTERISTIC
/begin CHARACTERISTIC _g_PL_AD_fw_Radar_1R1V_rpc_LocBypassingRunnable_LocBypassingRunnable_m_pad_ensRLocationsPort_par_out_local.TChangeableMemPool._._._m_arrayPool._0_._elem._m_LocationList._Item._134_._measStatus "" VALUE 0xB00110F5 __UByte_Value 0 NO_COMPU_METHOD 0 255 ECU_ADDRESS_EXTENSION 0x2 BYTE_ORDER MSB_LAST /end CHARACTERISTIC
/begin CHARACTERISTIC _g_PL_AD_fw_Radar_1R1V_rpc_LocBypassingRunnable_LocBypassingRunnable_m_pad_ensRLocationsPort_par_out_local.TChangeableMemPool._._._m_arrayPool._0_._elem._m_LocationList._Item._134_._phi._m_value "" VALUE 0xB00110E8 __Float16_Value 0 NO_COMPU_METHOD -65504 65504 ECU_ADDRESS_EXTENSION 0x2 BYTE_ORDER MSB_LAST /end CHARACTERISTIC
/begin CHARACTERISTIC _g_PL_AD_fw_Radar_1R1V_rpc_LocBypassingRunnable_LocBypassingRunnable_m_pad_ensRLocationsPort_par_out_local.TChangeableMemPool._._._m_arrayPool._0_._elem._m_LocationList._Item._134_._phiQly "" VALUE 0xB00110EB __UByte_Value 0 NO_COMPU_METHOD 0 255 ECU_ADDRESS_EXTENSION 0x2 BYTE_ORDER MSB_LAST /end CHARACTERISTIC
/begin CHARACTERISTIC _g_PL_AD_fw_Radar_1R1V_rpc_LocBypassingRunnable_LocBypassingRunnable_m_pad_ensRLocationsPort_par_out_local.TChangeableMemPool._._._m_arrayPool._0_._elem._m_LocationList._Item._134_._phiVar._m_value "" VALUE 0xB00110EE __Float16_Value 0 NO_COMPU_METHOD -65504 65504 ECU_ADDRESS_EXTENSION 0x2 BYTE_ORDER MSB_LAST /end CHARACTERISTIC
/begin CHARACTERISTIC _g_PL_AD_fw_Radar_1R1V_rpc_LocBypassingRunnable_LocBypassingRunnable_m_pad_ensRLocationsPort_par_out_local.TChangeableMemPool._._._m_arrayPool._0_._elem._m_LocationList._Item._134_._theta._m_value "" VALUE 0xB00110E6 __Float16_Value 0 NO_COMPU_METHOD -65504 65504 ECU_ADDRESS_EXTENSION 0x2 BYTE_ORDER MSB_LAST /end CHARACTERISTIC
/begin CHARACTERISTIC _g_PL_AD_fw_Radar_1R1V_rpc_LocBypassingRunnable_LocBypassingRunnable_m_pad_ensRLocationsPort_par_out_local.TChangeableMemPool._._._m_arrayPool._0_._elem._m_LocationList._Item._134_._thetaQly "" VALUE 0xB00110EA __UByte_Value 0 NO_COMPU_METHOD 0 255 ECU_ADDRESS_EXTENSION 0x2 BYTE_ORDER MSB_LAST /end CHARACTERISTIC
/begin CHARACTERISTIC _g_PL_AD_fw_Radar_1R1V_rpc_LocBypassingRunnable_LocBypassingRunnable_m_pad_ensRLocationsPort_par_out_local.TChangeableMemPool._._._m_arrayPool._0_._elem._m_LocationList._Item._134_._thetaVar._m_value "" VALUE 0xB00110EC __Float16_Value 0 NO_COMPU_METHOD -65504 65504 ECU_ADDRESS_EXTENSION 0x2 BYTE_ORDER MSB_LAST /end CHARACTERISTIC
/begin CHARACTERISTIC _g_PL_AD_fw_Radar_1R1V_rpc_LocBypassingRunnable_LocBypassingRunnable_m_pad_ensRLocationsPort_par_out_local.TChangeableMemPool._._._m_arrayPool._0_._elem._m_LocationList._Item._134_._v "" VALUE 0xB00110DC __Float32_Value 0 NO_COMPU_METHOD -3.4028234663852886E+38 3.4028234663852886E+38 ECU_ADDRESS_EXTENSION 0x2 BYTE_ORDER MSB_LAST /end CHARACTERISTIC
/begin CHARACTERISTIC _g_PL_AD_fw_Radar_1R1V_rpc_LocBypassingRunnable_LocBypassingRunnable_m_pad_ensRLocationsPort_par_out_local.TChangeableMemPool._._._m_arrayPool._0_._elem._m_LocationList._Item._134_._vVar._m_value "" VALUE 0xB00110E2 __Float16_Value 0 NO_COMPU_METHOD -65504 65504 ECU_ADDRESS_EXTENSION 0x2 BYTE_ORDER MSB_LAST /end CHARACTERISTIC
/begin CHARACTERISTIC _g_PL_AD_fw_Radar_1R1V_rpc_LocBypassingRunnable_LocBypassingRunnable_m_pad_ensRLocationsPort_par_out_local.TChangeableMemPool._._._m_arrayPool._0_._elem._m_LocationList._Item._135_._Rcs._m_value "" VALUE 0xB0011110 __Float16_Value 0 NO_COMPU_METHOD -65504 65504 ECU_ADDRESS_EXTENSION 0x2 BYTE_ORDER MSB_LAST /end CHARACTERISTIC
/begin CHARACTERISTIC _g_PL_AD_fw_Radar_1R1V_rpc_LocBypassingRunnable_LocBypassingRunnable_m_pad_ensRLocationsPort_par_out_local.TChangeableMemPool._._._m_arrayPool._0_._elem._m_LocationList._Item._135_._Rssi._m_value "" VALUE 0xB0011112 __Float16_Value 0 NO_COMPU_METHOD -65504 65504 ECU_ADDRESS_EXTENSION 0x2 BYTE_ORDER MSB_LAST /end CHARACTERISTIC
/begin CHARACTERISTIC _g_PL_AD_fw_Radar_1R1V_rpc_LocBypassingRunnable_LocBypassingRunnable_m_pad_ensRLocationsPort_par_out_local.TChangeableMemPool._._._m_arrayPool._0_._elem._m_LocationList._Item._135_._d "" VALUE 0xB00110F8 __Float32_Value 0 NO_COMPU_METHOD -3.4028234663852886E+38 3.4028234663852886E+38 ECU_ADDRESS_EXTENSION 0x2 BYTE_ORDER MSB_LAST /end CHARACTERISTIC
/begin CHARACTERISTIC _g_PL_AD_fw_Radar_1R1V_rpc_LocBypassingRunnable_LocBypassingRunnable_m_pad_ensRLocationsPort_par_out_local.TChangeableMemPool._._._m_arrayPool._0_._elem._m_LocationList._Item._135_._dVar._m_value "" VALUE 0xB0011100 __Float16_Value 0 NO_COMPU_METHOD -65504 65504 ECU_ADDRESS_EXTENSION 0x2 BYTE_ORDER MSB_LAST /end CHARACTERISTIC
/begin CHARACTERISTIC _g_PL_AD_fw_Radar_1R1V_rpc_LocBypassingRunnable_LocBypassingRunnable_m_pad_ensRLocationsPort_par_out_local.TChangeableMemPool._._._m_arrayPool._0_._elem._m_LocationList._Item._135_._dvCov._m_value "" VALUE 0xB0011104 __Float16_Value 0 NO_COMPU_METHOD -65504 65504 ECU_ADDRESS_EXTENSION 0x2 BYTE_ORDER MSB_LAST /end CHARACTERISTIC
/begin CHARACTERISTIC _g_PL_AD_fw_Radar_1R1V_rpc_LocBypassingRunnable_LocBypassingRunnable_m_pad_ensRLocationsPort_par_out_local.TChangeableMemPool._._._m_arrayPool._0_._elem._m_LocationList._Item._135_._dvQly "" VALUE 0xB0011114 __UByte_Value 0 NO_COMPU_METHOD 0 255 ECU_ADDRESS_EXTENSION 0x2 BYTE_ORDER MSB_LAST /end CHARACTERISTIC
/begin CHARACTERISTIC _g_PL_AD_fw_Radar_1R1V_rpc_LocBypassingRunnable_LocBypassingRunnable_m_pad_ensRLocationsPort_par_out_local.TChangeableMemPool._._._m_arrayPool._0_._elem._m_LocationList._Item._135_._idxAzimuthAmbiguityPeer "" VALUE 0xB0011116 __UWord_Value 0 NO_COMPU_METHOD 0 65535 ECU_ADDRESS_EXTENSION 0x2 BYTE_ORDER MSB_LAST /end CHARACTERISTIC
/begin CHARACTERISTIC _g_PL_AD_fw_Radar_1R1V_rpc_LocBypassingRunnable_LocBypassingRunnable_m_pad_ensRLocationsPort_par_out_local.TChangeableMemPool._._._m_arrayPool._0_._elem._m_LocationList._Item._135_._measStatus "" VALUE 0xB0011115 __UByte_Value 0 NO_COMPU_METHOD 0 255 ECU_ADDRESS_EXTENSION 0x2 BYTE_ORDER MSB_LAST /end CHARACTERISTIC
/begin CHARACTERISTIC _g_PL_AD_fw_Radar_1R1V_rpc_LocBypassingRunnable_LocBypassingRunnable_m_pad_ensRLocationsPort_par_out_local.TChangeableMemPool._._._m_arrayPool._0_._elem._m_LocationList._Item._135_._phi._m_value "" VALUE 0xB0011108 __Float16_Value 0 NO_COMPU_METHOD -65504 65504 ECU_ADDRESS_EXTENSION 0x2 BYTE_ORDER MSB_LAST /end CHARACTERISTIC
/begin CHARACTERISTIC _g_PL_AD_fw_Radar_1R1V_rpc_LocBypassingRunnable_LocBypassingRunnable_m_pad_ensRLocationsPort_par_out_local.TChangeableMemPool._._._m_arrayPool._0_._elem._m_LocationList._Item._135_._phiQly "" VALUE 0xB001110B __UByte_Value 0 NO_COMPU_METHOD 0 255 ECU_ADDRESS_EXTENSION 0x2 BYTE_ORDER MSB_LAST /end CHARACTERISTIC
/begin CHARACTERISTIC _g_PL_AD_fw_Radar_1R1V_rpc_LocBypassingRunnable_LocBypassingRunnable_m_pad_ensRLocationsPort_par_out_local.TChangeableMemPool._._._m_arrayPool._0_._elem._m_LocationList._Item._135_._phiVar._m_value "" VALUE 0xB001110E __Float16_Value 0 NO_COMPU_METHOD -65504 65504 ECU_ADDRESS_EXTENSION 0x2 BYTE_ORDER MSB_LAST /end CHARACTERISTIC
/begin CHARACTERISTIC _g_PL_AD_fw_Radar_1R1V_rpc_LocBypassingRunnable_LocBypassingRunnable_m_pad_ensRLocationsPort_par_out_local.TChangeableMemPool._._._m_arrayPool._0_._elem._m_LocationList._Item._135_._theta._m_value "" VALUE 0xB0011106 __Float16_Value 0 NO_COMPU_METHOD -65504 65504 ECU_ADDRESS_EXTENSION 0x2 BYTE_ORDER MSB_LAST /end CHARACTERISTIC
/begin CHARACTERISTIC _g_PL_AD_fw_Radar_1R1V_rpc_LocBypassingRunnable_LocBypassingRunnable_m_pad_ensRLocationsPort_par_out_local.TChangeableMemPool._._._m_arrayPool._0_._elem._m_LocationList._Item._135_._thetaQly "" VALUE 0xB001110A __UByte_Value 0 NO_COMPU_METHOD 0 255 ECU_ADDRESS_EXTENSION 0x2 BYTE_ORDER MSB_LAST /end CHARACTERISTIC
/begin CHARACTERISTIC _g_PL_AD_fw_Radar_1R1V_rpc_LocBypassingRunnable_LocBypassingRunnable_m_pad_ensRLocationsPort_par_out_local.TChangeableMemPool._._._m_arrayPool._0_._elem._m_LocationList._Item._135_._thetaVar._m_value "" VALUE 0xB001110C __Float16_Value 0 NO_COMPU_METHOD -65504 65504 ECU_ADDRESS_EXTENSION 0x2 BYTE_ORDER MSB_LAST /end CHARACTERISTIC
/begin CHARACTERISTIC _g_PL_AD_fw_Radar_1R1V_rpc_LocBypassingRunnable_LocBypassingRunnable_m_pad_ensRLocationsPort_par_out_local.TChangeableMemPool._._._m_arrayPool._0_._elem._m_LocationList._Item._135_._v "" VALUE 0xB00110FC __Float32_Value 0 NO_COMPU_METHOD -3.4028234663852886E+38 3.4028234663852886E+38 ECU_ADDRESS_EXTENSION 0x2 BYTE_ORDER MSB_LAST /end CHARACTERISTIC
/begin CHARACTERISTIC _g_PL_AD_fw_Radar_1R1V_rpc_LocBypassingRunnable_LocBypassingRunnable_m_pad_ensRLocationsPort_par_out_local.TChangeableMemPool._._._m_arrayPool._0_._elem._m_LocationList._Item._135_._vVar._m_value "" VALUE 0xB0011102 __Float16_Value 0 NO_COMPU_METHOD -65504 65504 ECU_ADDRESS_EXTENSION 0x2 BYTE_ORDER MSB_LAST /end CHARACTERISTIC
/begin CHARACTERISTIC _g_PL_AD_fw_Radar_1R1V_rpc_LocBypassingRunnable_LocBypassingRunnable_m_pad_ensRLocationsPort_par_out_local.TChangeableMemPool._._._m_arrayPool._0_._elem._m_LocationList._Item._136_._Rcs._m_value "" VALUE 0xB0011130 __Float16_Value 0 NO_COMPU_METHOD -65504 65504 ECU_ADDRESS_EXTENSION 0x2 BYTE_ORDER MSB_LAST /end CHARACTERISTIC
/begin CHARACTERISTIC _g_PL_AD_fw_Radar_1R1V_rpc_LocBypassingRunnable_LocBypassingRunnable_m_pad_ensRLocationsPort_par_out_local.TChangeableMemPool._._._m_arrayPool._0_._elem._m_LocationList._Item._136_._Rssi._m_value "" VALUE 0xB0011132 __Float16_Value 0 NO_COMPU_METHOD -65504 65504 ECU_ADDRESS_EXTENSION 0x2 BYTE_ORDER MSB_LAST /end CHARACTERISTIC
/begin CHARACTERISTIC _g_PL_AD_fw_Radar_1R1V_rpc_LocBypassingRunnable_LocBypassingRunnable_m_pad_ensRLocationsPort_par_out_local.TChangeableMemPool._._._m_arrayPool._0_._elem._m_LocationList._Item._136_._d "" VALUE 0xB0011118 __Float32_Value 0 NO_COMPU_METHOD -3.4028234663852886E+38 3.4028234663852886E+38 ECU_ADDRESS_EXTENSION 0x2 BYTE_ORDER MSB_LAST /end CHARACTERISTIC
/begin CHARACTERISTIC _g_PL_AD_fw_Radar_1R1V_rpc_LocBypassingRunnable_LocBypassingRunnable_m_pad_ensRLocationsPort_par_out_local.TChangeableMemPool._._._m_arrayPool._0_._elem._m_LocationList._Item._136_._dVar._m_value "" VALUE 0xB0011120 __Float16_Value 0 NO_COMPU_METHOD -65504 65504 ECU_ADDRESS_EXTENSION 0x2 BYTE_ORDER MSB_LAST /end CHARACTERISTIC
/begin CHARACTERISTIC _g_PL_AD_fw_Radar_1R1V_rpc_LocBypassingRunnable_LocBypassingRunnable_m_pad_ensRLocationsPort_par_out_local.TChangeableMemPool._._._m_arrayPool._0_._elem._m_LocationList._Item._136_._dvCov._m_value "" VALUE 0xB0011124 __Float16_Value 0 NO_COMPU_METHOD -65504 65504 ECU_ADDRESS_EXTENSION 0x2 BYTE_ORDER MSB_LAST /end CHARACTERISTIC
/begin CHARACTERISTIC _g_PL_AD_fw_Radar_1R1V_rpc_LocBypassingRunnable_LocBypassingRunnable_m_pad_ensRLocationsPort_par_out_local.TChangeableMemPool._._._m_arrayPool._0_._elem._m_LocationList._Item._136_._dvQly "" VALUE 0xB0011134 __UByte_Value 0 NO_COMPU_METHOD 0 255 ECU_ADDRESS_EXTENSION 0x2 BYTE_ORDER MSB_LAST /end CHARACTERISTIC
/begin CHARACTERISTIC _g_PL_AD_fw_Radar_1R1V_rpc_LocBypassingRunnable_LocBypassingRunnable_m_pad_ensRLocationsPort_par_out_local.TChangeableMemPool._._._m_arrayPool._0_._elem._m_LocationList._Item._136_._idxAzimuthAmbiguityPeer "" VALUE 0xB0011136 __UWord_Value 0 NO_COMPU_METHOD 0 65535 ECU_ADDRESS_EXTENSION 0x2 BYTE_ORDER MSB_LAST /end CHARACTERISTIC
/begin CHARACTERISTIC _g_PL_AD_fw_Radar_1R1V_rpc_LocBypassingRunnable_LocBypassingRunnable_m_pad_ensRLocationsPort_par_out_local.TChangeableMemPool._._._m_arrayPool._0_._elem._m_LocationList._Item._136_._measStatus "" VALUE 0xB0011135 __UByte_Value 0 NO_COMPU_METHOD 0 255 ECU_ADDRESS_EXTENSION 0x2 BYTE_ORDER MSB_LAST /end CHARACTERISTIC
/begin CHARACTERISTIC _g_PL_AD_fw_Radar_1R1V_rpc_LocBypassingRunnable_LocBypassingRunnable_m_pad_ensRLocationsPort_par_out_local.TChangeableMemPool._._._m_arrayPool._0_._elem._m_LocationList._Item._136_._phi._m_value "" VALUE 0xB0011128 __Float16_Value 0 NO_COMPU_METHOD -65504 65504 ECU_ADDRESS_EXTENSION 0x2 BYTE_ORDER MSB_LAST /end CHARACTERISTIC
/begin CHARACTERISTIC _g_PL_AD_fw_Radar_1R1V_rpc_LocBypassingRunnable_LocBypassingRunnable_m_pad_ensRLocationsPort_par_out_local.TChangeableMemPool._._._m_arrayPool._0_._elem._m_LocationList._Item._136_._phiQly "" VALUE 0xB001112B __UByte_Value 0 NO_COMPU_METHOD 0 255 ECU_ADDRESS_EXTENSION 0x2 BYTE_ORDER MSB_LAST /end CHARACTERISTIC
/begin CHARACTERISTIC _g_PL_AD_fw_Radar_1R1V_rpc_LocBypassingRunnable_LocBypassingRunnable_m_pad_ensRLocationsPort_par_out_local.TChangeableMemPool._._._m_arrayPool._0_._elem._m_LocationList._Item._136_._phiVar._m_value "" VALUE 0xB001112E __Float16_Value 0 NO_COMPU_METHOD -65504 65504 ECU_ADDRESS_EXTENSION 0x2 BYTE_ORDER MSB_LAST /end CHARACTERISTIC
/begin CHARACTERISTIC _g_PL_AD_fw_Radar_1R1V_rpc_LocBypassingRunnable_LocBypassingRunnable_m_pad_ensRLocationsPort_par_out_local.TChangeableMemPool._._._m_arrayPool._0_._elem._m_LocationList._Item._136_._theta._m_value "" VALUE 0xB0011126 __Float16_Value 0 NO_COMPU_METHOD -65504 65504 ECU_ADDRESS_EXTENSION 0x2 BYTE_ORDER MSB_LAST /end CHARACTERISTIC
/begin CHARACTERISTIC _g_PL_AD_fw_Radar_1R1V_rpc_LocBypassingRunnable_LocBypassingRunnable_m_pad_ensRLocationsPort_par_out_local.TChangeableMemPool._._._m_arrayPool._0_._elem._m_LocationList._Item._136_._thetaQly "" VALUE 0xB001112A __UByte_Value 0 NO_COMPU_METHOD 0 255 ECU_ADDRESS_EXTENSION 0x2 BYTE_ORDER MSB_LAST /end CHARACTERISTIC
/begin CHARACTERISTIC _g_PL_AD_fw_Radar_1R1V_rpc_LocBypassingRunnable_LocBypassingRunnable_m_pad_ensRLocationsPort_par_out_local.TChangeableMemPool._._._m_arrayPool._0_._elem._m_LocationList._Item._136_._thetaVar._m_value "" VALUE 0xB001112C __Float16_Value 0 NO_COMPU_METHOD -65504 65504 ECU_ADDRESS_EXTENSION 0x2 BYTE_ORDER MSB_LAST /end CHARACTERISTIC
/begin CHARACTERISTIC _g_PL_AD_fw_Radar_1R1V_rpc_LocBypassingRunnable_LocBypassingRunnable_m_pad_ensRLocationsPort_par_out_local.TChangeableMemPool._._._m_arrayPool._0_._elem._m_LocationList._Item._136_._v "" VALUE 0xB001111C __Float32_Value 0 NO_COMPU_METHOD -3.4028234663852886E+38 3.4028234663852886E+38 ECU_ADDRESS_EXTENSION 0x2 BYTE_ORDER MSB_LAST /end CHARACTERISTIC
/begin CHARACTERISTIC _g_PL_AD_fw_Radar_1R1V_rpc_LocBypassingRunnable_LocBypassingRunnable_m_pad_ensRLocationsPort_par_out_local.TChangeableMemPool._._._m_arrayPool._0_._elem._m_LocationList._Item._136_._vVar._m_value "" VALUE 0xB0011122 __Float16_Value 0 NO_COMPU_METHOD -65504 65504 ECU_ADDRESS_EXTENSION 0x2 BYTE_ORDER MSB_LAST /end CHARACTERISTIC
/begin CHARACTERISTIC _g_PL_AD_fw_Radar_1R1V_rpc_LocBypassingRunnable_LocBypassingRunnable_m_pad_ensRLocationsPort_par_out_local.TChangeableMemPool._._._m_arrayPool._0_._elem._m_LocationList._Item._137_._Rcs._m_value "" VALUE 0xB0011150 __Float16_Value 0 NO_COMPU_METHOD -65504 65504 ECU_ADDRESS_EXTENSION 0x2 BYTE_ORDER MSB_LAST /end CHARACTERISTIC
/begin CHARACTERISTIC _g_PL_AD_fw_Radar_1R1V_rpc_LocBypassingRunnable_LocBypassingRunnable_m_pad_ensRLocationsPort_par_out_local.TChangeableMemPool._._._m_arrayPool._0_._elem._m_LocationList._Item._137_._Rssi._m_value "" VALUE 0xB0011152 __Float16_Value 0 NO_COMPU_METHOD -65504 65504 ECU_ADDRESS_EXTENSION 0x2 BYTE_ORDER MSB_LAST /end CHARACTERISTIC
/begin CHARACTERISTIC _g_PL_AD_fw_Radar_1R1V_rpc_LocBypassingRunnable_LocBypassingRunnable_m_pad_ensRLocationsPort_par_out_local.TChangeableMemPool._._._m_arrayPool._0_._elem._m_LocationList._Item._137_._d "" VALUE 0xB0011138 __Float32_Value 0 NO_COMPU_METHOD -3.4028234663852886E+38 3.4028234663852886E+38 ECU_ADDRESS_EXTENSION 0x2 BYTE_ORDER MSB_LAST /end CHARACTERISTIC
/begin CHARACTERISTIC _g_PL_AD_fw_Radar_1R1V_rpc_LocBypassingRunnable_LocBypassingRunnable_m_pad_ensRLocationsPort_par_out_local.TChangeableMemPool._._._m_arrayPool._0_._elem._m_LocationList._Item._137_._dVar._m_value "" VALUE 0xB0011140 __Float16_Value 0 NO_COMPU_METHOD -65504 65504 ECU_ADDRESS_EXTENSION 0x2 BYTE_ORDER MSB_LAST /end CHARACTERISTIC
/begin CHARACTERISTIC _g_PL_AD_fw_Radar_1R1V_rpc_LocBypassingRunnable_LocBypassingRunnable_m_pad_ensRLocationsPort_par_out_local.TChangeableMemPool._._._m_arrayPool._0_._elem._m_LocationList._Item._137_._dvCov._m_value "" VALUE 0xB0011144 __Float16_Value 0 NO_COMPU_METHOD -65504 65504 ECU_ADDRESS_EXTENSION 0x2 BYTE_ORDER MSB_LAST /end CHARACTERISTIC
/begin CHARACTERISTIC _g_PL_AD_fw_Radar_1R1V_rpc_LocBypassingRunnable_LocBypassingRunnable_m_pad_ensRLocationsPort_par_out_local.TChangeableMemPool._._._m_arrayPool._0_._elem._m_LocationList._Item._137_._dvQly "" VALUE 0xB0011154 __UByte_Value 0 NO_COMPU_METHOD 0 255 ECU_ADDRESS_EXTENSION 0x2 BYTE_ORDER MSB_LAST /end CHARACTERISTIC
/begin CHARACTERISTIC _g_PL_AD_fw_Radar_1R1V_rpc_LocBypassingRunnable_LocBypassingRunnable_m_pad_ensRLocationsPort_par_out_local.TChangeableMemPool._._._m_arrayPool._0_._elem._m_LocationList._Item._137_._idxAzimuthAmbiguityPeer "" VALUE 0xB0011156 __UWord_Value 0 NO_COMPU_METHOD 0 65535 ECU_ADDRESS_EXTENSION 0x2 BYTE_ORDER MSB_LAST /end CHARACTERISTIC
/begin CHARACTERISTIC _g_PL_AD_fw_Radar_1R1V_rpc_LocBypassingRunnable_LocBypassingRunnable_m_pad_ensRLocationsPort_par_out_local.TChangeableMemPool._._._m_arrayPool._0_._elem._m_LocationList._Item._137_._measStatus "" VALUE 0xB0011155 __UByte_Value 0 NO_COMPU_METHOD 0 255 ECU_ADDRESS_EXTENSION 0x2 BYTE_ORDER MSB_LAST /end CHARACTERISTIC
/begin CHARACTERISTIC _g_PL_AD_fw_Radar_1R1V_rpc_LocBypassingRunnable_LocBypassingRunnable_m_pad_ensRLocationsPort_par_out_local.TChangeableMemPool._._._m_arrayPool._0_._elem._m_LocationList._Item._137_._phi._m_value "" VALUE 0xB0011148 __Float16_Value 0 NO_COMPU_METHOD -65504 65504 ECU_ADDRESS_EXTENSION 0x2 BYTE_ORDER MSB_LAST /end CHARACTERISTIC
/begin CHARACTERISTIC _g_PL_AD_fw_Radar_1R1V_rpc_LocBypassingRunnable_LocBypassingRunnable_m_pad_ensRLocationsPort_par_out_local.TChangeableMemPool._._._m_arrayPool._0_._elem._m_LocationList._Item._137_._phiQly "" VALUE 0xB001114B __UByte_Value 0 NO_COMPU_METHOD 0 255 ECU_ADDRESS_EXTENSION 0x2 BYTE_ORDER MSB_LAST /end CHARACTERISTIC
/begin CHARACTERISTIC _g_PL_AD_fw_Radar_1R1V_rpc_LocBypassingRunnable_LocBypassingRunnable_m_pad_ensRLocationsPort_par_out_local.TChangeableMemPool._._._m_arrayPool._0_._elem._m_LocationList._Item._137_._phiVar._m_value "" VALUE 0xB001114E __Float16_Value 0 NO_COMPU_METHOD -65504 65504 ECU_ADDRESS_EXTENSION 0x2 BYTE_ORDER MSB_LAST /end CHARACTERISTIC
/begin CHARACTERISTIC _g_PL_AD_fw_Radar_1R1V_rpc_LocBypassingRunnable_LocBypassingRunnable_m_pad_ensRLocationsPort_par_out_local.TChangeableMemPool._._._m_arrayPool._0_._elem._m_LocationList._Item._137_._theta._m_value "" VALUE 0xB0011146 __Float16_Value 0 NO_COMPU_METHOD -65504 65504 ECU_ADDRESS_EXTENSION 0x2 BYTE_ORDER MSB_LAST /end CHARACTERISTIC
/begin CHARACTERISTIC _g_PL_AD_fw_Radar_1R1V_rpc_LocBypassingRunnable_LocBypassingRunnable_m_pad_ensRLocationsPort_par_out_local.TChangeableMemPool._._._m_arrayPool._0_._elem._m_LocationList._Item._137_._thetaQly "" VALUE 0xB001114A __UByte_Value 0 NO_COMPU_METHOD 0 255 ECU_ADDRESS_EXTENSION 0x2 BYTE_ORDER MSB_LAST /end CHARACTERISTIC
/begin CHARACTERISTIC _g_PL_AD_fw_Radar_1R1V_rpc_LocBypassingRunnable_LocBypassingRunnable_m_pad_ensRLocationsPort_par_out_local.TChangeableMemPool._._._m_arrayPool._0_._elem._m_LocationList._Item._137_._thetaVar._m_value "" VALUE 0xB001114C __Float16_Value 0 NO_COMPU_METHOD -65504 65504 ECU_ADDRESS_EXTENSION 0x2 BYTE_ORDER MSB_LAST /end CHARACTERISTIC
/begin CHARACTERISTIC _g_PL_AD_fw_Radar_1R1V_rpc_LocBypassingRunnable_LocBypassingRunnable_m_pad_ensRLocationsPort_par_out_local.TChangeableMemPool._._._m_arrayPool._0_._elem._m_LocationList._Item._137_._v "" VALUE 0xB001113C __Float32_Value 0 NO_COMPU_METHOD -3.4028234663852886E+38 3.4028234663852886E+38 ECU_ADDRESS_EXTENSION 0x2 BYTE_ORDER MSB_LAST /end CHARACTERISTIC
/begin CHARACTERISTIC _g_PL_AD_fw_Radar_1R1V_rpc_LocBypassingRunnable_LocBypassingRunnable_m_pad_ensRLocationsPort_par_out_local.TChangeableMemPool._._._m_arrayPool._0_._elem._m_LocationList._Item._137_._vVar._m_value "" VALUE 0xB0011142 __Float16_Value 0 NO_COMPU_METHOD -65504 65504 ECU_ADDRESS_EXTENSION 0x2 BYTE_ORDER MSB_LAST /end CHARACTERISTIC
/begin CHARACTERISTIC _g_PL_AD_fw_Radar_1R1V_rpc_LocBypassingRunnable_LocBypassingRunnable_m_pad_ensRLocationsPort_par_out_local.TChangeableMemPool._._._m_arrayPool._0_._elem._m_LocationList._Item._138_._Rcs._m_value "" VALUE 0xB0011170 __Float16_Value 0 NO_COMPU_METHOD -65504 65504 ECU_ADDRESS_EXTENSION 0x2 BYTE_ORDER MSB_LAST /end CHARACTERISTIC
/begin CHARACTERISTIC _g_PL_AD_fw_Radar_1R1V_rpc_LocBypassingRunnable_LocBypassingRunnable_m_pad_ensRLocationsPort_par_out_local.TChangeableMemPool._._._m_arrayPool._0_._elem._m_LocationList._Item._138_._Rssi._m_value "" VALUE 0xB0011172 __Float16_Value 0 NO_COMPU_METHOD -65504 65504 ECU_ADDRESS_EXTENSION 0x2 BYTE_ORDER MSB_LAST /end CHARACTERISTIC
/begin CHARACTERISTIC _g_PL_AD_fw_Radar_1R1V_rpc_LocBypassingRunnable_LocBypassingRunnable_m_pad_ensRLocationsPort_par_out_local.TChangeableMemPool._._._m_arrayPool._0_._elem._m_LocationList._Item._138_._d "" VALUE 0xB0011158 __Float32_Value 0 NO_COMPU_METHOD -3.4028234663852886E+38 3.4028234663852886E+38 ECU_ADDRESS_EXTENSION 0x2 BYTE_ORDER MSB_LAST /end CHARACTERISTIC
/begin CHARACTERISTIC _g_PL_AD_fw_Radar_1R1V_rpc_LocBypassingRunnable_LocBypassingRunnable_m_pad_ensRLocationsPort_par_out_local.TChangeableMemPool._._._m_arrayPool._0_._elem._m_LocationList._Item._138_._dVar._m_value "" VALUE 0xB0011160 __Float16_Value 0 NO_COMPU_METHOD -65504 65504 ECU_ADDRESS_EXTENSION 0x2 BYTE_ORDER MSB_LAST /end CHARACTERISTIC
/begin CHARACTERISTIC _g_PL_AD_fw_Radar_1R1V_rpc_LocBypassingRunnable_LocBypassingRunnable_m_pad_ensRLocationsPort_par_out_local.TChangeableMemPool._._._m_arrayPool._0_._elem._m_LocationList._Item._138_._dvCov._m_value "" VALUE 0xB0011164 __Float16_Value 0 NO_COMPU_METHOD -65504 65504 ECU_ADDRESS_EXTENSION 0x2 BYTE_ORDER MSB_LAST /end CHARACTERISTIC
/begin CHARACTERISTIC _g_PL_AD_fw_Radar_1R1V_rpc_LocBypassingRunnable_LocBypassingRunnable_m_pad_ensRLocationsPort_par_out_local.TChangeableMemPool._._._m_arrayPool._0_._elem._m_LocationList._Item._138_._dvQly "" VALUE 0xB0011174 __UByte_Value 0 NO_COMPU_METHOD 0 255 ECU_ADDRESS_EXTENSION 0x2 BYTE_ORDER MSB_LAST /end CHARACTERISTIC
/begin CHARACTERISTIC _g_PL_AD_fw_Radar_1R1V_rpc_LocBypassingRunnable_LocBypassingRunnable_m_pad_ensRLocationsPort_par_out_local.TChangeableMemPool._._._m_arrayPool._0_._elem._m_LocationList._Item._138_._idxAzimuthAmbiguityPeer "" VALUE 0xB0011176 __UWord_Value 0 NO_COMPU_METHOD 0 65535 ECU_ADDRESS_EXTENSION 0x2 BYTE_ORDER MSB_LAST /end CHARACTERISTIC
/begin CHARACTERISTIC _g_PL_AD_fw_Radar_1R1V_rpc_LocBypassingRunnable_LocBypassingRunnable_m_pad_ensRLocationsPort_par_out_local.TChangeableMemPool._._._m_arrayPool._0_._elem._m_LocationList._Item._138_._measStatus "" VALUE 0xB0011175 __UByte_Value 0 NO_COMPU_METHOD 0 255 ECU_ADDRESS_EXTENSION 0x2 BYTE_ORDER MSB_LAST /end CHARACTERISTIC
/begin CHARACTERISTIC _g_PL_AD_fw_Radar_1R1V_rpc_LocBypassingRunnable_LocBypassingRunnable_m_pad_ensRLocationsPort_par_out_local.TChangeableMemPool._._._m_arrayPool._0_._elem._m_LocationList._Item._138_._phi._m_value "" VALUE 0xB0011168 __Float16_Value 0 NO_COMPU_METHOD -65504 65504 ECU_ADDRESS_EXTENSION 0x2 BYTE_ORDER MSB_LAST /end CHARACTERISTIC
/begin CHARACTERISTIC _g_PL_AD_fw_Radar_1R1V_rpc_LocBypassingRunnable_LocBypassingRunnable_m_pad_ensRLocationsPort_par_out_local.TChangeableMemPool._._._m_arrayPool._0_._elem._m_LocationList._Item._138_._phiQly "" VALUE 0xB001116B __UByte_Value 0 NO_COMPU_METHOD 0 255 ECU_ADDRESS_EXTENSION 0x2 BYTE_ORDER MSB_LAST /end CHARACTERISTIC
/begin CHARACTERISTIC _g_PL_AD_fw_Radar_1R1V_rpc_LocBypassingRunnable_LocBypassingRunnable_m_pad_ensRLocationsPort_par_out_local.TChangeableMemPool._._._m_arrayPool._0_._elem._m_LocationList._Item._138_._phiVar._m_value "" VALUE 0xB001116E __Float16_Value 0 NO_COMPU_METHOD -65504 65504 ECU_ADDRESS_EXTENSION 0x2 BYTE_ORDER MSB_LAST /end CHARACTERISTIC
/begin CHARACTERISTIC _g_PL_AD_fw_Radar_1R1V_rpc_LocBypassingRunnable_LocBypassingRunnable_m_pad_ensRLocationsPort_par_out_local.TChangeableMemPool._._._m_arrayPool._0_._elem._m_LocationList._Item._138_._theta._m_value "" VALUE 0xB0011166 __Float16_Value 0 NO_COMPU_METHOD -65504 65504 ECU_ADDRESS_EXTENSION 0x2 BYTE_ORDER MSB_LAST /end CHARACTERISTIC
/begin CHARACTERISTIC _g_PL_AD_fw_Radar_1R1V_rpc_LocBypassingRunnable_LocBypassingRunnable_m_pad_ensRLocationsPort_par_out_local.TChangeableMemPool._._._m_arrayPool._0_._elem._m_LocationList._Item._138_._thetaQly "" VALUE 0xB001116A __UByte_Value 0 NO_COMPU_METHOD 0 255 ECU_ADDRESS_EXTENSION 0x2 BYTE_ORDER MSB_LAST /end CHARACTERISTIC
/begin CHARACTERISTIC _g_PL_AD_fw_Radar_1R1V_rpc_LocBypassingRunnable_LocBypassingRunnable_m_pad_ensRLocationsPort_par_out_local.TChangeableMemPool._._._m_arrayPool._0_._elem._m_LocationList._Item._138_._thetaVar._m_value "" VALUE 0xB001116C __Float16_Value 0 NO_COMPU_METHOD -65504 65504 ECU_ADDRESS_EXTENSION 0x2 BYTE_ORDER MSB_LAST /end CHARACTERISTIC
/begin CHARACTERISTIC _g_PL_AD_fw_Radar_1R1V_rpc_LocBypassingRunnable_LocBypassingRunnable_m_pad_ensRLocationsPort_par_out_local.TChangeableMemPool._._._m_arrayPool._0_._elem._m_LocationList._Item._138_._v "" VALUE 0xB001115C __Float32_Value 0 NO_COMPU_METHOD -3.4028234663852886E+38 3.4028234663852886E+38 ECU_ADDRESS_EXTENSION 0x2 BYTE_ORDER MSB_LAST /end CHARACTERISTIC
/begin CHARACTERISTIC _g_PL_AD_fw_Radar_1R1V_rpc_LocBypassingRunnable_LocBypassingRunnable_m_pad_ensRLocationsPort_par_out_local.TChangeableMemPool._._._m_arrayPool._0_._elem._m_LocationList._Item._138_._vVar._m_value "" VALUE 0xB0011162 __Float16_Value 0 NO_COMPU_METHOD -65504 65504 ECU_ADDRESS_EXTENSION 0x2 BYTE_ORDER MSB_LAST /end CHARACTERISTIC
/begin CHARACTERISTIC _g_PL_AD_fw_Radar_1R1V_rpc_LocBypassingRunnable_LocBypassingRunnable_m_pad_ensRLocationsPort_par_out_local.TChangeableMemPool._._._m_arrayPool._0_._elem._m_LocationList._Item._139_._Rcs._m_value "" VALUE 0xB0011190 __Float16_Value 0 NO_COMPU_METHOD -65504 65504 ECU_ADDRESS_EXTENSION 0x2 BYTE_ORDER MSB_LAST /end CHARACTERISTIC
/begin CHARACTERISTIC _g_PL_AD_fw_Radar_1R1V_rpc_LocBypassingRunnable_LocBypassingRunnable_m_pad_ensRLocationsPort_par_out_local.TChangeableMemPool._._._m_arrayPool._0_._elem._m_LocationList._Item._139_._Rssi._m_value "" VALUE 0xB0011192 __Float16_Value 0 NO_COMPU_METHOD -65504 65504 ECU_ADDRESS_EXTENSION 0x2 BYTE_ORDER MSB_LAST /end CHARACTERISTIC
/begin CHARACTERISTIC _g_PL_AD_fw_Radar_1R1V_rpc_LocBypassingRunnable_LocBypassingRunnable_m_pad_ensRLocationsPort_par_out_local.TChangeableMemPool._._._m_arrayPool._0_._elem._m_LocationList._Item._139_._d "" VALUE 0xB0011178 __Float32_Value 0 NO_COMPU_METHOD -3.4028234663852886E+38 3.4028234663852886E+38 ECU_ADDRESS_EXTENSION 0x2 BYTE_ORDER MSB_LAST /end CHARACTERISTIC
/begin CHARACTERISTIC _g_PL_AD_fw_Radar_1R1V_rpc_LocBypassingRunnable_LocBypassingRunnable_m_pad_ensRLocationsPort_par_out_local.TChangeableMemPool._._._m_arrayPool._0_._elem._m_LocationList._Item._139_._dVar._m_value "" VALUE 0xB0011180 __Float16_Value 0 NO_COMPU_METHOD -65504 65504 ECU_ADDRESS_EXTENSION 0x2 BYTE_ORDER MSB_LAST /end CHARACTERISTIC
/begin CHARACTERISTIC _g_PL_AD_fw_Radar_1R1V_rpc_LocBypassingRunnable_LocBypassingRunnable_m_pad_ensRLocationsPort_par_out_local.TChangeableMemPool._._._m_arrayPool._0_._elem._m_LocationList._Item._139_._dvCov._m_value "" VALUE 0xB0011184 __Float16_Value 0 NO_COMPU_METHOD -65504 65504 ECU_ADDRESS_EXTENSION 0x2 BYTE_ORDER MSB_LAST /end CHARACTERISTIC
/begin CHARACTERISTIC _g_PL_AD_fw_Radar_1R1V_rpc_LocBypassingRunnable_LocBypassingRunnable_m_pad_ensRLocationsPort_par_out_local.TChangeableMemPool._._._m_arrayPool._0_._elem._m_LocationList._Item._139_._dvQly "" VALUE 0xB0011194 __UByte_Value 0 NO_COMPU_METHOD 0 255 ECU_ADDRESS_EXTENSION 0x2 BYTE_ORDER MSB_LAST /end CHARACTERISTIC
/begin CHARACTERISTIC _g_PL_AD_fw_Radar_1R1V_rpc_LocBypassingRunnable_LocBypassingRunnable_m_pad_ensRLocationsPort_par_out_local.TChangeableMemPool._._._m_arrayPool._0_._elem._m_LocationList._Item._139_._idxAzimuthAmbiguityPeer "" VALUE 0xB0011196 __UWord_Value 0 NO_COMPU_METHOD 0 65535 ECU_ADDRESS_EXTENSION 0x2 BYTE_ORDER MSB_LAST /end CHARACTERISTIC
/begin CHARACTERISTIC _g_PL_AD_fw_Radar_1R1V_rpc_LocBypassingRunnable_LocBypassingRunnable_m_pad_ensRLocationsPort_par_out_local.TChangeableMemPool._._._m_arrayPool._0_._elem._m_LocationList._Item._139_._measStatus "" VALUE 0xB0011195 __UByte_Value 0 NO_COMPU_METHOD 0 255 ECU_ADDRESS_EXTENSION 0x2 BYTE_ORDER MSB_LAST /end CHARACTERISTIC
/begin CHARACTERISTIC _g_PL_AD_fw_Radar_1R1V_rpc_LocBypassingRunnable_LocBypassingRunnable_m_pad_ensRLocationsPort_par_out_local.TChangeableMemPool._._._m_arrayPool._0_._elem._m_LocationList._Item._139_._phi._m_value "" VALUE 0xB0011188 __Float16_Value 0 NO_COMPU_METHOD -65504 65504 ECU_ADDRESS_EXTENSION 0x2 BYTE_ORDER MSB_LAST /end CHARACTERISTIC
/begin CHARACTERISTIC _g_PL_AD_fw_Radar_1R1V_rpc_LocBypassingRunnable_LocBypassingRunnable_m_pad_ensRLocationsPort_par_out_local.TChangeableMemPool._._._m_arrayPool._0_._elem._m_LocationList._Item._139_._phiQly "" VALUE 0xB001118B __UByte_Value 0 NO_COMPU_METHOD 0 255 ECU_ADDRESS_EXTENSION 0x2 BYTE_ORDER MSB_LAST /end CHARACTERISTIC
/begin CHARACTERISTIC _g_PL_AD_fw_Radar_1R1V_rpc_LocBypassingRunnable_LocBypassingRunnable_m_pad_ensRLocationsPort_par_out_local.TChangeableMemPool._._._m_arrayPool._0_._elem._m_LocationList._Item._139_._phiVar._m_value "" VALUE 0xB001118E __Float16_Value 0 NO_COMPU_METHOD -65504 65504 ECU_ADDRESS_EXTENSION 0x2 BYTE_ORDER MSB_LAST /end CHARACTERISTIC
/begin CHARACTERISTIC _g_PL_AD_fw_Radar_1R1V_rpc_LocBypassingRunnable_LocBypassingRunnable_m_pad_ensRLocationsPort_par_out_local.TChangeableMemPool._._._m_arrayPool._0_._elem._m_LocationList._Item._139_._theta._m_value "" VALUE 0xB0011186 __Float16_Value 0 NO_COMPU_METHOD -65504 65504 ECU_ADDRESS_EXTENSION 0x2 BYTE_ORDER MSB_LAST /end CHARACTERISTIC
/begin CHARACTERISTIC _g_PL_AD_fw_Radar_1R1V_rpc_LocBypassingRunnable_LocBypassingRunnable_m_pad_ensRLocationsPort_par_out_local.TChangeableMemPool._._._m_arrayPool._0_._elem._m_LocationList._Item._139_._thetaQly "" VALUE 0xB001118A __UByte_Value 0 NO_COMPU_METHOD 0 255 ECU_ADDRESS_EXTENSION 0x2 BYTE_ORDER MSB_LAST /end CHARACTERISTIC
/begin CHARACTERISTIC _g_PL_AD_fw_Radar_1R1V_rpc_LocBypassingRunnable_LocBypassingRunnable_m_pad_ensRLocationsPort_par_out_local.TChangeableMemPool._._._m_arrayPool._0_._elem._m_LocationList._Item._139_._thetaVar._m_value "" VALUE 0xB001118C __Float16_Value 0 NO_COMPU_METHOD -65504 65504 ECU_ADDRESS_EXTENSION 0x2 BYTE_ORDER MSB_LAST /end CHARACTERISTIC
/begin CHARACTERISTIC _g_PL_AD_fw_Radar_1R1V_rpc_LocBypassingRunnable_LocBypassingRunnable_m_pad_ensRLocationsPort_par_out_local.TChangeableMemPool._._._m_arrayPool._0_._elem._m_LocationList._Item._139_._v "" VALUE 0xB001117C __Float32_Value 0 NO_COMPU_METHOD -3.4028234663852886E+38 3.4028234663852886E+38 ECU_ADDRESS_EXTENSION 0x2 BYTE_ORDER MSB_LAST /end CHARACTERISTIC
/begin CHARACTERISTIC _g_PL_AD_fw_Radar_1R1V_rpc_LocBypassingRunnable_LocBypassingRunnable_m_pad_ensRLocationsPort_par_out_local.TChangeableMemPool._._._m_arrayPool._0_._elem._m_LocationList._Item._139_._vVar._m_value "" VALUE 0xB0011182 __Float16_Value 0 NO_COMPU_METHOD -65504 65504 ECU_ADDRESS_EXTENSION 0x2 BYTE_ORDER MSB_LAST /end CHARACTERISTIC
/begin CHARACTERISTIC _g_PL_AD_fw_Radar_1R1V_rpc_LocBypassingRunnable_LocBypassingRunnable_m_pad_ensRLocationsPort_par_out_local.TChangeableMemPool._._._m_arrayPool._0_._elem._m_LocationList._Item._13_._Rcs._m_value "" VALUE 0xB00101D0 __Float16_Value 0 NO_COMPU_METHOD -65504 65504 ECU_ADDRESS_EXTENSION 0x2 BYTE_ORDER MSB_LAST /end CHARACTERISTIC
/begin CHARACTERISTIC _g_PL_AD_fw_Radar_1R1V_rpc_LocBypassingRunnable_LocBypassingRunnable_m_pad_ensRLocationsPort_par_out_local.TChangeableMemPool._._._m_arrayPool._0_._elem._m_LocationList._Item._13_._Rssi._m_value "" VALUE 0xB00101D2 __Float16_Value 0 NO_COMPU_METHOD -65504 65504 ECU_ADDRESS_EXTENSION 0x2 BYTE_ORDER MSB_LAST /end CHARACTERISTIC
/begin CHARACTERISTIC _g_PL_AD_fw_Radar_1R1V_rpc_LocBypassingRunnable_LocBypassingRunnable_m_pad_ensRLocationsPort_par_out_local.TChangeableMemPool._._._m_arrayPool._0_._elem._m_LocationList._Item._13_._d "" VALUE 0xB00101B8 __Float32_Value 0 NO_COMPU_METHOD -3.4028234663852886E+38 3.4028234663852886E+38 ECU_ADDRESS_EXTENSION 0x2 BYTE_ORDER MSB_LAST /end CHARACTERISTIC
/begin CHARACTERISTIC _g_PL_AD_fw_Radar_1R1V_rpc_LocBypassingRunnable_LocBypassingRunnable_m_pad_ensRLocationsPort_par_out_local.TChangeableMemPool._._._m_arrayPool._0_._elem._m_LocationList._Item._13_._dVar._m_value "" VALUE 0xB00101C0 __Float16_Value 0 NO_COMPU_METHOD -65504 65504 ECU_ADDRESS_EXTENSION 0x2 BYTE_ORDER MSB_LAST /end CHARACTERISTIC
/begin CHARACTERISTIC _g_PL_AD_fw_Radar_1R1V_rpc_LocBypassingRunnable_LocBypassingRunnable_m_pad_ensRLocationsPort_par_out_local.TChangeableMemPool._._._m_arrayPool._0_._elem._m_LocationList._Item._13_._dvCov._m_value "" VALUE 0xB00101C4 __Float16_Value 0 NO_COMPU_METHOD -65504 65504 ECU_ADDRESS_EXTENSION 0x2 BYTE_ORDER MSB_LAST /end CHARACTERISTIC
/begin CHARACTERISTIC _g_PL_AD_fw_Radar_1R1V_rpc_LocBypassingRunnable_LocBypassingRunnable_m_pad_ensRLocationsPort_par_out_local.TChangeableMemPool._._._m_arrayPool._0_._elem._m_LocationList._Item._13_._dvQly "" VALUE 0xB00101D4 __UByte_Value 0 NO_COMPU_METHOD 0 255 ECU_ADDRESS_EXTENSION 0x2 BYTE_ORDER MSB_LAST /end CHARACTERISTIC
/begin CHARACTERISTIC _g_PL_AD_fw_Radar_1R1V_rpc_LocBypassingRunnable_LocBypassingRunnable_m_pad_ensRLocationsPort_par_out_local.TChangeableMemPool._._._m_arrayPool._0_._elem._m_LocationList._Item._13_._idxAzimuthAmbiguityPeer "" VALUE 0xB00101D6 __UWord_Value 0 NO_COMPU_METHOD 0 65535 ECU_ADDRESS_EXTENSION 0x2 BYTE_ORDER MSB_LAST /end CHARACTERISTIC
/begin CHARACTERISTIC _g_PL_AD_fw_Radar_1R1V_rpc_LocBypassingRunnable_LocBypassingRunnable_m_pad_ensRLocationsPort_par_out_local.TChangeableMemPool._._._m_arrayPool._0_._elem._m_LocationList._Item._13_._measStatus "" VALUE 0xB00101D5 __UByte_Value 0 NO_COMPU_METHOD 0 255 ECU_ADDRESS_EXTENSION 0x2 BYTE_ORDER MSB_LAST /end CHARACTERISTIC
/begin CHARACTERISTIC _g_PL_AD_fw_Radar_1R1V_rpc_LocBypassingRunnable_LocBypassingRunnable_m_pad_ensRLocationsPort_par_out_local.TChangeableMemPool._._._m_arrayPool._0_._elem._m_LocationList._Item._13_._phi._m_value "" VALUE 0xB00101C8 __Float16_Value 0 NO_COMPU_METHOD -65504 65504 ECU_ADDRESS_EXTENSION 0x2 BYTE_ORDER MSB_LAST /end CHARACTERISTIC
/begin CHARACTERISTIC _g_PL_AD_fw_Radar_1R1V_rpc_LocBypassingRunnable_LocBypassingRunnable_m_pad_ensRLocationsPort_par_out_local.TChangeableMemPool._._._m_arrayPool._0_._elem._m_LocationList._Item._13_._phiQly "" VALUE 0xB00101CB __UByte_Value 0 NO_COMPU_METHOD 0 255 ECU_ADDRESS_EXTENSION 0x2 BYTE_ORDER MSB_LAST /end CHARACTERISTIC
/begin CHARACTERISTIC _g_PL_AD_fw_Radar_1R1V_rpc_LocBypassingRunnable_LocBypassingRunnable_m_pad_ensRLocationsPort_par_out_local.TChangeableMemPool._._._m_arrayPool._0_._elem._m_LocationList._Item._13_._phiVar._m_value "" VALUE 0xB00101CE __Float16_Value 0 NO_COMPU_METHOD -65504 65504 ECU_ADDRESS_EXTENSION 0x2 BYTE_ORDER MSB_LAST /end CHARACTERISTIC
/begin CHARACTERISTIC _g_PL_AD_fw_Radar_1R1V_rpc_LocBypassingRunnable_LocBypassingRunnable_m_pad_ensRLocationsPort_par_out_local.TChangeableMemPool._._._m_arrayPool._0_._elem._m_LocationList._Item._13_._theta._m_value "" VALUE 0xB00101C6 __Float16_Value 0 NO_COMPU_METHOD -65504 65504 ECU_ADDRESS_EXTENSION 0x2 BYTE_ORDER MSB_LAST /end CHARACTERISTIC
/begin CHARACTERISTIC _g_PL_AD_fw_Radar_1R1V_rpc_LocBypassingRunnable_LocBypassingRunnable_m_pad_ensRLocationsPort_par_out_local.TChangeableMemPool._._._m_arrayPool._0_._elem._m_LocationList._Item._13_._thetaQly "" VALUE 0xB00101CA __UByte_Value 0 NO_COMPU_METHOD 0 255 ECU_ADDRESS_EXTENSION 0x2 BYTE_ORDER MSB_LAST /end CHARACTERISTIC
/begin CHARACTERISTIC _g_PL_AD_fw_Radar_1R1V_rpc_LocBypassingRunnable_LocBypassingRunnable_m_pad_ensRLocationsPort_par_out_local.TChangeableMemPool._._._m_arrayPool._0_._elem._m_LocationList._Item._13_._thetaVar._m_value "" VALUE 0xB00101CC __Float16_Value 0 NO_COMPU_METHOD -65504 65504 ECU_ADDRESS_EXTENSION 0x2 BYTE_ORDER MSB_LAST /end CHARACTERISTIC
/begin CHARACTERISTIC _g_PL_AD_fw_Radar_1R1V_rpc_LocBypassingRunnable_LocBypassingRunnable_m_pad_ensRLocationsPort_par_out_local.TChangeableMemPool._._._m_arrayPool._0_._elem._m_LocationList._Item._13_._v "" VALUE 0xB00101BC __Float32_Value 0 NO_COMPU_METHOD -3.4028234663852886E+38 3.4028234663852886E+38 ECU_ADDRESS_EXTENSION 0x2 BYTE_ORDER MSB_LAST /end CHARACTERISTIC
/begin CHARACTERISTIC _g_PL_AD_fw_Radar_1R1V_rpc_LocBypassingRunnable_LocBypassingRunnable_m_pad_ensRLocationsPort_par_out_local.TChangeableMemPool._._._m_arrayPool._0_._elem._m_LocationList._Item._13_._vVar._m_value "" VALUE 0xB00101C2 __Float16_Value 0 NO_COMPU_METHOD -65504 65504 ECU_ADDRESS_EXTENSION 0x2 BYTE_ORDER MSB_LAST /end CHARACTERISTIC
/begin CHARACTERISTIC _g_PL_AD_fw_Radar_1R1V_rpc_LocBypassingRunnable_LocBypassingRunnable_m_pad_ensRLocationsPort_par_out_local.TChangeableMemPool._._._m_arrayPool._0_._elem._m_LocationList._Item._140_._Rcs._m_value "" VALUE 0xB00111B0 __Float16_Value 0 NO_COMPU_METHOD -65504 65504 ECU_ADDRESS_EXTENSION 0x2 BYTE_ORDER MSB_LAST /end CHARACTERISTIC
/begin CHARACTERISTIC _g_PL_AD_fw_Radar_1R1V_rpc_LocBypassingRunnable_LocBypassingRunnable_m_pad_ensRLocationsPort_par_out_local.TChangeableMemPool._._._m_arrayPool._0_._elem._m_LocationList._Item._140_._Rssi._m_value "" VALUE 0xB00111B2 __Float16_Value 0 NO_COMPU_METHOD -65504 65504 ECU_ADDRESS_EXTENSION 0x2 BYTE_ORDER MSB_LAST /end CHARACTERISTIC
/begin CHARACTERISTIC _g_PL_AD_fw_Radar_1R1V_rpc_LocBypassingRunnable_LocBypassingRunnable_m_pad_ensRLocationsPort_par_out_local.TChangeableMemPool._._._m_arrayPool._0_._elem._m_LocationList._Item._140_._d "" VALUE 0xB0011198 __Float32_Value 0 NO_COMPU_METHOD -3.4028234663852886E+38 3.4028234663852886E+38 ECU_ADDRESS_EXTENSION 0x2 BYTE_ORDER MSB_LAST /end CHARACTERISTIC
/begin CHARACTERISTIC _g_PL_AD_fw_Radar_1R1V_rpc_LocBypassingRunnable_LocBypassingRunnable_m_pad_ensRLocationsPort_par_out_local.TChangeableMemPool._._._m_arrayPool._0_._elem._m_LocationList._Item._140_._dVar._m_value "" VALUE 0xB00111A0 __Float16_Value 0 NO_COMPU_METHOD -65504 65504 ECU_ADDRESS_EXTENSION 0x2 BYTE_ORDER MSB_LAST /end CHARACTERISTIC
/begin CHARACTERISTIC _g_PL_AD_fw_Radar_1R1V_rpc_LocBypassingRunnable_LocBypassingRunnable_m_pad_ensRLocationsPort_par_out_local.TChangeableMemPool._._._m_arrayPool._0_._elem._m_LocationList._Item._140_._dvCov._m_value "" VALUE 0xB00111A4 __Float16_Value 0 NO_COMPU_METHOD -65504 65504 ECU_ADDRESS_EXTENSION 0x2 BYTE_ORDER MSB_LAST /end CHARACTERISTIC
/begin CHARACTERISTIC _g_PL_AD_fw_Radar_1R1V_rpc_LocBypassingRunnable_LocBypassingRunnable_m_pad_ensRLocationsPort_par_out_local.TChangeableMemPool._._._m_arrayPool._0_._elem._m_LocationList._Item._140_._dvQly "" VALUE 0xB00111B4 __UByte_Value 0 NO_COMPU_METHOD 0 255 ECU_ADDRESS_EXTENSION 0x2 BYTE_ORDER MSB_LAST /end CHARACTERISTIC
/begin CHARACTERISTIC _g_PL_AD_fw_Radar_1R1V_rpc_LocBypassingRunnable_LocBypassingRunnable_m_pad_ensRLocationsPort_par_out_local.TChangeableMemPool._._._m_arrayPool._0_._elem._m_LocationList._Item._140_._idxAzimuthAmbiguityPeer "" VALUE 0xB00111B6 __UWord_Value 0 NO_COMPU_METHOD 0 65535 ECU_ADDRESS_EXTENSION 0x2 BYTE_ORDER MSB_LAST /end CHARACTERISTIC
/begin CHARACTERISTIC _g_PL_AD_fw_Radar_1R1V_rpc_LocBypassingRunnable_LocBypassingRunnable_m_pad_ensRLocationsPort_par_out_local.TChangeableMemPool._._._m_arrayPool._0_._elem._m_LocationList._Item._140_._measStatus "" VALUE 0xB00111B5 __UByte_Value 0 NO_COMPU_METHOD 0 255 ECU_ADDRESS_EXTENSION 0x2 BYTE_ORDER MSB_LAST /end CHARACTERISTIC
/begin CHARACTERISTIC _g_PL_AD_fw_Radar_1R1V_rpc_LocBypassingRunnable_LocBypassingRunnable_m_pad_ensRLocationsPort_par_out_local.TChangeableMemPool._._._m_arrayPool._0_._elem._m_LocationList._Item._140_._phi._m_value "" VALUE 0xB00111A8 __Float16_Value 0 NO_COMPU_METHOD -65504 65504 ECU_ADDRESS_EXTENSION 0x2 BYTE_ORDER MSB_LAST /end CHARACTERISTIC
/begin CHARACTERISTIC _g_PL_AD_fw_Radar_1R1V_rpc_LocBypassingRunnable_LocBypassingRunnable_m_pad_ensRLocationsPort_par_out_local.TChangeableMemPool._._._m_arrayPool._0_._elem._m_LocationList._Item._140_._phiQly "" VALUE 0xB00111AB __UByte_Value 0 NO_COMPU_METHOD 0 255 ECU_ADDRESS_EXTENSION 0x2 BYTE_ORDER MSB_LAST /end CHARACTERISTIC
/begin CHARACTERISTIC _g_PL_AD_fw_Radar_1R1V_rpc_LocBypassingRunnable_LocBypassingRunnable_m_pad_ensRLocationsPort_par_out_local.TChangeableMemPool._._._m_arrayPool._0_._elem._m_LocationList._Item._140_._phiVar._m_value "" VALUE 0xB00111AE __Float16_Value 0 NO_COMPU_METHOD -65504 65504 ECU_ADDRESS_EXTENSION 0x2 BYTE_ORDER MSB_LAST /end CHARACTERISTIC
/begin CHARACTERISTIC _g_PL_AD_fw_Radar_1R1V_rpc_LocBypassingRunnable_LocBypassingRunnable_m_pad_ensRLocationsPort_par_out_local.TChangeableMemPool._._._m_arrayPool._0_._elem._m_LocationList._Item._140_._theta._m_value "" VALUE 0xB00111A6 __Float16_Value 0 NO_COMPU_METHOD -65504 65504 ECU_ADDRESS_EXTENSION 0x2 BYTE_ORDER MSB_LAST /end CHARACTERISTIC
/begin CHARACTERISTIC _g_PL_AD_fw_Radar_1R1V_rpc_LocBypassingRunnable_LocBypassingRunnable_m_pad_ensRLocationsPort_par_out_local.TChangeableMemPool._._._m_arrayPool._0_._elem._m_LocationList._Item._140_._thetaQly "" VALUE 0xB00111AA __UByte_Value 0 NO_COMPU_METHOD 0 255 ECU_ADDRESS_EXTENSION 0x2 BYTE_ORDER MSB_LAST /end CHARACTERISTIC
/begin CHARACTERISTIC _g_PL_AD_fw_Radar_1R1V_rpc_LocBypassingRunnable_LocBypassingRunnable_m_pad_ensRLocationsPort_par_out_local.TChangeableMemPool._._._m_arrayPool._0_._elem._m_LocationList._Item._140_._thetaVar._m_value "" VALUE 0xB00111AC __Float16_Value 0 NO_COMPU_METHOD -65504 65504 ECU_ADDRESS_EXTENSION 0x2 BYTE_ORDER MSB_LAST /end CHARACTERISTIC
/begin CHARACTERISTIC _g_PL_AD_fw_Radar_1R1V_rpc_LocBypassingRunnable_LocBypassingRunnable_m_pad_ensRLocationsPort_par_out_local.TChangeableMemPool._._._m_arrayPool._0_._elem._m_LocationList._Item._140_._v "" VALUE 0xB001119C __Float32_Value 0 NO_COMPU_METHOD -3.4028234663852886E+38 3.4028234663852886E+38 ECU_ADDRESS_EXTENSION 0x2 BYTE_ORDER MSB_LAST /end CHARACTERISTIC
/begin CHARACTERISTIC _g_PL_AD_fw_Radar_1R1V_rpc_LocBypassingRunnable_LocBypassingRunnable_m_pad_ensRLocationsPort_par_out_local.TChangeableMemPool._._._m_arrayPool._0_._elem._m_LocationList._Item._140_._vVar._m_value "" VALUE 0xB00111A2 __Float16_Value 0 NO_COMPU_METHOD -65504 65504 ECU_ADDRESS_EXTENSION 0x2 BYTE_ORDER MSB_LAST /end CHARACTERISTIC
/begin CHARACTERISTIC _g_PL_AD_fw_Radar_1R1V_rpc_LocBypassingRunnable_LocBypassingRunnable_m_pad_ensRLocationsPort_par_out_local.TChangeableMemPool._._._m_arrayPool._0_._elem._m_LocationList._Item._141_._Rcs._m_value "" VALUE 0xB00111D0 __Float16_Value 0 NO_COMPU_METHOD -65504 65504 ECU_ADDRESS_EXTENSION 0x2 BYTE_ORDER MSB_LAST /end CHARACTERISTIC
/begin CHARACTERISTIC _g_PL_AD_fw_Radar_1R1V_rpc_LocBypassingRunnable_LocBypassingRunnable_m_pad_ensRLocationsPort_par_out_local.TChangeableMemPool._._._m_arrayPool._0_._elem._m_LocationList._Item._141_._Rssi._m_value "" VALUE 0xB00111D2 __Float16_Value 0 NO_COMPU_METHOD -65504 65504 ECU_ADDRESS_EXTENSION 0x2 BYTE_ORDER MSB_LAST /end CHARACTERISTIC
/begin CHARACTERISTIC _g_PL_AD_fw_Radar_1R1V_rpc_LocBypassingRunnable_LocBypassingRunnable_m_pad_ensRLocationsPort_par_out_local.TChangeableMemPool._._._m_arrayPool._0_._elem._m_LocationList._Item._141_._d "" VALUE 0xB00111B8 __Float32_Value 0 NO_COMPU_METHOD -3.4028234663852886E+38 3.4028234663852886E+38 ECU_ADDRESS_EXTENSION 0x2 BYTE_ORDER MSB_LAST /end CHARACTERISTIC
/begin CHARACTERISTIC _g_PL_AD_fw_Radar_1R1V_rpc_LocBypassingRunnable_LocBypassingRunnable_m_pad_ensRLocationsPort_par_out_local.TChangeableMemPool._._._m_arrayPool._0_._elem._m_LocationList._Item._141_._dVar._m_value "" VALUE 0xB00111C0 __Float16_Value 0 NO_COMPU_METHOD -65504 65504 ECU_ADDRESS_EXTENSION 0x2 BYTE_ORDER MSB_LAST /end CHARACTERISTIC
/begin CHARACTERISTIC _g_PL_AD_fw_Radar_1R1V_rpc_LocBypassingRunnable_LocBypassingRunnable_m_pad_ensRLocationsPort_par_out_local.TChangeableMemPool._._._m_arrayPool._0_._elem._m_LocationList._Item._141_._dvCov._m_value "" VALUE 0xB00111C4 __Float16_Value 0 NO_COMPU_METHOD -65504 65504 ECU_ADDRESS_EXTENSION 0x2 BYTE_ORDER MSB_LAST /end CHARACTERISTIC
/begin CHARACTERISTIC _g_PL_AD_fw_Radar_1R1V_rpc_LocBypassingRunnable_LocBypassingRunnable_m_pad_ensRLocationsPort_par_out_local.TChangeableMemPool._._._m_arrayPool._0_._elem._m_LocationList._Item._141_._dvQly "" VALUE 0xB00111D4 __UByte_Value 0 NO_COMPU_METHOD 0 255 ECU_ADDRESS_EXTENSION 0x2 BYTE_ORDER MSB_LAST /end CHARACTERISTIC
/begin CHARACTERISTIC _g_PL_AD_fw_Radar_1R1V_rpc_LocBypassingRunnable_LocBypassingRunnable_m_pad_ensRLocationsPort_par_out_local.TChangeableMemPool._._._m_arrayPool._0_._elem._m_LocationList._Item._141_._idxAzimuthAmbiguityPeer "" VALUE 0xB00111D6 __UWord_Value 0 NO_COMPU_METHOD 0 65535 ECU_ADDRESS_EXTENSION 0x2 BYTE_ORDER MSB_LAST /end CHARACTERISTIC
/begin CHARACTERISTIC _g_PL_AD_fw_Radar_1R1V_rpc_LocBypassingRunnable_LocBypassingRunnable_m_pad_ensRLocationsPort_par_out_local.TChangeableMemPool._._._m_arrayPool._0_._elem._m_LocationList._Item._141_._measStatus "" VALUE 0xB00111D5 __UByte_Value 0 NO_COMPU_METHOD 0 255 ECU_ADDRESS_EXTENSION 0x2 BYTE_ORDER MSB_LAST /end CHARACTERISTIC
/begin CHARACTERISTIC _g_PL_AD_fw_Radar_1R1V_rpc_LocBypassingRunnable_LocBypassingRunnable_m_pad_ensRLocationsPort_par_out_local.TChangeableMemPool._._._m_arrayPool._0_._elem._m_LocationList._Item._141_._phi._m_value "" VALUE 0xB00111C8 __Float16_Value 0 NO_COMPU_METHOD -65504 65504 ECU_ADDRESS_EXTENSION 0x2 BYTE_ORDER MSB_LAST /end CHARACTERISTIC
/begin CHARACTERISTIC _g_PL_AD_fw_Radar_1R1V_rpc_LocBypassingRunnable_LocBypassingRunnable_m_pad_ensRLocationsPort_par_out_local.TChangeableMemPool._._._m_arrayPool._0_._elem._m_LocationList._Item._141_._phiQly "" VALUE 0xB00111CB __UByte_Value 0 NO_COMPU_METHOD 0 255 ECU_ADDRESS_EXTENSION 0x2 BYTE_ORDER MSB_LAST /end CHARACTERISTIC
/begin CHARACTERISTIC _g_PL_AD_fw_Radar_1R1V_rpc_LocBypassingRunnable_LocBypassingRunnable_m_pad_ensRLocationsPort_par_out_local.TChangeableMemPool._._._m_arrayPool._0_._elem._m_LocationList._Item._141_._phiVar._m_value "" VALUE 0xB00111CE __Float16_Value 0 NO_COMPU_METHOD -65504 65504 ECU_ADDRESS_EXTENSION 0x2 BYTE_ORDER MSB_LAST /end CHARACTERISTIC
/begin CHARACTERISTIC _g_PL_AD_fw_Radar_1R1V_rpc_LocBypassingRunnable_LocBypassingRunnable_m_pad_ensRLocationsPort_par_out_local.TChangeableMemPool._._._m_arrayPool._0_._elem._m_LocationList._Item._141_._theta._m_value "" VALUE 0xB00111C6 __Float16_Value 0 NO_COMPU_METHOD -65504 65504 ECU_ADDRESS_EXTENSION 0x2 BYTE_ORDER MSB_LAST /end CHARACTERISTIC
/begin CHARACTERISTIC _g_PL_AD_fw_Radar_1R1V_rpc_LocBypassingRunnable_LocBypassingRunnable_m_pad_ensRLocationsPort_par_out_local.TChangeableMemPool._._._m_arrayPool._0_._elem._m_LocationList._Item._141_._thetaQly "" VALUE 0xB00111CA __UByte_Value 0 NO_COMPU_METHOD 0 255 ECU_ADDRESS_EXTENSION 0x2 BYTE_ORDER MSB_LAST /end CHARACTERISTIC
/begin CHARACTERISTIC _g_PL_AD_fw_Radar_1R1V_rpc_LocBypassingRunnable_LocBypassingRunnable_m_pad_ensRLocationsPort_par_out_local.TChangeableMemPool._._._m_arrayPool._0_._elem._m_LocationList._Item._141_._thetaVar._m_value "" VALUE 0xB00111CC __Float16_Value 0 NO_COMPU_METHOD -65504 65504 ECU_ADDRESS_EXTENSION 0x2 BYTE_ORDER MSB_LAST /end CHARACTERISTIC
/begin CHARACTERISTIC _g_PL_AD_fw_Radar_1R1V_rpc_LocBypassingRunnable_LocBypassingRunnable_m_pad_ensRLocationsPort_par_out_local.TChangeableMemPool._._._m_arrayPool._0_._elem._m_LocationList._Item._141_._v "" VALUE 0xB00111BC __Float32_Value 0 NO_COMPU_METHOD -3.4028234663852886E+38 3.4028234663852886E+38 ECU_ADDRESS_EXTENSION 0x2 BYTE_ORDER MSB_LAST /end CHARACTERISTIC
/begin CHARACTERISTIC _g_PL_AD_fw_Radar_1R1V_rpc_LocBypassingRunnable_LocBypassingRunnable_m_pad_ensRLocationsPort_par_out_local.TChangeableMemPool._._._m_arrayPool._0_._elem._m_LocationList._Item._141_._vVar._m_value "" VALUE 0xB00111C2 __Float16_Value 0 NO_COMPU_METHOD -65504 65504 ECU_ADDRESS_EXTENSION 0x2 BYTE_ORDER MSB_LAST /end CHARACTERISTIC
/begin CHARACTERISTIC _g_PL_AD_fw_Radar_1R1V_rpc_LocBypassingRunnable_LocBypassingRunnable_m_pad_ensRLocationsPort_par_out_local.TChangeableMemPool._._._m_arrayPool._0_._elem._m_LocationList._Item._142_._Rcs._m_value "" VALUE 0xB00111F0 __Float16_Value 0 NO_COMPU_METHOD -65504 65504 ECU_ADDRESS_EXTENSION 0x2 BYTE_ORDER MSB_LAST /end CHARACTERISTIC
/begin CHARACTERISTIC _g_PL_AD_fw_Radar_1R1V_rpc_LocBypassingRunnable_LocBypassingRunnable_m_pad_ensRLocationsPort_par_out_local.TChangeableMemPool._._._m_arrayPool._0_._elem._m_LocationList._Item._142_._Rssi._m_value "" VALUE 0xB00111F2 __Float16_Value 0 NO_COMPU_METHOD -65504 65504 ECU_ADDRESS_EXTENSION 0x2 BYTE_ORDER MSB_LAST /end CHARACTERISTIC
/begin CHARACTERISTIC _g_PL_AD_fw_Radar_1R1V_rpc_LocBypassingRunnable_LocBypassingRunnable_m_pad_ensRLocationsPort_par_out_local.TChangeableMemPool._._._m_arrayPool._0_._elem._m_LocationList._Item._142_._d "" VALUE 0xB00111D8 __Float32_Value 0 NO_COMPU_METHOD -3.4028234663852886E+38 3.4028234663852886E+38 ECU_ADDRESS_EXTENSION 0x2 BYTE_ORDER MSB_LAST /end CHARACTERISTIC
/begin CHARACTERISTIC _g_PL_AD_fw_Radar_1R1V_rpc_LocBypassingRunnable_LocBypassingRunnable_m_pad_ensRLocationsPort_par_out_local.TChangeableMemPool._._._m_arrayPool._0_._elem._m_LocationList._Item._142_._dVar._m_value "" VALUE 0xB00111E0 __Float16_Value 0 NO_COMPU_METHOD -65504 65504 ECU_ADDRESS_EXTENSION 0x2 BYTE_ORDER MSB_LAST /end CHARACTERISTIC
/begin CHARACTERISTIC _g_PL_AD_fw_Radar_1R1V_rpc_LocBypassingRunnable_LocBypassingRunnable_m_pad_ensRLocationsPort_par_out_local.TChangeableMemPool._._._m_arrayPool._0_._elem._m_LocationList._Item._142_._dvCov._m_value "" VALUE 0xB00111E4 __Float16_Value 0 NO_COMPU_METHOD -65504 65504 ECU_ADDRESS_EXTENSION 0x2 BYTE_ORDER MSB_LAST /end CHARACTERISTIC
/begin CHARACTERISTIC _g_PL_AD_fw_Radar_1R1V_rpc_LocBypassingRunnable_LocBypassingRunnable_m_pad_ensRLocationsPort_par_out_local.TChangeableMemPool._._._m_arrayPool._0_._elem._m_LocationList._Item._142_._dvQly "" VALUE 0xB00111F4 __UByte_Value 0 NO_COMPU_METHOD 0 255 ECU_ADDRESS_EXTENSION 0x2 BYTE_ORDER MSB_LAST /end CHARACTERISTIC
/begin CHARACTERISTIC _g_PL_AD_fw_Radar_1R1V_rpc_LocBypassingRunnable_LocBypassingRunnable_m_pad_ensRLocationsPort_par_out_local.TChangeableMemPool._._._m_arrayPool._0_._elem._m_LocationList._Item._142_._idxAzimuthAmbiguityPeer "" VALUE 0xB00111F6 __UWord_Value 0 NO_COMPU_METHOD 0 65535 ECU_ADDRESS_EXTENSION 0x2 BYTE_ORDER MSB_LAST /end CHARACTERISTIC
/begin CHARACTERISTIC _g_PL_AD_fw_Radar_1R1V_rpc_LocBypassingRunnable_LocBypassingRunnable_m_pad_ensRLocationsPort_par_out_local.TChangeableMemPool._._._m_arrayPool._0_._elem._m_LocationList._Item._142_._measStatus "" VALUE 0xB00111F5 __UByte_Value 0 NO_COMPU_METHOD 0 255 ECU_ADDRESS_EXTENSION 0x2 BYTE_ORDER MSB_LAST /end CHARACTERISTIC
/begin CHARACTERISTIC _g_PL_AD_fw_Radar_1R1V_rpc_LocBypassingRunnable_LocBypassingRunnable_m_pad_ensRLocationsPort_par_out_local.TChangeableMemPool._._._m_arrayPool._0_._elem._m_LocationList._Item._142_._phi._m_value "" VALUE 0xB00111E8 __Float16_Value 0 NO_COMPU_METHOD -65504 65504 ECU_ADDRESS_EXTENSION 0x2 BYTE_ORDER MSB_LAST /end CHARACTERISTIC
/begin CHARACTERISTIC _g_PL_AD_fw_Radar_1R1V_rpc_LocBypassingRunnable_LocBypassingRunnable_m_pad_ensRLocationsPort_par_out_local.TChangeableMemPool._._._m_arrayPool._0_._elem._m_LocationList._Item._142_._phiQly "" VALUE 0xB00111EB __UByte_Value 0 NO_COMPU_METHOD 0 255 ECU_ADDRESS_EXTENSION 0x2 BYTE_ORDER MSB_LAST /end CHARACTERISTIC
/begin CHARACTERISTIC _g_PL_AD_fw_Radar_1R1V_rpc_LocBypassingRunnable_LocBypassingRunnable_m_pad_ensRLocationsPort_par_out_local.TChangeableMemPool._._._m_arrayPool._0_._elem._m_LocationList._Item._142_._phiVar._m_value "" VALUE 0xB00111EE __Float16_Value 0 NO_COMPU_METHOD -65504 65504 ECU_ADDRESS_EXTENSION 0x2 BYTE_ORDER MSB_LAST /end CHARACTERISTIC
/begin CHARACTERISTIC _g_PL_AD_fw_Radar_1R1V_rpc_LocBypassingRunnable_LocBypassingRunnable_m_pad_ensRLocationsPort_par_out_local.TChangeableMemPool._._._m_arrayPool._0_._elem._m_LocationList._Item._142_._theta._m_value "" VALUE 0xB00111E6 __Float16_Value 0 NO_COMPU_METHOD -65504 65504 ECU_ADDRESS_EXTENSION 0x2 BYTE_ORDER MSB_LAST /end CHARACTERISTIC
/begin CHARACTERISTIC _g_PL_AD_fw_Radar_1R1V_rpc_LocBypassingRunnable_LocBypassingRunnable_m_pad_ensRLocationsPort_par_out_local.TChangeableMemPool._._._m_arrayPool._0_._elem._m_LocationList._Item._142_._thetaQly "" VALUE 0xB00111EA __UByte_Value 0 NO_COMPU_METHOD 0 255 ECU_ADDRESS_EXTENSION 0x2 BYTE_ORDER MSB_LAST /end CHARACTERISTIC
/begin CHARACTERISTIC _g_PL_AD_fw_Radar_1R1V_rpc_LocBypassingRunnable_LocBypassingRunnable_m_pad_ensRLocationsPort_par_out_local.TChangeableMemPool._._._m_arrayPool._0_._elem._m_LocationList._Item._142_._thetaVar._m_value "" VALUE 0xB00111EC __Float16_Value 0 NO_COMPU_METHOD -65504 65504 ECU_ADDRESS_EXTENSION 0x2 BYTE_ORDER MSB_LAST /end CHARACTERISTIC
/begin CHARACTERISTIC _g_PL_AD_fw_Radar_1R1V_rpc_LocBypassingRunnable_LocBypassingRunnable_m_pad_ensRLocationsPort_par_out_local.TChangeableMemPool._._._m_arrayPool._0_._elem._m_LocationList._Item._142_._v "" VALUE 0xB00111DC __Float32_Value 0 NO_COMPU_METHOD -3.4028234663852886E+38 3.4028234663852886E+38 ECU_ADDRESS_EXTENSION 0x2 BYTE_ORDER MSB_LAST /end CHARACTERISTIC
/begin CHARACTERISTIC _g_PL_AD_fw_Radar_1R1V_rpc_LocBypassingRunnable_LocBypassingRunnable_m_pad_ensRLocationsPort_par_out_local.TChangeableMemPool._._._m_arrayPool._0_._elem._m_LocationList._Item._142_._vVar._m_value "" VALUE 0xB00111E2 __Float16_Value 0 NO_COMPU_METHOD -65504 65504 ECU_ADDRESS_EXTENSION 0x2 BYTE_ORDER MSB_LAST /end CHARACTERISTIC
/begin CHARACTERISTIC _g_PL_AD_fw_Radar_1R1V_rpc_LocBypassingRunnable_LocBypassingRunnable_m_pad_ensRLocationsPort_par_out_local.TChangeableMemPool._._._m_arrayPool._0_._elem._m_LocationList._Item._143_._Rcs._m_value "" VALUE 0xB0011210 __Float16_Value 0 NO_COMPU_METHOD -65504 65504 ECU_ADDRESS_EXTENSION 0x2 BYTE_ORDER MSB_LAST /end CHARACTERISTIC
/begin CHARACTERISTIC _g_PL_AD_fw_Radar_1R1V_rpc_LocBypassingRunnable_LocBypassingRunnable_m_pad_ensRLocationsPort_par_out_local.TChangeableMemPool._._._m_arrayPool._0_._elem._m_LocationList._Item._143_._Rssi._m_value "" VALUE 0xB0011212 __Float16_Value 0 NO_COMPU_METHOD -65504 65504 ECU_ADDRESS_EXTENSION 0x2 BYTE_ORDER MSB_LAST /end CHARACTERISTIC
/begin CHARACTERISTIC _g_PL_AD_fw_Radar_1R1V_rpc_LocBypassingRunnable_LocBypassingRunnable_m_pad_ensRLocationsPort_par_out_local.TChangeableMemPool._._._m_arrayPool._0_._elem._m_LocationList._Item._143_._d "" VALUE 0xB00111F8 __Float32_Value 0 NO_COMPU_METHOD -3.4028234663852886E+38 3.4028234663852886E+38 ECU_ADDRESS_EXTENSION 0x2 BYTE_ORDER MSB_LAST /end CHARACTERISTIC
/begin CHARACTERISTIC _g_PL_AD_fw_Radar_1R1V_rpc_LocBypassingRunnable_LocBypassingRunnable_m_pad_ensRLocationsPort_par_out_local.TChangeableMemPool._._._m_arrayPool._0_._elem._m_LocationList._Item._143_._dVar._m_value "" VALUE 0xB0011200 __Float16_Value 0 NO_COMPU_METHOD -65504 65504 ECU_ADDRESS_EXTENSION 0x2 BYTE_ORDER MSB_LAST /end CHARACTERISTIC
/begin CHARACTERISTIC _g_PL_AD_fw_Radar_1R1V_rpc_LocBypassingRunnable_LocBypassingRunnable_m_pad_ensRLocationsPort_par_out_local.TChangeableMemPool._._._m_arrayPool._0_._elem._m_LocationList._Item._143_._dvCov._m_value "" VALUE 0xB0011204 __Float16_Value 0 NO_COMPU_METHOD -65504 65504 ECU_ADDRESS_EXTENSION 0x2 BYTE_ORDER MSB_LAST /end CHARACTERISTIC
/begin CHARACTERISTIC _g_PL_AD_fw_Radar_1R1V_rpc_LocBypassingRunnable_LocBypassingRunnable_m_pad_ensRLocationsPort_par_out_local.TChangeableMemPool._._._m_arrayPool._0_._elem._m_LocationList._Item._143_._dvQly "" VALUE 0xB0011214 __UByte_Value 0 NO_COMPU_METHOD 0 255 ECU_ADDRESS_EXTENSION 0x2 BYTE_ORDER MSB_LAST /end CHARACTERISTIC
/begin COMPU_METHOD EDiaInternalStates_Copy1 "enumeration table" TAB_VERB "%.0" "" COMPU_TAB_REF EDiaInternalStates_Copy1 /end COMPU_METHOD
/begin COMPU_METHOD EErrorIDs "enumeration table" TAB_VERB "%.0" "" COMPU_TAB_REF EErrorIDs /end COMPU_METHOD
/begin COMPU_METHOD ELineLength "enumeration table" TAB_VERB "%.0" "" COMPU_TAB_REF ELineLength /end COMPU_METHOD
/begin COMPU_METHOD ELongComfFunc "enumeration table" TAB_VERB "%.0" "" COMPU_TAB_REF ELongComfFunc /end COMPU_METHOD
/begin COMPU_METHOD EMEM_voltage.CONVERSION "@@@@RuleName created by CANape" LINEAR "%3.1" "" COEFFS_LINEAR 0.0015209960937500001 0 /end COMPU_METHOD
/begin COMPU_METHOD EMainState "enumeration table" TAB_VERB "%.0" "" COMPU_TAB_REF EMainState /end COMPU_METHOD
/begin COMPU_METHOD EManagerDatasetStatus "enumeration table" TAB_VERB "%.0" "" COMPU_TAB_REF EManagerDatasetStatus /end COMPU_METHOD
/begin COMPU_METHOD EMovementState "enumeration table" TAB_VERB "%.0" "" COMPU_TAB_REF EMovementState /end COMPU_METHOD
/begin COMPU_METHOD EObjectClass "enumeration table" TAB_VERB "%.0" "" COMPU_TAB_REF EObjectClass /end COMPU_METHOD
/begin COMPU_METHOD EObjectLane "enumeration table" TAB_VERB "%.0" "" COMPU_TAB_REF EObjectLane /end COMPU_METHOD
/begin COMPU_METHOD EObjectPreSelect "enumeration table" TAB_VERB "%.0" "" COMPU_TAB_REF EObjectPreSelect /end COMPU_METHOD
/begin COMPU_METHOD EObjectQualifierCMS "enumeration table" TAB_VERB "%.0" "" COMPU_TAB_REF EObjectQualifierCMS /end COMPU_METHOD
/begin COMPU_METHOD EObjectQualifierDTR "enumeration table" TAB_VERB "%.0" "" COMPU_TAB_REF EObjectQualifierDTR /end COMPU_METHOD
/begin COMPU_METHOD EObstacleClassification "enumeration table" TAB_VERB "%.0" "" COMPU_TAB_REF EObstacleClassification /end COMPU_METHOD
/begin COMPU_METHOD EOrientAngle "enumeration table" TAB_VERB "%.0" "" COMPU_TAB_REF EOrientAngle /end COMPU_METHOD
/begin COMPU_METHOD EOrientAngleFault "enumeration table" TAB_VERB "%.0" "" COMPU_TAB_REF EOrientAngleFault /end COMPU_METHOD
/begin COMPU_METHOD EQ_LSB_0_00048828125 "" LINEAR "%13.11" "" COEFFS_LINEAR 0.00048828125 0 /end COMPU_METHOD
/begin COMPU_METHOD EQ_LSB_0_03125 "" LINEAR "%9.5" "" COEFFS_LINEAR 0.03125 0 /end COMPU_METHOD
/begin COMPU_METHOD ERifStatus "enumeration table" TAB_VERB "%.0" "" COMPU_TAB_REF ERifStatus /end COMPU_METHOD
/begin COMPU_METHOD ERxsOcpDir "enumeration table" TAB_VERB "%.0" "" COMPU_TAB_REF ERxsOcpDir /end COMPU_METHOD
/begin COMPU_METHOD ESetSpeedRoundingStrategy "enumeration table" TAB_VERB "%.0" "" COMPU_TAB_REF ESetSpeedRoundingStrategy /end COMPU_METHOD
/begin COMPU_METHOD EState "enumeration table" TAB_VERB "%.0" "" COMPU_TAB_REF EState /end COMPU_METHOD
/begin COMPU_METHOD ETimeGapProcessesingStrategy "enumeration table" TAB_VERB "%.0" "" COMPU_TAB_REF ETimeGapProcessesingStrategy /end COMPU_METHOD
/begin COMPU_METHOD EVarSrchRng "enumeration table" TAB_VERB "%.0" "" COMPU_TAB_REF EVarSrchRng /end COMPU_METHOD
/begin COMPU_METHOD EVarSteps "enumeration table" TAB_VERB "%.0" "" COMPU_TAB_REF EVarSteps /end COMPU_METHOD
/begin COMPU_METHOD EVariantIdx "enumeration table" TAB_VERB "%.0" "" COMPU_TAB_REF EVariantIdx /end COMPU_METHOD
/begin COMPU_METHOD EffectiveSpeedLimitTypeAndCondition "enumeration table" TAB_VERB "%.0" "" COMPU_TAB_REF EffectiveSpeedLimitTypeAndCondition /end COMPU_METHOD
/begin COMPU_METHOD EmsStandstillIndication "enumeration table" TAB_VERB "%.0" "" COMPU_TAB_REF EmsStandstillIndication /end COMPU_METHOD
/begin COMPU_METHOD EmsWheelMovingDirection "enumeration table" TAB_VERB "%.0" "" COMPU_TAB_REF EmsWheelMovingDirection /end COMPU_METHOD
/begin COMPU_METHOD EngineStrategyPrivate "enumeration table" TAB_VERB "%.0" "" COMPU_TAB_REF EngineStrategyPrivate /end COMPU_METHOD
/begin COMPU_METHOD EventId "enumeration table" TAB_VERB "%.0" "" COMPU_TAB_REF EventId /end COMPU_METHOD
/begin COMPU_METHOD EventId_Copy1 "enumeration table" TAB_VERB "%.0" "" COMPU_TAB_REF EventId_Copy1 /end COMPU_METHOD
/begin COMPU_METHOD EventId_Copy2 "enumeration table" TAB_VERB "%.0" "" COMPU_TAB_REF EventId_Copy2 /end COMPU_METHOD
/begin COMPU_METHOD EventId_Copy3 "enumeration table" TAB_VERB "%.0" "" COMPU_TAB_REF EventId_Copy3 /end COMPU_METHOD
/begin COMPU_METHOD ExecutionRecommendation "enumeration table" TAB_VERB "%.0" "" COMPU_TAB_REF ExecutionRecommendation /end COMPU_METHOD
/begin COMPU_METHOD FCTRequest "enumeration table" TAB_VERB "%.0" "" COMPU_TAB_REF FCTRequest /end COMPU_METHOD
/begin COMPU_METHOD FCTRequest_Copy1 "enumeration table" TAB_VERB "%.0" "" COMPU_TAB_REF FCTRequest_Copy1 /end COMPU_METHOD
/begin COMPU_METHOD FEP_Statemachine_State_t "enumeration table" TAB_VERB "%.0" "" COMPU_TAB_REF FEP_Statemachine_State_t /end COMPU_METHOD
/begin COMPU_METHOD FadeStrategy_v0 "enumeration table" TAB_VERB "%.0" "" COMPU_TAB_REF FadeStrategy_v0 /end COMPU_METHOD
/begin COMPU_METHOD FilteringPhase "enumeration table" TAB_VERB "%.0" "" COMPU_TAB_REF FilteringPhase /end COMPU_METHOD
/begin COMPU_METHOD FourTruthValue "enumeration table" TAB_VERB "%.0" "" COMPU_TAB_REF FourTruthValue /end COMPU_METHOD
/begin COMPU_METHOD HSM_FunctionTag "enumeration table" TAB_VERB "%.0" "" COMPU_TAB_REF HSM_FunctionTag /end COMPU_METHOD
/begin COMPU_METHOD HSM_ModeTag "enumeration table" TAB_VERB "%.0" "" COMPU_TAB_REF HSM_ModeTag /end COMPU_METHOD
/begin COMPU_METHOD HSM_PortStatusTag "enumeration table" TAB_VERB "%.0" "" COMPU_TAB_REF HSM_PortStatusTag /end COMPU_METHOD
/begin COMPU_METHOD HV_SERVICE_AVAILABILITY_STATES "enumeration table" TAB_VERB "%.0" "" COMPU_TAB_REF HV_SERVICE_AVAILABILITY_STATES /end COMPU_METHOD
/begin COMPU_METHOD HapticWarningViaBrakeProfile "enumeration table" TAB_VERB "%.0" "" COMPU_TAB_REF HapticWarningViaBrakeProfile /end COMPU_METHOD
/begin COMPU_METHOD IIR2FilterStates "enumeration table" TAB_VERB "%.0" "" COMPU_TAB_REF IIR2FilterStates /end COMPU_METHOD
/begin COMPU_METHOD IcmDebugSyncPoints_t "enumeration table" TAB_VERB "%.0" "" COMPU_TAB_REF IcmDebugSyncPoints_t /end COMPU_METHOD
/begin COMPU_METHOD IcmDet "enumeration table" TAB_VERB "%.0" "" COMPU_TAB_REF IcmDet /end COMPU_METHOD
/begin COMPU_METHOD IcmDetInd "enumeration table" TAB_VERB "%.0" "" COMPU_TAB_REF IcmDetInd /end COMPU_METHOD
/begin COMPU_METHOD IcmDetInd_Copy1 "enumeration table" TAB_VERB "%.0" "" COMPU_TAB_REF IcmDetInd_Copy1 /end COMPU_METHOD
/begin COMPU_METHOD IcmDetSubState "enumeration table" TAB_VERB "%.0" "" COMPU_TAB_REF IcmDetSubState /end COMPU_METHOD
/begin COMPU_METHOD IcmDetSubState_Copy1 "enumeration table" TAB_VERB "%.0" "" COMPU_TAB_REF IcmDetSubState_Copy1 /end COMPU_METHOD
/begin COMPU_METHOD IcmDet_Copy1 "enumeration table" TAB_VERB "%.0" "" COMPU_TAB_REF IcmDet_Copy1 /end COMPU_METHOD
/begin COMPU_METHOD IcmMainState "enumeration table" TAB_VERB "%.0" "" COMPU_TAB_REF IcmMainState /end COMPU_METHOD
/begin COMPU_METHOD IcmMainState_Copy1 "enumeration table" TAB_VERB "%.0" "" COMPU_TAB_REF IcmMainState_Copy1 /end COMPU_METHOD
/begin COMPU_METHOD IcmRepSubState "enumeration table" TAB_VERB "%.0" "" COMPU_TAB_REF IcmRepSubState /end COMPU_METHOD
/begin COMPU_METHOD IcmRepSubState_Copy1 "enumeration table" TAB_VERB "%.0" "" COMPU_TAB_REF IcmRepSubState_Copy1 /end COMPU_METHOD
/begin COMPU_METHOD IfxPort_Mode "enumeration table" TAB_VERB "%.0" "" COMPU_TAB_REF IfxPort_Mode /end COMPU_METHOD
/begin COMPU_METHOD IfxPort_PadDriver "enumeration table" TAB_VERB "%.0" "" COMPU_TAB_REF IfxPort_PadDriver /end COMPU_METHOD
/begin COMPU_METHOD IndicatorBlindnessState "enumeration table" TAB_VERB "%.0" "" COMPU_TAB_REF IndicatorBlindnessState /end COMPU_METHOD
/begin COMPU_METHOD LaneAssociation "enumeration table" TAB_VERB "%.0" "" COMPU_TAB_REF LaneAssociation /end COMPU_METHOD
/begin COMPU_METHOD LcState "enumeration table" TAB_VERB "%.0" "" COMPU_TAB_REF LcState /end COMPU_METHOD
/begin COMPU_METHOD LcmStateId "enumeration table" TAB_VERB "%.0" "" COMPU_TAB_REF LcmStateId /end COMPU_METHOD
/begin COMPU_METHOD LocIntStatus "enumeration table" TAB_VERB "%.0" "" COMPU_TAB_REF LocIntStatus /end COMPU_METHOD
/begin COMPU_METHOD MetaState "enumeration table" TAB_VERB "%.0" "" COMPU_TAB_REF MetaState /end COMPU_METHOD
/begin COMPU_METHOD MotionModelType "enumeration table" TAB_VERB "%.0" "" COMPU_TAB_REF MotionModelType /end COMPU_METHOD
/begin COMPU_METHOD MotionModelType.OLD_Copy1 "enumeration table" TAB_VERB "%.0" "" COMPU_TAB_REF MotionModelType.OLD_1 /end COMPU_METHOD
/begin COMPU_METHOD MotionType "enumeration table" TAB_VERB "%.0" "" COMPU_TAB_REF MotionType /end COMPU_METHOD
/begin COMPU_METHOD NO_FORMULA "" IDENTICAL "%6.2" "" /end COMPU_METHOD
/begin COMPU_METHOD N_dSW_ub "Norming of distances (Laengs und Quer)" LINEAR "%10.7" "m" COEFFS_LINEAR 0.0078125 0 /end COMPU_METHOD
/begin COMPU_METHOD N_fak2UW_uw "Norming of Faktoren zw. 0 u 2" LINEAR "%16.15" "-" COEFFS_LINEAR 3.0517578125E-05 0 /end COMPU_METHOD
/begin COMPU_METHOD N_fak4SW_uw "Norming of Faktoren zw. -4 u 4" LINEAR "%14.13" "-" COEFFS_LINEAR 0.0001220703125 0 /end COMPU_METHOD
/begin COMPU_METHOD N_tUL_uw "Norming of time (Zeitluecke und Differenzzeiten)" LINEAR "%19.11" "s" COEFFS_LINEAR 0.00048828125 0 /end COMPU_METHOD
/begin COMPU_METHOD N_tUW_uw "Norming of time (Zeitluecke und Differenzzeiten)" LINEAR "%14.11" "s" COEFFS_LINEAR 0.00048828125 0 /end COMPU_METHOD
/begin COMPU_METHOD N_vSW_uw "Norming of velocity" LINEAR "%11.8" "m/s" COEFFS_LINEAR 0.00390625 0 /end COMPU_METHOD
/begin COMPU_METHOD ObjectType "enumeration table" TAB_VERB "%.0" "" COMPU_TAB_REF ObjectType /end COMPU_METHOD
/begin COMPU_METHOD ObstacleSensorIndex "enumeration table" TAB_VERB "%.0" "" COMPU_TAB_REF ObstacleSensorIndex /end COMPU_METHOD
/begin COMPU_VTAB EDiaInternalStates_Copy1 "enumeration table" TAB_VERB 17 0 "DIA_INTERNAL_STATE_IDLE" 1 "DIA_INTERNAL_STATE_CHECK_START_REQUEST_PARAMS" 2 "DIA_INTERNAL_STATE_CHECK_PRECONDITIONS" 3 "DIA_INTERNAL_STATE_CHECK_START_COMPONENT_STATE" 4 "DIA_INTERNAL_STATE_INIT_ERROR" 5 "DIA_INTERNAL_STATE_START_ERROR" 6 "DIA_INTERNAL_STATE_WAITING_RUNNING" 7 "DIA_INTERNAL_STATE_CHECK_RUN_TO_STOP_REQUEST" 8 "DIA_INTERNAL_STATE_CHECK_STOP_CONDITIONS" 9 "DIA_INTERNAL_STATE_CHECK_STOP_COMPONENT_STATE" 10 "DIA_INTERNAL_STATE_TWICE_STARTED" 11 "DIA_INTERNAL_STATE_PROCESS_STOP" 12 "DIA_INTERNAL_STATE_WAITING_STOP" 13 "DIA_INTERNAL_STATE_STOP_ERROR" 14 "DIA_INTERNAL_STATE_STOPPED" 15 "DIA_INTERNAL_STATE_CHECK_IDLE_TO_STOP_REQUEST" 16 "DIA_INTERNAL_STATE_STOP_BUT_NEVER_STARTED" /end COMPU_VTAB
/begin COMPU_VTAB EErrorIDs "enumeration table" TAB_VERB 36 70 "E_DataLostError" 71 "E_AssignFullDataLostError" 72 "E_ReleaseFullDataLostError" 73 "E_DataFullDataLostError" 74 "E_MempoolFullError" 75 "E_NoMempoolError" 76 "E_MempoolAlreadyConnected" 77 "E_ConnectCommandError" 78 "E_DisconnectCommandError" 79 "E_DoubleConnectError" 80 "E_RemoveSubscriberError" 81 "E_CRCError" 82 "E_PlacementReserveError" 83 "E_SizeMismatchError" 84 "E_InvalidPointerError" 85 "E_InvalidSequenceNumberError" 86 "E_SubscriberOverflowError" 87 "E_PortCommandOverflowError" 88 "E_RecorderOverflowError" 89 "E_InselSelectError" 90 "E_NoLastDeliveryToBeReservedError" 91 "E_SenderReceiverConcurrencyError" 92 "E_PortProxyUnassociatedError" 93 "E_PortProxyDoubleConnectionError" 94 "E_SenderPortInvalidProxyError" 95 "E_SenderPortDoubleProxyConnectionError" 96 "E_ReceiverPortInvalidProxyError" 97 "E_ReceiverPortDoubleProxyConnectionError" 98 "E_AssignError" 99 "E_AssignCounterError" 100 "E_ReleaseError" 101 "E_COOLSharedMemoryMemPoolError" 102 "E_COOLSharedMemoryMemSetPortDataPoolError" 103 "E_COOLInterDomainContainerError" 104 "E_MeasurementIdOutOfRange" 105 "E_IncorrectBaseClassError" /end COMPU_VTAB
/begin COMPU_VTAB ELineLength "enumeration table" TAB_VERB 7 0 "class0" 1 "class1" 2 "class2" 3 "class3" 4 "class4" 5 "class5" 6 "class6" /end COMPU_VTAB
/begin COMPU_VTAB ELongComfFunc "enumeration table" TAB_VERB 3 0 "ACC" 1 "ADC" 2 "Parallel" /end COMPU_VTAB
/begin COMPU_VTAB EMainState "enumeration table" TAB_VERB 4 0 "init" 1 "normal" 2 "defaults" 3 "error" /end COMPU_VTAB
/begin COMPU_VTAB EManagerDatasetStatus "enumeration table" TAB_VERB 4 0 "notEvaluated" 1 "notAvailable" 2 "incompatible" 3 "valid" /end COMPU_VTAB
/begin COMPU_VTAB EMovementState "enumeration table" TAB_VERB 8 0 "none" 1 "moving" 2 "stopped" 3 "stationary" 4 "oncoming" 5 "stoppedOncoming" 6 "starting" 7 "crossing" /end COMPU_VTAB
/begin COMPU_VTAB EObjectClass "enumeration table" TAB_VERB 11 0 "point" 1 "pedestrian" 2 "bicycle" 3 "motorbike" 4 "car" 5 "truck" 6 "wide" 7 "animal" 8 "unknown" 9 "twoWheeler" 14 "noClass" /end COMPU_VTAB
/begin COMPU_VTAB EObjectLane "enumeration table" TAB_VERB 6 0 "noLane" 1 "ego" 2 "firstLeft" 3 "firstRight" 4 "secondLeft" 5 "secondRight" /end COMPU_VTAB
/begin COMPU_VTAB EObjectPreSelect "enumeration table" TAB_VERB 10 0 "notSelected" 1 "firstEgo" 2 "secondEgo" 3 "firstLeft" 4 "secondLeft" 5 "otherLeftCutIn" 6 "firstRight" 7 "secondRight" 8 "otherCutInRight" 9 "crossing" /end COMPU_VTAB
/begin COMPU_VTAB EObjectQualifierCMS "enumeration table" TAB_VERB 4 0 "noQual" 1 "longCollisionWarn" 2 "longCollisionBrake" 3 "fusion" /end COMPU_VTAB
/begin COMPU_VTAB EObjectQualifierDTR "enumeration table" TAB_VERB 3 0 "noQual" 1 "accept" 2 "fusion" /end COMPU_VTAB
/begin COMPU_VTAB EObstacleClassification "enumeration table" TAB_VERB 4 0 "noClass" 1 "obstacleHigh" 2 "obstacleLow" 3 "noObstacle" /end COMPU_VTAB
/begin COMPU_VTAB EOrientAngle "enumeration table" TAB_VERB 10 0 "noObject" 1 "deg_0_360" 2 "deg_45" 3 "deg_90" 4 "deg_135" 5 "deg_180" 6 "deg_225" 7 "deg_270" 8 "deg_315" 9 "no_angle" /end COMPU_VTAB
/begin COMPU_VTAB EOrientAngleFault "enumeration table" TAB_VERB 4 0 "pm_180" 1 "pm_90" 2 "pm_45" 3 "pm_22d5" /end COMPU_VTAB
/begin COMPU_VTAB ERifStatus "enumeration table" TAB_VERB 12 0 "enRifOk" 1 "enRifConfEnableTimeoutErr" 2 "enRifConfDisableTimeoutErr" 3 "enRifConfResetTimeoutErr" 4 "enRifDataCrcErr" 5 "enRifDataCounterErr" 6 "enRifDfuLkstpErr" 7 "enRifRegCrcErr" 8 "enRifSftyCtrlErr" 9 "enRifCalDeskewErr" 10 "enRifCalTimeoutErr" 11 "enRifHwRegisterErr" /end COMPU_VTAB
/begin COMPU_VTAB ERxsOcpDir "enumeration table" TAB_VERB 3 -1 "enOcpDirIgnore" 0 "enOcpDirDown" 1 "enOcpDirUp" /end COMPU_VTAB
/begin COMPU_VTAB ESetSpeedRoundingStrategy "enumeration table" TAB_VERB 3 0 "roundingDown" 1 "roundingUp" 2 "roundingNearest" /end COMPU_VTAB
/begin COMPU_VTAB_RANGE EState "" 2 0 0 "NET_VALID" 1 1 "NET_ERROR_INVALID" DEFAULT_VALUE "" /end COMPU_VTAB_RANGE
/begin COMPU_VTAB ETimeGapProcessesingStrategy "enumeration table" TAB_VERB 2 0 "readTimeGapIndex" 1 "calculateTimeGapIndex" /end COMPU_VTAB
/begin COMPU_VTAB EVarSrchRng "enumeration table" TAB_VERB 3 0 "enSrPre" 1 "enSrSo" 2 "enSrAll" /end COMPU_VTAB
/begin COMPU_VTAB EVarSteps "enumeration table" TAB_VERB 5 0 "enNoStep" 1 "enPreStep" 2 "enPreStepTt" 3 "enSoStep" 4 "enAllStep" /end COMPU_VTAB
/begin COMPU_VTAB EVariantIdx "enumeration table" TAB_VERB 3 0 "na" 0 "ods_defender_all" 1 "ods_golf_all" /end COMPU_VTAB
/begin COMPU_VTAB EffectiveSpeedLimitTypeAndCondition "enumeration table" TAB_VERB 8 0 "implicitSpeedLimit" 1 "explicitSpeedLimitBySign" 2 "explicitNightSpeedLimit" 3 "explicitDaySpeedLimit" 4 "explicitTimeDependentSpeedLimit" 5 "explicitRainSpeedLimit" 6 "explicitSnowSpeedLimit" 7 "unknown" /end COMPU_VTAB
/begin COMPU_VTAB EmsStandstillIndication "enumeration table" TAB_VERB 3 0 "notStandstill" 1 "standstill" 3 "standstillReliable" /end COMPU_VTAB
/begin COMPU_VTAB EmsWheelMovingDirection "enumeration table" TAB_VERB 4 0 "undetermined" 1 "forward" 2 "backward" 3 "wheelStandstill" /end COMPU_VTAB
/begin COMPU_VTAB EngineStrategyPrivate "enumeration table" TAB_VERB 2 0 "standard" 1 "inhibitEngineStop" /end COMPU_VTAB
/begin COMPU_VTAB_RANGE EventId "" 44 0 0 "RIF_CONF_ENABLE_TIMEOUT" 1 1 "RIF_CONF_DISABLE_TIMEOUT" 2 2 "RIF_CONF_RESET_TIMEOUT" 3 3 "RIF_DATA_CRC" 4 4 "RIF_DATA_COUNTER" 5 5 "RIF_DFU_LKSTP" 6 6 "RIF_REG_CRC" 7 7 "RIF_SFTY_CTRL" 8 8 "RIF_CAL_DESKEW" 9 9 "RIF_CAL_TIMEOUT" 10 10 "SPU_INT_TIMEOUT" 11 11 "SPU_MON_STAT_REG" 12 12 "SPU_HW_INIT" 13 13 "SPU_SBST" 14 14 "MMIC_CONFIG_FAILED" 15 15 "MMIC_MODRUN_FAILED" 16 16 "MMIC_EVALMON_FAILED" 17 17 "MMIC_TXLOWPOW_ERR" 18 18 "MMIC_TXAMPDRFT_ERR" 19 19 "MMIC_TXPHADRFT_ERR" 20 20 "MMIC_RXAMPDRFT_ERR" 21 21 "MMIC_RXPHADRFT_ERR" 22 22 "MMIC_RXGAIN_ERR" 23 23 "MMIC_RXCORFRQ_ERR" 24 24 "MMIC_UNDERVOLT_ERR" 25 25 "MMIC_BALLBREAK_ERR" 26 26 "MMIC_MBC_ERR" 27 27 "MMIC_OVERVOLT_ERR" 28 28 "MMIC_PLLDLDUNLOCK_ERR" 29 29 "MMIC_SPISEGV_ERR" 30 30 "MMIC_LVDS_ERR" 31 31 "MMIC_RMP_ERR" 32 32 "MMIC_RFSP_ERR" 33 33 "MMIC_SNR_ERR" 34 34 "MMIC_OVERTEMP_ERR" 35 35 "MMIC_VERSION_FACTORYDATA_ERR" 36 36 "MMIC_MISSING_FACTORYDATA" 37 37 "ANTENNA_DIAGRAM_ERR" 38 38 "ERROR_DSP_INTERNAL" 39 39 "SPU_CONF_SLOT_REG_CRC" 40 40 "RIF_HW_REGISTER_ERR" 41 41 "SPU_EMEM_INTERFACE" 42 42 "SPU_RIF_INTERFACE" 43 43 "EVENTS_SIZE" DEFAULT_VALUE "" /end COMPU_VTAB_RANGE
/begin COMPU_VTAB EventId_Copy1 "enumeration table" TAB_VERB 46 0 "RIF_CONF_ENABLE_TIMEOUT" 1 "RIF_CONF_DISABLE_TIMEOUT" 2 "RIF_CONF_RESET_TIMEOUT" 3 "RIF_DATA_CRC" 4 "RIF_DATA_COUNTER" 5 "RIF_DFU_LKSTP" 6 "RIF_REG_CRC" 7 "RIF_SFTY_CTRL" 8 "RIF_CAL_DESKEW" 9 "RIF_CAL_TIMEOUT" 10 "SPU_INT_TIMEOUT" 11 "SPU_MON_STAT_REG" 12 "SPU_HW_INIT" 13 "SPU_SBST" 14 "MMIC_CONFIG_FAILED" 15 "MMIC_MODRUN_FAILED" 16 "MMIC_EVALMON_FAILED" 17 "MMIC_TXLOWPOW_ERR" 18 "MMIC_TXAMPDRFT_ERR" 19 "MMIC_TXPHADRFT_ERR" 20 "MMIC_RXAMPDRFT_ERR" 21 "MMIC_RXPHADRFT_ERR" 22 "MMIC_RXGAIN_ERR" 23 "MMIC_RXCORFRQ_ERR" 24 "MMIC_UNDERVOLT_ERR" 25 "MMIC_BALLBREAK_ERR" 26 "MMIC_MBC_ERR" 27 "MMIC_OVERVOLT_ERR" 28 "MMIC_PLLDLDUNLOCK_ERR" 29 "MMIC_SPISEGV_ERR" 30 "MMIC_LVDS_ERR" 31 "MMIC_RMP_ERR" 32 "MMIC_RFSP_ERR" 33 "MMIC_SNR_ERR" 34 "MMIC_OVERTEMP_ERR" 35 "MMIC_VERSION_FACTORYDATA_ERR" 36 "MMIC_MISSING_FACTORYDATA" 37 "ANTENNA_DIAGRAM_ERR" 38 "DSP_INTERNAL_ASSERT" 39 "SPU_CONF_SLOT_REG_CRC" 40 "RIF_HW_REGISTER_ERR" 41 "SPU_EMEM_INTERFACE" 42 "SPU_RIF_INTERFACE" 43 "MMIC_INTERNAL_ERR" 44 "SPU_EXEC_TIME" 45 "EVENTS_SIZE" /end COMPU_VTAB
/begin COMPU_VTAB EventId_Copy2 "enumeration table" TAB_VERB 49 0 "RIF_CONF_ENABLE_TIMEOUT" 1 "RIF_CONF_DISABLE_TIMEOUT" 2 "RIF_CONF_RESET_TIMEOUT" 3 "RIF_DATA_CRC" 4 "RIF_DATA_COUNTER" 5 "RIF_DFU_LKSTP" 6 "RIF_REG_CRC" 7 "RIF_SFTY_CTRL" 8 "RIF_CAL_DESKEW" 9 "RIF_CAL_TIMEOUT" 10 "SPU_INT_TIMEOUT" 11 "SPU_MON_STAT_REG" 12 "SPU_HW_INIT" 13 "SPU_SBST" 14 "MMIC_CONFIG_FAILED" 15 "MMIC_MODRUN_FAILED" 16 "MMIC_EVALMON_FAILED" 17 "MMIC_TXLOWPOW_ERR" 18 "MMIC_TXAMPDRFT_ERR" 19 "MMIC_TXPHADRFT_ERR" 20 "MMIC_RXAMPDRFT_ERR" 21 "MMIC_RXPHADRFT_ERR" 22 "MMIC_RXGAIN_ERR" 23 "MMIC_RXCORFRQ_ERR" 24 "MMIC_UNDERVOLT_ERR" 25 "MMIC_BALLBREAK_ERR" 26 "MMIC_MBC_ERR" 27 "MMIC_OVERVOLT_ERR" 28 "MMIC_PLLDLDUNLOCK_ERR" 29 "MMIC_SPISEGV_ERR" 30 "MMIC_LVDS_ERR" 31 "MMIC_RMP_ERR" 32 "MMIC_RFSP_ERR" 33 "MMIC_SNR_ERR" 34 "MMIC_OVERTEMP_ERR" 35 "MMIC_VERSION_FACTORYDATA_ERR" 36 "MMIC_MISSING_FACTORYDATA" 37 "ANTENNA_DIAGRAM_ERR" 38 "DSP_INTERNAL_ASSERT" 39 "SPU_CONF_SLOT_REG_CRC" 40 "RIF_HW_REGISTER_ERR" 41 "SPU_EMEM_INTERFACE" 42 "SPU_RIF_INTERFACE" 43 "MMIC_INTERNAL_ERR" 44 "SPU_EXEC_TIME" 45 "SPU_CTRL_FLOW_CRC" 46 "SPU_SM_CTRL_STAT" 47 "SPU_ERR_INT" 48 "EVENTS_SIZE" /end COMPU_VTAB
/begin COMPU_VTAB EventId_Copy3 "enumeration table" TAB_VERB 57 0 "enRifConfEnableTimeout" 1 "enRifConfDisableTimeout" 2 "enRifConfResetTimeout" 3 "enRifDataCrc" 4 "enRifDataCounter" 5 "enRifDfuLkstp" 6 "enRifRegCrc" 7 "enRifSftyCtrl" 8 "enRifCalDeskew" 9 "enRifCalTimeout" 10 "enSpuIntTimeout" 11 "enSpuMonStatReg" 12 "enSpuHwInit" 13 "enSpuSbst" 14 "enMmicConfigFailed" 15 "enMmicModrunFailed" 16 "enMmicEvalmonFailed" 17 "enMmicTxlowpowErr" 18 "enMmicTxampdrftErr" 19 "enMmicTxphadrftErr" 20 "enMmicRxampdrftErr" 21 "enMmicRxphadrftErr" 22 "enMmicRxgainErr" 23 "enMmicRxcorfrqErr" 24 "enMmicUndervoltErr" 25 "enMmicBallbreakErr" 26 "enMmicMbcErr" 27 "enMmicOvervoltErr" 28 "enMmicPlldldunlockErr" 29 "enMmicSpisegvErr" 30 "enMmicLvdsErr" 31 "enMmicRmpErr" 32 "enMmicRfspErr" 33 "enMmicSnrErr" 34 "enMmicOvertempErr" 35 "enMmicVersionFactorydataErr" 36 "enMmicMissingFactorydata" 37 "enAntennaDiagramErr" 38 "enDspInternalAssert" 39 "enSpuConfSlotRegCrc" 40 "enRifHwRegister" 41 "enSpuEmemInterface" 42 "enSpuRifInterface" 43 "enMmicInternalErr" 44 "enSpuExecTime" 45 "enSpuCtrlFlowCrc" 46 "enSpuSmCtrlStat" 47 "enSpuErrInt" 48 "enSpuCmemDataInconsistency" 49 "enMmicMbcErrLt" 50 "enMmicBallbreakErrLt" 51 "enMmicPlldldunlockErrLt" 52 "enMmicOvertempState" 53 "enDspInputRangeErr" 54 "enDspMissedCycleErr" 55 "enDspCycleTimeExceededErr" 56 "enEventsSize" /end COMPU_VTAB
/begin COMPU_VTAB_RANGE ExecutionRecommendation "" 3 0 0 "INVALID_AND_NOT_RECOMMENDED" 1 1 "VALID_BUT_NOT_RECOMMENDED" 2 2 "VALID_AND_RECOMMENDED" DEFAULT_VALUE "" /end COMPU_VTAB_RANGE
/begin COMPU_VTAB_RANGE FCTRequest "" 4 0 0 "FCTREQ_NO_REQUEST" 1 1 "FCTREQ_HOLD" 2 2 "FCTREQ_ACKNOWLEDGE" 3 3 "FCTREQ_DRIVE_OFF" DEFAULT_VALUE "" /end COMPU_VTAB_RANGE
/begin COMPU_VTAB FCTRequest_Copy1 "enumeration table" TAB_VERB 3 0 "FCTREQ_NO_REQUEST" 1 "FCTREQ_DRIVE_OFF" 2 "FCTREQ_HOLD" /end COMPU_VTAB
/begin COMPU_VTAB FEP_Statemachine_State_t "enumeration table" TAB_VERB 7 0 "FepStateSpuBypass" 1 "FepStateMod1stFft" 2 "FepStateIcmProc" 3 "FepState2ndFftIntDet" 4 "FepStateLog2PowSpect" 5 "FepStateDone" 6 "FepStateError" /end COMPU_VTAB
/begin COMPU_VTAB FadeStrategy_v0 "enumeration table" TAB_VERB 3 0 "immediate" 1 "fast" 2 "soft" /end COMPU_VTAB
/begin COMPU_VTAB FilteringPhase "enumeration table" TAB_VERB 3 0 "Init" 1 "Filtering" 2 "Inactive" /end COMPU_VTAB
/begin COMPU_VTAB FourTruthValue "enumeration table" TAB_VERB 4 0 "no" 1 "yes" 2 "unknown" 3 "infoNotAvailable" /end COMPU_VTAB
/begin COMPU_VTAB HSM_FunctionTag "enumeration table" TAB_VERB 77 0 "HSM_FUNC_NONE" 1 "HSM_FUNC_VERSION" 2 "HSM_FUNC_DIAGNOSTICS" 3 "HSM_FUNC_SESSION_LOGIN" 4 "HSM_FUNC_SESSION_LOGOUT" 5 "HSM_FUNC_SESSION_STATUS" 6 "HSM_FUNC_SESSION_CLOSE" 7 "HSM_FUNC_CANCEL_JOB" 8 "HSM_FUNC_CHECKSUM_START" 9 "HSM_FUNC_CHECKSUM_UPDATE" 10 "HSM_FUNC_CHECKSUM_FINISH" 11 "HSM_FUNC_HASH_START" 12 "HSM_FUNC_HASH_UPDATE" 13 "HSM_FUNC_HASH_FINISH" 14 "HSM_FUNC_SIGN_GENERATE_START" 15 "HSM_FUNC_SIGN_GENERATE_UPDATE" 16 "HSM_FUNC_SIGN_GENERATE_FINISH" 17 "HSM_FUNC_SIGN_VERIFY_START" 18 "HSM_FUNC_SIGN_VERIFY_UPDATE" 19 "HSM_FUNC_SIGN_VERIFY_FINISH" 20 "HSM_FUNC_MAC_GENERATE_START" 21 "HSM_FUNC_MAC_GENERATE_UPDATE" 22 "HSM_FUNC_MAC_GENERATE_FINISH" 23 "HSM_FUNC_MAC_VERIFY_START" 24 "HSM_FUNC_MAC_VERIFY_UPDATE" 25 "HSM_FUNC_MAC_VERIFY_FINISH" 26 "HSM_FUNC_ENCRYPT_START" 27 "HSM_FUNC_ENCRYPT_UPDATE" 28 "HSM_FUNC_ENCRYPT_FINISH" 29 "HSM_FUNC_DECRYPT_START_X" 30 "HSM_FUNC_DECRYPT_UPDATE_X" 31 "HSM_FUNC_DECRYPT_FINISH_X" 32 "HSM_FUNC_AUTH_ENCRYPT_START" 33 "HSM_FUNC_AUTH_UPDATE" 34 "HSM_FUNC_AUTH_ENCRYPT_FINISH" 35 "HSM_FUNC_AUTH_DECRYPT_START_X" 36 "HSM_FUNC_AUTH_DECRYPT_FINISH_X" 37 "HSM_FUNC_ASYM_ENCRYPT" 38 "HSM_FUNC_ASYM_DECRYPT" 39 "HSM_FUNC_RANDOM_GENERATE" 40 "HSM_FUNC_TRUE_RANDOM_GENERATE" 41 "HSM_FUNC_RANDOM_SEED_EXTEND" 42 "HSM_FUNC_SHE_ENCRYPT_ECB" 43 "HSM_FUNC_SHE_DECRYPT_ECB" 44 "HSM_FUNC_SHE_ENCRYPT_CBC" 45 "HSM_FUNC_SHE_DECRYPT_CBC" 46 "HSM_FUNC_SHE_MAC_GENERATE" 47 "HSM_FUNC_SHE_MAC_VERIFY" 48 "HSM_FUNC_SHE_LOAD_KEY" 49 "HSM_FUNC_SHE_LOAD_KEY_EXTENDED" 50 "HSM_FUNC_SHE_LOAD_PLAIN_KEY" 51 "HSM_FUNC_SHE_EXPORT_RAM_KEY" 52 "HSM_FUNC_SHE_GET_ID" 53 "HSM_FUNC_SHE_INIT_RNG" 54 "HSM_FUNC_SHE_EXTEND_SEED" 55 "HSM_FUNC_SHE_RND" 56 "HSM_FUNC_SHE_SECURE_BOOT" 57 "HSM_FUNC_SHE_SECURE_BOOT_FAILURE" 58 "HSM_FUNC_SHE_SECURE_BOOT_OK" 59 "HSM_FUNC_SHE_DEBUG_CHALLENGE" 60 "HSM_FUNC_SHE_DEBUG_AUTHORIZE" 61 "HSM_FUNC_CHECKSUM" 62 "HSM_FUNC_HASH" 63 "HSM_FUNC_MAC_GENERATE" 64 "HSM_FUNC_MAC_VERIFY" 65 "HSM_FUNC_ENCRYPT" 66 "HSM_FUNC_DECRYPT" 67 "HSM_FUNC_AUTH_ENCRYPT" 68 "HSM_FUNC_AUTH_DECRYPT_X" 69 "HSM_FUNC_SIGN_GENERATE" 70 "HSM_FUNC_SIGN_VERIFY" 71 "HSM_FUNC_DATA_READ_ADAPTED2APP" 72 "HSM_FUNC_DATA_WRITE_ADAPTED2APP" 73 "HSM_FUNC_DATA_DELETE_ADAPTED2APP" 74 "HSM_FUNC_BULK_MAC_VERIFY" 75 "HSM_FUNC_BULK_MAC_GENERATE" 2147483647 "HSM_FUNC_RESERVED" /end COMPU_VTAB
/begin COMPU_VTAB HSM_ModeTag "enumeration table" TAB_VERB 8 1 "HSM_MODE_NOT_STARTED" 2 "HSM_MODE_BOOTING" 3 "HSM_MODE_BOOTLOADER" 4 "HSM_MODE_CORE_APP" 5 "HSM_MODE_INVALID" 6 "HSM_MODE_CORE_APP_STOPPED" 7 "HSM_MODE_SUSPENDED" 2147483647 "HSM_MODE_RESERVED" /end COMPU_VTAB
/begin COMPU_VTAB HSM_PortStatusTag "enumeration table" TAB_VERB 5 0 "HSM_STATUS_IDLE" 1 "HSM_STATUS_PENDING" 2 "HSM_STATUS_PROCESSING" 3 "HSM_STATUS_COMPLETE" 2147483647 "HSM_PORTSTATUS_RESERVED" /end COMPU_VTAB
/begin COMPU_VTAB HV_SERVICE_AVAILABILITY_STATES "enumeration table" TAB_VERB 4 0 "UNAVAILABLE" 1 "AVAILABLE" 2 "HEALING" 3 "DEGRADING" /end COMPU_VTAB
/begin COMPU_VTAB_RANGE HapticWarningViaBrakeProfile "" 2 0 0 "NO_WARNING" 7 7 "MAX_SEVERITY" DEFAULT_VALUE "" /end COMPU_VTAB_RANGE
/begin COMPU_VTAB_RANGE IIR2FilterStates "" 3 0 0 "uninitialized" 1 1 "initialization" 2 2 "initialized" DEFAULT_VALUE "" /end COMPU_VTAB_RANGE
/begin COMPU_VTAB IcmDebugSyncPoints_t "enumeration table" TAB_VERB 11 0 "IcmSyncInit" 1 "IcmSyncWriteTimeData" 2 "IcmSyncReadFirstFFTResult" 3 "IcmSyncMainStateInterferenceFound" 4 "IcmSyncMainStateAllDone" 5 "IcmSyncDetectionStateIFFTdone" 6 "IcmSyncDetectionStateAlldone" 7 "IcmSyncRepairIfftSubStateEnd" 8 "IcmSyncRepairFftSubStateBegin" 9 "IcmSyncRepairFftSubStateEnd" 10 "IcmSyncSPUdone" /end COMPU_VTAB
/begin COMPU_VTAB_RANGE IcmDet "" 3 0 0 "NO_INTERFERENCE_FOUND" 1 1 "INTERFERENCE_FOUND" 2 2 "INTERFERENCE_OVER_LIMIT" DEFAULT_VALUE "" /end COMPU_VTAB_RANGE
/begin COMPU_VTAB_RANGE IcmDetInd "" 3 0 0 "INDICATOR_OFF" 1 1 "INDICATOR_LIMIT1" 2 2 "INDICATOR_LIMIT2" DEFAULT_VALUE "" /end COMPU_VTAB_RANGE
/begin COMPU_VTAB IcmDetInd_Copy1 "enumeration table" TAB_VERB 3 0 "enIndicatorOff" 1 "enIndicatorLimit1" 2 "enIndicatorLimit2" /end COMPU_VTAB
/begin COMPU_VTAB_RANGE IcmDetSubState "" 4 0 0 "DET_IFFT_STATISTIC" 1 1 "DET_IFFT" 2 2 "DET_INVWIN_THRESH" 3 3 "DET_EVAL_RESULT" DEFAULT_VALUE "" /end COMPU_VTAB_RANGE
/begin COMPU_VTAB IcmDetSubState_Copy1 "enumeration table" TAB_VERB 4 0 "enDetIfftStatistic" 1 "enDetIfft" 2 "enDetInvwinThresh" 3 "enDetEvalResult" /end COMPU_VTAB
/begin COMPU_VTAB IcmDet_Copy1 "enumeration table" TAB_VERB 3 0 "enNoInterferenceFound" 1 "enInterferenceFound" 2 "enInterferenceOverLimit" /end COMPU_VTAB
/begin COMPU_VTAB_RANGE IcmMainState "" 2 0 0 "DETECTION" 1 1 "REPAIR" DEFAULT_VALUE "" /end COMPU_VTAB_RANGE
/begin COMPU_VTAB IcmMainState_Copy1 "enumeration table" TAB_VERB 2 0 "enDetection" 1 "enRepair" /end COMPU_VTAB
/begin COMPU_VTAB_RANGE IcmRepSubState "" 2 0 0 "REP_IFFT" 1 1 "REP_FFT" DEFAULT_VALUE "" /end COMPU_VTAB_RANGE
/begin COMPU_VTAB IcmRepSubState_Copy1 "enumeration table" TAB_VERB 2 0 "enRepIfft" 1 "enRepFft" /end COMPU_VTAB
/begin COMPU_VTAB_RANGE IfxPort_Mode "" 19 0 0 "IfxPort_Mode_inputNoPullDevice" 8 8 "IfxPort_Mode_inputPullDown" 16 16 "IfxPort_Mode_inputPullUp" 128 128 "IfxPort_Mode_outputPushPullGeneral" 136 136 "IfxPort_Mode_outputPushPullAlt1" 144 144 "IfxPort_Mode_outputPushPullAlt2" 152 152 "IfxPort_Mode_outputPushPullAlt3" 160 160 "IfxPort_Mode_outputPushPullAlt4" 168 168 "IfxPort_Mode_outputPushPullAlt5" 176 176 "IfxPort_Mode_outputPushPullAlt6" 184 184 "IfxPort_Mode_outputPushPullAlt7" 192 192 "IfxPort_Mode_outputOpenDrainGeneral" 200 200 "IfxPort_Mode_outputOpenDrainAlt1" 208 208 "IfxPort_Mode_outputOpenDrainAlt2" 216 216 "IfxPort_Mode_outputOpenDrainAlt3" 224 224 "IfxPort_Mode_outputOpenDrainAlt4" 232 232 "IfxPort_Mode_outputOpenDrainAlt5" 240 240 "IfxPort_Mode_outputOpenDrainAlt6" 248 248 "IfxPort_Mode_outputOpenDrainAlt7" DEFAULT_VALUE "" /end COMPU_VTAB_RANGE
/begin COMPU_VTAB_RANGE IfxPort_PadDriver "" 8 0 0 "IfxPort_PadDriver_cmosAutomotiveSpeed1" 1 1 "IfxPort_PadDriver_cmosAutomotiveSpeed2" 2 2 "IfxPort_PadDriver_cmosAutomotiveSpeed3" 3 3 "IfxPort_PadDriver_cmosAutomotiveSpeed4" 8 8 "IfxPort_PadDriver_ttlSpeed1" 9 9 "IfxPort_PadDriver_ttlSpeed2" 10 10 "IfxPort_PadDriver_ttlSpeed3" 11 11 "IfxPort_PadDriver_ttlSpeed4" DEFAULT_VALUE "" /end COMPU_VTAB_RANGE
/begin COMPU_VTAB IndicatorBlindnessState "enumeration table" TAB_VERB 3 0 "init" 1 "blindnessNotDetected" 2 "blindnessDetected" /end COMPU_VTAB
/begin COMPU_VTAB LaneAssociation "enumeration table" TAB_VERB 11 0 "LeftEgoLine" 1 "RightEgoLine" 2 "LeftNeighborLine" 3 "RightNeighborLine" 4 "LeftFlatRoadEdge" 5 "RightFlatRoadEdge" 6 "LeftRaisedRoadEdge" 7 "RightRaisedRoadEdge" 8 "NotSelectedCandidate" 9 "LeftEgoCourseLine" 10 "RightEgoCourseLine" /end COMPU_VTAB
/begin COMPU_VTAB LcState "enumeration table" TAB_VERB 7 0 "INVALID" 1 "INIT" 2 "SHUTDOWN" 3 "PASSIVE" 4 "DEGRADED" 5 "FULL_PERFORMANCE" 6 "REINIT" /end COMPU_VTAB
/begin COMPU_VTAB LcmStateId "enumeration table" TAB_VERB 4 0 "init" 1 "passive" 2 "performing" 3 "reinit" /end COMPU_VTAB
/begin COMPU_VTAB LocIntStatus "enumeration table" TAB_VERB 2 0 "enLocIntInvalid" 1 "enLocIntValid" /end COMPU_VTAB
/begin COMPU_VTAB MetaState "enumeration table" TAB_VERB 14 0 "INVALID" 1 "STARTUP" 2 "REINIT" 3 "PASSIVE" 4 "SHUTDOWN" 5 "OOS" 6 "DEGRADED" 7 "FULL_PERFORMANCE" 8 "BADCONNECTION" 9 "LONG_UNAVAILABLE" 10 "LAT_UNAVAILABLE" 11 "LIMITED_PERFORMANCE" 12 "OOS_MCAM_LAT_AVAILABLE" 13 "TOTAL_NUMBER" /end COMPU_VTAB
/begin COMPU_VTAB_RANGE MotionModelType "" 9 0 0 "unknown" 1 1 "nonObstacle" 2 2 "stationaryObstacle" 3 3 "unknownObstacle" 4 4 "unknownMobile" 5 5 "twoWheeler" 6 6 "fourPlusWheeler" 7 7 "pedestrian" 8 8 "numMotionModel" DEFAULT_VALUE "" /end COMPU_VTAB_RANGE
/begin COMPU_VTAB_RANGE MotionModelType.OLD_1 "" 9 0 0 "unknown" 1 1 "nonObstacle" 2 2 "stationaryObstacle" 3 3 "unknownObstacle" 4 4 "twoWheeler" 5 5 "unknownMobile" 6 6 "fourPlusWheeler" 7 7 "pedestrian" 8 8 "numMotionModel" DEFAULT_VALUE "" /end COMPU_VTAB_RANGE
/begin COMPU_VTAB_RANGE MotionType "" 2 0 0 "MotionType_Comfort" 1 1 "MotionType_Emergency" DEFAULT_VALUE "" /end COMPU_VTAB_RANGE
/begin COMPU_VTAB_RANGE ObjectType "" 3 0 0 "Car" 1 1 "Truck" 2 2 "Unknown" DEFAULT_VALUE "" /end COMPU_VTAB_RANGE
/begin COMPU_VTAB ObstacleSensorIndex "enumeration table" TAB_VERB 19 0 "invalidObstacleSensorIndex" 1 "frontCenterLocationRadar" 2 "frontCenterVideo" 3 "fusedFrontObjectSensor" 3 "envModelSensor" 4 "frontLeftCornerObjectRadar" 5 "frontRightCornerObjectRadar" 6 "rearLeftCornerObjectRadar" 7 "rearRightCornerObjectRadar" 8 "trackedVideoObjectSensor" 9 "frontLeftCornerLocationRadar" 10 "frontRightCornerLocationRadar" 11 "rearLeftCornerLocationRadar" 12 "rearRightCornerLocationRadar" 13 "lidarSensor" 14 "customObstacleSensorIndex1" 15 "customObstacleSensorIndex2" 16 "customObstacleSensorIndex3" 255 "maxValueInvalidObstacleSensorIndex" /end COMPU_VTAB
/begin RECORD_LAYOUT __Float16_Value FNC_VALUES 1 FLOAT16_IEEE ROW_DIR DIRECT /end RECORD_LAYOUT
/begin RECORD_LAYOUT __Float32_Value FNC_VALUES 1 FLOAT32_IEEE ROW_DIR DIRECT /end RECORD_LAYOUT
/begin RECORD_LAYOUT __UByte_Value FNC_VALUES 1 UBYTE ROW_DIR DIRECT /end RECORD_LAYOUT
/begin RECORD_LAYOUT __UWord_Value FNC_VALUES 1 UWORD ROW_DIR DIRECT /end RECORD_LAYOUT
/end MODULE
/end PROJECT
