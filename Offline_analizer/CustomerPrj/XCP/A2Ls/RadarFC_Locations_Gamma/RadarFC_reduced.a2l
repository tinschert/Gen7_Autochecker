ASAP2_VERSION 1 71
/begin PROJECT RADAR_GEN5 ""
/begin HEADER "" VERSION "TO_BE_FILLED" /end HEADER
/begin MODULE RADAR_GEN5 ""
/begin MOD_COMMON "" ALIGNMENT_BYTE 1 ALIGNMENT_WORD 2 ALIGNMENT_LONG 4 ALIGNMENT_FLOAT16_IEEE 2 ALIGNMENT_FLOAT32_IEEE 4 ALIGNMENT_FLOAT64_IEEE 4 ALIGNMENT_INT64 4 /end MOD_COMMON
/begin CHARACTERISTIC _g_PL_AD_fw_Radar_1R1V_rpc_LocBypassingRunnable_LocBypassingRunnable_m_pad_ensRLocationsPort_par_out_local.TChangeableMemPool._._._m_arrayPool._0_._elem._m_LocationList._Item._32_._theta._m_value "" VALUE 0xB0010426 __Float16_Value 0 NO_COMPU_METHOD -65504 65504 ECU_ADDRESS_EXTENSION 0x2 BYTE_ORDER MSB_LAST /end CHARACTERISTIC
/begin CHARACTERISTIC _g_PL_AD_fw_Radar_1R1V_rpc_LocBypassingRunnable_LocBypassingRunnable_m_pad_ensRLocationsPort_par_out_local.TChangeableMemPool._._._m_arrayPool._0_._elem._m_LocationList._Item._32_._thetaQly "" VALUE 0xB001042A __UByte_Value 0 NO_COMPU_METHOD 0 255 ECU_ADDRESS_EXTENSION 0x2 BYTE_ORDER MSB_LAST /end CHARACTERISTIC
/begin CHARACTERISTIC _g_PL_AD_fw_Radar_1R1V_rpc_LocBypassingRunnable_LocBypassingRunnable_m_pad_ensRLocationsPort_par_out_local.TChangeableMemPool._._._m_arrayPool._0_._elem._m_LocationList._Item._32_._thetaVar._m_value "" VALUE 0xB001042C __Float16_Value 0 NO_COMPU_METHOD -65504 65504 ECU_ADDRESS_EXTENSION 0x2 BYTE_ORDER MSB_LAST /end CHARACTERISTIC
/begin CHARACTERISTIC _g_PL_AD_fw_Radar_1R1V_rpc_LocBypassingRunnable_LocBypassingRunnable_m_pad_ensRLocationsPort_par_out_local.TChangeableMemPool._._._m_arrayPool._0_._elem._m_LocationList._Item._32_._v "" VALUE 0xB001041C __Float32_Value 0 NO_COMPU_METHOD -3.4028234663852886E+38 3.4028234663852886E+38 ECU_ADDRESS_EXTENSION 0x2 BYTE_ORDER MSB_LAST /end CHARACTERISTIC
/begin CHARACTERISTIC _g_PL_AD_fw_Radar_1R1V_rpc_LocBypassingRunnable_LocBypassingRunnable_m_pad_ensRLocationsPort_par_out_local.TChangeableMemPool._._._m_arrayPool._0_._elem._m_LocationList._Item._32_._vVar._m_value "" VALUE 0xB0010422 __Float16_Value 0 NO_COMPU_METHOD -65504 65504 ECU_ADDRESS_EXTENSION 0x2 BYTE_ORDER MSB_LAST /end CHARACTERISTIC
/begin CHARACTERISTIC _g_PL_AD_fw_Radar_1R1V_rpc_LocBypassingRunnable_LocBypassingRunnable_m_pad_ensRLocationsPort_par_out_local.TChangeableMemPool._._._m_arrayPool._0_._elem._m_LocationList._Item._33_._Rcs._m_value "" VALUE 0xB0010450 __Float16_Value 0 NO_COMPU_METHOD -65504 65504 ECU_ADDRESS_EXTENSION 0x2 BYTE_ORDER MSB_LAST /end CHARACTERISTIC
/begin CHARACTERISTIC _g_PL_AD_fw_Radar_1R1V_rpc_LocBypassingRunnable_LocBypassingRunnable_m_pad_ensRLocationsPort_par_out_local.TChangeableMemPool._._._m_arrayPool._0_._elem._m_LocationList._Item._33_._Rssi._m_value "" VALUE 0xB0010452 __Float16_Value 0 NO_COMPU_METHOD -65504 65504 ECU_ADDRESS_EXTENSION 0x2 BYTE_ORDER MSB_LAST /end CHARACTERISTIC
/begin CHARACTERISTIC _g_PL_AD_fw_Radar_1R1V_rpc_LocBypassingRunnable_LocBypassingRunnable_m_pad_ensRLocationsPort_par_out_local.TChangeableMemPool._._._m_arrayPool._0_._elem._m_LocationList._Item._33_._d "" VALUE 0xB0010438 __Float32_Value 0 NO_COMPU_METHOD -3.4028234663852886E+38 3.4028234663852886E+38 ECU_ADDRESS_EXTENSION 0x2 BYTE_ORDER MSB_LAST /end CHARACTERISTIC
/begin CHARACTERISTIC _g_PL_AD_fw_Radar_1R1V_rpc_LocBypassingRunnable_LocBypassingRunnable_m_pad_ensRLocationsPort_par_out_local.TChangeableMemPool._._._m_arrayPool._0_._elem._m_LocationList._Item._33_._dVar._m_value "" VALUE 0xB0010440 __Float16_Value 0 NO_COMPU_METHOD -65504 65504 ECU_ADDRESS_EXTENSION 0x2 BYTE_ORDER MSB_LAST /end CHARACTERISTIC
/begin CHARACTERISTIC _g_PL_AD_fw_Radar_1R1V_rpc_LocBypassingRunnable_LocBypassingRunnable_m_pad_ensRLocationsPort_par_out_local.TChangeableMemPool._._._m_arrayPool._0_._elem._m_LocationList._Item._33_._dvCov._m_value "" VALUE 0xB0010444 __Float16_Value 0 NO_COMPU_METHOD -65504 65504 ECU_ADDRESS_EXTENSION 0x2 BYTE_ORDER MSB_LAST /end CHARACTERISTIC
/begin CHARACTERISTIC _g_PL_AD_fw_Radar_1R1V_rpc_LocBypassingRunnable_LocBypassingRunnable_m_pad_ensRLocationsPort_par_out_local.TChangeableMemPool._._._m_arrayPool._0_._elem._m_LocationList._Item._33_._dvQly "" VALUE 0xB0010454 __UByte_Value 0 NO_COMPU_METHOD 0 255 ECU_ADDRESS_EXTENSION 0x2 BYTE_ORDER MSB_LAST /end CHARACTERISTIC
/begin CHARACTERISTIC _g_PL_AD_fw_Radar_1R1V_rpc_LocBypassingRunnable_LocBypassingRunnable_m_pad_ensRLocationsPort_par_out_local.TChangeableMemPool._._._m_arrayPool._0_._elem._m_LocationList._Item._33_._idxAzimuthAmbiguityPeer "" VALUE 0xB0010456 __UWord_Value 0 NO_COMPU_METHOD 0 65535 ECU_ADDRESS_EXTENSION 0x2 BYTE_ORDER MSB_LAST /end CHARACTERISTIC
/begin CHARACTERISTIC _g_PL_AD_fw_Radar_1R1V_rpc_LocBypassingRunnable_LocBypassingRunnable_m_pad_ensRLocationsPort_par_out_local.TChangeableMemPool._._._m_arrayPool._0_._elem._m_LocationList._Item._33_._measStatus "" VALUE 0xB0010455 __UByte_Value 0 NO_COMPU_METHOD 0 255 ECU_ADDRESS_EXTENSION 0x2 BYTE_ORDER MSB_LAST /end CHARACTERISTIC
/begin CHARACTERISTIC _g_PL_AD_fw_Radar_1R1V_rpc_LocBypassingRunnable_LocBypassingRunnable_m_pad_ensRLocationsPort_par_out_local.TChangeableMemPool._._._m_arrayPool._0_._elem._m_LocationList._Item._33_._phi._m_value "" VALUE 0xB0010448 __Float16_Value 0 NO_COMPU_METHOD -65504 65504 ECU_ADDRESS_EXTENSION 0x2 BYTE_ORDER MSB_LAST /end CHARACTERISTIC
/begin CHARACTERISTIC _g_PL_AD_fw_Radar_1R1V_rpc_LocBypassingRunnable_LocBypassingRunnable_m_pad_ensRLocationsPort_par_out_local.TChangeableMemPool._._._m_arrayPool._0_._elem._m_LocationList._Item._33_._phiQly "" VALUE 0xB001044B __UByte_Value 0 NO_COMPU_METHOD 0 255 ECU_ADDRESS_EXTENSION 0x2 BYTE_ORDER MSB_LAST /end CHARACTERISTIC
/begin CHARACTERISTIC _g_PL_AD_fw_Radar_1R1V_rpc_LocBypassingRunnable_LocBypassingRunnable_m_pad_ensRLocationsPort_par_out_local.TChangeableMemPool._._._m_arrayPool._0_._elem._m_LocationList._Item._33_._phiVar._m_value "" VALUE 0xB001044E __Float16_Value 0 NO_COMPU_METHOD -65504 65504 ECU_ADDRESS_EXTENSION 0x2 BYTE_ORDER MSB_LAST /end CHARACTERISTIC
/begin CHARACTERISTIC _g_PL_AD_fw_Radar_1R1V_rpc_LocBypassingRunnable_LocBypassingRunnable_m_pad_ensRLocationsPort_par_out_local.TChangeableMemPool._._._m_arrayPool._0_._elem._m_LocationList._Item._33_._theta._m_value "" VALUE 0xB0010446 __Float16_Value 0 NO_COMPU_METHOD -65504 65504 ECU_ADDRESS_EXTENSION 0x2 BYTE_ORDER MSB_LAST /end CHARACTERISTIC
/begin CHARACTERISTIC _g_PL_AD_fw_Radar_1R1V_rpc_LocBypassingRunnable_LocBypassingRunnable_m_pad_ensRLocationsPort_par_out_local.TChangeableMemPool._._._m_arrayPool._0_._elem._m_LocationList._Item._33_._thetaQly "" VALUE 0xB001044A __UByte_Value 0 NO_COMPU_METHOD 0 255 ECU_ADDRESS_EXTENSION 0x2 BYTE_ORDER MSB_LAST /end CHARACTERISTIC
/begin CHARACTERISTIC _g_PL_AD_fw_Radar_1R1V_rpc_LocBypassingRunnable_LocBypassingRunnable_m_pad_ensRLocationsPort_par_out_local.TChangeableMemPool._._._m_arrayPool._0_._elem._m_LocationList._Item._33_._thetaVar._m_value "" VALUE 0xB001044C __Float16_Value 0 NO_COMPU_METHOD -65504 65504 ECU_ADDRESS_EXTENSION 0x2 BYTE_ORDER MSB_LAST /end CHARACTERISTIC
/begin CHARACTERISTIC _g_PL_AD_fw_Radar_1R1V_rpc_LocBypassingRunnable_LocBypassingRunnable_m_pad_ensRLocationsPort_par_out_local.TChangeableMemPool._._._m_arrayPool._0_._elem._m_LocationList._Item._33_._v "" VALUE 0xB001043C __Float32_Value 0 NO_COMPU_METHOD -3.4028234663852886E+38 3.4028234663852886E+38 ECU_ADDRESS_EXTENSION 0x2 BYTE_ORDER MSB_LAST /end CHARACTERISTIC
/begin CHARACTERISTIC _g_PL_AD_fw_Radar_1R1V_rpc_LocBypassingRunnable_LocBypassingRunnable_m_pad_ensRLocationsPort_par_out_local.TChangeableMemPool._._._m_arrayPool._0_._elem._m_LocationList._Item._33_._vVar._m_value "" VALUE 0xB0010442 __Float16_Value 0 NO_COMPU_METHOD -65504 65504 ECU_ADDRESS_EXTENSION 0x2 BYTE_ORDER MSB_LAST /end CHARACTERISTIC
/begin CHARACTERISTIC _g_PL_AD_fw_Radar_1R1V_rpc_LocBypassingRunnable_LocBypassingRunnable_m_pad_ensRLocationsPort_par_out_local.TChangeableMemPool._._._m_arrayPool._0_._elem._m_LocationList._Item._34_._Rcs._m_value "" VALUE 0xB0010470 __Float16_Value 0 NO_COMPU_METHOD -65504 65504 ECU_ADDRESS_EXTENSION 0x2 BYTE_ORDER MSB_LAST /end CHARACTERISTIC
/begin CHARACTERISTIC _g_PL_AD_fw_Radar_1R1V_rpc_LocBypassingRunnable_LocBypassingRunnable_m_pad_ensRLocationsPort_par_out_local.TChangeableMemPool._._._m_arrayPool._0_._elem._m_LocationList._Item._34_._Rssi._m_value "" VALUE 0xB0010472 __Float16_Value 0 NO_COMPU_METHOD -65504 65504 ECU_ADDRESS_EXTENSION 0x2 BYTE_ORDER MSB_LAST /end CHARACTERISTIC
/begin CHARACTERISTIC _g_PL_AD_fw_Radar_1R1V_rpc_LocBypassingRunnable_LocBypassingRunnable_m_pad_ensRLocationsPort_par_out_local.TChangeableMemPool._._._m_arrayPool._0_._elem._m_LocationList._Item._34_._d "" VALUE 0xB0010458 __Float32_Value 0 NO_COMPU_METHOD -3.4028234663852886E+38 3.4028234663852886E+38 ECU_ADDRESS_EXTENSION 0x2 BYTE_ORDER MSB_LAST /end CHARACTERISTIC
/begin CHARACTERISTIC _g_PL_AD_fw_Radar_1R1V_rpc_LocBypassingRunnable_LocBypassingRunnable_m_pad_ensRLocationsPort_par_out_local.TChangeableMemPool._._._m_arrayPool._0_._elem._m_LocationList._Item._34_._dVar._m_value "" VALUE 0xB0010460 __Float16_Value 0 NO_COMPU_METHOD -65504 65504 ECU_ADDRESS_EXTENSION 0x2 BYTE_ORDER MSB_LAST /end CHARACTERISTIC
/begin CHARACTERISTIC _g_PL_AD_fw_Radar_1R1V_rpc_LocBypassingRunnable_LocBypassingRunnable_m_pad_ensRLocationsPort_par_out_local.TChangeableMemPool._._._m_arrayPool._0_._elem._m_LocationList._Item._34_._dvCov._m_value "" VALUE 0xB0010464 __Float16_Value 0 NO_COMPU_METHOD -65504 65504 ECU_ADDRESS_EXTENSION 0x2 BYTE_ORDER MSB_LAST /end CHARACTERISTIC
/begin CHARACTERISTIC _g_PL_AD_fw_Radar_1R1V_rpc_LocBypassingRunnable_LocBypassingRunnable_m_pad_ensRLocationsPort_par_out_local.TChangeableMemPool._._._m_arrayPool._0_._elem._m_LocationList._Item._34_._dvQly "" VALUE 0xB0010474 __UByte_Value 0 NO_COMPU_METHOD 0 255 ECU_ADDRESS_EXTENSION 0x2 BYTE_ORDER MSB_LAST /end CHARACTERISTIC
/begin CHARACTERISTIC _g_PL_AD_fw_Radar_1R1V_rpc_LocBypassingRunnable_LocBypassingRunnable_m_pad_ensRLocationsPort_par_out_local.TChangeableMemPool._._._m_arrayPool._0_._elem._m_LocationList._Item._34_._idxAzimuthAmbiguityPeer "" VALUE 0xB0010476 __UWord_Value 0 NO_COMPU_METHOD 0 65535 ECU_ADDRESS_EXTENSION 0x2 BYTE_ORDER MSB_LAST /end CHARACTERISTIC
/begin CHARACTERISTIC _g_PL_AD_fw_Radar_1R1V_rpc_LocBypassingRunnable_LocBypassingRunnable_m_pad_ensRLocationsPort_par_out_local.TChangeableMemPool._._._m_arrayPool._0_._elem._m_LocationList._Item._34_._measStatus "" VALUE 0xB0010475 __UByte_Value 0 NO_COMPU_METHOD 0 255 ECU_ADDRESS_EXTENSION 0x2 BYTE_ORDER MSB_LAST /end CHARACTERISTIC
/begin CHARACTERISTIC _g_PL_AD_fw_Radar_1R1V_rpc_LocBypassingRunnable_LocBypassingRunnable_m_pad_ensRLocationsPort_par_out_local.TChangeableMemPool._._._m_arrayPool._0_._elem._m_LocationList._Item._34_._phi._m_value "" VALUE 0xB0010468 __Float16_Value 0 NO_COMPU_METHOD -65504 65504 ECU_ADDRESS_EXTENSION 0x2 BYTE_ORDER MSB_LAST /end CHARACTERISTIC
/begin CHARACTERISTIC _g_PL_AD_fw_Radar_1R1V_rpc_LocBypassingRunnable_LocBypassingRunnable_m_pad_ensRLocationsPort_par_out_local.TChangeableMemPool._._._m_arrayPool._0_._elem._m_LocationList._Item._34_._phiQly "" VALUE 0xB001046B __UByte_Value 0 NO_COMPU_METHOD 0 255 ECU_ADDRESS_EXTENSION 0x2 BYTE_ORDER MSB_LAST /end CHARACTERISTIC
/begin CHARACTERISTIC _g_PL_AD_fw_Radar_1R1V_rpc_LocBypassingRunnable_LocBypassingRunnable_m_pad_ensRLocationsPort_par_out_local.TChangeableMemPool._._._m_arrayPool._0_._elem._m_LocationList._Item._34_._phiVar._m_value "" VALUE 0xB001046E __Float16_Value 0 NO_COMPU_METHOD -65504 65504 ECU_ADDRESS_EXTENSION 0x2 BYTE_ORDER MSB_LAST /end CHARACTERISTIC
/begin CHARACTERISTIC _g_PL_AD_fw_Radar_1R1V_rpc_LocBypassingRunnable_LocBypassingRunnable_m_pad_ensRLocationsPort_par_out_local.TChangeableMemPool._._._m_arrayPool._0_._elem._m_LocationList._Item._34_._theta._m_value "" VALUE 0xB0010466 __Float16_Value 0 NO_COMPU_METHOD -65504 65504 ECU_ADDRESS_EXTENSION 0x2 BYTE_ORDER MSB_LAST /end CHARACTERISTIC
/begin CHARACTERISTIC _g_PL_AD_fw_Radar_1R1V_rpc_LocBypassingRunnable_LocBypassingRunnable_m_pad_ensRLocationsPort_par_out_local.TChangeableMemPool._._._m_arrayPool._0_._elem._m_LocationList._Item._34_._thetaQly "" VALUE 0xB001046A __UByte_Value 0 NO_COMPU_METHOD 0 255 ECU_ADDRESS_EXTENSION 0x2 BYTE_ORDER MSB_LAST /end CHARACTERISTIC
/begin CHARACTERISTIC _g_PL_AD_fw_Radar_1R1V_rpc_LocBypassingRunnable_LocBypassingRunnable_m_pad_ensRLocationsPort_par_out_local.TChangeableMemPool._._._m_arrayPool._0_._elem._m_LocationList._Item._34_._thetaVar._m_value "" VALUE 0xB001046C __Float16_Value 0 NO_COMPU_METHOD -65504 65504 ECU_ADDRESS_EXTENSION 0x2 BYTE_ORDER MSB_LAST /end CHARACTERISTIC
/begin CHARACTERISTIC _g_PL_AD_fw_Radar_1R1V_rpc_LocBypassingRunnable_LocBypassingRunnable_m_pad_ensRLocationsPort_par_out_local.TChangeableMemPool._._._m_arrayPool._0_._elem._m_LocationList._Item._34_._v "" VALUE 0xB001045C __Float32_Value 0 NO_COMPU_METHOD -3.4028234663852886E+38 3.4028234663852886E+38 ECU_ADDRESS_EXTENSION 0x2 BYTE_ORDER MSB_LAST /end CHARACTERISTIC
/begin CHARACTERISTIC _g_PL_AD_fw_Radar_1R1V_rpc_LocBypassingRunnable_LocBypassingRunnable_m_pad_ensRLocationsPort_par_out_local.TChangeableMemPool._._._m_arrayPool._0_._elem._m_LocationList._Item._34_._vVar._m_value "" VALUE 0xB0010462 __Float16_Value 0 NO_COMPU_METHOD -65504 65504 ECU_ADDRESS_EXTENSION 0x2 BYTE_ORDER MSB_LAST /end CHARACTERISTIC
/begin CHARACTERISTIC _g_PL_AD_fw_Radar_1R1V_rpc_LocBypassingRunnable_LocBypassingRunnable_m_pad_ensRLocationsPort_par_out_local.TChangeableMemPool._._._m_arrayPool._0_._elem._m_LocationList._Item._35_._Rcs._m_value "" VALUE 0xB0010490 __Float16_Value 0 NO_COMPU_METHOD -65504 65504 ECU_ADDRESS_EXTENSION 0x2 BYTE_ORDER MSB_LAST /end CHARACTERISTIC
/begin CHARACTERISTIC _g_PL_AD_fw_Radar_1R1V_rpc_LocBypassingRunnable_LocBypassingRunnable_m_pad_ensRLocationsPort_par_out_local.TChangeableMemPool._._._m_arrayPool._0_._elem._m_LocationList._Item._35_._Rssi._m_value "" VALUE 0xB0010492 __Float16_Value 0 NO_COMPU_METHOD -65504 65504 ECU_ADDRESS_EXTENSION 0x2 BYTE_ORDER MSB_LAST /end CHARACTERISTIC
/begin CHARACTERISTIC _g_PL_AD_fw_Radar_1R1V_rpc_LocBypassingRunnable_LocBypassingRunnable_m_pad_ensRLocationsPort_par_out_local.TChangeableMemPool._._._m_arrayPool._0_._elem._m_LocationList._Item._35_._d "" VALUE 0xB0010478 __Float32_Value 0 NO_COMPU_METHOD -3.4028234663852886E+38 3.4028234663852886E+38 ECU_ADDRESS_EXTENSION 0x2 BYTE_ORDER MSB_LAST /end CHARACTERISTIC
/begin CHARACTERISTIC _g_PL_AD_fw_Radar_1R1V_rpc_LocBypassingRunnable_LocBypassingRunnable_m_pad_ensRLocationsPort_par_out_local.TChangeableMemPool._._._m_arrayPool._0_._elem._m_LocationList._Item._35_._dVar._m_value "" VALUE 0xB0010480 __Float16_Value 0 NO_COMPU_METHOD -65504 65504 ECU_ADDRESS_EXTENSION 0x2 BYTE_ORDER MSB_LAST /end CHARACTERISTIC
/begin CHARACTERISTIC _g_PL_AD_fw_Radar_1R1V_rpc_LocBypassingRunnable_LocBypassingRunnable_m_pad_ensRLocationsPort_par_out_local.TChangeableMemPool._._._m_arrayPool._0_._elem._m_LocationList._Item._35_._dvCov._m_value "" VALUE 0xB0010484 __Float16_Value 0 NO_COMPU_METHOD -65504 65504 ECU_ADDRESS_EXTENSION 0x2 BYTE_ORDER MSB_LAST /end CHARACTERISTIC
/begin CHARACTERISTIC _g_PL_AD_fw_Radar_1R1V_rpc_LocBypassingRunnable_LocBypassingRunnable_m_pad_ensRLocationsPort_par_out_local.TChangeableMemPool._._._m_arrayPool._0_._elem._m_LocationList._Item._35_._dvQly "" VALUE 0xB0010494 __UByte_Value 0 NO_COMPU_METHOD 0 255 ECU_ADDRESS_EXTENSION 0x2 BYTE_ORDER MSB_LAST /end CHARACTERISTIC
/begin CHARACTERISTIC _g_PL_AD_fw_Radar_1R1V_rpc_LocBypassingRunnable_LocBypassingRunnable_m_pad_ensRLocationsPort_par_out_local.TChangeableMemPool._._._m_arrayPool._0_._elem._m_LocationList._Item._35_._idxAzimuthAmbiguityPeer "" VALUE 0xB0010496 __UWord_Value 0 NO_COMPU_METHOD 0 65535 ECU_ADDRESS_EXTENSION 0x2 BYTE_ORDER MSB_LAST /end CHARACTERISTIC
/begin CHARACTERISTIC _g_PL_AD_fw_Radar_1R1V_rpc_LocBypassingRunnable_LocBypassingRunnable_m_pad_ensRLocationsPort_par_out_local.TChangeableMemPool._._._m_arrayPool._0_._elem._m_LocationList._Item._35_._measStatus "" VALUE 0xB0010495 __UByte_Value 0 NO_COMPU_METHOD 0 255 ECU_ADDRESS_EXTENSION 0x2 BYTE_ORDER MSB_LAST /end CHARACTERISTIC
/begin CHARACTERISTIC _g_PL_AD_fw_Radar_1R1V_rpc_LocBypassingRunnable_LocBypassingRunnable_m_pad_ensRLocationsPort_par_out_local.TChangeableMemPool._._._m_arrayPool._0_._elem._m_LocationList._Item._35_._phi._m_value "" VALUE 0xB0010488 __Float16_Value 0 NO_COMPU_METHOD -65504 65504 ECU_ADDRESS_EXTENSION 0x2 BYTE_ORDER MSB_LAST /end CHARACTERISTIC
/begin CHARACTERISTIC _g_PL_AD_fw_Radar_1R1V_rpc_LocBypassingRunnable_LocBypassingRunnable_m_pad_ensRLocationsPort_par_out_local.TChangeableMemPool._._._m_arrayPool._0_._elem._m_LocationList._Item._35_._phiQly "" VALUE 0xB001048B __UByte_Value 0 NO_COMPU_METHOD 0 255 ECU_ADDRESS_EXTENSION 0x2 BYTE_ORDER MSB_LAST /end CHARACTERISTIC
/begin CHARACTERISTIC _g_PL_AD_fw_Radar_1R1V_rpc_LocBypassingRunnable_LocBypassingRunnable_m_pad_ensRLocationsPort_par_out_local.TChangeableMemPool._._._m_arrayPool._0_._elem._m_LocationList._Item._35_._phiVar._m_value "" VALUE 0xB001048E __Float16_Value 0 NO_COMPU_METHOD -65504 65504 ECU_ADDRESS_EXTENSION 0x2 BYTE_ORDER MSB_LAST /end CHARACTERISTIC
/begin CHARACTERISTIC _g_PL_AD_fw_Radar_1R1V_rpc_LocBypassingRunnable_LocBypassingRunnable_m_pad_ensRLocationsPort_par_out_local.TChangeableMemPool._._._m_arrayPool._0_._elem._m_LocationList._Item._35_._theta._m_value "" VALUE 0xB0010486 __Float16_Value 0 NO_COMPU_METHOD -65504 65504 ECU_ADDRESS_EXTENSION 0x2 BYTE_ORDER MSB_LAST /end CHARACTERISTIC
/begin CHARACTERISTIC _g_PL_AD_fw_Radar_1R1V_rpc_LocBypassingRunnable_LocBypassingRunnable_m_pad_ensRLocationsPort_par_out_local.TChangeableMemPool._._._m_arrayPool._0_._elem._m_LocationList._Item._35_._thetaQly "" VALUE 0xB001048A __UByte_Value 0 NO_COMPU_METHOD 0 255 ECU_ADDRESS_EXTENSION 0x2 BYTE_ORDER MSB_LAST /end CHARACTERISTIC
/begin CHARACTERISTIC _g_PL_AD_fw_Radar_1R1V_rpc_LocBypassingRunnable_LocBypassingRunnable_m_pad_ensRLocationsPort_par_out_local.TChangeableMemPool._._._m_arrayPool._0_._elem._m_LocationList._Item._35_._thetaVar._m_value "" VALUE 0xB001048C __Float16_Value 0 NO_COMPU_METHOD -65504 65504 ECU_ADDRESS_EXTENSION 0x2 BYTE_ORDER MSB_LAST /end CHARACTERISTIC
/begin CHARACTERISTIC _g_PL_AD_fw_Radar_1R1V_rpc_LocBypassingRunnable_LocBypassingRunnable_m_pad_ensRLocationsPort_par_out_local.TChangeableMemPool._._._m_arrayPool._0_._elem._m_LocationList._Item._35_._v "" VALUE 0xB001047C __Float32_Value 0 NO_COMPU_METHOD -3.4028234663852886E+38 3.4028234663852886E+38 ECU_ADDRESS_EXTENSION 0x2 BYTE_ORDER MSB_LAST /end CHARACTERISTIC
/begin CHARACTERISTIC _g_PL_AD_fw_Radar_1R1V_rpc_LocBypassingRunnable_LocBypassingRunnable_m_pad_ensRLocationsPort_par_out_local.TChangeableMemPool._._._m_arrayPool._0_._elem._m_LocationList._Item._35_._vVar._m_value "" VALUE 0xB0010482 __Float16_Value 0 NO_COMPU_METHOD -65504 65504 ECU_ADDRESS_EXTENSION 0x2 BYTE_ORDER MSB_LAST /end CHARACTERISTIC
/begin CHARACTERISTIC _g_PL_AD_fw_Radar_1R1V_rpc_LocBypassingRunnable_LocBypassingRunnable_m_pad_ensRLocationsPort_par_out_local.TChangeableMemPool._._._m_arrayPool._0_._elem._m_LocationList._Item._36_._Rcs._m_value "" VALUE 0xB00104B0 __Float16_Value 0 NO_COMPU_METHOD -65504 65504 ECU_ADDRESS_EXTENSION 0x2 BYTE_ORDER MSB_LAST /end CHARACTERISTIC
/begin CHARACTERISTIC _g_PL_AD_fw_Radar_1R1V_rpc_LocBypassingRunnable_LocBypassingRunnable_m_pad_ensRLocationsPort_par_out_local.TChangeableMemPool._._._m_arrayPool._0_._elem._m_LocationList._Item._36_._Rssi._m_value "" VALUE 0xB00104B2 __Float16_Value 0 NO_COMPU_METHOD -65504 65504 ECU_ADDRESS_EXTENSION 0x2 BYTE_ORDER MSB_LAST /end CHARACTERISTIC
/begin CHARACTERISTIC _g_PL_AD_fw_Radar_1R1V_rpc_LocBypassingRunnable_LocBypassingRunnable_m_pad_ensRLocationsPort_par_out_local.TChangeableMemPool._._._m_arrayPool._0_._elem._m_LocationList._Item._36_._d "" VALUE 0xB0010498 __Float32_Value 0 NO_COMPU_METHOD -3.4028234663852886E+38 3.4028234663852886E+38 ECU_ADDRESS_EXTENSION 0x2 BYTE_ORDER MSB_LAST /end CHARACTERISTIC
/begin CHARACTERISTIC _g_PL_AD_fw_Radar_1R1V_rpc_LocBypassingRunnable_LocBypassingRunnable_m_pad_ensRLocationsPort_par_out_local.TChangeableMemPool._._._m_arrayPool._0_._elem._m_LocationList._Item._36_._dVar._m_value "" VALUE 0xB00104A0 __Float16_Value 0 NO_COMPU_METHOD -65504 65504 ECU_ADDRESS_EXTENSION 0x2 BYTE_ORDER MSB_LAST /end CHARACTERISTIC
/begin CHARACTERISTIC _g_PL_AD_fw_Radar_1R1V_rpc_LocBypassingRunnable_LocBypassingRunnable_m_pad_ensRLocationsPort_par_out_local.TChangeableMemPool._._._m_arrayPool._0_._elem._m_LocationList._Item._36_._dvCov._m_value "" VALUE 0xB00104A4 __Float16_Value 0 NO_COMPU_METHOD -65504 65504 ECU_ADDRESS_EXTENSION 0x2 BYTE_ORDER MSB_LAST /end CHARACTERISTIC
/begin CHARACTERISTIC _g_PL_AD_fw_Radar_1R1V_rpc_LocBypassingRunnable_LocBypassingRunnable_m_pad_ensRLocationsPort_par_out_local.TChangeableMemPool._._._m_arrayPool._0_._elem._m_LocationList._Item._36_._dvQly "" VALUE 0xB00104B4 __UByte_Value 0 NO_COMPU_METHOD 0 255 ECU_ADDRESS_EXTENSION 0x2 BYTE_ORDER MSB_LAST /end CHARACTERISTIC
/begin CHARACTERISTIC _g_PL_AD_fw_Radar_1R1V_rpc_LocBypassingRunnable_LocBypassingRunnable_m_pad_ensRLocationsPort_par_out_local.TChangeableMemPool._._._m_arrayPool._0_._elem._m_LocationList._Item._36_._idxAzimuthAmbiguityPeer "" VALUE 0xB00104B6 __UWord_Value 0 NO_COMPU_METHOD 0 65535 ECU_ADDRESS_EXTENSION 0x2 BYTE_ORDER MSB_LAST /end CHARACTERISTIC
/begin CHARACTERISTIC _g_PL_AD_fw_Radar_1R1V_rpc_LocBypassingRunnable_LocBypassingRunnable_m_pad_ensRLocationsPort_par_out_local.TChangeableMemPool._._._m_arrayPool._0_._elem._m_LocationList._Item._36_._measStatus "" VALUE 0xB00104B5 __UByte_Value 0 NO_COMPU_METHOD 0 255 ECU_ADDRESS_EXTENSION 0x2 BYTE_ORDER MSB_LAST /end CHARACTERISTIC
/begin CHARACTERISTIC _g_PL_AD_fw_Radar_1R1V_rpc_LocBypassingRunnable_LocBypassingRunnable_m_pad_ensRLocationsPort_par_out_local.TChangeableMemPool._._._m_arrayPool._0_._elem._m_LocationList._Item._36_._phi._m_value "" VALUE 0xB00104A8 __Float16_Value 0 NO_COMPU_METHOD -65504 65504 ECU_ADDRESS_EXTENSION 0x2 BYTE_ORDER MSB_LAST /end CHARACTERISTIC
/begin CHARACTERISTIC _g_PL_AD_fw_Radar_1R1V_rpc_LocBypassingRunnable_LocBypassingRunnable_m_pad_ensRLocationsPort_par_out_local.TChangeableMemPool._._._m_arrayPool._0_._elem._m_LocationList._Item._36_._phiQly "" VALUE 0xB00104AB __UByte_Value 0 NO_COMPU_METHOD 0 255 ECU_ADDRESS_EXTENSION 0x2 BYTE_ORDER MSB_LAST /end CHARACTERISTIC
/begin CHARACTERISTIC _g_PL_AD_fw_Radar_1R1V_rpc_LocBypassingRunnable_LocBypassingRunnable_m_pad_ensRLocationsPort_par_out_local.TChangeableMemPool._._._m_arrayPool._0_._elem._m_LocationList._Item._36_._phiVar._m_value "" VALUE 0xB00104AE __Float16_Value 0 NO_COMPU_METHOD -65504 65504 ECU_ADDRESS_EXTENSION 0x2 BYTE_ORDER MSB_LAST /end CHARACTERISTIC
/begin CHARACTERISTIC _g_PL_AD_fw_Radar_1R1V_rpc_LocBypassingRunnable_LocBypassingRunnable_m_pad_ensRLocationsPort_par_out_local.TChangeableMemPool._._._m_arrayPool._0_._elem._m_LocationList._Item._36_._theta._m_value "" VALUE 0xB00104A6 __Float16_Value 0 NO_COMPU_METHOD -65504 65504 ECU_ADDRESS_EXTENSION 0x2 BYTE_ORDER MSB_LAST /end CHARACTERISTIC
/begin CHARACTERISTIC _g_PL_AD_fw_Radar_1R1V_rpc_LocBypassingRunnable_LocBypassingRunnable_m_pad_ensRLocationsPort_par_out_local.TChangeableMemPool._._._m_arrayPool._0_._elem._m_LocationList._Item._36_._thetaQly "" VALUE 0xB00104AA __UByte_Value 0 NO_COMPU_METHOD 0 255 ECU_ADDRESS_EXTENSION 0x2 BYTE_ORDER MSB_LAST /end CHARACTERISTIC
/begin CHARACTERISTIC _g_PL_AD_fw_Radar_1R1V_rpc_LocBypassingRunnable_LocBypassingRunnable_m_pad_ensRLocationsPort_par_out_local.TChangeableMemPool._._._m_arrayPool._0_._elem._m_LocationList._Item._36_._thetaVar._m_value "" VALUE 0xB00104AC __Float16_Value 0 NO_COMPU_METHOD -65504 65504 ECU_ADDRESS_EXTENSION 0x2 BYTE_ORDER MSB_LAST /end CHARACTERISTIC
/begin CHARACTERISTIC _g_PL_AD_fw_Radar_1R1V_rpc_LocBypassingRunnable_LocBypassingRunnable_m_pad_ensRLocationsPort_par_out_local.TChangeableMemPool._._._m_arrayPool._0_._elem._m_LocationList._Item._36_._v "" VALUE 0xB001049C __Float32_Value 0 NO_COMPU_METHOD -3.4028234663852886E+38 3.4028234663852886E+38 ECU_ADDRESS_EXTENSION 0x2 BYTE_ORDER MSB_LAST /end CHARACTERISTIC
/begin CHARACTERISTIC _g_PL_AD_fw_Radar_1R1V_rpc_LocBypassingRunnable_LocBypassingRunnable_m_pad_ensRLocationsPort_par_out_local.TChangeableMemPool._._._m_arrayPool._0_._elem._m_LocationList._Item._36_._vVar._m_value "" VALUE 0xB00104A2 __Float16_Value 0 NO_COMPU_METHOD -65504 65504 ECU_ADDRESS_EXTENSION 0x2 BYTE_ORDER MSB_LAST /end CHARACTERISTIC
/begin CHARACTERISTIC _g_PL_AD_fw_Radar_1R1V_rpc_LocBypassingRunnable_LocBypassingRunnable_m_pad_ensRLocationsPort_par_out_local.TChangeableMemPool._._._m_arrayPool._0_._elem._m_LocationList._Item._37_._Rcs._m_value "" VALUE 0xB00104D0 __Float16_Value 0 NO_COMPU_METHOD -65504 65504 ECU_ADDRESS_EXTENSION 0x2 BYTE_ORDER MSB_LAST /end CHARACTERISTIC
/begin CHARACTERISTIC _g_PL_AD_fw_Radar_1R1V_rpc_LocBypassingRunnable_LocBypassingRunnable_m_pad_ensRLocationsPort_par_out_local.TChangeableMemPool._._._m_arrayPool._0_._elem._m_LocationList._Item._37_._Rssi._m_value "" VALUE 0xB00104D2 __Float16_Value 0 NO_COMPU_METHOD -65504 65504 ECU_ADDRESS_EXTENSION 0x2 BYTE_ORDER MSB_LAST /end CHARACTERISTIC
/begin CHARACTERISTIC _g_PL_AD_fw_Radar_1R1V_rpc_LocBypassingRunnable_LocBypassingRunnable_m_pad_ensRLocationsPort_par_out_local.TChangeableMemPool._._._m_arrayPool._0_._elem._m_LocationList._Item._37_._d "" VALUE 0xB00104B8 __Float32_Value 0 NO_COMPU_METHOD -3.4028234663852886E+38 3.4028234663852886E+38 ECU_ADDRESS_EXTENSION 0x2 BYTE_ORDER MSB_LAST /end CHARACTERISTIC
/begin CHARACTERISTIC _g_PL_AD_fw_Radar_1R1V_rpc_LocBypassingRunnable_LocBypassingRunnable_m_pad_ensRLocationsPort_par_out_local.TChangeableMemPool._._._m_arrayPool._0_._elem._m_LocationList._Item._37_._dVar._m_value "" VALUE 0xB00104C0 __Float16_Value 0 NO_COMPU_METHOD -65504 65504 ECU_ADDRESS_EXTENSION 0x2 BYTE_ORDER MSB_LAST /end CHARACTERISTIC
/begin CHARACTERISTIC _g_PL_AD_fw_Radar_1R1V_rpc_LocBypassingRunnable_LocBypassingRunnable_m_pad_ensRLocationsPort_par_out_local.TChangeableMemPool._._._m_arrayPool._0_._elem._m_LocationList._Item._37_._dvCov._m_value "" VALUE 0xB00104C4 __Float16_Value 0 NO_COMPU_METHOD -65504 65504 ECU_ADDRESS_EXTENSION 0x2 BYTE_ORDER MSB_LAST /end CHARACTERISTIC
/begin CHARACTERISTIC _g_PL_AD_fw_Radar_1R1V_rpc_LocBypassingRunnable_LocBypassingRunnable_m_pad_ensRLocationsPort_par_out_local.TChangeableMemPool._._._m_arrayPool._0_._elem._m_LocationList._Item._37_._dvQly "" VALUE 0xB00104D4 __UByte_Value 0 NO_COMPU_METHOD 0 255 ECU_ADDRESS_EXTENSION 0x2 BYTE_ORDER MSB_LAST /end CHARACTERISTIC
/begin CHARACTERISTIC _g_PL_AD_fw_Radar_1R1V_rpc_LocBypassingRunnable_LocBypassingRunnable_m_pad_ensRLocationsPort_par_out_local.TChangeableMemPool._._._m_arrayPool._0_._elem._m_LocationList._Item._37_._idxAzimuthAmbiguityPeer "" VALUE 0xB00104D6 __UWord_Value 0 NO_COMPU_METHOD 0 65535 ECU_ADDRESS_EXTENSION 0x2 BYTE_ORDER MSB_LAST /end CHARACTERISTIC
/begin CHARACTERISTIC _g_PL_AD_fw_Radar_1R1V_rpc_LocBypassingRunnable_LocBypassingRunnable_m_pad_ensRLocationsPort_par_out_local.TChangeableMemPool._._._m_arrayPool._0_._elem._m_LocationList._Item._37_._measStatus "" VALUE 0xB00104D5 __UByte_Value 0 NO_COMPU_METHOD 0 255 ECU_ADDRESS_EXTENSION 0x2 BYTE_ORDER MSB_LAST /end CHARACTERISTIC
/begin CHARACTERISTIC _g_PL_AD_fw_Radar_1R1V_rpc_LocBypassingRunnable_LocBypassingRunnable_m_pad_ensRLocationsPort_par_out_local.TChangeableMemPool._._._m_arrayPool._0_._elem._m_LocationList._Item._37_._phi._m_value "" VALUE 0xB00104C8 __Float16_Value 0 NO_COMPU_METHOD -65504 65504 ECU_ADDRESS_EXTENSION 0x2 BYTE_ORDER MSB_LAST /end CHARACTERISTIC
/begin CHARACTERISTIC _g_PL_AD_fw_Radar_1R1V_rpc_LocBypassingRunnable_LocBypassingRunnable_m_pad_ensRLocationsPort_par_out_local.TChangeableMemPool._._._m_arrayPool._0_._elem._m_LocationList._Item._37_._phiQly "" VALUE 0xB00104CB __UByte_Value 0 NO_COMPU_METHOD 0 255 ECU_ADDRESS_EXTENSION 0x2 BYTE_ORDER MSB_LAST /end CHARACTERISTIC
/begin CHARACTERISTIC _g_PL_AD_fw_Radar_1R1V_rpc_LocBypassingRunnable_LocBypassingRunnable_m_pad_ensRLocationsPort_par_out_local.TChangeableMemPool._._._m_arrayPool._0_._elem._m_LocationList._Item._37_._phiVar._m_value "" VALUE 0xB00104CE __Float16_Value 0 NO_COMPU_METHOD -65504 65504 ECU_ADDRESS_EXTENSION 0x2 BYTE_ORDER MSB_LAST /end CHARACTERISTIC
/begin CHARACTERISTIC _g_PL_AD_fw_Radar_1R1V_rpc_LocBypassingRunnable_LocBypassingRunnable_m_pad_ensRLocationsPort_par_out_local.TChangeableMemPool._._._m_arrayPool._0_._elem._m_LocationList._Item._37_._theta._m_value "" VALUE 0xB00104C6 __Float16_Value 0 NO_COMPU_METHOD -65504 65504 ECU_ADDRESS_EXTENSION 0x2 BYTE_ORDER MSB_LAST /end CHARACTERISTIC
/begin CHARACTERISTIC _g_PL_AD_fw_Radar_1R1V_rpc_LocBypassingRunnable_LocBypassingRunnable_m_pad_ensRLocationsPort_par_out_local.TChangeableMemPool._._._m_arrayPool._0_._elem._m_LocationList._Item._37_._thetaQly "" VALUE 0xB00104CA __UByte_Value 0 NO_COMPU_METHOD 0 255 ECU_ADDRESS_EXTENSION 0x2 BYTE_ORDER MSB_LAST /end CHARACTERISTIC
/begin CHARACTERISTIC _g_PL_AD_fw_Radar_1R1V_rpc_LocBypassingRunnable_LocBypassingRunnable_m_pad_ensRLocationsPort_par_out_local.TChangeableMemPool._._._m_arrayPool._0_._elem._m_LocationList._Item._37_._thetaVar._m_value "" VALUE 0xB00104CC __Float16_Value 0 NO_COMPU_METHOD -65504 65504 ECU_ADDRESS_EXTENSION 0x2 BYTE_ORDER MSB_LAST /end CHARACTERISTIC
/begin CHARACTERISTIC _g_PL_AD_fw_Radar_1R1V_rpc_LocBypassingRunnable_LocBypassingRunnable_m_pad_ensRLocationsPort_par_out_local.TChangeableMemPool._._._m_arrayPool._0_._elem._m_LocationList._Item._37_._v "" VALUE 0xB00104BC __Float32_Value 0 NO_COMPU_METHOD -3.4028234663852886E+38 3.4028234663852886E+38 ECU_ADDRESS_EXTENSION 0x2 BYTE_ORDER MSB_LAST /end CHARACTERISTIC
/begin CHARACTERISTIC _g_PL_AD_fw_Radar_1R1V_rpc_LocBypassingRunnable_LocBypassingRunnable_m_pad_ensRLocationsPort_par_out_local.TChangeableMemPool._._._m_arrayPool._0_._elem._m_LocationList._Item._37_._vVar._m_value "" VALUE 0xB00104C2 __Float16_Value 0 NO_COMPU_METHOD -65504 65504 ECU_ADDRESS_EXTENSION 0x2 BYTE_ORDER MSB_LAST /end CHARACTERISTIC
/begin CHARACTERISTIC _g_PL_AD_fw_Radar_1R1V_rpc_LocBypassingRunnable_LocBypassingRunnable_m_pad_ensRLocationsPort_par_out_local.TChangeableMemPool._._._m_arrayPool._0_._elem._m_LocationList._Item._38_._Rcs._m_value "" VALUE 0xB00104F0 __Float16_Value 0 NO_COMPU_METHOD -65504 65504 ECU_ADDRESS_EXTENSION 0x2 BYTE_ORDER MSB_LAST /end CHARACTERISTIC
/begin CHARACTERISTIC _g_PL_AD_fw_Radar_1R1V_rpc_LocBypassingRunnable_LocBypassingRunnable_m_pad_ensRLocationsPort_par_out_local.TChangeableMemPool._._._m_arrayPool._0_._elem._m_LocationList._Item._38_._Rssi._m_value "" VALUE 0xB00104F2 __Float16_Value 0 NO_COMPU_METHOD -65504 65504 ECU_ADDRESS_EXTENSION 0x2 BYTE_ORDER MSB_LAST /end CHARACTERISTIC
/begin CHARACTERISTIC _g_PL_AD_fw_Radar_1R1V_rpc_LocBypassingRunnable_LocBypassingRunnable_m_pad_ensRLocationsPort_par_out_local.TChangeableMemPool._._._m_arrayPool._0_._elem._m_LocationList._Item._38_._d "" VALUE 0xB00104D8 __Float32_Value 0 NO_COMPU_METHOD -3.4028234663852886E+38 3.4028234663852886E+38 ECU_ADDRESS_EXTENSION 0x2 BYTE_ORDER MSB_LAST /end CHARACTERISTIC
/begin CHARACTERISTIC _g_PL_AD_fw_Radar_1R1V_rpc_LocBypassingRunnable_LocBypassingRunnable_m_pad_ensRLocationsPort_par_out_local.TChangeableMemPool._._._m_arrayPool._0_._elem._m_LocationList._Item._38_._dVar._m_value "" VALUE 0xB00104E0 __Float16_Value 0 NO_COMPU_METHOD -65504 65504 ECU_ADDRESS_EXTENSION 0x2 BYTE_ORDER MSB_LAST /end CHARACTERISTIC
/begin CHARACTERISTIC _g_PL_AD_fw_Radar_1R1V_rpc_LocBypassingRunnable_LocBypassingRunnable_m_pad_ensRLocationsPort_par_out_local.TChangeableMemPool._._._m_arrayPool._0_._elem._m_LocationList._Item._38_._dvCov._m_value "" VALUE 0xB00104E4 __Float16_Value 0 NO_COMPU_METHOD -65504 65504 ECU_ADDRESS_EXTENSION 0x2 BYTE_ORDER MSB_LAST /end CHARACTERISTIC
/begin CHARACTERISTIC _g_PL_AD_fw_Radar_1R1V_rpc_LocBypassingRunnable_LocBypassingRunnable_m_pad_ensRLocationsPort_par_out_local.TChangeableMemPool._._._m_arrayPool._0_._elem._m_LocationList._Item._38_._dvQly "" VALUE 0xB00104F4 __UByte_Value 0 NO_COMPU_METHOD 0 255 ECU_ADDRESS_EXTENSION 0x2 BYTE_ORDER MSB_LAST /end CHARACTERISTIC
/begin CHARACTERISTIC _g_PL_AD_fw_Radar_1R1V_rpc_LocBypassingRunnable_LocBypassingRunnable_m_pad_ensRLocationsPort_par_out_local.TChangeableMemPool._._._m_arrayPool._0_._elem._m_LocationList._Item._38_._idxAzimuthAmbiguityPeer "" VALUE 0xB00104F6 __UWord_Value 0 NO_COMPU_METHOD 0 65535 ECU_ADDRESS_EXTENSION 0x2 BYTE_ORDER MSB_LAST /end CHARACTERISTIC
/begin CHARACTERISTIC _g_PL_AD_fw_Radar_1R1V_rpc_LocBypassingRunnable_LocBypassingRunnable_m_pad_ensRLocationsPort_par_out_local.TChangeableMemPool._._._m_arrayPool._0_._elem._m_LocationList._Item._38_._measStatus "" VALUE 0xB00104F5 __UByte_Value 0 NO_COMPU_METHOD 0 255 ECU_ADDRESS_EXTENSION 0x2 BYTE_ORDER MSB_LAST /end CHARACTERISTIC
/begin CHARACTERISTIC _g_PL_AD_fw_Radar_1R1V_rpc_LocBypassingRunnable_LocBypassingRunnable_m_pad_ensRLocationsPort_par_out_local.TChangeableMemPool._._._m_arrayPool._0_._elem._m_LocationList._Item._38_._phi._m_value "" VALUE 0xB00104E8 __Float16_Value 0 NO_COMPU_METHOD -65504 65504 ECU_ADDRESS_EXTENSION 0x2 BYTE_ORDER MSB_LAST /end CHARACTERISTIC
/begin CHARACTERISTIC _g_PL_AD_fw_Radar_1R1V_rpc_LocBypassingRunnable_LocBypassingRunnable_m_pad_ensRLocationsPort_par_out_local.TChangeableMemPool._._._m_arrayPool._0_._elem._m_LocationList._Item._38_._phiQly "" VALUE 0xB00104EB __UByte_Value 0 NO_COMPU_METHOD 0 255 ECU_ADDRESS_EXTENSION 0x2 BYTE_ORDER MSB_LAST /end CHARACTERISTIC
/begin CHARACTERISTIC _g_PL_AD_fw_Radar_1R1V_rpc_LocBypassingRunnable_LocBypassingRunnable_m_pad_ensRLocationsPort_par_out_local.TChangeableMemPool._._._m_arrayPool._0_._elem._m_LocationList._Item._38_._phiVar._m_value "" VALUE 0xB00104EE __Float16_Value 0 NO_COMPU_METHOD -65504 65504 ECU_ADDRESS_EXTENSION 0x2 BYTE_ORDER MSB_LAST /end CHARACTERISTIC
/begin CHARACTERISTIC _g_PL_AD_fw_Radar_1R1V_rpc_LocBypassingRunnable_LocBypassingRunnable_m_pad_ensRLocationsPort_par_out_local.TChangeableMemPool._._._m_arrayPool._0_._elem._m_LocationList._Item._38_._theta._m_value "" VALUE 0xB00104E6 __Float16_Value 0 NO_COMPU_METHOD -65504 65504 ECU_ADDRESS_EXTENSION 0x2 BYTE_ORDER MSB_LAST /end CHARACTERISTIC
/begin CHARACTERISTIC _g_PL_AD_fw_Radar_1R1V_rpc_LocBypassingRunnable_LocBypassingRunnable_m_pad_ensRLocationsPort_par_out_local.TChangeableMemPool._._._m_arrayPool._0_._elem._m_LocationList._Item._38_._thetaQly "" VALUE 0xB00104EA __UByte_Value 0 NO_COMPU_METHOD 0 255 ECU_ADDRESS_EXTENSION 0x2 BYTE_ORDER MSB_LAST /end CHARACTERISTIC
/begin CHARACTERISTIC _g_PL_AD_fw_Radar_1R1V_rpc_LocBypassingRunnable_LocBypassingRunnable_m_pad_ensRLocationsPort_par_out_local.TChangeableMemPool._._._m_arrayPool._0_._elem._m_LocationList._Item._38_._thetaVar._m_value "" VALUE 0xB00104EC __Float16_Value 0 NO_COMPU_METHOD -65504 65504 ECU_ADDRESS_EXTENSION 0x2 BYTE_ORDER MSB_LAST /end CHARACTERISTIC
/begin CHARACTERISTIC _g_PL_AD_fw_Radar_1R1V_rpc_LocBypassingRunnable_LocBypassingRunnable_m_pad_ensRLocationsPort_par_out_local.TChangeableMemPool._._._m_arrayPool._0_._elem._m_LocationList._Item._38_._v "" VALUE 0xB00104DC __Float32_Value 0 NO_COMPU_METHOD -3.4028234663852886E+38 3.4028234663852886E+38 ECU_ADDRESS_EXTENSION 0x2 BYTE_ORDER MSB_LAST /end CHARACTERISTIC
/begin CHARACTERISTIC _g_PL_AD_fw_Radar_1R1V_rpc_LocBypassingRunnable_LocBypassingRunnable_m_pad_ensRLocationsPort_par_out_local.TChangeableMemPool._._._m_arrayPool._0_._elem._m_LocationList._Item._38_._vVar._m_value "" VALUE 0xB00104E2 __Float16_Value 0 NO_COMPU_METHOD -65504 65504 ECU_ADDRESS_EXTENSION 0x2 BYTE_ORDER MSB_LAST /end CHARACTERISTIC
/begin CHARACTERISTIC _g_PL_AD_fw_Radar_1R1V_rpc_LocBypassingRunnable_LocBypassingRunnable_m_pad_ensRLocationsPort_par_out_local.TChangeableMemPool._._._m_arrayPool._0_._elem._m_LocationList._Item._39_._Rcs._m_value "" VALUE 0xB0010510 __Float16_Value 0 NO_COMPU_METHOD -65504 65504 ECU_ADDRESS_EXTENSION 0x2 BYTE_ORDER MSB_LAST /end CHARACTERISTIC
/begin CHARACTERISTIC _g_PL_AD_fw_Radar_1R1V_rpc_LocBypassingRunnable_LocBypassingRunnable_m_pad_ensRLocationsPort_par_out_local.TChangeableMemPool._._._m_arrayPool._0_._elem._m_LocationList._Item._39_._Rssi._m_value "" VALUE 0xB0010512 __Float16_Value 0 NO_COMPU_METHOD -65504 65504 ECU_ADDRESS_EXTENSION 0x2 BYTE_ORDER MSB_LAST /end CHARACTERISTIC
/begin CHARACTERISTIC _g_PL_AD_fw_Radar_1R1V_rpc_LocBypassingRunnable_LocBypassingRunnable_m_pad_ensRLocationsPort_par_out_local.TChangeableMemPool._._._m_arrayPool._0_._elem._m_LocationList._Item._39_._d "" VALUE 0xB00104F8 __Float32_Value 0 NO_COMPU_METHOD -3.4028234663852886E+38 3.4028234663852886E+38 ECU_ADDRESS_EXTENSION 0x2 BYTE_ORDER MSB_LAST /end CHARACTERISTIC
/begin CHARACTERISTIC _g_PL_AD_fw_Radar_1R1V_rpc_LocBypassingRunnable_LocBypassingRunnable_m_pad_ensRLocationsPort_par_out_local.TChangeableMemPool._._._m_arrayPool._0_._elem._m_LocationList._Item._39_._dVar._m_value "" VALUE 0xB0010500 __Float16_Value 0 NO_COMPU_METHOD -65504 65504 ECU_ADDRESS_EXTENSION 0x2 BYTE_ORDER MSB_LAST /end CHARACTERISTIC
/begin CHARACTERISTIC _g_PL_AD_fw_Radar_1R1V_rpc_LocBypassingRunnable_LocBypassingRunnable_m_pad_ensRLocationsPort_par_out_local.TChangeableMemPool._._._m_arrayPool._0_._elem._m_LocationList._Item._39_._dvCov._m_value "" VALUE 0xB0010504 __Float16_Value 0 NO_COMPU_METHOD -65504 65504 ECU_ADDRESS_EXTENSION 0x2 BYTE_ORDER MSB_LAST /end CHARACTERISTIC
/begin CHARACTERISTIC _g_PL_AD_fw_Radar_1R1V_rpc_LocBypassingRunnable_LocBypassingRunnable_m_pad_ensRLocationsPort_par_out_local.TChangeableMemPool._._._m_arrayPool._0_._elem._m_LocationList._Item._39_._dvQly "" VALUE 0xB0010514 __UByte_Value 0 NO_COMPU_METHOD 0 255 ECU_ADDRESS_EXTENSION 0x2 BYTE_ORDER MSB_LAST /end CHARACTERISTIC
/begin CHARACTERISTIC _g_PL_AD_fw_Radar_1R1V_rpc_LocBypassingRunnable_LocBypassingRunnable_m_pad_ensRLocationsPort_par_out_local.TChangeableMemPool._._._m_arrayPool._0_._elem._m_LocationList._Item._39_._idxAzimuthAmbiguityPeer "" VALUE 0xB0010516 __UWord_Value 0 NO_COMPU_METHOD 0 65535 ECU_ADDRESS_EXTENSION 0x2 BYTE_ORDER MSB_LAST /end CHARACTERISTIC
/begin CHARACTERISTIC _g_PL_AD_fw_Radar_1R1V_rpc_LocBypassingRunnable_LocBypassingRunnable_m_pad_ensRLocationsPort_par_out_local.TChangeableMemPool._._._m_arrayPool._0_._elem._m_LocationList._Item._39_._measStatus "" VALUE 0xB0010515 __UByte_Value 0 NO_COMPU_METHOD 0 255 ECU_ADDRESS_EXTENSION 0x2 BYTE_ORDER MSB_LAST /end CHARACTERISTIC
/begin CHARACTERISTIC _g_PL_AD_fw_Radar_1R1V_rpc_LocBypassingRunnable_LocBypassingRunnable_m_pad_ensRLocationsPort_par_out_local.TChangeableMemPool._._._m_arrayPool._0_._elem._m_LocationList._Item._39_._phi._m_value "" VALUE 0xB0010508 __Float16_Value 0 NO_COMPU_METHOD -65504 65504 ECU_ADDRESS_EXTENSION 0x2 BYTE_ORDER MSB_LAST /end CHARACTERISTIC
/begin CHARACTERISTIC _g_PL_AD_fw_Radar_1R1V_rpc_LocBypassingRunnable_LocBypassingRunnable_m_pad_ensRLocationsPort_par_out_local.TChangeableMemPool._._._m_arrayPool._0_._elem._m_LocationList._Item._39_._phiQly "" VALUE 0xB001050B __UByte_Value 0 NO_COMPU_METHOD 0 255 ECU_ADDRESS_EXTENSION 0x2 BYTE_ORDER MSB_LAST /end CHARACTERISTIC
/begin CHARACTERISTIC _g_PL_AD_fw_Radar_1R1V_rpc_LocBypassingRunnable_LocBypassingRunnable_m_pad_ensRLocationsPort_par_out_local.TChangeableMemPool._._._m_arrayPool._0_._elem._m_LocationList._Item._39_._phiVar._m_value "" VALUE 0xB001050E __Float16_Value 0 NO_COMPU_METHOD -65504 65504 ECU_ADDRESS_EXTENSION 0x2 BYTE_ORDER MSB_LAST /end CHARACTERISTIC
/begin CHARACTERISTIC _g_PL_AD_fw_Radar_1R1V_rpc_LocBypassingRunnable_LocBypassingRunnable_m_pad_ensRLocationsPort_par_out_local.TChangeableMemPool._._._m_arrayPool._0_._elem._m_LocationList._Item._39_._theta._m_value "" VALUE 0xB0010506 __Float16_Value 0 NO_COMPU_METHOD -65504 65504 ECU_ADDRESS_EXTENSION 0x2 BYTE_ORDER MSB_LAST /end CHARACTERISTIC
/begin CHARACTERISTIC _g_PL_AD_fw_Radar_1R1V_rpc_LocBypassingRunnable_LocBypassingRunnable_m_pad_ensRLocationsPort_par_out_local.TChangeableMemPool._._._m_arrayPool._0_._elem._m_LocationList._Item._39_._thetaQly "" VALUE 0xB001050A __UByte_Value 0 NO_COMPU_METHOD 0 255 ECU_ADDRESS_EXTENSION 0x2 BYTE_ORDER MSB_LAST /end CHARACTERISTIC
/begin CHARACTERISTIC _g_PL_AD_fw_Radar_1R1V_rpc_LocBypassingRunnable_LocBypassingRunnable_m_pad_ensRLocationsPort_par_out_local.TChangeableMemPool._._._m_arrayPool._0_._elem._m_LocationList._Item._39_._thetaVar._m_value "" VALUE 0xB001050C __Float16_Value 0 NO_COMPU_METHOD -65504 65504 ECU_ADDRESS_EXTENSION 0x2 BYTE_ORDER MSB_LAST /end CHARACTERISTIC
/begin CHARACTERISTIC _g_PL_AD_fw_Radar_1R1V_rpc_LocBypassingRunnable_LocBypassingRunnable_m_pad_ensRLocationsPort_par_out_local.TChangeableMemPool._._._m_arrayPool._0_._elem._m_LocationList._Item._39_._v "" VALUE 0xB00104FC __Float32_Value 0 NO_COMPU_METHOD -3.4028234663852886E+38 3.4028234663852886E+38 ECU_ADDRESS_EXTENSION 0x2 BYTE_ORDER MSB_LAST /end CHARACTERISTIC
/begin CHARACTERISTIC _g_PL_AD_fw_Radar_1R1V_rpc_LocBypassingRunnable_LocBypassingRunnable_m_pad_ensRLocationsPort_par_out_local.TChangeableMemPool._._._m_arrayPool._0_._elem._m_LocationList._Item._39_._vVar._m_value "" VALUE 0xB0010502 __Float16_Value 0 NO_COMPU_METHOD -65504 65504 ECU_ADDRESS_EXTENSION 0x2 BYTE_ORDER MSB_LAST /end CHARACTERISTIC
/begin CHARACTERISTIC _g_PL_AD_fw_Radar_1R1V_rpc_LocBypassingRunnable_LocBypassingRunnable_m_pad_ensRLocationsPort_par_out_local.TChangeableMemPool._._._m_arrayPool._0_._elem._m_LocationList._Item._3_._Rcs._m_value "" VALUE 0xB0010090 __Float16_Value 0 NO_COMPU_METHOD -65504 65504 ECU_ADDRESS_EXTENSION 0x2 BYTE_ORDER MSB_LAST /end CHARACTERISTIC
/begin CHARACTERISTIC _g_PL_AD_fw_Radar_1R1V_rpc_LocBypassingRunnable_LocBypassingRunnable_m_pad_ensRLocationsPort_par_out_local.TChangeableMemPool._._._m_arrayPool._0_._elem._m_LocationList._Item._3_._Rssi._m_value "" VALUE 0xB0010092 __Float16_Value 0 NO_COMPU_METHOD -65504 65504 ECU_ADDRESS_EXTENSION 0x2 BYTE_ORDER MSB_LAST /end CHARACTERISTIC
/begin CHARACTERISTIC _g_PL_AD_fw_Radar_1R1V_rpc_LocBypassingRunnable_LocBypassingRunnable_m_pad_ensRLocationsPort_par_out_local.TChangeableMemPool._._._m_arrayPool._0_._elem._m_LocationList._Item._3_._d "" VALUE 0xB0010078 __Float32_Value 0 NO_COMPU_METHOD -3.4028234663852886E+38 3.4028234663852886E+38 ECU_ADDRESS_EXTENSION 0x2 BYTE_ORDER MSB_LAST /end CHARACTERISTIC
/begin CHARACTERISTIC _g_PL_AD_fw_Radar_1R1V_rpc_LocBypassingRunnable_LocBypassingRunnable_m_pad_ensRLocationsPort_par_out_local.TChangeableMemPool._._._m_arrayPool._0_._elem._m_LocationList._Item._3_._dVar._m_value "" VALUE 0xB0010080 __Float16_Value 0 NO_COMPU_METHOD -65504 65504 ECU_ADDRESS_EXTENSION 0x2 BYTE_ORDER MSB_LAST /end CHARACTERISTIC
/begin CHARACTERISTIC _g_PL_AD_fw_Radar_1R1V_rpc_LocBypassingRunnable_LocBypassingRunnable_m_pad_ensRLocationsPort_par_out_local.TChangeableMemPool._._._m_arrayPool._0_._elem._m_LocationList._Item._3_._dvCov._m_value "" VALUE 0xB0010084 __Float16_Value 0 NO_COMPU_METHOD -65504 65504 ECU_ADDRESS_EXTENSION 0x2 BYTE_ORDER MSB_LAST /end CHARACTERISTIC
/begin CHARACTERISTIC _g_PL_AD_fw_Radar_1R1V_rpc_LocBypassingRunnable_LocBypassingRunnable_m_pad_ensRLocationsPort_par_out_local.TChangeableMemPool._._._m_arrayPool._0_._elem._m_LocationList._Item._3_._dvQly "" VALUE 0xB0010094 __UByte_Value 0 NO_COMPU_METHOD 0 255 ECU_ADDRESS_EXTENSION 0x2 BYTE_ORDER MSB_LAST /end CHARACTERISTIC
/begin CHARACTERISTIC _g_PL_AD_fw_Radar_1R1V_rpc_LocBypassingRunnable_LocBypassingRunnable_m_pad_ensRLocationsPort_par_out_local.TChangeableMemPool._._._m_arrayPool._0_._elem._m_LocationList._Item._3_._idxAzimuthAmbiguityPeer "" VALUE 0xB0010096 __UWord_Value 0 NO_COMPU_METHOD 0 65535 ECU_ADDRESS_EXTENSION 0x2 BYTE_ORDER MSB_LAST /end CHARACTERISTIC
/begin CHARACTERISTIC _g_PL_AD_fw_Radar_1R1V_rpc_LocBypassingRunnable_LocBypassingRunnable_m_pad_ensRLocationsPort_par_out_local.TChangeableMemPool._._._m_arrayPool._0_._elem._m_LocationList._Item._3_._measStatus "" VALUE 0xB0010095 __UByte_Value 0 NO_COMPU_METHOD 0 255 ECU_ADDRESS_EXTENSION 0x2 BYTE_ORDER MSB_LAST /end CHARACTERISTIC
/begin CHARACTERISTIC _g_PL_AD_fw_Radar_1R1V_rpc_LocBypassingRunnable_LocBypassingRunnable_m_pad_ensRLocationsPort_par_out_local.TChangeableMemPool._._._m_arrayPool._0_._elem._m_LocationList._Item._3_._phi._m_value "" VALUE 0xB0010088 __Float16_Value 0 NO_COMPU_METHOD -65504 65504 ECU_ADDRESS_EXTENSION 0x2 BYTE_ORDER MSB_LAST /end CHARACTERISTIC
/begin CHARACTERISTIC _g_PL_AD_fw_Radar_1R1V_rpc_LocBypassingRunnable_LocBypassingRunnable_m_pad_ensRLocationsPort_par_out_local.TChangeableMemPool._._._m_arrayPool._0_._elem._m_LocationList._Item._3_._phiQly "" VALUE 0xB001008B __UByte_Value 0 NO_COMPU_METHOD 0 255 ECU_ADDRESS_EXTENSION 0x2 BYTE_ORDER MSB_LAST /end CHARACTERISTIC
/begin CHARACTERISTIC _g_PL_AD_fw_Radar_1R1V_rpc_LocBypassingRunnable_LocBypassingRunnable_m_pad_ensRLocationsPort_par_out_local.TChangeableMemPool._._._m_arrayPool._0_._elem._m_LocationList._Item._3_._phiVar._m_value "" VALUE 0xB001008E __Float16_Value 0 NO_COMPU_METHOD -65504 65504 ECU_ADDRESS_EXTENSION 0x2 BYTE_ORDER MSB_LAST /end CHARACTERISTIC
/begin CHARACTERISTIC _g_PL_AD_fw_Radar_1R1V_rpc_LocBypassingRunnable_LocBypassingRunnable_m_pad_ensRLocationsPort_par_out_local.TChangeableMemPool._._._m_arrayPool._0_._elem._m_LocationList._Item._3_._theta._m_value "" VALUE 0xB0010086 __Float16_Value 0 NO_COMPU_METHOD -65504 65504 ECU_ADDRESS_EXTENSION 0x2 BYTE_ORDER MSB_LAST /end CHARACTERISTIC
/begin CHARACTERISTIC _g_PL_AD_fw_Radar_1R1V_rpc_LocBypassingRunnable_LocBypassingRunnable_m_pad_ensRLocationsPort_par_out_local.TChangeableMemPool._._._m_arrayPool._0_._elem._m_LocationList._Item._3_._thetaQly "" VALUE 0xB001008A __UByte_Value 0 NO_COMPU_METHOD 0 255 ECU_ADDRESS_EXTENSION 0x2 BYTE_ORDER MSB_LAST /end CHARACTERISTIC
/begin CHARACTERISTIC _g_PL_AD_fw_Radar_1R1V_rpc_LocBypassingRunnable_LocBypassingRunnable_m_pad_ensRLocationsPort_par_out_local.TChangeableMemPool._._._m_arrayPool._0_._elem._m_LocationList._Item._3_._thetaVar._m_value "" VALUE 0xB001008C __Float16_Value 0 NO_COMPU_METHOD -65504 65504 ECU_ADDRESS_EXTENSION 0x2 BYTE_ORDER MSB_LAST /end CHARACTERISTIC
/begin CHARACTERISTIC _g_PL_AD_fw_Radar_1R1V_rpc_LocBypassingRunnable_LocBypassingRunnable_m_pad_ensRLocationsPort_par_out_local.TChangeableMemPool._._._m_arrayPool._0_._elem._m_LocationList._Item._3_._v "" VALUE 0xB001007C __Float32_Value 0 NO_COMPU_METHOD -3.4028234663852886E+38 3.4028234663852886E+38 ECU_ADDRESS_EXTENSION 0x2 BYTE_ORDER MSB_LAST /end CHARACTERISTIC
/begin CHARACTERISTIC _g_PL_AD_fw_Radar_1R1V_rpc_LocBypassingRunnable_LocBypassingRunnable_m_pad_ensRLocationsPort_par_out_local.TChangeableMemPool._._._m_arrayPool._0_._elem._m_LocationList._Item._3_._vVar._m_value "" VALUE 0xB0010082 __Float16_Value 0 NO_COMPU_METHOD -65504 65504 ECU_ADDRESS_EXTENSION 0x2 BYTE_ORDER MSB_LAST /end CHARACTERISTIC
/begin CHARACTERISTIC _g_PL_AD_fw_Radar_1R1V_rpc_LocBypassingRunnable_LocBypassingRunnable_m_pad_ensRLocationsPort_par_out_local.TChangeableMemPool._._._m_arrayPool._0_._elem._m_LocationList._Item._40_._Rcs._m_value "" VALUE 0xB0010530 __Float16_Value 0 NO_COMPU_METHOD -65504 65504 ECU_ADDRESS_EXTENSION 0x2 BYTE_ORDER MSB_LAST /end CHARACTERISTIC
/begin CHARACTERISTIC _g_PL_AD_fw_Radar_1R1V_rpc_LocBypassingRunnable_LocBypassingRunnable_m_pad_ensRLocationsPort_par_out_local.TChangeableMemPool._._._m_arrayPool._0_._elem._m_LocationList._Item._40_._Rssi._m_value "" VALUE 0xB0010532 __Float16_Value 0 NO_COMPU_METHOD -65504 65504 ECU_ADDRESS_EXTENSION 0x2 BYTE_ORDER MSB_LAST /end CHARACTERISTIC
/begin CHARACTERISTIC _g_PL_AD_fw_Radar_1R1V_rpc_LocBypassingRunnable_LocBypassingRunnable_m_pad_ensRLocationsPort_par_out_local.TChangeableMemPool._._._m_arrayPool._0_._elem._m_LocationList._Item._40_._d "" VALUE 0xB0010518 __Float32_Value 0 NO_COMPU_METHOD -3.4028234663852886E+38 3.4028234663852886E+38 ECU_ADDRESS_EXTENSION 0x2 BYTE_ORDER MSB_LAST /end CHARACTERISTIC
/begin CHARACTERISTIC _g_PL_AD_fw_Radar_1R1V_rpc_LocBypassingRunnable_LocBypassingRunnable_m_pad_ensRLocationsPort_par_out_local.TChangeableMemPool._._._m_arrayPool._0_._elem._m_LocationList._Item._40_._dVar._m_value "" VALUE 0xB0010520 __Float16_Value 0 NO_COMPU_METHOD -65504 65504 ECU_ADDRESS_EXTENSION 0x2 BYTE_ORDER MSB_LAST /end CHARACTERISTIC
/begin CHARACTERISTIC _g_PL_AD_fw_Radar_1R1V_rpc_LocBypassingRunnable_LocBypassingRunnable_m_pad_ensRLocationsPort_par_out_local.TChangeableMemPool._._._m_arrayPool._0_._elem._m_LocationList._Item._40_._dvCov._m_value "" VALUE 0xB0010524 __Float16_Value 0 NO_COMPU_METHOD -65504 65504 ECU_ADDRESS_EXTENSION 0x2 BYTE_ORDER MSB_LAST /end CHARACTERISTIC
/begin CHARACTERISTIC _g_PL_AD_fw_Radar_1R1V_rpc_LocBypassingRunnable_LocBypassingRunnable_m_pad_ensRLocationsPort_par_out_local.TChangeableMemPool._._._m_arrayPool._0_._elem._m_LocationList._Item._40_._dvQly "" VALUE 0xB0010534 __UByte_Value 0 NO_COMPU_METHOD 0 255 ECU_ADDRESS_EXTENSION 0x2 BYTE_ORDER MSB_LAST /end CHARACTERISTIC
/begin CHARACTERISTIC _g_PL_AD_fw_Radar_1R1V_rpc_LocBypassingRunnable_LocBypassingRunnable_m_pad_ensRLocationsPort_par_out_local.TChangeableMemPool._._._m_arrayPool._0_._elem._m_LocationList._Item._40_._idxAzimuthAmbiguityPeer "" VALUE 0xB0010536 __UWord_Value 0 NO_COMPU_METHOD 0 65535 ECU_ADDRESS_EXTENSION 0x2 BYTE_ORDER MSB_LAST /end CHARACTERISTIC
/begin CHARACTERISTIC _g_PL_AD_fw_Radar_1R1V_rpc_LocBypassingRunnable_LocBypassingRunnable_m_pad_ensRLocationsPort_par_out_local.TChangeableMemPool._._._m_arrayPool._0_._elem._m_LocationList._Item._40_._measStatus "" VALUE 0xB0010535 __UByte_Value 0 NO_COMPU_METHOD 0 255 ECU_ADDRESS_EXTENSION 0x2 BYTE_ORDER MSB_LAST /end CHARACTERISTIC
/begin CHARACTERISTIC _g_PL_AD_fw_Radar_1R1V_rpc_LocBypassingRunnable_LocBypassingRunnable_m_pad_ensRLocationsPort_par_out_local.TChangeableMemPool._._._m_arrayPool._0_._elem._m_LocationList._Item._40_._phi._m_value "" VALUE 0xB0010528 __Float16_Value 0 NO_COMPU_METHOD -65504 65504 ECU_ADDRESS_EXTENSION 0x2 BYTE_ORDER MSB_LAST /end CHARACTERISTIC
/begin CHARACTERISTIC _g_PL_AD_fw_Radar_1R1V_rpc_LocBypassingRunnable_LocBypassingRunnable_m_pad_ensRLocationsPort_par_out_local.TChangeableMemPool._._._m_arrayPool._0_._elem._m_LocationList._Item._40_._phiQly "" VALUE 0xB001052B __UByte_Value 0 NO_COMPU_METHOD 0 255 ECU_ADDRESS_EXTENSION 0x2 BYTE_ORDER MSB_LAST /end CHARACTERISTIC
/begin CHARACTERISTIC _g_PL_AD_fw_Radar_1R1V_rpc_LocBypassingRunnable_LocBypassingRunnable_m_pad_ensRLocationsPort_par_out_local.TChangeableMemPool._._._m_arrayPool._0_._elem._m_LocationList._Item._40_._phiVar._m_value "" VALUE 0xB001052E __Float16_Value 0 NO_COMPU_METHOD -65504 65504 ECU_ADDRESS_EXTENSION 0x2 BYTE_ORDER MSB_LAST /end CHARACTERISTIC
/begin CHARACTERISTIC _g_PL_AD_fw_Radar_1R1V_rpc_LocBypassingRunnable_LocBypassingRunnable_m_pad_ensRLocationsPort_par_out_local.TChangeableMemPool._._._m_arrayPool._0_._elem._m_LocationList._Item._40_._theta._m_value "" VALUE 0xB0010526 __Float16_Value 0 NO_COMPU_METHOD -65504 65504 ECU_ADDRESS_EXTENSION 0x2 BYTE_ORDER MSB_LAST /end CHARACTERISTIC
/begin CHARACTERISTIC _g_PL_AD_fw_Radar_1R1V_rpc_LocBypassingRunnable_LocBypassingRunnable_m_pad_ensRLocationsPort_par_out_local.TChangeableMemPool._._._m_arrayPool._0_._elem._m_LocationList._Item._40_._thetaQly "" VALUE 0xB001052A __UByte_Value 0 NO_COMPU_METHOD 0 255 ECU_ADDRESS_EXTENSION 0x2 BYTE_ORDER MSB_LAST /end CHARACTERISTIC
/begin CHARACTERISTIC _g_PL_AD_fw_Radar_1R1V_rpc_LocBypassingRunnable_LocBypassingRunnable_m_pad_ensRLocationsPort_par_out_local.TChangeableMemPool._._._m_arrayPool._0_._elem._m_LocationList._Item._40_._thetaVar._m_value "" VALUE 0xB001052C __Float16_Value 0 NO_COMPU_METHOD -65504 65504 ECU_ADDRESS_EXTENSION 0x2 BYTE_ORDER MSB_LAST /end CHARACTERISTIC
/begin CHARACTERISTIC _g_PL_AD_fw_Radar_1R1V_rpc_LocBypassingRunnable_LocBypassingRunnable_m_pad_ensRLocationsPort_par_out_local.TChangeableMemPool._._._m_arrayPool._0_._elem._m_LocationList._Item._40_._v "" VALUE 0xB001051C __Float32_Value 0 NO_COMPU_METHOD -3.4028234663852886E+38 3.4028234663852886E+38 ECU_ADDRESS_EXTENSION 0x2 BYTE_ORDER MSB_LAST /end CHARACTERISTIC
/begin CHARACTERISTIC _g_PL_AD_fw_Radar_1R1V_rpc_LocBypassingRunnable_LocBypassingRunnable_m_pad_ensRLocationsPort_par_out_local.TChangeableMemPool._._._m_arrayPool._0_._elem._m_LocationList._Item._40_._vVar._m_value "" VALUE 0xB0010522 __Float16_Value 0 NO_COMPU_METHOD -65504 65504 ECU_ADDRESS_EXTENSION 0x2 BYTE_ORDER MSB_LAST /end CHARACTERISTIC
/begin CHARACTERISTIC _g_PL_AD_fw_Radar_1R1V_rpc_LocBypassingRunnable_LocBypassingRunnable_m_pad_ensRLocationsPort_par_out_local.TChangeableMemPool._._._m_arrayPool._0_._elem._m_LocationList._Item._41_._Rcs._m_value "" VALUE 0xB0010550 __Float16_Value 0 NO_COMPU_METHOD -65504 65504 ECU_ADDRESS_EXTENSION 0x2 BYTE_ORDER MSB_LAST /end CHARACTERISTIC
/begin CHARACTERISTIC _g_PL_AD_fw_Radar_1R1V_rpc_LocBypassingRunnable_LocBypassingRunnable_m_pad_ensRLocationsPort_par_out_local.TChangeableMemPool._._._m_arrayPool._0_._elem._m_LocationList._Item._41_._Rssi._m_value "" VALUE 0xB0010552 __Float16_Value 0 NO_COMPU_METHOD -65504 65504 ECU_ADDRESS_EXTENSION 0x2 BYTE_ORDER MSB_LAST /end CHARACTERISTIC
/begin CHARACTERISTIC _g_PL_AD_fw_Radar_1R1V_rpc_LocBypassingRunnable_LocBypassingRunnable_m_pad_ensRLocationsPort_par_out_local.TChangeableMemPool._._._m_arrayPool._0_._elem._m_LocationList._Item._41_._d "" VALUE 0xB0010538 __Float32_Value 0 NO_COMPU_METHOD -3.4028234663852886E+38 3.4028234663852886E+38 ECU_ADDRESS_EXTENSION 0x2 BYTE_ORDER MSB_LAST /end CHARACTERISTIC
/begin CHARACTERISTIC _g_PL_AD_fw_Radar_1R1V_rpc_LocBypassingRunnable_LocBypassingRunnable_m_pad_ensRLocationsPort_par_out_local.TChangeableMemPool._._._m_arrayPool._0_._elem._m_LocationList._Item._41_._dVar._m_value "" VALUE 0xB0010540 __Float16_Value 0 NO_COMPU_METHOD -65504 65504 ECU_ADDRESS_EXTENSION 0x2 BYTE_ORDER MSB_LAST /end CHARACTERISTIC
/begin CHARACTERISTIC _g_PL_AD_fw_Radar_1R1V_rpc_LocBypassingRunnable_LocBypassingRunnable_m_pad_ensRLocationsPort_par_out_local.TChangeableMemPool._._._m_arrayPool._0_._elem._m_LocationList._Item._41_._dvCov._m_value "" VALUE 0xB0010544 __Float16_Value 0 NO_COMPU_METHOD -65504 65504 ECU_ADDRESS_EXTENSION 0x2 BYTE_ORDER MSB_LAST /end CHARACTERISTIC
/begin CHARACTERISTIC _g_PL_AD_fw_Radar_1R1V_rpc_LocBypassingRunnable_LocBypassingRunnable_m_pad_ensRLocationsPort_par_out_local.TChangeableMemPool._._._m_arrayPool._0_._elem._m_LocationList._Item._41_._dvQly "" VALUE 0xB0010554 __UByte_Value 0 NO_COMPU_METHOD 0 255 ECU_ADDRESS_EXTENSION 0x2 BYTE_ORDER MSB_LAST /end CHARACTERISTIC
/begin CHARACTERISTIC _g_PL_AD_fw_Radar_1R1V_rpc_LocBypassingRunnable_LocBypassingRunnable_m_pad_ensRLocationsPort_par_out_local.TChangeableMemPool._._._m_arrayPool._0_._elem._m_LocationList._Item._41_._idxAzimuthAmbiguityPeer "" VALUE 0xB0010556 __UWord_Value 0 NO_COMPU_METHOD 0 65535 ECU_ADDRESS_EXTENSION 0x2 BYTE_ORDER MSB_LAST /end CHARACTERISTIC
/begin CHARACTERISTIC _g_PL_AD_fw_Radar_1R1V_rpc_LocBypassingRunnable_LocBypassingRunnable_m_pad_ensRLocationsPort_par_out_local.TChangeableMemPool._._._m_arrayPool._0_._elem._m_LocationList._Item._41_._measStatus "" VALUE 0xB0010555 __UByte_Value 0 NO_COMPU_METHOD 0 255 ECU_ADDRESS_EXTENSION 0x2 BYTE_ORDER MSB_LAST /end CHARACTERISTIC
/begin CHARACTERISTIC _g_PL_AD_fw_Radar_1R1V_rpc_LocBypassingRunnable_LocBypassingRunnable_m_pad_ensRLocationsPort_par_out_local.TChangeableMemPool._._._m_arrayPool._0_._elem._m_LocationList._Item._41_._phi._m_value "" VALUE 0xB0010548 __Float16_Value 0 NO_COMPU_METHOD -65504 65504 ECU_ADDRESS_EXTENSION 0x2 BYTE_ORDER MSB_LAST /end CHARACTERISTIC
/begin CHARACTERISTIC _g_PL_AD_fw_Radar_1R1V_rpc_LocBypassingRunnable_LocBypassingRunnable_m_pad_ensRLocationsPort_par_out_local.TChangeableMemPool._._._m_arrayPool._0_._elem._m_LocationList._Item._41_._phiQly "" VALUE 0xB001054B __UByte_Value 0 NO_COMPU_METHOD 0 255 ECU_ADDRESS_EXTENSION 0x2 BYTE_ORDER MSB_LAST /end CHARACTERISTIC
/begin CHARACTERISTIC _g_PL_AD_fw_Radar_1R1V_rpc_LocBypassingRunnable_LocBypassingRunnable_m_pad_ensRLocationsPort_par_out_local.TChangeableMemPool._._._m_arrayPool._0_._elem._m_LocationList._Item._41_._phiVar._m_value "" VALUE 0xB001054E __Float16_Value 0 NO_COMPU_METHOD -65504 65504 ECU_ADDRESS_EXTENSION 0x2 BYTE_ORDER MSB_LAST /end CHARACTERISTIC
/begin CHARACTERISTIC _g_PL_AD_fw_Radar_1R1V_rpc_LocBypassingRunnable_LocBypassingRunnable_m_pad_ensRLocationsPort_par_out_local.TChangeableMemPool._._._m_arrayPool._0_._elem._m_LocationList._Item._41_._theta._m_value "" VALUE 0xB0010546 __Float16_Value 0 NO_COMPU_METHOD -65504 65504 ECU_ADDRESS_EXTENSION 0x2 BYTE_ORDER MSB_LAST /end CHARACTERISTIC
/begin CHARACTERISTIC _g_PL_AD_fw_Radar_1R1V_rpc_LocBypassingRunnable_LocBypassingRunnable_m_pad_ensRLocationsPort_par_out_local.TChangeableMemPool._._._m_arrayPool._0_._elem._m_LocationList._Item._41_._thetaQly "" VALUE 0xB001054A __UByte_Value 0 NO_COMPU_METHOD 0 255 ECU_ADDRESS_EXTENSION 0x2 BYTE_ORDER MSB_LAST /end CHARACTERISTIC
/begin CHARACTERISTIC _g_PL_AD_fw_Radar_1R1V_rpc_LocBypassingRunnable_LocBypassingRunnable_m_pad_ensRLocationsPort_par_out_local.TChangeableMemPool._._._m_arrayPool._0_._elem._m_LocationList._Item._41_._thetaVar._m_value "" VALUE 0xB001054C __Float16_Value 0 NO_COMPU_METHOD -65504 65504 ECU_ADDRESS_EXTENSION 0x2 BYTE_ORDER MSB_LAST /end CHARACTERISTIC
/begin CHARACTERISTIC _g_PL_AD_fw_Radar_1R1V_rpc_LocBypassingRunnable_LocBypassingRunnable_m_pad_ensRLocationsPort_par_out_local.TChangeableMemPool._._._m_arrayPool._0_._elem._m_LocationList._Item._41_._v "" VALUE 0xB001053C __Float32_Value 0 NO_COMPU_METHOD -3.4028234663852886E+38 3.4028234663852886E+38 ECU_ADDRESS_EXTENSION 0x2 BYTE_ORDER MSB_LAST /end CHARACTERISTIC
/begin CHARACTERISTIC _g_PL_AD_fw_Radar_1R1V_rpc_LocBypassingRunnable_LocBypassingRunnable_m_pad_ensRLocationsPort_par_out_local.TChangeableMemPool._._._m_arrayPool._0_._elem._m_LocationList._Item._41_._vVar._m_value "" VALUE 0xB0010542 __Float16_Value 0 NO_COMPU_METHOD -65504 65504 ECU_ADDRESS_EXTENSION 0x2 BYTE_ORDER MSB_LAST /end CHARACTERISTIC
/begin CHARACTERISTIC _g_PL_AD_fw_Radar_1R1V_rpc_LocBypassingRunnable_LocBypassingRunnable_m_pad_ensRLocationsPort_par_out_local.TChangeableMemPool._._._m_arrayPool._0_._elem._m_LocationList._Item._42_._Rcs._m_value "" VALUE 0xB0010570 __Float16_Value 0 NO_COMPU_METHOD -65504 65504 ECU_ADDRESS_EXTENSION 0x2 BYTE_ORDER MSB_LAST /end CHARACTERISTIC
/begin CHARACTERISTIC _g_PL_AD_fw_Radar_1R1V_rpc_LocBypassingRunnable_LocBypassingRunnable_m_pad_ensRLocationsPort_par_out_local.TChangeableMemPool._._._m_arrayPool._0_._elem._m_LocationList._Item._42_._Rssi._m_value "" VALUE 0xB0010572 __Float16_Value 0 NO_COMPU_METHOD -65504 65504 ECU_ADDRESS_EXTENSION 0x2 BYTE_ORDER MSB_LAST /end CHARACTERISTIC
/begin CHARACTERISTIC _g_PL_AD_fw_Radar_1R1V_rpc_LocBypassingRunnable_LocBypassingRunnable_m_pad_ensRLocationsPort_par_out_local.TChangeableMemPool._._._m_arrayPool._0_._elem._m_LocationList._Item._42_._d "" VALUE 0xB0010558 __Float32_Value 0 NO_COMPU_METHOD -3.4028234663852886E+38 3.4028234663852886E+38 ECU_ADDRESS_EXTENSION 0x2 BYTE_ORDER MSB_LAST /end CHARACTERISTIC
/begin CHARACTERISTIC _g_PL_AD_fw_Radar_1R1V_rpc_LocBypassingRunnable_LocBypassingRunnable_m_pad_ensRLocationsPort_par_out_local.TChangeableMemPool._._._m_arrayPool._0_._elem._m_LocationList._Item._42_._dVar._m_value "" VALUE 0xB0010560 __Float16_Value 0 NO_COMPU_METHOD -65504 65504 ECU_ADDRESS_EXTENSION 0x2 BYTE_ORDER MSB_LAST /end CHARACTERISTIC
/begin CHARACTERISTIC _g_PL_AD_fw_Radar_1R1V_rpc_LocBypassingRunnable_LocBypassingRunnable_m_pad_ensRLocationsPort_par_out_local.TChangeableMemPool._._._m_arrayPool._0_._elem._m_LocationList._Item._42_._dvCov._m_value "" VALUE 0xB0010564 __Float16_Value 0 NO_COMPU_METHOD -65504 65504 ECU_ADDRESS_EXTENSION 0x2 BYTE_ORDER MSB_LAST /end CHARACTERISTIC
/begin CHARACTERISTIC _g_PL_AD_fw_Radar_1R1V_rpc_LocBypassingRunnable_LocBypassingRunnable_m_pad_ensRLocationsPort_par_out_local.TChangeableMemPool._._._m_arrayPool._0_._elem._m_LocationList._Item._42_._dvQly "" VALUE 0xB0010574 __UByte_Value 0 NO_COMPU_METHOD 0 255 ECU_ADDRESS_EXTENSION 0x2 BYTE_ORDER MSB_LAST /end CHARACTERISTIC
/begin CHARACTERISTIC _g_PL_AD_fw_Radar_1R1V_rpc_LocBypassingRunnable_LocBypassingRunnable_m_pad_ensRLocationsPort_par_out_local.TChangeableMemPool._._._m_arrayPool._0_._elem._m_LocationList._Item._42_._idxAzimuthAmbiguityPeer "" VALUE 0xB0010576 __UWord_Value 0 NO_COMPU_METHOD 0 65535 ECU_ADDRESS_EXTENSION 0x2 BYTE_ORDER MSB_LAST /end CHARACTERISTIC
/begin CHARACTERISTIC _g_PL_AD_fw_Radar_1R1V_rpc_LocBypassingRunnable_LocBypassingRunnable_m_pad_ensRLocationsPort_par_out_local.TChangeableMemPool._._._m_arrayPool._0_._elem._m_LocationList._Item._42_._measStatus "" VALUE 0xB0010575 __UByte_Value 0 NO_COMPU_METHOD 0 255 ECU_ADDRESS_EXTENSION 0x2 BYTE_ORDER MSB_LAST /end CHARACTERISTIC
/begin CHARACTERISTIC _g_PL_AD_fw_Radar_1R1V_rpc_LocBypassingRunnable_LocBypassingRunnable_m_pad_ensRLocationsPort_par_out_local.TChangeableMemPool._._._m_arrayPool._0_._elem._m_LocationList._Item._42_._phi._m_value "" VALUE 0xB0010568 __Float16_Value 0 NO_COMPU_METHOD -65504 65504 ECU_ADDRESS_EXTENSION 0x2 BYTE_ORDER MSB_LAST /end CHARACTERISTIC
/begin CHARACTERISTIC _g_PL_AD_fw_Radar_1R1V_rpc_LocBypassingRunnable_LocBypassingRunnable_m_pad_ensRLocationsPort_par_out_local.TChangeableMemPool._._._m_arrayPool._0_._elem._m_LocationList._Item._42_._phiQly "" VALUE 0xB001056B __UByte_Value 0 NO_COMPU_METHOD 0 255 ECU_ADDRESS_EXTENSION 0x2 BYTE_ORDER MSB_LAST /end CHARACTERISTIC
/begin CHARACTERISTIC _g_PL_AD_fw_Radar_1R1V_rpc_LocBypassingRunnable_LocBypassingRunnable_m_pad_ensRLocationsPort_par_out_local.TChangeableMemPool._._._m_arrayPool._0_._elem._m_LocationList._Item._42_._phiVar._m_value "" VALUE 0xB001056E __Float16_Value 0 NO_COMPU_METHOD -65504 65504 ECU_ADDRESS_EXTENSION 0x2 BYTE_ORDER MSB_LAST /end CHARACTERISTIC
/begin CHARACTERISTIC _g_PL_AD_fw_Radar_1R1V_rpc_LocBypassingRunnable_LocBypassingRunnable_m_pad_ensRLocationsPort_par_out_local.TChangeableMemPool._._._m_arrayPool._0_._elem._m_LocationList._Item._42_._theta._m_value "" VALUE 0xB0010566 __Float16_Value 0 NO_COMPU_METHOD -65504 65504 ECU_ADDRESS_EXTENSION 0x2 BYTE_ORDER MSB_LAST /end CHARACTERISTIC
/begin CHARACTERISTIC _g_PL_AD_fw_Radar_1R1V_rpc_LocBypassingRunnable_LocBypassingRunnable_m_pad_ensRLocationsPort_par_out_local.TChangeableMemPool._._._m_arrayPool._0_._elem._m_LocationList._Item._42_._thetaQly "" VALUE 0xB001056A __UByte_Value 0 NO_COMPU_METHOD 0 255 ECU_ADDRESS_EXTENSION 0x2 BYTE_ORDER MSB_LAST /end CHARACTERISTIC
/begin CHARACTERISTIC _g_PL_AD_fw_Radar_1R1V_rpc_LocBypassingRunnable_LocBypassingRunnable_m_pad_ensRLocationsPort_par_out_local.TChangeableMemPool._._._m_arrayPool._0_._elem._m_LocationList._Item._42_._thetaVar._m_value "" VALUE 0xB001056C __Float16_Value 0 NO_COMPU_METHOD -65504 65504 ECU_ADDRESS_EXTENSION 0x2 BYTE_ORDER MSB_LAST /end CHARACTERISTIC
/begin CHARACTERISTIC _g_PL_AD_fw_Radar_1R1V_rpc_LocBypassingRunnable_LocBypassingRunnable_m_pad_ensRLocationsPort_par_out_local.TChangeableMemPool._._._m_arrayPool._0_._elem._m_LocationList._Item._42_._v "" VALUE 0xB001055C __Float32_Value 0 NO_COMPU_METHOD -3.4028234663852886E+38 3.4028234663852886E+38 ECU_ADDRESS_EXTENSION 0x2 BYTE_ORDER MSB_LAST /end CHARACTERISTIC
/begin CHARACTERISTIC _g_PL_AD_fw_Radar_1R1V_rpc_LocBypassingRunnable_LocBypassingRunnable_m_pad_ensRLocationsPort_par_out_local.TChangeableMemPool._._._m_arrayPool._0_._elem._m_LocationList._Item._42_._vVar._m_value "" VALUE 0xB0010562 __Float16_Value 0 NO_COMPU_METHOD -65504 65504 ECU_ADDRESS_EXTENSION 0x2 BYTE_ORDER MSB_LAST /end CHARACTERISTIC
/begin CHARACTERISTIC _g_PL_AD_fw_Radar_1R1V_rpc_LocBypassingRunnable_LocBypassingRunnable_m_pad_ensRLocationsPort_par_out_local.TChangeableMemPool._._._m_arrayPool._0_._elem._m_LocationList._Item._43_._Rcs._m_value "" VALUE 0xB0010590 __Float16_Value 0 NO_COMPU_METHOD -65504 65504 ECU_ADDRESS_EXTENSION 0x2 BYTE_ORDER MSB_LAST /end CHARACTERISTIC
/begin CHARACTERISTIC _g_PL_AD_fw_Radar_1R1V_rpc_LocBypassingRunnable_LocBypassingRunnable_m_pad_ensRLocationsPort_par_out_local.TChangeableMemPool._._._m_arrayPool._0_._elem._m_LocationList._Item._43_._Rssi._m_value "" VALUE 0xB0010592 __Float16_Value 0 NO_COMPU_METHOD -65504 65504 ECU_ADDRESS_EXTENSION 0x2 BYTE_ORDER MSB_LAST /end CHARACTERISTIC
/begin CHARACTERISTIC _g_PL_AD_fw_Radar_1R1V_rpc_LocBypassingRunnable_LocBypassingRunnable_m_pad_ensRLocationsPort_par_out_local.TChangeableMemPool._._._m_arrayPool._0_._elem._m_LocationList._Item._43_._d "" VALUE 0xB0010578 __Float32_Value 0 NO_COMPU_METHOD -3.4028234663852886E+38 3.4028234663852886E+38 ECU_ADDRESS_EXTENSION 0x2 BYTE_ORDER MSB_LAST /end CHARACTERISTIC
/begin CHARACTERISTIC _g_PL_AD_fw_Radar_1R1V_rpc_LocBypassingRunnable_LocBypassingRunnable_m_pad_ensRLocationsPort_par_out_local.TChangeableMemPool._._._m_arrayPool._0_._elem._m_LocationList._Item._43_._dVar._m_value "" VALUE 0xB0010580 __Float16_Value 0 NO_COMPU_METHOD -65504 65504 ECU_ADDRESS_EXTENSION 0x2 BYTE_ORDER MSB_LAST /end CHARACTERISTIC
/begin CHARACTERISTIC _g_PL_AD_fw_Radar_1R1V_rpc_LocBypassingRunnable_LocBypassingRunnable_m_pad_ensRLocationsPort_par_out_local.TChangeableMemPool._._._m_arrayPool._0_._elem._m_LocationList._Item._43_._dvCov._m_value "" VALUE 0xB0010584 __Float16_Value 0 NO_COMPU_METHOD -65504 65504 ECU_ADDRESS_EXTENSION 0x2 BYTE_ORDER MSB_LAST /end CHARACTERISTIC
/begin CHARACTERISTIC _g_PL_AD_fw_Radar_1R1V_rpc_LocBypassingRunnable_LocBypassingRunnable_m_pad_ensRLocationsPort_par_out_local.TChangeableMemPool._._._m_arrayPool._0_._elem._m_LocationList._Item._43_._dvQly "" VALUE 0xB0010594 __UByte_Value 0 NO_COMPU_METHOD 0 255 ECU_ADDRESS_EXTENSION 0x2 BYTE_ORDER MSB_LAST /end CHARACTERISTIC
/begin CHARACTERISTIC _g_PL_AD_fw_Radar_1R1V_rpc_LocBypassingRunnable_LocBypassingRunnable_m_pad_ensRLocationsPort_par_out_local.TChangeableMemPool._._._m_arrayPool._0_._elem._m_LocationList._Item._43_._idxAzimuthAmbiguityPeer "" VALUE 0xB0010596 __UWord_Value 0 NO_COMPU_METHOD 0 65535 ECU_ADDRESS_EXTENSION 0x2 BYTE_ORDER MSB_LAST /end CHARACTERISTIC
/begin CHARACTERISTIC _g_PL_AD_fw_Radar_1R1V_rpc_LocBypassingRunnable_LocBypassingRunnable_m_pad_ensRLocationsPort_par_out_local.TChangeableMemPool._._._m_arrayPool._0_._elem._m_LocationList._Item._43_._measStatus "" VALUE 0xB0010595 __UByte_Value 0 NO_COMPU_METHOD 0 255 ECU_ADDRESS_EXTENSION 0x2 BYTE_ORDER MSB_LAST /end CHARACTERISTIC
/begin CHARACTERISTIC _g_PL_AD_fw_Radar_1R1V_rpc_LocBypassingRunnable_LocBypassingRunnable_m_pad_ensRLocationsPort_par_out_local.TChangeableMemPool._._._m_arrayPool._0_._elem._m_LocationList._Item._43_._phi._m_value "" VALUE 0xB0010588 __Float16_Value 0 NO_COMPU_METHOD -65504 65504 ECU_ADDRESS_EXTENSION 0x2 BYTE_ORDER MSB_LAST /end CHARACTERISTIC
/begin CHARACTERISTIC _g_PL_AD_fw_Radar_1R1V_rpc_LocBypassingRunnable_LocBypassingRunnable_m_pad_ensRLocationsPort_par_out_local.TChangeableMemPool._._._m_arrayPool._0_._elem._m_LocationList._Item._43_._phiQly "" VALUE 0xB001058B __UByte_Value 0 NO_COMPU_METHOD 0 255 ECU_ADDRESS_EXTENSION 0x2 BYTE_ORDER MSB_LAST /end CHARACTERISTIC
/begin CHARACTERISTIC _g_PL_AD_fw_Radar_1R1V_rpc_LocBypassingRunnable_LocBypassingRunnable_m_pad_ensRLocationsPort_par_out_local.TChangeableMemPool._._._m_arrayPool._0_._elem._m_LocationList._Item._43_._phiVar._m_value "" VALUE 0xB001058E __Float16_Value 0 NO_COMPU_METHOD -65504 65504 ECU_ADDRESS_EXTENSION 0x2 BYTE_ORDER MSB_LAST /end CHARACTERISTIC
/begin CHARACTERISTIC _g_PL_AD_fw_Radar_1R1V_rpc_LocBypassingRunnable_LocBypassingRunnable_m_pad_ensRLocationsPort_par_out_local.TChangeableMemPool._._._m_arrayPool._0_._elem._m_LocationList._Item._43_._theta._m_value "" VALUE 0xB0010586 __Float16_Value 0 NO_COMPU_METHOD -65504 65504 ECU_ADDRESS_EXTENSION 0x2 BYTE_ORDER MSB_LAST /end CHARACTERISTIC
/begin CHARACTERISTIC _g_PL_AD_fw_Radar_1R1V_rpc_LocBypassingRunnable_LocBypassingRunnable_m_pad_ensRLocationsPort_par_out_local.TChangeableMemPool._._._m_arrayPool._0_._elem._m_LocationList._Item._43_._thetaQly "" VALUE 0xB001058A __UByte_Value 0 NO_COMPU_METHOD 0 255 ECU_ADDRESS_EXTENSION 0x2 BYTE_ORDER MSB_LAST /end CHARACTERISTIC
/begin CHARACTERISTIC _g_PL_AD_fw_Radar_1R1V_rpc_LocBypassingRunnable_LocBypassingRunnable_m_pad_ensRLocationsPort_par_out_local.TChangeableMemPool._._._m_arrayPool._0_._elem._m_LocationList._Item._43_._thetaVar._m_value "" VALUE 0xB001058C __Float16_Value 0 NO_COMPU_METHOD -65504 65504 ECU_ADDRESS_EXTENSION 0x2 BYTE_ORDER MSB_LAST /end CHARACTERISTIC
/begin CHARACTERISTIC _g_PL_AD_fw_Radar_1R1V_rpc_LocBypassingRunnable_LocBypassingRunnable_m_pad_ensRLocationsPort_par_out_local.TChangeableMemPool._._._m_arrayPool._0_._elem._m_LocationList._Item._43_._v "" VALUE 0xB001057C __Float32_Value 0 NO_COMPU_METHOD -3.4028234663852886E+38 3.4028234663852886E+38 ECU_ADDRESS_EXTENSION 0x2 BYTE_ORDER MSB_LAST /end CHARACTERISTIC
/begin CHARACTERISTIC _g_PL_AD_fw_Radar_1R1V_rpc_LocBypassingRunnable_LocBypassingRunnable_m_pad_ensRLocationsPort_par_out_local.TChangeableMemPool._._._m_arrayPool._0_._elem._m_LocationList._Item._43_._vVar._m_value "" VALUE 0xB0010582 __Float16_Value 0 NO_COMPU_METHOD -65504 65504 ECU_ADDRESS_EXTENSION 0x2 BYTE_ORDER MSB_LAST /end CHARACTERISTIC
/begin CHARACTERISTIC _g_PL_AD_fw_Radar_1R1V_rpc_LocBypassingRunnable_LocBypassingRunnable_m_pad_ensRLocationsPort_par_out_local.TChangeableMemPool._._._m_arrayPool._0_._elem._m_LocationList._Item._44_._Rcs._m_value "" VALUE 0xB00105B0 __Float16_Value 0 NO_COMPU_METHOD -65504 65504 ECU_ADDRESS_EXTENSION 0x2 BYTE_ORDER MSB_LAST /end CHARACTERISTIC
/begin CHARACTERISTIC _g_PL_AD_fw_Radar_1R1V_rpc_LocBypassingRunnable_LocBypassingRunnable_m_pad_ensRLocationsPort_par_out_local.TChangeableMemPool._._._m_arrayPool._0_._elem._m_LocationList._Item._44_._Rssi._m_value "" VALUE 0xB00105B2 __Float16_Value 0 NO_COMPU_METHOD -65504 65504 ECU_ADDRESS_EXTENSION 0x2 BYTE_ORDER MSB_LAST /end CHARACTERISTIC
/begin CHARACTERISTIC _g_PL_AD_fw_Radar_1R1V_rpc_LocBypassingRunnable_LocBypassingRunnable_m_pad_ensRLocationsPort_par_out_local.TChangeableMemPool._._._m_arrayPool._0_._elem._m_LocationList._Item._44_._d "" VALUE 0xB0010598 __Float32_Value 0 NO_COMPU_METHOD -3.4028234663852886E+38 3.4028234663852886E+38 ECU_ADDRESS_EXTENSION 0x2 BYTE_ORDER MSB_LAST /end CHARACTERISTIC
/begin CHARACTERISTIC _g_PL_AD_fw_Radar_1R1V_rpc_LocBypassingRunnable_LocBypassingRunnable_m_pad_ensRLocationsPort_par_out_local.TChangeableMemPool._._._m_arrayPool._0_._elem._m_LocationList._Item._44_._dVar._m_value "" VALUE 0xB00105A0 __Float16_Value 0 NO_COMPU_METHOD -65504 65504 ECU_ADDRESS_EXTENSION 0x2 BYTE_ORDER MSB_LAST /end CHARACTERISTIC
/begin CHARACTERISTIC _g_PL_AD_fw_Radar_1R1V_rpc_LocBypassingRunnable_LocBypassingRunnable_m_pad_ensRLocationsPort_par_out_local.TChangeableMemPool._._._m_arrayPool._0_._elem._m_LocationList._Item._44_._dvCov._m_value "" VALUE 0xB00105A4 __Float16_Value 0 NO_COMPU_METHOD -65504 65504 ECU_ADDRESS_EXTENSION 0x2 BYTE_ORDER MSB_LAST /end CHARACTERISTIC
/begin CHARACTERISTIC _g_PL_AD_fw_Radar_1R1V_rpc_LocBypassingRunnable_LocBypassingRunnable_m_pad_ensRLocationsPort_par_out_local.TChangeableMemPool._._._m_arrayPool._0_._elem._m_LocationList._Item._44_._dvQly "" VALUE 0xB00105B4 __UByte_Value 0 NO_COMPU_METHOD 0 255 ECU_ADDRESS_EXTENSION 0x2 BYTE_ORDER MSB_LAST /end CHARACTERISTIC
/begin CHARACTERISTIC _g_PL_AD_fw_Radar_1R1V_rpc_LocBypassingRunnable_LocBypassingRunnable_m_pad_ensRLocationsPort_par_out_local.TChangeableMemPool._._._m_arrayPool._0_._elem._m_LocationList._Item._44_._idxAzimuthAmbiguityPeer "" VALUE 0xB00105B6 __UWord_Value 0 NO_COMPU_METHOD 0 65535 ECU_ADDRESS_EXTENSION 0x2 BYTE_ORDER MSB_LAST /end CHARACTERISTIC
/begin CHARACTERISTIC _g_PL_AD_fw_Radar_1R1V_rpc_LocBypassingRunnable_LocBypassingRunnable_m_pad_ensRLocationsPort_par_out_local.TChangeableMemPool._._._m_arrayPool._0_._elem._m_LocationList._Item._44_._measStatus "" VALUE 0xB00105B5 __UByte_Value 0 NO_COMPU_METHOD 0 255 ECU_ADDRESS_EXTENSION 0x2 BYTE_ORDER MSB_LAST /end CHARACTERISTIC
/begin CHARACTERISTIC _g_PL_AD_fw_Radar_1R1V_rpc_LocBypassingRunnable_LocBypassingRunnable_m_pad_ensRLocationsPort_par_out_local.TChangeableMemPool._._._m_arrayPool._0_._elem._m_LocationList._Item._44_._phi._m_value "" VALUE 0xB00105A8 __Float16_Value 0 NO_COMPU_METHOD -65504 65504 ECU_ADDRESS_EXTENSION 0x2 BYTE_ORDER MSB_LAST /end CHARACTERISTIC
/begin CHARACTERISTIC _g_PL_AD_fw_Radar_1R1V_rpc_LocBypassingRunnable_LocBypassingRunnable_m_pad_ensRLocationsPort_par_out_local.TChangeableMemPool._._._m_arrayPool._0_._elem._m_LocationList._Item._44_._phiQly "" VALUE 0xB00105AB __UByte_Value 0 NO_COMPU_METHOD 0 255 ECU_ADDRESS_EXTENSION 0x2 BYTE_ORDER MSB_LAST /end CHARACTERISTIC
/begin CHARACTERISTIC _g_PL_AD_fw_Radar_1R1V_rpc_LocBypassingRunnable_LocBypassingRunnable_m_pad_ensRLocationsPort_par_out_local.TChangeableMemPool._._._m_arrayPool._0_._elem._m_LocationList._Item._44_._phiVar._m_value "" VALUE 0xB00105AE __Float16_Value 0 NO_COMPU_METHOD -65504 65504 ECU_ADDRESS_EXTENSION 0x2 BYTE_ORDER MSB_LAST /end CHARACTERISTIC
/begin CHARACTERISTIC _g_PL_AD_fw_Radar_1R1V_rpc_LocBypassingRunnable_LocBypassingRunnable_m_pad_ensRLocationsPort_par_out_local.TChangeableMemPool._._._m_arrayPool._0_._elem._m_LocationList._Item._44_._theta._m_value "" VALUE 0xB00105A6 __Float16_Value 0 NO_COMPU_METHOD -65504 65504 ECU_ADDRESS_EXTENSION 0x2 BYTE_ORDER MSB_LAST /end CHARACTERISTIC
/begin CHARACTERISTIC _g_PL_AD_fw_Radar_1R1V_rpc_LocBypassingRunnable_LocBypassingRunnable_m_pad_ensRLocationsPort_par_out_local.TChangeableMemPool._._._m_arrayPool._0_._elem._m_LocationList._Item._44_._thetaQly "" VALUE 0xB00105AA __UByte_Value 0 NO_COMPU_METHOD 0 255 ECU_ADDRESS_EXTENSION 0x2 BYTE_ORDER MSB_LAST /end CHARACTERISTIC
/begin CHARACTERISTIC _g_PL_AD_fw_Radar_1R1V_rpc_LocBypassingRunnable_LocBypassingRunnable_m_pad_ensRLocationsPort_par_out_local.TChangeableMemPool._._._m_arrayPool._0_._elem._m_LocationList._Item._44_._thetaVar._m_value "" VALUE 0xB00105AC __Float16_Value 0 NO_COMPU_METHOD -65504 65504 ECU_ADDRESS_EXTENSION 0x2 BYTE_ORDER MSB_LAST /end CHARACTERISTIC
/begin CHARACTERISTIC _g_PL_AD_fw_Radar_1R1V_rpc_LocBypassingRunnable_LocBypassingRunnable_m_pad_ensRLocationsPort_par_out_local.TChangeableMemPool._._._m_arrayPool._0_._elem._m_LocationList._Item._44_._v "" VALUE 0xB001059C __Float32_Value 0 NO_COMPU_METHOD -3.4028234663852886E+38 3.4028234663852886E+38 ECU_ADDRESS_EXTENSION 0x2 BYTE_ORDER MSB_LAST /end CHARACTERISTIC
/begin CHARACTERISTIC _g_PL_AD_fw_Radar_1R1V_rpc_LocBypassingRunnable_LocBypassingRunnable_m_pad_ensRLocationsPort_par_out_local.TChangeableMemPool._._._m_arrayPool._0_._elem._m_LocationList._Item._44_._vVar._m_value "" VALUE 0xB00105A2 __Float16_Value 0 NO_COMPU_METHOD -65504 65504 ECU_ADDRESS_EXTENSION 0x2 BYTE_ORDER MSB_LAST /end CHARACTERISTIC
/begin CHARACTERISTIC _g_PL_AD_fw_Radar_1R1V_rpc_LocBypassingRunnable_LocBypassingRunnable_m_pad_ensRLocationsPort_par_out_local.TChangeableMemPool._._._m_arrayPool._0_._elem._m_LocationList._Item._45_._Rcs._m_value "" VALUE 0xB00105D0 __Float16_Value 0 NO_COMPU_METHOD -65504 65504 ECU_ADDRESS_EXTENSION 0x2 BYTE_ORDER MSB_LAST /end CHARACTERISTIC
/begin CHARACTERISTIC _g_PL_AD_fw_Radar_1R1V_rpc_LocBypassingRunnable_LocBypassingRunnable_m_pad_ensRLocationsPort_par_out_local.TChangeableMemPool._._._m_arrayPool._0_._elem._m_LocationList._Item._45_._Rssi._m_value "" VALUE 0xB00105D2 __Float16_Value 0 NO_COMPU_METHOD -65504 65504 ECU_ADDRESS_EXTENSION 0x2 BYTE_ORDER MSB_LAST /end CHARACTERISTIC
/begin CHARACTERISTIC _g_PL_AD_fw_Radar_1R1V_rpc_LocBypassingRunnable_LocBypassingRunnable_m_pad_ensRLocationsPort_par_out_local.TChangeableMemPool._._._m_arrayPool._0_._elem._m_LocationList._Item._45_._d "" VALUE 0xB00105B8 __Float32_Value 0 NO_COMPU_METHOD -3.4028234663852886E+38 3.4028234663852886E+38 ECU_ADDRESS_EXTENSION 0x2 BYTE_ORDER MSB_LAST /end CHARACTERISTIC
/begin CHARACTERISTIC _g_PL_AD_fw_Radar_1R1V_rpc_LocBypassingRunnable_LocBypassingRunnable_m_pad_ensRLocationsPort_par_out_local.TChangeableMemPool._._._m_arrayPool._0_._elem._m_LocationList._Item._45_._dVar._m_value "" VALUE 0xB00105C0 __Float16_Value 0 NO_COMPU_METHOD -65504 65504 ECU_ADDRESS_EXTENSION 0x2 BYTE_ORDER MSB_LAST /end CHARACTERISTIC
/begin CHARACTERISTIC _g_PL_AD_fw_Radar_1R1V_rpc_LocBypassingRunnable_LocBypassingRunnable_m_pad_ensRLocationsPort_par_out_local.TChangeableMemPool._._._m_arrayPool._0_._elem._m_LocationList._Item._45_._dvCov._m_value "" VALUE 0xB00105C4 __Float16_Value 0 NO_COMPU_METHOD -65504 65504 ECU_ADDRESS_EXTENSION 0x2 BYTE_ORDER MSB_LAST /end CHARACTERISTIC
/begin CHARACTERISTIC _g_PL_AD_fw_Radar_1R1V_rpc_LocBypassingRunnable_LocBypassingRunnable_m_pad_ensRLocationsPort_par_out_local.TChangeableMemPool._._._m_arrayPool._0_._elem._m_LocationList._Item._45_._dvQly "" VALUE 0xB00105D4 __UByte_Value 0 NO_COMPU_METHOD 0 255 ECU_ADDRESS_EXTENSION 0x2 BYTE_ORDER MSB_LAST /end CHARACTERISTIC
/begin CHARACTERISTIC _g_PL_AD_fw_Radar_1R1V_rpc_LocBypassingRunnable_LocBypassingRunnable_m_pad_ensRLocationsPort_par_out_local.TChangeableMemPool._._._m_arrayPool._0_._elem._m_LocationList._Item._45_._idxAzimuthAmbiguityPeer "" VALUE 0xB00105D6 __UWord_Value 0 NO_COMPU_METHOD 0 65535 ECU_ADDRESS_EXTENSION 0x2 BYTE_ORDER MSB_LAST /end CHARACTERISTIC
/begin CHARACTERISTIC _g_PL_AD_fw_Radar_1R1V_rpc_LocBypassingRunnable_LocBypassingRunnable_m_pad_ensRLocationsPort_par_out_local.TChangeableMemPool._._._m_arrayPool._0_._elem._m_LocationList._Item._45_._measStatus "" VALUE 0xB00105D5 __UByte_Value 0 NO_COMPU_METHOD 0 255 ECU_ADDRESS_EXTENSION 0x2 BYTE_ORDER MSB_LAST /end CHARACTERISTIC
/begin CHARACTERISTIC _g_PL_AD_fw_Radar_1R1V_rpc_LocBypassingRunnable_LocBypassingRunnable_m_pad_ensRLocationsPort_par_out_local.TChangeableMemPool._._._m_arrayPool._0_._elem._m_LocationList._Item._45_._phi._m_value "" VALUE 0xB00105C8 __Float16_Value 0 NO_COMPU_METHOD -65504 65504 ECU_ADDRESS_EXTENSION 0x2 BYTE_ORDER MSB_LAST /end CHARACTERISTIC
/begin CHARACTERISTIC _g_PL_AD_fw_Radar_1R1V_rpc_LocBypassingRunnable_LocBypassingRunnable_m_pad_ensRLocationsPort_par_out_local.TChangeableMemPool._._._m_arrayPool._0_._elem._m_LocationList._Item._45_._phiQly "" VALUE 0xB00105CB __UByte_Value 0 NO_COMPU_METHOD 0 255 ECU_ADDRESS_EXTENSION 0x2 BYTE_ORDER MSB_LAST /end CHARACTERISTIC
/begin CHARACTERISTIC _g_PL_AD_fw_Radar_1R1V_rpc_LocBypassingRunnable_LocBypassingRunnable_m_pad_ensRLocationsPort_par_out_local.TChangeableMemPool._._._m_arrayPool._0_._elem._m_LocationList._Item._45_._phiVar._m_value "" VALUE 0xB00105CE __Float16_Value 0 NO_COMPU_METHOD -65504 65504 ECU_ADDRESS_EXTENSION 0x2 BYTE_ORDER MSB_LAST /end CHARACTERISTIC
/begin CHARACTERISTIC _g_PL_AD_fw_Radar_1R1V_rpc_LocBypassingRunnable_LocBypassingRunnable_m_pad_ensRLocationsPort_par_out_local.TChangeableMemPool._._._m_arrayPool._0_._elem._m_LocationList._Item._45_._theta._m_value "" VALUE 0xB00105C6 __Float16_Value 0 NO_COMPU_METHOD -65504 65504 ECU_ADDRESS_EXTENSION 0x2 BYTE_ORDER MSB_LAST /end CHARACTERISTIC
/begin CHARACTERISTIC _g_PL_AD_fw_Radar_1R1V_rpc_LocBypassingRunnable_LocBypassingRunnable_m_pad_ensRLocationsPort_par_out_local.TChangeableMemPool._._._m_arrayPool._0_._elem._m_LocationList._Item._45_._thetaQly "" VALUE 0xB00105CA __UByte_Value 0 NO_COMPU_METHOD 0 255 ECU_ADDRESS_EXTENSION 0x2 BYTE_ORDER MSB_LAST /end CHARACTERISTIC
/begin CHARACTERISTIC _g_PL_AD_fw_Radar_1R1V_rpc_LocBypassingRunnable_LocBypassingRunnable_m_pad_ensRLocationsPort_par_out_local.TChangeableMemPool._._._m_arrayPool._0_._elem._m_LocationList._Item._45_._thetaVar._m_value "" VALUE 0xB00105CC __Float16_Value 0 NO_COMPU_METHOD -65504 65504 ECU_ADDRESS_EXTENSION 0x2 BYTE_ORDER MSB_LAST /end CHARACTERISTIC
/begin CHARACTERISTIC _g_PL_AD_fw_Radar_1R1V_rpc_LocBypassingRunnable_LocBypassingRunnable_m_pad_ensRLocationsPort_par_out_local.TChangeableMemPool._._._m_arrayPool._0_._elem._m_LocationList._Item._45_._v "" VALUE 0xB00105BC __Float32_Value 0 NO_COMPU_METHOD -3.4028234663852886E+38 3.4028234663852886E+38 ECU_ADDRESS_EXTENSION 0x2 BYTE_ORDER MSB_LAST /end CHARACTERISTIC
/begin CHARACTERISTIC _g_PL_AD_fw_Radar_1R1V_rpc_LocBypassingRunnable_LocBypassingRunnable_m_pad_ensRLocationsPort_par_out_local.TChangeableMemPool._._._m_arrayPool._0_._elem._m_LocationList._Item._45_._vVar._m_value "" VALUE 0xB00105C2 __Float16_Value 0 NO_COMPU_METHOD -65504 65504 ECU_ADDRESS_EXTENSION 0x2 BYTE_ORDER MSB_LAST /end CHARACTERISTIC
/begin CHARACTERISTIC _g_PL_AD_fw_Radar_1R1V_rpc_LocBypassingRunnable_LocBypassingRunnable_m_pad_ensRLocationsPort_par_out_local.TChangeableMemPool._._._m_arrayPool._0_._elem._m_LocationList._Item._46_._Rcs._m_value "" VALUE 0xB00105F0 __Float16_Value 0 NO_COMPU_METHOD -65504 65504 ECU_ADDRESS_EXTENSION 0x2 BYTE_ORDER MSB_LAST /end CHARACTERISTIC
/begin CHARACTERISTIC _g_PL_AD_fw_Radar_1R1V_rpc_LocBypassingRunnable_LocBypassingRunnable_m_pad_ensRLocationsPort_par_out_local.TChangeableMemPool._._._m_arrayPool._0_._elem._m_LocationList._Item._46_._Rssi._m_value "" VALUE 0xB00105F2 __Float16_Value 0 NO_COMPU_METHOD -65504 65504 ECU_ADDRESS_EXTENSION 0x2 BYTE_ORDER MSB_LAST /end CHARACTERISTIC
/begin CHARACTERISTIC _g_PL_AD_fw_Radar_1R1V_rpc_LocBypassingRunnable_LocBypassingRunnable_m_pad_ensRLocationsPort_par_out_local.TChangeableMemPool._._._m_arrayPool._0_._elem._m_LocationList._Item._46_._d "" VALUE 0xB00105D8 __Float32_Value 0 NO_COMPU_METHOD -3.4028234663852886E+38 3.4028234663852886E+38 ECU_ADDRESS_EXTENSION 0x2 BYTE_ORDER MSB_LAST /end CHARACTERISTIC
/begin CHARACTERISTIC _g_PL_AD_fw_Radar_1R1V_rpc_LocBypassingRunnable_LocBypassingRunnable_m_pad_ensRLocationsPort_par_out_local.TChangeableMemPool._._._m_arrayPool._0_._elem._m_LocationList._Item._46_._dVar._m_value "" VALUE 0xB00105E0 __Float16_Value 0 NO_COMPU_METHOD -65504 65504 ECU_ADDRESS_EXTENSION 0x2 BYTE_ORDER MSB_LAST /end CHARACTERISTIC
/begin CHARACTERISTIC _g_PL_AD_fw_Radar_1R1V_rpc_LocBypassingRunnable_LocBypassingRunnable_m_pad_ensRLocationsPort_par_out_local.TChangeableMemPool._._._m_arrayPool._0_._elem._m_LocationList._Item._46_._dvCov._m_value "" VALUE 0xB00105E4 __Float16_Value 0 NO_COMPU_METHOD -65504 65504 ECU_ADDRESS_EXTENSION 0x2 BYTE_ORDER MSB_LAST /end CHARACTERISTIC
/begin CHARACTERISTIC _g_PL_AD_fw_Radar_1R1V_rpc_LocBypassingRunnable_LocBypassingRunnable_m_pad_ensRLocationsPort_par_out_local.TChangeableMemPool._._._m_arrayPool._0_._elem._m_LocationList._Item._46_._dvQly "" VALUE 0xB00105F4 __UByte_Value 0 NO_COMPU_METHOD 0 255 ECU_ADDRESS_EXTENSION 0x2 BYTE_ORDER MSB_LAST /end CHARACTERISTIC
/begin CHARACTERISTIC _g_PL_AD_fw_Radar_1R1V_rpc_LocBypassingRunnable_LocBypassingRunnable_m_pad_ensRLocationsPort_par_out_local.TChangeableMemPool._._._m_arrayPool._0_._elem._m_LocationList._Item._46_._idxAzimuthAmbiguityPeer "" VALUE 0xB00105F6 __UWord_Value 0 NO_COMPU_METHOD 0 65535 ECU_ADDRESS_EXTENSION 0x2 BYTE_ORDER MSB_LAST /end CHARACTERISTIC
/begin CHARACTERISTIC _g_PL_AD_fw_Radar_1R1V_rpc_LocBypassingRunnable_LocBypassingRunnable_m_pad_ensRLocationsPort_par_out_local.TChangeableMemPool._._._m_arrayPool._0_._elem._m_LocationList._Item._46_._measStatus "" VALUE 0xB00105F5 __UByte_Value 0 NO_COMPU_METHOD 0 255 ECU_ADDRESS_EXTENSION 0x2 BYTE_ORDER MSB_LAST /end CHARACTERISTIC
/begin CHARACTERISTIC _g_PL_AD_fw_Radar_1R1V_rpc_LocBypassingRunnable_LocBypassingRunnable_m_pad_ensRLocationsPort_par_out_local.TChangeableMemPool._._._m_arrayPool._0_._elem._m_LocationList._Item._46_._phi._m_value "" VALUE 0xB00105E8 __Float16_Value 0 NO_COMPU_METHOD -65504 65504 ECU_ADDRESS_EXTENSION 0x2 BYTE_ORDER MSB_LAST /end CHARACTERISTIC
/begin CHARACTERISTIC _g_PL_AD_fw_Radar_1R1V_rpc_LocBypassingRunnable_LocBypassingRunnable_m_pad_ensRLocationsPort_par_out_local.TChangeableMemPool._._._m_arrayPool._0_._elem._m_LocationList._Item._46_._phiQly "" VALUE 0xB00105EB __UByte_Value 0 NO_COMPU_METHOD 0 255 ECU_ADDRESS_EXTENSION 0x2 BYTE_ORDER MSB_LAST /end CHARACTERISTIC
/begin CHARACTERISTIC _g_PL_AD_fw_Radar_1R1V_rpc_LocBypassingRunnable_LocBypassingRunnable_m_pad_ensRLocationsPort_par_out_local.TChangeableMemPool._._._m_arrayPool._0_._elem._m_LocationList._Item._46_._phiVar._m_value "" VALUE 0xB00105EE __Float16_Value 0 NO_COMPU_METHOD -65504 65504 ECU_ADDRESS_EXTENSION 0x2 BYTE_ORDER MSB_LAST /end CHARACTERISTIC
/begin CHARACTERISTIC _g_PL_AD_fw_Radar_1R1V_rpc_LocBypassingRunnable_LocBypassingRunnable_m_pad_ensRLocationsPort_par_out_local.TChangeableMemPool._._._m_arrayPool._0_._elem._m_LocationList._Item._46_._theta._m_value "" VALUE 0xB00105E6 __Float16_Value 0 NO_COMPU_METHOD -65504 65504 ECU_ADDRESS_EXTENSION 0x2 BYTE_ORDER MSB_LAST /end CHARACTERISTIC
/begin CHARACTERISTIC _g_PL_AD_fw_Radar_1R1V_rpc_LocBypassingRunnable_LocBypassingRunnable_m_pad_ensRLocationsPort_par_out_local.TChangeableMemPool._._._m_arrayPool._0_._elem._m_LocationList._Item._46_._thetaQly "" VALUE 0xB00105EA __UByte_Value 0 NO_COMPU_METHOD 0 255 ECU_ADDRESS_EXTENSION 0x2 BYTE_ORDER MSB_LAST /end CHARACTERISTIC
/begin CHARACTERISTIC _g_PL_AD_fw_Radar_1R1V_rpc_LocBypassingRunnable_LocBypassingRunnable_m_pad_ensRLocationsPort_par_out_local.TChangeableMemPool._._._m_arrayPool._0_._elem._m_LocationList._Item._46_._thetaVar._m_value "" VALUE 0xB00105EC __Float16_Value 0 NO_COMPU_METHOD -65504 65504 ECU_ADDRESS_EXTENSION 0x2 BYTE_ORDER MSB_LAST /end CHARACTERISTIC
/begin CHARACTERISTIC _g_PL_AD_fw_Radar_1R1V_rpc_LocBypassingRunnable_LocBypassingRunnable_m_pad_ensRLocationsPort_par_out_local.TChangeableMemPool._._._m_arrayPool._0_._elem._m_LocationList._Item._46_._v "" VALUE 0xB00105DC __Float32_Value 0 NO_COMPU_METHOD -3.4028234663852886E+38 3.4028234663852886E+38 ECU_ADDRESS_EXTENSION 0x2 BYTE_ORDER MSB_LAST /end CHARACTERISTIC
/begin CHARACTERISTIC _g_PL_AD_fw_Radar_1R1V_rpc_LocBypassingRunnable_LocBypassingRunnable_m_pad_ensRLocationsPort_par_out_local.TChangeableMemPool._._._m_arrayPool._0_._elem._m_LocationList._Item._46_._vVar._m_value "" VALUE 0xB00105E2 __Float16_Value 0 NO_COMPU_METHOD -65504 65504 ECU_ADDRESS_EXTENSION 0x2 BYTE_ORDER MSB_LAST /end CHARACTERISTIC
/begin CHARACTERISTIC _g_PL_AD_fw_Radar_1R1V_rpc_LocBypassingRunnable_LocBypassingRunnable_m_pad_ensRLocationsPort_par_out_local.TChangeableMemPool._._._m_arrayPool._0_._elem._m_LocationList._Item._47_._Rcs._m_value "" VALUE 0xB0010610 __Float16_Value 0 NO_COMPU_METHOD -65504 65504 ECU_ADDRESS_EXTENSION 0x2 BYTE_ORDER MSB_LAST /end CHARACTERISTIC
/begin CHARACTERISTIC _g_PL_AD_fw_Radar_1R1V_rpc_LocBypassingRunnable_LocBypassingRunnable_m_pad_ensRLocationsPort_par_out_local.TChangeableMemPool._._._m_arrayPool._0_._elem._m_LocationList._Item._47_._Rssi._m_value "" VALUE 0xB0010612 __Float16_Value 0 NO_COMPU_METHOD -65504 65504 ECU_ADDRESS_EXTENSION 0x2 BYTE_ORDER MSB_LAST /end CHARACTERISTIC
/begin CHARACTERISTIC _g_PL_AD_fw_Radar_1R1V_rpc_LocBypassingRunnable_LocBypassingRunnable_m_pad_ensRLocationsPort_par_out_local.TChangeableMemPool._._._m_arrayPool._0_._elem._m_LocationList._Item._47_._d "" VALUE 0xB00105F8 __Float32_Value 0 NO_COMPU_METHOD -3.4028234663852886E+38 3.4028234663852886E+38 ECU_ADDRESS_EXTENSION 0x2 BYTE_ORDER MSB_LAST /end CHARACTERISTIC
/begin CHARACTERISTIC _g_PL_AD_fw_Radar_1R1V_rpc_LocBypassingRunnable_LocBypassingRunnable_m_pad_ensRLocationsPort_par_out_local.TChangeableMemPool._._._m_arrayPool._0_._elem._m_LocationList._Item._47_._dVar._m_value "" VALUE 0xB0010600 __Float16_Value 0 NO_COMPU_METHOD -65504 65504 ECU_ADDRESS_EXTENSION 0x2 BYTE_ORDER MSB_LAST /end CHARACTERISTIC
/begin CHARACTERISTIC _g_PL_AD_fw_Radar_1R1V_rpc_LocBypassingRunnable_LocBypassingRunnable_m_pad_ensRLocationsPort_par_out_local.TChangeableMemPool._._._m_arrayPool._0_._elem._m_LocationList._Item._47_._dvCov._m_value "" VALUE 0xB0010604 __Float16_Value 0 NO_COMPU_METHOD -65504 65504 ECU_ADDRESS_EXTENSION 0x2 BYTE_ORDER MSB_LAST /end CHARACTERISTIC
/begin CHARACTERISTIC _g_PL_AD_fw_Radar_1R1V_rpc_LocBypassingRunnable_LocBypassingRunnable_m_pad_ensRLocationsPort_par_out_local.TChangeableMemPool._._._m_arrayPool._0_._elem._m_LocationList._Item._47_._dvQly "" VALUE 0xB0010614 __UByte_Value 0 NO_COMPU_METHOD 0 255 ECU_ADDRESS_EXTENSION 0x2 BYTE_ORDER MSB_LAST /end CHARACTERISTIC
/begin CHARACTERISTIC _g_PL_AD_fw_Radar_1R1V_rpc_LocBypassingRunnable_LocBypassingRunnable_m_pad_ensRLocationsPort_par_out_local.TChangeableMemPool._._._m_arrayPool._0_._elem._m_LocationList._Item._47_._idxAzimuthAmbiguityPeer "" VALUE 0xB0010616 __UWord_Value 0 NO_COMPU_METHOD 0 65535 ECU_ADDRESS_EXTENSION 0x2 BYTE_ORDER MSB_LAST /end CHARACTERISTIC
/begin CHARACTERISTIC _g_PL_AD_fw_Radar_1R1V_rpc_LocBypassingRunnable_LocBypassingRunnable_m_pad_ensRLocationsPort_par_out_local.TChangeableMemPool._._._m_arrayPool._0_._elem._m_LocationList._Item._47_._measStatus "" VALUE 0xB0010615 __UByte_Value 0 NO_COMPU_METHOD 0 255 ECU_ADDRESS_EXTENSION 0x2 BYTE_ORDER MSB_LAST /end CHARACTERISTIC
/begin CHARACTERISTIC _g_PL_AD_fw_Radar_1R1V_rpc_LocBypassingRunnable_LocBypassingRunnable_m_pad_ensRLocationsPort_par_out_local.TChangeableMemPool._._._m_arrayPool._0_._elem._m_LocationList._Item._47_._phi._m_value "" VALUE 0xB0010608 __Float16_Value 0 NO_COMPU_METHOD -65504 65504 ECU_ADDRESS_EXTENSION 0x2 BYTE_ORDER MSB_LAST /end CHARACTERISTIC
/begin CHARACTERISTIC _g_PL_AD_fw_Radar_1R1V_rpc_LocBypassingRunnable_LocBypassingRunnable_m_pad_ensRLocationsPort_par_out_local.TChangeableMemPool._._._m_arrayPool._0_._elem._m_LocationList._Item._47_._phiQly "" VALUE 0xB001060B __UByte_Value 0 NO_COMPU_METHOD 0 255 ECU_ADDRESS_EXTENSION 0x2 BYTE_ORDER MSB_LAST /end CHARACTERISTIC
/begin CHARACTERISTIC _g_PL_AD_fw_Radar_1R1V_rpc_LocBypassingRunnable_LocBypassingRunnable_m_pad_ensRLocationsPort_par_out_local.TChangeableMemPool._._._m_arrayPool._0_._elem._m_LocationList._Item._47_._phiVar._m_value "" VALUE 0xB001060E __Float16_Value 0 NO_COMPU_METHOD -65504 65504 ECU_ADDRESS_EXTENSION 0x2 BYTE_ORDER MSB_LAST /end CHARACTERISTIC
/begin CHARACTERISTIC _g_PL_AD_fw_Radar_1R1V_rpc_LocBypassingRunnable_LocBypassingRunnable_m_pad_ensRLocationsPort_par_out_local.TChangeableMemPool._._._m_arrayPool._0_._elem._m_LocationList._Item._47_._theta._m_value "" VALUE 0xB0010606 __Float16_Value 0 NO_COMPU_METHOD -65504 65504 ECU_ADDRESS_EXTENSION 0x2 BYTE_ORDER MSB_LAST /end CHARACTERISTIC
/begin CHARACTERISTIC _g_PL_AD_fw_Radar_1R1V_rpc_LocBypassingRunnable_LocBypassingRunnable_m_pad_ensRLocationsPort_par_out_local.TChangeableMemPool._._._m_arrayPool._0_._elem._m_LocationList._Item._47_._thetaQly "" VALUE 0xB001060A __UByte_Value 0 NO_COMPU_METHOD 0 255 ECU_ADDRESS_EXTENSION 0x2 BYTE_ORDER MSB_LAST /end CHARACTERISTIC
/begin CHARACTERISTIC _g_PL_AD_fw_Radar_1R1V_rpc_LocBypassingRunnable_LocBypassingRunnable_m_pad_ensRLocationsPort_par_out_local.TChangeableMemPool._._._m_arrayPool._0_._elem._m_LocationList._Item._47_._thetaVar._m_value "" VALUE 0xB001060C __Float16_Value 0 NO_COMPU_METHOD -65504 65504 ECU_ADDRESS_EXTENSION 0x2 BYTE_ORDER MSB_LAST /end CHARACTERISTIC
/begin CHARACTERISTIC _g_PL_AD_fw_Radar_1R1V_rpc_LocBypassingRunnable_LocBypassingRunnable_m_pad_ensRLocationsPort_par_out_local.TChangeableMemPool._._._m_arrayPool._0_._elem._m_LocationList._Item._47_._v "" VALUE 0xB00105FC __Float32_Value 0 NO_COMPU_METHOD -3.4028234663852886E+38 3.4028234663852886E+38 ECU_ADDRESS_EXTENSION 0x2 BYTE_ORDER MSB_LAST /end CHARACTERISTIC
/begin CHARACTERISTIC _g_PL_AD_fw_Radar_1R1V_rpc_LocBypassingRunnable_LocBypassingRunnable_m_pad_ensRLocationsPort_par_out_local.TChangeableMemPool._._._m_arrayPool._0_._elem._m_LocationList._Item._47_._vVar._m_value "" VALUE 0xB0010602 __Float16_Value 0 NO_COMPU_METHOD -65504 65504 ECU_ADDRESS_EXTENSION 0x2 BYTE_ORDER MSB_LAST /end CHARACTERISTIC
/begin CHARACTERISTIC _g_PL_AD_fw_Radar_1R1V_rpc_LocBypassingRunnable_LocBypassingRunnable_m_pad_ensRLocationsPort_par_out_local.TChangeableMemPool._._._m_arrayPool._0_._elem._m_LocationList._Item._48_._Rcs._m_value "" VALUE 0xB0010630 __Float16_Value 0 NO_COMPU_METHOD -65504 65504 ECU_ADDRESS_EXTENSION 0x2 BYTE_ORDER MSB_LAST /end CHARACTERISTIC
/begin CHARACTERISTIC _g_PL_AD_fw_Radar_1R1V_rpc_LocBypassingRunnable_LocBypassingRunnable_m_pad_ensRLocationsPort_par_out_local.TChangeableMemPool._._._m_arrayPool._0_._elem._m_LocationList._Item._48_._Rssi._m_value "" VALUE 0xB0010632 __Float16_Value 0 NO_COMPU_METHOD -65504 65504 ECU_ADDRESS_EXTENSION 0x2 BYTE_ORDER MSB_LAST /end CHARACTERISTIC
/begin CHARACTERISTIC _g_PL_AD_fw_Radar_1R1V_rpc_LocBypassingRunnable_LocBypassingRunnable_m_pad_ensRLocationsPort_par_out_local.TChangeableMemPool._._._m_arrayPool._0_._elem._m_LocationList._Item._48_._d "" VALUE 0xB0010618 __Float32_Value 0 NO_COMPU_METHOD -3.4028234663852886E+38 3.4028234663852886E+38 ECU_ADDRESS_EXTENSION 0x2 BYTE_ORDER MSB_LAST /end CHARACTERISTIC
/begin CHARACTERISTIC _g_PL_AD_fw_Radar_1R1V_rpc_LocBypassingRunnable_LocBypassingRunnable_m_pad_ensRLocationsPort_par_out_local.TChangeableMemPool._._._m_arrayPool._0_._elem._m_LocationList._Item._48_._dVar._m_value "" VALUE 0xB0010620 __Float16_Value 0 NO_COMPU_METHOD -65504 65504 ECU_ADDRESS_EXTENSION 0x2 BYTE_ORDER MSB_LAST /end CHARACTERISTIC
/begin CHARACTERISTIC _g_PL_AD_fw_Radar_1R1V_rpc_LocBypassingRunnable_LocBypassingRunnable_m_pad_ensRLocationsPort_par_out_local.TChangeableMemPool._._._m_arrayPool._0_._elem._m_LocationList._Item._48_._dvCov._m_value "" VALUE 0xB0010624 __Float16_Value 0 NO_COMPU_METHOD -65504 65504 ECU_ADDRESS_EXTENSION 0x2 BYTE_ORDER MSB_LAST /end CHARACTERISTIC
/begin CHARACTERISTIC _g_PL_AD_fw_Radar_1R1V_rpc_LocBypassingRunnable_LocBypassingRunnable_m_pad_ensRLocationsPort_par_out_local.TChangeableMemPool._._._m_arrayPool._0_._elem._m_LocationList._Item._48_._dvQly "" VALUE 0xB0010634 __UByte_Value 0 NO_COMPU_METHOD 0 255 ECU_ADDRESS_EXTENSION 0x2 BYTE_ORDER MSB_LAST /end CHARACTERISTIC
/begin CHARACTERISTIC _g_PL_AD_fw_Radar_1R1V_rpc_LocBypassingRunnable_LocBypassingRunnable_m_pad_ensRLocationsPort_par_out_local.TChangeableMemPool._._._m_arrayPool._0_._elem._m_LocationList._Item._48_._idxAzimuthAmbiguityPeer "" VALUE 0xB0010636 __UWord_Value 0 NO_COMPU_METHOD 0 65535 ECU_ADDRESS_EXTENSION 0x2 BYTE_ORDER MSB_LAST /end CHARACTERISTIC
/begin CHARACTERISTIC _g_PL_AD_fw_Radar_1R1V_rpc_LocBypassingRunnable_LocBypassingRunnable_m_pad_ensRLocationsPort_par_out_local.TChangeableMemPool._._._m_arrayPool._0_._elem._m_LocationList._Item._48_._measStatus "" VALUE 0xB0010635 __UByte_Value 0 NO_COMPU_METHOD 0 255 ECU_ADDRESS_EXTENSION 0x2 BYTE_ORDER MSB_LAST /end CHARACTERISTIC
/begin CHARACTERISTIC _g_PL_AD_fw_Radar_1R1V_rpc_LocBypassingRunnable_LocBypassingRunnable_m_pad_ensRLocationsPort_par_out_local.TChangeableMemPool._._._m_arrayPool._0_._elem._m_LocationList._Item._48_._phi._m_value "" VALUE 0xB0010628 __Float16_Value 0 NO_COMPU_METHOD -65504 65504 ECU_ADDRESS_EXTENSION 0x2 BYTE_ORDER MSB_LAST /end CHARACTERISTIC
/begin CHARACTERISTIC _g_PL_AD_fw_Radar_1R1V_rpc_LocBypassingRunnable_LocBypassingRunnable_m_pad_ensRLocationsPort_par_out_local.TChangeableMemPool._._._m_arrayPool._0_._elem._m_LocationList._Item._48_._phiQly "" VALUE 0xB001062B __UByte_Value 0 NO_COMPU_METHOD 0 255 ECU_ADDRESS_EXTENSION 0x2 BYTE_ORDER MSB_LAST /end CHARACTERISTIC
/begin CHARACTERISTIC _g_PL_AD_fw_Radar_1R1V_rpc_LocBypassingRunnable_LocBypassingRunnable_m_pad_ensRLocationsPort_par_out_local.TChangeableMemPool._._._m_arrayPool._0_._elem._m_LocationList._Item._48_._phiVar._m_value "" VALUE 0xB001062E __Float16_Value 0 NO_COMPU_METHOD -65504 65504 ECU_ADDRESS_EXTENSION 0x2 BYTE_ORDER MSB_LAST /end CHARACTERISTIC
/begin CHARACTERISTIC _g_PL_AD_fw_Radar_1R1V_rpc_LocBypassingRunnable_LocBypassingRunnable_m_pad_ensRLocationsPort_par_out_local.TChangeableMemPool._._._m_arrayPool._0_._elem._m_LocationList._Item._48_._theta._m_value "" VALUE 0xB0010626 __Float16_Value 0 NO_COMPU_METHOD -65504 65504 ECU_ADDRESS_EXTENSION 0x2 BYTE_ORDER MSB_LAST /end CHARACTERISTIC
/begin CHARACTERISTIC _g_PL_AD_fw_Radar_1R1V_rpc_LocBypassingRunnable_LocBypassingRunnable_m_pad_ensRLocationsPort_par_out_local.TChangeableMemPool._._._m_arrayPool._0_._elem._m_LocationList._Item._48_._thetaQly "" VALUE 0xB001062A __UByte_Value 0 NO_COMPU_METHOD 0 255 ECU_ADDRESS_EXTENSION 0x2 BYTE_ORDER MSB_LAST /end CHARACTERISTIC
/begin CHARACTERISTIC _g_PL_AD_fw_Radar_1R1V_rpc_LocBypassingRunnable_LocBypassingRunnable_m_pad_ensRLocationsPort_par_out_local.TChangeableMemPool._._._m_arrayPool._0_._elem._m_LocationList._Item._48_._thetaVar._m_value "" VALUE 0xB001062C __Float16_Value 0 NO_COMPU_METHOD -65504 65504 ECU_ADDRESS_EXTENSION 0x2 BYTE_ORDER MSB_LAST /end CHARACTERISTIC
/begin CHARACTERISTIC _g_PL_AD_fw_Radar_1R1V_rpc_LocBypassingRunnable_LocBypassingRunnable_m_pad_ensRLocationsPort_par_out_local.TChangeableMemPool._._._m_arrayPool._0_._elem._m_LocationList._Item._48_._v "" VALUE 0xB001061C __Float32_Value 0 NO_COMPU_METHOD -3.4028234663852886E+38 3.4028234663852886E+38 ECU_ADDRESS_EXTENSION 0x2 BYTE_ORDER MSB_LAST /end CHARACTERISTIC
/begin CHARACTERISTIC _g_PL_AD_fw_Radar_1R1V_rpc_LocBypassingRunnable_LocBypassingRunnable_m_pad_ensRLocationsPort_par_out_local.TChangeableMemPool._._._m_arrayPool._0_._elem._m_LocationList._Item._48_._vVar._m_value "" VALUE 0xB0010622 __Float16_Value 0 NO_COMPU_METHOD -65504 65504 ECU_ADDRESS_EXTENSION 0x2 BYTE_ORDER MSB_LAST /end CHARACTERISTIC
/begin CHARACTERISTIC _g_PL_AD_fw_Radar_1R1V_rpc_LocBypassingRunnable_LocBypassingRunnable_m_pad_ensRLocationsPort_par_out_local.TChangeableMemPool._._._m_arrayPool._0_._elem._m_LocationList._Item._49_._Rcs._m_value "" VALUE 0xB0010650 __Float16_Value 0 NO_COMPU_METHOD -65504 65504 ECU_ADDRESS_EXTENSION 0x2 BYTE_ORDER MSB_LAST /end CHARACTERISTIC
/begin CHARACTERISTIC _g_PL_AD_fw_Radar_1R1V_rpc_LocBypassingRunnable_LocBypassingRunnable_m_pad_ensRLocationsPort_par_out_local.TChangeableMemPool._._._m_arrayPool._0_._elem._m_LocationList._Item._49_._Rssi._m_value "" VALUE 0xB0010652 __Float16_Value 0 NO_COMPU_METHOD -65504 65504 ECU_ADDRESS_EXTENSION 0x2 BYTE_ORDER MSB_LAST /end CHARACTERISTIC
/begin CHARACTERISTIC _g_PL_AD_fw_Radar_1R1V_rpc_LocBypassingRunnable_LocBypassingRunnable_m_pad_ensRLocationsPort_par_out_local.TChangeableMemPool._._._m_arrayPool._0_._elem._m_LocationList._Item._49_._d "" VALUE 0xB0010638 __Float32_Value 0 NO_COMPU_METHOD -3.4028234663852886E+38 3.4028234663852886E+38 ECU_ADDRESS_EXTENSION 0x2 BYTE_ORDER MSB_LAST /end CHARACTERISTIC
/begin CHARACTERISTIC _g_PL_AD_fw_Radar_1R1V_rpc_LocBypassingRunnable_LocBypassingRunnable_m_pad_ensRLocationsPort_par_out_local.TChangeableMemPool._._._m_arrayPool._0_._elem._m_LocationList._Item._49_._dVar._m_value "" VALUE 0xB0010640 __Float16_Value 0 NO_COMPU_METHOD -65504 65504 ECU_ADDRESS_EXTENSION 0x2 BYTE_ORDER MSB_LAST /end CHARACTERISTIC
/begin CHARACTERISTIC _g_PL_AD_fw_Radar_1R1V_rpc_LocBypassingRunnable_LocBypassingRunnable_m_pad_ensRLocationsPort_par_out_local.TChangeableMemPool._._._m_arrayPool._0_._elem._m_LocationList._Item._49_._dvCov._m_value "" VALUE 0xB0010644 __Float16_Value 0 NO_COMPU_METHOD -65504 65504 ECU_ADDRESS_EXTENSION 0x2 BYTE_ORDER MSB_LAST /end CHARACTERISTIC
/begin CHARACTERISTIC _g_PL_AD_fw_Radar_1R1V_rpc_LocBypassingRunnable_LocBypassingRunnable_m_pad_ensRLocationsPort_par_out_local.TChangeableMemPool._._._m_arrayPool._0_._elem._m_LocationList._Item._49_._dvQly "" VALUE 0xB0010654 __UByte_Value 0 NO_COMPU_METHOD 0 255 ECU_ADDRESS_EXTENSION 0x2 BYTE_ORDER MSB_LAST /end CHARACTERISTIC
/begin CHARACTERISTIC _g_PL_AD_fw_Radar_1R1V_rpc_LocBypassingRunnable_LocBypassingRunnable_m_pad_ensRLocationsPort_par_out_local.TChangeableMemPool._._._m_arrayPool._0_._elem._m_LocationList._Item._49_._idxAzimuthAmbiguityPeer "" VALUE 0xB0010656 __UWord_Value 0 NO_COMPU_METHOD 0 65535 ECU_ADDRESS_EXTENSION 0x2 BYTE_ORDER MSB_LAST /end CHARACTERISTIC
/begin CHARACTERISTIC _g_PL_AD_fw_Radar_1R1V_rpc_LocBypassingRunnable_LocBypassingRunnable_m_pad_ensRLocationsPort_par_out_local.TChangeableMemPool._._._m_arrayPool._0_._elem._m_LocationList._Item._49_._measStatus "" VALUE 0xB0010655 __UByte_Value 0 NO_COMPU_METHOD 0 255 ECU_ADDRESS_EXTENSION 0x2 BYTE_ORDER MSB_LAST /end CHARACTERISTIC
/begin CHARACTERISTIC _g_PL_AD_fw_Radar_1R1V_rpc_LocBypassingRunnable_LocBypassingRunnable_m_pad_ensRLocationsPort_par_out_local.TChangeableMemPool._._._m_arrayPool._0_._elem._m_LocationList._Item._49_._phi._m_value "" VALUE 0xB0010648 __Float16_Value 0 NO_COMPU_METHOD -65504 65504 ECU_ADDRESS_EXTENSION 0x2 BYTE_ORDER MSB_LAST /end CHARACTERISTIC
/begin CHARACTERISTIC _g_PL_AD_fw_Radar_1R1V_rpc_LocBypassingRunnable_LocBypassingRunnable_m_pad_ensRLocationsPort_par_out_local.TChangeableMemPool._._._m_arrayPool._0_._elem._m_LocationList._Item._49_._phiQly "" VALUE 0xB001064B __UByte_Value 0 NO_COMPU_METHOD 0 255 ECU_ADDRESS_EXTENSION 0x2 BYTE_ORDER MSB_LAST /end CHARACTERISTIC
/begin CHARACTERISTIC _g_PL_AD_fw_Radar_1R1V_rpc_LocBypassingRunnable_LocBypassingRunnable_m_pad_ensRLocationsPort_par_out_local.TChangeableMemPool._._._m_arrayPool._0_._elem._m_LocationList._Item._49_._phiVar._m_value "" VALUE 0xB001064E __Float16_Value 0 NO_COMPU_METHOD -65504 65504 ECU_ADDRESS_EXTENSION 0x2 BYTE_ORDER MSB_LAST /end CHARACTERISTIC
/begin CHARACTERISTIC _g_PL_AD_fw_Radar_1R1V_rpc_LocBypassingRunnable_LocBypassingRunnable_m_pad_ensRLocationsPort_par_out_local.TChangeableMemPool._._._m_arrayPool._0_._elem._m_LocationList._Item._49_._theta._m_value "" VALUE 0xB0010646 __Float16_Value 0 NO_COMPU_METHOD -65504 65504 ECU_ADDRESS_EXTENSION 0x2 BYTE_ORDER MSB_LAST /end CHARACTERISTIC
/begin CHARACTERISTIC _g_PL_AD_fw_Radar_1R1V_rpc_LocBypassingRunnable_LocBypassingRunnable_m_pad_ensRLocationsPort_par_out_local.TChangeableMemPool._._._m_arrayPool._0_._elem._m_LocationList._Item._49_._thetaQly "" VALUE 0xB001064A __UByte_Value 0 NO_COMPU_METHOD 0 255 ECU_ADDRESS_EXTENSION 0x2 BYTE_ORDER MSB_LAST /end CHARACTERISTIC
/begin CHARACTERISTIC _g_PL_AD_fw_Radar_1R1V_rpc_LocBypassingRunnable_LocBypassingRunnable_m_pad_ensRLocationsPort_par_out_local.TChangeableMemPool._._._m_arrayPool._0_._elem._m_LocationList._Item._49_._thetaVar._m_value "" VALUE 0xB001064C __Float16_Value 0 NO_COMPU_METHOD -65504 65504 ECU_ADDRESS_EXTENSION 0x2 BYTE_ORDER MSB_LAST /end CHARACTERISTIC
/begin CHARACTERISTIC _g_PL_AD_fw_Radar_1R1V_rpc_LocBypassingRunnable_LocBypassingRunnable_m_pad_ensRLocationsPort_par_out_local.TChangeableMemPool._._._m_arrayPool._0_._elem._m_LocationList._Item._49_._v "" VALUE 0xB001063C __Float32_Value 0 NO_COMPU_METHOD -3.4028234663852886E+38 3.4028234663852886E+38 ECU_ADDRESS_EXTENSION 0x2 BYTE_ORDER MSB_LAST /end CHARACTERISTIC
/begin CHARACTERISTIC _g_PL_AD_fw_Radar_1R1V_rpc_LocBypassingRunnable_LocBypassingRunnable_m_pad_ensRLocationsPort_par_out_local.TChangeableMemPool._._._m_arrayPool._0_._elem._m_LocationList._Item._49_._vVar._m_value "" VALUE 0xB0010642 __Float16_Value 0 NO_COMPU_METHOD -65504 65504 ECU_ADDRESS_EXTENSION 0x2 BYTE_ORDER MSB_LAST /end CHARACTERISTIC
/begin CHARACTERISTIC _g_PL_AD_fw_Radar_1R1V_rpc_LocBypassingRunnable_LocBypassingRunnable_m_pad_ensRLocationsPort_par_out_local.TChangeableMemPool._._._m_arrayPool._0_._elem._m_LocationList._Item._4_._Rcs._m_value "" VALUE 0xB00100B0 __Float16_Value 0 NO_COMPU_METHOD -65504 65504 ECU_ADDRESS_EXTENSION 0x2 BYTE_ORDER MSB_LAST /end CHARACTERISTIC
/begin CHARACTERISTIC _g_PL_AD_fw_Radar_1R1V_rpc_LocBypassingRunnable_LocBypassingRunnable_m_pad_ensRLocationsPort_par_out_local.TChangeableMemPool._._._m_arrayPool._0_._elem._m_LocationList._Item._4_._Rssi._m_value "" VALUE 0xB00100B2 __Float16_Value 0 NO_COMPU_METHOD -65504 65504 ECU_ADDRESS_EXTENSION 0x2 BYTE_ORDER MSB_LAST /end CHARACTERISTIC
/begin CHARACTERISTIC _g_PL_AD_fw_Radar_1R1V_rpc_LocBypassingRunnable_LocBypassingRunnable_m_pad_ensRLocationsPort_par_out_local.TChangeableMemPool._._._m_arrayPool._0_._elem._m_LocationList._Item._4_._d "" VALUE 0xB0010098 __Float32_Value 0 NO_COMPU_METHOD -3.4028234663852886E+38 3.4028234663852886E+38 ECU_ADDRESS_EXTENSION 0x2 BYTE_ORDER MSB_LAST /end CHARACTERISTIC
/begin CHARACTERISTIC _g_PL_AD_fw_Radar_1R1V_rpc_LocBypassingRunnable_LocBypassingRunnable_m_pad_ensRLocationsPort_par_out_local.TChangeableMemPool._._._m_arrayPool._0_._elem._m_LocationList._Item._4_._dVar._m_value "" VALUE 0xB00100A0 __Float16_Value 0 NO_COMPU_METHOD -65504 65504 ECU_ADDRESS_EXTENSION 0x2 BYTE_ORDER MSB_LAST /end CHARACTERISTIC
/begin CHARACTERISTIC _g_PL_AD_fw_Radar_1R1V_rpc_LocBypassingRunnable_LocBypassingRunnable_m_pad_ensRLocationsPort_par_out_local.TChangeableMemPool._._._m_arrayPool._0_._elem._m_LocationList._Item._4_._dvCov._m_value "" VALUE 0xB00100A4 __Float16_Value 0 NO_COMPU_METHOD -65504 65504 ECU_ADDRESS_EXTENSION 0x2 BYTE_ORDER MSB_LAST /end CHARACTERISTIC
/begin CHARACTERISTIC _g_PL_AD_fw_Radar_1R1V_rpc_LocBypassingRunnable_LocBypassingRunnable_m_pad_ensRLocationsPort_par_out_local.TChangeableMemPool._._._m_arrayPool._0_._elem._m_LocationList._Item._4_._dvQly "" VALUE 0xB00100B4 __UByte_Value 0 NO_COMPU_METHOD 0 255 ECU_ADDRESS_EXTENSION 0x2 BYTE_ORDER MSB_LAST /end CHARACTERISTIC
/begin CHARACTERISTIC _g_PL_AD_fw_Radar_1R1V_rpc_LocBypassingRunnable_LocBypassingRunnable_m_pad_ensRLocationsPort_par_out_local.TChangeableMemPool._._._m_arrayPool._0_._elem._m_LocationList._Item._4_._idxAzimuthAmbiguityPeer "" VALUE 0xB00100B6 __UWord_Value 0 NO_COMPU_METHOD 0 65535 ECU_ADDRESS_EXTENSION 0x2 BYTE_ORDER MSB_LAST /end CHARACTERISTIC
/begin CHARACTERISTIC _g_PL_AD_fw_Radar_1R1V_rpc_LocBypassingRunnable_LocBypassingRunnable_m_pad_ensRLocationsPort_par_out_local.TChangeableMemPool._._._m_arrayPool._0_._elem._m_LocationList._Item._4_._measStatus "" VALUE 0xB00100B5 __UByte_Value 0 NO_COMPU_METHOD 0 255 ECU_ADDRESS_EXTENSION 0x2 BYTE_ORDER MSB_LAST /end CHARACTERISTIC
/begin CHARACTERISTIC _g_PL_AD_fw_Radar_1R1V_rpc_LocBypassingRunnable_LocBypassingRunnable_m_pad_ensRLocationsPort_par_out_local.TChangeableMemPool._._._m_arrayPool._0_._elem._m_LocationList._Item._4_._phi._m_value "" VALUE 0xB00100A8 __Float16_Value 0 NO_COMPU_METHOD -65504 65504 ECU_ADDRESS_EXTENSION 0x2 BYTE_ORDER MSB_LAST /end CHARACTERISTIC
/begin CHARACTERISTIC _g_PL_AD_fw_Radar_1R1V_rpc_LocBypassingRunnable_LocBypassingRunnable_m_pad_ensRLocationsPort_par_out_local.TChangeableMemPool._._._m_arrayPool._0_._elem._m_LocationList._Item._4_._phiQly "" VALUE 0xB00100AB __UByte_Value 0 NO_COMPU_METHOD 0 255 ECU_ADDRESS_EXTENSION 0x2 BYTE_ORDER MSB_LAST /end CHARACTERISTIC
/begin CHARACTERISTIC _g_PL_AD_fw_Radar_1R1V_rpc_LocBypassingRunnable_LocBypassingRunnable_m_pad_ensRLocationsPort_par_out_local.TChangeableMemPool._._._m_arrayPool._0_._elem._m_LocationList._Item._4_._phiVar._m_value "" VALUE 0xB00100AE __Float16_Value 0 NO_COMPU_METHOD -65504 65504 ECU_ADDRESS_EXTENSION 0x2 BYTE_ORDER MSB_LAST /end CHARACTERISTIC
/begin CHARACTERISTIC _g_PL_AD_fw_Radar_1R1V_rpc_LocBypassingRunnable_LocBypassingRunnable_m_pad_ensRLocationsPort_par_out_local.TChangeableMemPool._._._m_arrayPool._0_._elem._m_LocationList._Item._4_._theta._m_value "" VALUE 0xB00100A6 __Float16_Value 0 NO_COMPU_METHOD -65504 65504 ECU_ADDRESS_EXTENSION 0x2 BYTE_ORDER MSB_LAST /end CHARACTERISTIC
/begin CHARACTERISTIC _g_PL_AD_fw_Radar_1R1V_rpc_LocBypassingRunnable_LocBypassingRunnable_m_pad_ensRLocationsPort_par_out_local.TChangeableMemPool._._._m_arrayPool._0_._elem._m_LocationList._Item._4_._thetaQly "" VALUE 0xB00100AA __UByte_Value 0 NO_COMPU_METHOD 0 255 ECU_ADDRESS_EXTENSION 0x2 BYTE_ORDER MSB_LAST /end CHARACTERISTIC
/begin CHARACTERISTIC _g_PL_AD_fw_Radar_1R1V_rpc_LocBypassingRunnable_LocBypassingRunnable_m_pad_ensRLocationsPort_par_out_local.TChangeableMemPool._._._m_arrayPool._0_._elem._m_LocationList._Item._4_._thetaVar._m_value "" VALUE 0xB00100AC __Float16_Value 0 NO_COMPU_METHOD -65504 65504 ECU_ADDRESS_EXTENSION 0x2 BYTE_ORDER MSB_LAST /end CHARACTERISTIC
/begin CHARACTERISTIC _g_PL_AD_fw_Radar_1R1V_rpc_LocBypassingRunnable_LocBypassingRunnable_m_pad_ensRLocationsPort_par_out_local.TChangeableMemPool._._._m_arrayPool._0_._elem._m_LocationList._Item._4_._v "" VALUE 0xB001009C __Float32_Value 0 NO_COMPU_METHOD -3.4028234663852886E+38 3.4028234663852886E+38 ECU_ADDRESS_EXTENSION 0x2 BYTE_ORDER MSB_LAST /end CHARACTERISTIC
/begin CHARACTERISTIC _g_PL_AD_fw_Radar_1R1V_rpc_LocBypassingRunnable_LocBypassingRunnable_m_pad_ensRLocationsPort_par_out_local.TChangeableMemPool._._._m_arrayPool._0_._elem._m_LocationList._Item._4_._vVar._m_value "" VALUE 0xB00100A2 __Float16_Value 0 NO_COMPU_METHOD -65504 65504 ECU_ADDRESS_EXTENSION 0x2 BYTE_ORDER MSB_LAST /end CHARACTERISTIC
/begin CHARACTERISTIC _g_PL_AD_fw_Radar_1R1V_rpc_LocBypassingRunnable_LocBypassingRunnable_m_pad_ensRLocationsPort_par_out_local.TChangeableMemPool._._._m_arrayPool._0_._elem._m_LocationList._Item._50_._Rcs._m_value "" VALUE 0xB0010670 __Float16_Value 0 NO_COMPU_METHOD -65504 65504 ECU_ADDRESS_EXTENSION 0x2 BYTE_ORDER MSB_LAST /end CHARACTERISTIC
/begin CHARACTERISTIC _g_PL_AD_fw_Radar_1R1V_rpc_LocBypassingRunnable_LocBypassingRunnable_m_pad_ensRLocationsPort_par_out_local.TChangeableMemPool._._._m_arrayPool._0_._elem._m_LocationList._Item._50_._Rssi._m_value "" VALUE 0xB0010672 __Float16_Value 0 NO_COMPU_METHOD -65504 65504 ECU_ADDRESS_EXTENSION 0x2 BYTE_ORDER MSB_LAST /end CHARACTERISTIC
/begin CHARACTERISTIC _g_PL_AD_fw_Radar_1R1V_rpc_LocBypassingRunnable_LocBypassingRunnable_m_pad_ensRLocationsPort_par_out_local.TChangeableMemPool._._._m_arrayPool._0_._elem._m_LocationList._Item._50_._d "" VALUE 0xB0010658 __Float32_Value 0 NO_COMPU_METHOD -3.4028234663852886E+38 3.4028234663852886E+38 ECU_ADDRESS_EXTENSION 0x2 BYTE_ORDER MSB_LAST /end CHARACTERISTIC
/begin CHARACTERISTIC _g_PL_AD_fw_Radar_1R1V_rpc_LocBypassingRunnable_LocBypassingRunnable_m_pad_ensRLocationsPort_par_out_local.TChangeableMemPool._._._m_arrayPool._0_._elem._m_LocationList._Item._50_._dVar._m_value "" VALUE 0xB0010660 __Float16_Value 0 NO_COMPU_METHOD -65504 65504 ECU_ADDRESS_EXTENSION 0x2 BYTE_ORDER MSB_LAST /end CHARACTERISTIC
/begin CHARACTERISTIC _g_PL_AD_fw_Radar_1R1V_rpc_LocBypassingRunnable_LocBypassingRunnable_m_pad_ensRLocationsPort_par_out_local.TChangeableMemPool._._._m_arrayPool._0_._elem._m_LocationList._Item._50_._dvCov._m_value "" VALUE 0xB0010664 __Float16_Value 0 NO_COMPU_METHOD -65504 65504 ECU_ADDRESS_EXTENSION 0x2 BYTE_ORDER MSB_LAST /end CHARACTERISTIC
/begin CHARACTERISTIC _g_PL_AD_fw_Radar_1R1V_rpc_LocBypassingRunnable_LocBypassingRunnable_m_pad_ensRLocationsPort_par_out_local.TChangeableMemPool._._._m_arrayPool._0_._elem._m_LocationList._Item._50_._dvQly "" VALUE 0xB0010674 __UByte_Value 0 NO_COMPU_METHOD 0 255 ECU_ADDRESS_EXTENSION 0x2 BYTE_ORDER MSB_LAST /end CHARACTERISTIC
/begin CHARACTERISTIC _g_PL_AD_fw_Radar_1R1V_rpc_LocBypassingRunnable_LocBypassingRunnable_m_pad_ensRLocationsPort_par_out_local.TChangeableMemPool._._._m_arrayPool._0_._elem._m_LocationList._Item._50_._idxAzimuthAmbiguityPeer "" VALUE 0xB0010676 __UWord_Value 0 NO_COMPU_METHOD 0 65535 ECU_ADDRESS_EXTENSION 0x2 BYTE_ORDER MSB_LAST /end CHARACTERISTIC
/begin CHARACTERISTIC _g_PL_AD_fw_Radar_1R1V_rpc_LocBypassingRunnable_LocBypassingRunnable_m_pad_ensRLocationsPort_par_out_local.TChangeableMemPool._._._m_arrayPool._0_._elem._m_LocationList._Item._50_._measStatus "" VALUE 0xB0010675 __UByte_Value 0 NO_COMPU_METHOD 0 255 ECU_ADDRESS_EXTENSION 0x2 BYTE_ORDER MSB_LAST /end CHARACTERISTIC
/begin CHARACTERISTIC _g_PL_AD_fw_Radar_1R1V_rpc_LocBypassingRunnable_LocBypassingRunnable_m_pad_ensRLocationsPort_par_out_local.TChangeableMemPool._._._m_arrayPool._0_._elem._m_LocationList._Item._50_._phi._m_value "" VALUE 0xB0010668 __Float16_Value 0 NO_COMPU_METHOD -65504 65504 ECU_ADDRESS_EXTENSION 0x2 BYTE_ORDER MSB_LAST /end CHARACTERISTIC
/begin CHARACTERISTIC _g_PL_AD_fw_Radar_1R1V_rpc_LocBypassingRunnable_LocBypassingRunnable_m_pad_ensRLocationsPort_par_out_local.TChangeableMemPool._._._m_arrayPool._0_._elem._m_LocationList._Item._50_._phiQly "" VALUE 0xB001066B __UByte_Value 0 NO_COMPU_METHOD 0 255 ECU_ADDRESS_EXTENSION 0x2 BYTE_ORDER MSB_LAST /end CHARACTERISTIC
/begin CHARACTERISTIC _g_PL_AD_fw_Radar_1R1V_rpc_LocBypassingRunnable_LocBypassingRunnable_m_pad_ensRLocationsPort_par_out_local.TChangeableMemPool._._._m_arrayPool._0_._elem._m_LocationList._Item._50_._phiVar._m_value "" VALUE 0xB001066E __Float16_Value 0 NO_COMPU_METHOD -65504 65504 ECU_ADDRESS_EXTENSION 0x2 BYTE_ORDER MSB_LAST /end CHARACTERISTIC
/begin CHARACTERISTIC _g_PL_AD_fw_Radar_1R1V_rpc_LocBypassingRunnable_LocBypassingRunnable_m_pad_ensRLocationsPort_par_out_local.TChangeableMemPool._._._m_arrayPool._0_._elem._m_LocationList._Item._50_._theta._m_value "" VALUE 0xB0010666 __Float16_Value 0 NO_COMPU_METHOD -65504 65504 ECU_ADDRESS_EXTENSION 0x2 BYTE_ORDER MSB_LAST /end CHARACTERISTIC
/begin CHARACTERISTIC _g_PL_AD_fw_Radar_1R1V_rpc_LocBypassingRunnable_LocBypassingRunnable_m_pad_ensRLocationsPort_par_out_local.TChangeableMemPool._._._m_arrayPool._0_._elem._m_LocationList._Item._50_._thetaQly "" VALUE 0xB001066A __UByte_Value 0 NO_COMPU_METHOD 0 255 ECU_ADDRESS_EXTENSION 0x2 BYTE_ORDER MSB_LAST /end CHARACTERISTIC
/begin CHARACTERISTIC _g_PL_AD_fw_Radar_1R1V_rpc_LocBypassingRunnable_LocBypassingRunnable_m_pad_ensRLocationsPort_par_out_local.TChangeableMemPool._._._m_arrayPool._0_._elem._m_LocationList._Item._50_._thetaVar._m_value "" VALUE 0xB001066C __Float16_Value 0 NO_COMPU_METHOD -65504 65504 ECU_ADDRESS_EXTENSION 0x2 BYTE_ORDER MSB_LAST /end CHARACTERISTIC
/begin CHARACTERISTIC _g_PL_AD_fw_Radar_1R1V_rpc_LocBypassingRunnable_LocBypassingRunnable_m_pad_ensRLocationsPort_par_out_local.TChangeableMemPool._._._m_arrayPool._0_._elem._m_LocationList._Item._50_._v "" VALUE 0xB001065C __Float32_Value 0 NO_COMPU_METHOD -3.4028234663852886E+38 3.4028234663852886E+38 ECU_ADDRESS_EXTENSION 0x2 BYTE_ORDER MSB_LAST /end CHARACTERISTIC
/begin CHARACTERISTIC _g_PL_AD_fw_Radar_1R1V_rpc_LocBypassingRunnable_LocBypassingRunnable_m_pad_ensRLocationsPort_par_out_local.TChangeableMemPool._._._m_arrayPool._0_._elem._m_LocationList._Item._50_._vVar._m_value "" VALUE 0xB0010662 __Float16_Value 0 NO_COMPU_METHOD -65504 65504 ECU_ADDRESS_EXTENSION 0x2 BYTE_ORDER MSB_LAST /end CHARACTERISTIC
/begin CHARACTERISTIC _g_PL_AD_fw_Radar_1R1V_rpc_LocBypassingRunnable_LocBypassingRunnable_m_pad_ensRLocationsPort_par_out_local.TChangeableMemPool._._._m_arrayPool._0_._elem._m_LocationList._Item._51_._Rcs._m_value "" VALUE 0xB0010690 __Float16_Value 0 NO_COMPU_METHOD -65504 65504 ECU_ADDRESS_EXTENSION 0x2 BYTE_ORDER MSB_LAST /end CHARACTERISTIC
/begin CHARACTERISTIC _g_PL_AD_fw_Radar_1R1V_rpc_LocBypassingRunnable_LocBypassingRunnable_m_pad_ensRLocationsPort_par_out_local.TChangeableMemPool._._._m_arrayPool._0_._elem._m_LocationList._Item._51_._Rssi._m_value "" VALUE 0xB0010692 __Float16_Value 0 NO_COMPU_METHOD -65504 65504 ECU_ADDRESS_EXTENSION 0x2 BYTE_ORDER MSB_LAST /end CHARACTERISTIC
/begin CHARACTERISTIC _g_PL_AD_fw_Radar_1R1V_rpc_LocBypassingRunnable_LocBypassingRunnable_m_pad_ensRLocationsPort_par_out_local.TChangeableMemPool._._._m_arrayPool._0_._elem._m_LocationList._Item._51_._d "" VALUE 0xB0010678 __Float32_Value 0 NO_COMPU_METHOD -3.4028234663852886E+38 3.4028234663852886E+38 ECU_ADDRESS_EXTENSION 0x2 BYTE_ORDER MSB_LAST /end CHARACTERISTIC
/begin CHARACTERISTIC _g_PL_AD_fw_Radar_1R1V_rpc_LocBypassingRunnable_LocBypassingRunnable_m_pad_ensRLocationsPort_par_out_local.TChangeableMemPool._._._m_arrayPool._0_._elem._m_LocationList._Item._51_._dVar._m_value "" VALUE 0xB0010680 __Float16_Value 0 NO_COMPU_METHOD -65504 65504 ECU_ADDRESS_EXTENSION 0x2 BYTE_ORDER MSB_LAST /end CHARACTERISTIC
/begin CHARACTERISTIC _g_PL_AD_fw_Radar_1R1V_rpc_LocBypassingRunnable_LocBypassingRunnable_m_pad_ensRLocationsPort_par_out_local.TChangeableMemPool._._._m_arrayPool._0_._elem._m_LocationList._Item._51_._dvCov._m_value "" VALUE 0xB0010684 __Float16_Value 0 NO_COMPU_METHOD -65504 65504 ECU_ADDRESS_EXTENSION 0x2 BYTE_ORDER MSB_LAST /end CHARACTERISTIC
/begin CHARACTERISTIC _g_PL_AD_fw_Radar_1R1V_rpc_LocBypassingRunnable_LocBypassingRunnable_m_pad_ensRLocationsPort_par_out_local.TChangeableMemPool._._._m_arrayPool._0_._elem._m_LocationList._Item._51_._dvQly "" VALUE 0xB0010694 __UByte_Value 0 NO_COMPU_METHOD 0 255 ECU_ADDRESS_EXTENSION 0x2 BYTE_ORDER MSB_LAST /end CHARACTERISTIC
/begin CHARACTERISTIC _g_PL_AD_fw_Radar_1R1V_rpc_LocBypassingRunnable_LocBypassingRunnable_m_pad_ensRLocationsPort_par_out_local.TChangeableMemPool._._._m_arrayPool._0_._elem._m_LocationList._Item._51_._idxAzimuthAmbiguityPeer "" VALUE 0xB0010696 __UWord_Value 0 NO_COMPU_METHOD 0 65535 ECU_ADDRESS_EXTENSION 0x2 BYTE_ORDER MSB_LAST /end CHARACTERISTIC
/begin CHARACTERISTIC _g_PL_AD_fw_Radar_1R1V_rpc_LocBypassingRunnable_LocBypassingRunnable_m_pad_ensRLocationsPort_par_out_local.TChangeableMemPool._._._m_arrayPool._0_._elem._m_LocationList._Item._51_._measStatus "" VALUE 0xB0010695 __UByte_Value 0 NO_COMPU_METHOD 0 255 ECU_ADDRESS_EXTENSION 0x2 BYTE_ORDER MSB_LAST /end CHARACTERISTIC
/begin CHARACTERISTIC _g_PL_AD_fw_Radar_1R1V_rpc_LocBypassingRunnable_LocBypassingRunnable_m_pad_ensRLocationsPort_par_out_local.TChangeableMemPool._._._m_arrayPool._0_._elem._m_LocationList._Item._51_._phi._m_value "" VALUE 0xB0010688 __Float16_Value 0 NO_COMPU_METHOD -65504 65504 ECU_ADDRESS_EXTENSION 0x2 BYTE_ORDER MSB_LAST /end CHARACTERISTIC
/begin CHARACTERISTIC _g_PL_AD_fw_Radar_1R1V_rpc_LocBypassingRunnable_LocBypassingRunnable_m_pad_ensRLocationsPort_par_out_local.TChangeableMemPool._._._m_arrayPool._0_._elem._m_LocationList._Item._51_._phiQly "" VALUE 0xB001068B __UByte_Value 0 NO_COMPU_METHOD 0 255 ECU_ADDRESS_EXTENSION 0x2 BYTE_ORDER MSB_LAST /end CHARACTERISTIC
/begin CHARACTERISTIC _g_PL_AD_fw_Radar_1R1V_rpc_LocBypassingRunnable_LocBypassingRunnable_m_pad_ensRLocationsPort_par_out_local.TChangeableMemPool._._._m_arrayPool._0_._elem._m_LocationList._Item._51_._phiVar._m_value "" VALUE 0xB001068E __Float16_Value 0 NO_COMPU_METHOD -65504 65504 ECU_ADDRESS_EXTENSION 0x2 BYTE_ORDER MSB_LAST /end CHARACTERISTIC
/begin CHARACTERISTIC _g_PL_AD_fw_Radar_1R1V_rpc_LocBypassingRunnable_LocBypassingRunnable_m_pad_ensRLocationsPort_par_out_local.TChangeableMemPool._._._m_arrayPool._0_._elem._m_LocationList._Item._51_._theta._m_value "" VALUE 0xB0010686 __Float16_Value 0 NO_COMPU_METHOD -65504 65504 ECU_ADDRESS_EXTENSION 0x2 BYTE_ORDER MSB_LAST /end CHARACTERISTIC
/begin CHARACTERISTIC _g_PL_AD_fw_Radar_1R1V_rpc_LocBypassingRunnable_LocBypassingRunnable_m_pad_ensRLocationsPort_par_out_local.TChangeableMemPool._._._m_arrayPool._0_._elem._m_LocationList._Item._51_._thetaQly "" VALUE 0xB001068A __UByte_Value 0 NO_COMPU_METHOD 0 255 ECU_ADDRESS_EXTENSION 0x2 BYTE_ORDER MSB_LAST /end CHARACTERISTIC
/begin CHARACTERISTIC _g_PL_AD_fw_Radar_1R1V_rpc_LocBypassingRunnable_LocBypassingRunnable_m_pad_ensRLocationsPort_par_out_local.TChangeableMemPool._._._m_arrayPool._0_._elem._m_LocationList._Item._51_._thetaVar._m_value "" VALUE 0xB001068C __Float16_Value 0 NO_COMPU_METHOD -65504 65504 ECU_ADDRESS_EXTENSION 0x2 BYTE_ORDER MSB_LAST /end CHARACTERISTIC
/begin CHARACTERISTIC _g_PL_AD_fw_Radar_1R1V_rpc_LocBypassingRunnable_LocBypassingRunnable_m_pad_ensRLocationsPort_par_out_local.TChangeableMemPool._._._m_arrayPool._0_._elem._m_LocationList._Item._51_._v "" VALUE 0xB001067C __Float32_Value 0 NO_COMPU_METHOD -3.4028234663852886E+38 3.4028234663852886E+38 ECU_ADDRESS_EXTENSION 0x2 BYTE_ORDER MSB_LAST /end CHARACTERISTIC
/begin CHARACTERISTIC _g_PL_AD_fw_Radar_1R1V_rpc_LocBypassingRunnable_LocBypassingRunnable_m_pad_ensRLocationsPort_par_out_local.TChangeableMemPool._._._m_arrayPool._0_._elem._m_LocationList._Item._51_._vVar._m_value "" VALUE 0xB0010682 __Float16_Value 0 NO_COMPU_METHOD -65504 65504 ECU_ADDRESS_EXTENSION 0x2 BYTE_ORDER MSB_LAST /end CHARACTERISTIC
/begin CHARACTERISTIC _g_PL_AD_fw_Radar_1R1V_rpc_LocBypassingRunnable_LocBypassingRunnable_m_pad_ensRLocationsPort_par_out_local.TChangeableMemPool._._._m_arrayPool._0_._elem._m_LocationList._Item._52_._Rcs._m_value "" VALUE 0xB00106B0 __Float16_Value 0 NO_COMPU_METHOD -65504 65504 ECU_ADDRESS_EXTENSION 0x2 BYTE_ORDER MSB_LAST /end CHARACTERISTIC
/begin CHARACTERISTIC _g_PL_AD_fw_Radar_1R1V_rpc_LocBypassingRunnable_LocBypassingRunnable_m_pad_ensRLocationsPort_par_out_local.TChangeableMemPool._._._m_arrayPool._0_._elem._m_LocationList._Item._52_._Rssi._m_value "" VALUE 0xB00106B2 __Float16_Value 0 NO_COMPU_METHOD -65504 65504 ECU_ADDRESS_EXTENSION 0x2 BYTE_ORDER MSB_LAST /end CHARACTERISTIC
/begin CHARACTERISTIC _g_PL_AD_fw_Radar_1R1V_rpc_LocBypassingRunnable_LocBypassingRunnable_m_pad_ensRLocationsPort_par_out_local.TChangeableMemPool._._._m_arrayPool._0_._elem._m_LocationList._Item._52_._d "" VALUE 0xB0010698 __Float32_Value 0 NO_COMPU_METHOD -3.4028234663852886E+38 3.4028234663852886E+38 ECU_ADDRESS_EXTENSION 0x2 BYTE_ORDER MSB_LAST /end CHARACTERISTIC
/begin CHARACTERISTIC _g_PL_AD_fw_Radar_1R1V_rpc_LocBypassingRunnable_LocBypassingRunnable_m_pad_ensRLocationsPort_par_out_local.TChangeableMemPool._._._m_arrayPool._0_._elem._m_LocationList._Item._52_._dVar._m_value "" VALUE 0xB00106A0 __Float16_Value 0 NO_COMPU_METHOD -65504 65504 ECU_ADDRESS_EXTENSION 0x2 BYTE_ORDER MSB_LAST /end CHARACTERISTIC
/begin CHARACTERISTIC _g_PL_AD_fw_Radar_1R1V_rpc_LocBypassingRunnable_LocBypassingRunnable_m_pad_ensRLocationsPort_par_out_local.TChangeableMemPool._._._m_arrayPool._0_._elem._m_LocationList._Item._52_._dvCov._m_value "" VALUE 0xB00106A4 __Float16_Value 0 NO_COMPU_METHOD -65504 65504 ECU_ADDRESS_EXTENSION 0x2 BYTE_ORDER MSB_LAST /end CHARACTERISTIC
/begin CHARACTERISTIC _g_PL_AD_fw_Radar_1R1V_rpc_LocBypassingRunnable_LocBypassingRunnable_m_pad_ensRLocationsPort_par_out_local.TChangeableMemPool._._._m_arrayPool._0_._elem._m_LocationList._Item._52_._dvQly "" VALUE 0xB00106B4 __UByte_Value 0 NO_COMPU_METHOD 0 255 ECU_ADDRESS_EXTENSION 0x2 BYTE_ORDER MSB_LAST /end CHARACTERISTIC
/begin CHARACTERISTIC _g_PL_AD_fw_Radar_1R1V_rpc_LocBypassingRunnable_LocBypassingRunnable_m_pad_ensRLocationsPort_par_out_local.TChangeableMemPool._._._m_arrayPool._0_._elem._m_LocationList._Item._52_._idxAzimuthAmbiguityPeer "" VALUE 0xB00106B6 __UWord_Value 0 NO_COMPU_METHOD 0 65535 ECU_ADDRESS_EXTENSION 0x2 BYTE_ORDER MSB_LAST /end CHARACTERISTIC
/begin CHARACTERISTIC _g_PL_AD_fw_Radar_1R1V_rpc_LocBypassingRunnable_LocBypassingRunnable_m_pad_ensRLocationsPort_par_out_local.TChangeableMemPool._._._m_arrayPool._0_._elem._m_LocationList._Item._52_._measStatus "" VALUE 0xB00106B5 __UByte_Value 0 NO_COMPU_METHOD 0 255 ECU_ADDRESS_EXTENSION 0x2 BYTE_ORDER MSB_LAST /end CHARACTERISTIC
/begin CHARACTERISTIC _g_PL_AD_fw_Radar_1R1V_rpc_LocBypassingRunnable_LocBypassingRunnable_m_pad_ensRLocationsPort_par_out_local.TChangeableMemPool._._._m_arrayPool._0_._elem._m_LocationList._Item._52_._phi._m_value "" VALUE 0xB00106A8 __Float16_Value 0 NO_COMPU_METHOD -65504 65504 ECU_ADDRESS_EXTENSION 0x2 BYTE_ORDER MSB_LAST /end CHARACTERISTIC
/begin CHARACTERISTIC _g_PL_AD_fw_Radar_1R1V_rpc_LocBypassingRunnable_LocBypassingRunnable_m_pad_ensRLocationsPort_par_out_local.TChangeableMemPool._._._m_arrayPool._0_._elem._m_LocationList._Item._52_._phiQly "" VALUE 0xB00106AB __UByte_Value 0 NO_COMPU_METHOD 0 255 ECU_ADDRESS_EXTENSION 0x2 BYTE_ORDER MSB_LAST /end CHARACTERISTIC
/begin CHARACTERISTIC _g_PL_AD_fw_Radar_1R1V_rpc_LocBypassingRunnable_LocBypassingRunnable_m_pad_ensRLocationsPort_par_out_local.TChangeableMemPool._._._m_arrayPool._0_._elem._m_LocationList._Item._52_._phiVar._m_value "" VALUE 0xB00106AE __Float16_Value 0 NO_COMPU_METHOD -65504 65504 ECU_ADDRESS_EXTENSION 0x2 BYTE_ORDER MSB_LAST /end CHARACTERISTIC
/begin CHARACTERISTIC _g_PL_AD_fw_Radar_1R1V_rpc_LocBypassingRunnable_LocBypassingRunnable_m_pad_ensRLocationsPort_par_out_local.TChangeableMemPool._._._m_arrayPool._0_._elem._m_LocationList._Item._52_._theta._m_value "" VALUE 0xB00106A6 __Float16_Value 0 NO_COMPU_METHOD -65504 65504 ECU_ADDRESS_EXTENSION 0x2 BYTE_ORDER MSB_LAST /end CHARACTERISTIC
/begin CHARACTERISTIC _g_PL_AD_fw_Radar_1R1V_rpc_LocBypassingRunnable_LocBypassingRunnable_m_pad_ensRLocationsPort_par_out_local.TChangeableMemPool._._._m_arrayPool._0_._elem._m_LocationList._Item._52_._thetaQly "" VALUE 0xB00106AA __UByte_Value 0 NO_COMPU_METHOD 0 255 ECU_ADDRESS_EXTENSION 0x2 BYTE_ORDER MSB_LAST /end CHARACTERISTIC
/begin CHARACTERISTIC _g_PL_AD_fw_Radar_1R1V_rpc_LocBypassingRunnable_LocBypassingRunnable_m_pad_ensRLocationsPort_par_out_local.TChangeableMemPool._._._m_arrayPool._0_._elem._m_LocationList._Item._52_._thetaVar._m_value "" VALUE 0xB00106AC __Float16_Value 0 NO_COMPU_METHOD -65504 65504 ECU_ADDRESS_EXTENSION 0x2 BYTE_ORDER MSB_LAST /end CHARACTERISTIC
/begin CHARACTERISTIC _g_PL_AD_fw_Radar_1R1V_rpc_LocBypassingRunnable_LocBypassingRunnable_m_pad_ensRLocationsPort_par_out_local.TChangeableMemPool._._._m_arrayPool._0_._elem._m_LocationList._Item._52_._v "" VALUE 0xB001069C __Float32_Value 0 NO_COMPU_METHOD -3.4028234663852886E+38 3.4028234663852886E+38 ECU_ADDRESS_EXTENSION 0x2 BYTE_ORDER MSB_LAST /end CHARACTERISTIC
/begin CHARACTERISTIC _g_PL_AD_fw_Radar_1R1V_rpc_LocBypassingRunnable_LocBypassingRunnable_m_pad_ensRLocationsPort_par_out_local.TChangeableMemPool._._._m_arrayPool._0_._elem._m_LocationList._Item._52_._vVar._m_value "" VALUE 0xB00106A2 __Float16_Value 0 NO_COMPU_METHOD -65504 65504 ECU_ADDRESS_EXTENSION 0x2 BYTE_ORDER MSB_LAST /end CHARACTERISTIC
/begin CHARACTERISTIC _g_PL_AD_fw_Radar_1R1V_rpc_LocBypassingRunnable_LocBypassingRunnable_m_pad_ensRLocationsPort_par_out_local.TChangeableMemPool._._._m_arrayPool._0_._elem._m_LocationList._Item._53_._Rcs._m_value "" VALUE 0xB00106D0 __Float16_Value 0 NO_COMPU_METHOD -65504 65504 ECU_ADDRESS_EXTENSION 0x2 BYTE_ORDER MSB_LAST /end CHARACTERISTIC
/begin CHARACTERISTIC _g_PL_AD_fw_Radar_1R1V_rpc_LocBypassingRunnable_LocBypassingRunnable_m_pad_ensRLocationsPort_par_out_local.TChangeableMemPool._._._m_arrayPool._0_._elem._m_LocationList._Item._53_._Rssi._m_value "" VALUE 0xB00106D2 __Float16_Value 0 NO_COMPU_METHOD -65504 65504 ECU_ADDRESS_EXTENSION 0x2 BYTE_ORDER MSB_LAST /end CHARACTERISTIC
/begin CHARACTERISTIC _g_PL_AD_fw_Radar_1R1V_rpc_LocBypassingRunnable_LocBypassingRunnable_m_pad_ensRLocationsPort_par_out_local.TChangeableMemPool._._._m_arrayPool._0_._elem._m_LocationList._Item._53_._d "" VALUE 0xB00106B8 __Float32_Value 0 NO_COMPU_METHOD -3.4028234663852886E+38 3.4028234663852886E+38 ECU_ADDRESS_EXTENSION 0x2 BYTE_ORDER MSB_LAST /end CHARACTERISTIC
/begin CHARACTERISTIC _g_PL_AD_fw_Radar_1R1V_rpc_LocBypassingRunnable_LocBypassingRunnable_m_pad_ensRLocationsPort_par_out_local.TChangeableMemPool._._._m_arrayPool._0_._elem._m_LocationList._Item._53_._dVar._m_value "" VALUE 0xB00106C0 __Float16_Value 0 NO_COMPU_METHOD -65504 65504 ECU_ADDRESS_EXTENSION 0x2 BYTE_ORDER MSB_LAST /end CHARACTERISTIC
/begin CHARACTERISTIC _g_PL_AD_fw_Radar_1R1V_rpc_LocBypassingRunnable_LocBypassingRunnable_m_pad_ensRLocationsPort_par_out_local.TChangeableMemPool._._._m_arrayPool._0_._elem._m_LocationList._Item._53_._dvCov._m_value "" VALUE 0xB00106C4 __Float16_Value 0 NO_COMPU_METHOD -65504 65504 ECU_ADDRESS_EXTENSION 0x2 BYTE_ORDER MSB_LAST /end CHARACTERISTIC
/begin CHARACTERISTIC _g_PL_AD_fw_Radar_1R1V_rpc_LocBypassingRunnable_LocBypassingRunnable_m_pad_ensRLocationsPort_par_out_local.TChangeableMemPool._._._m_arrayPool._0_._elem._m_LocationList._Item._53_._dvQly "" VALUE 0xB00106D4 __UByte_Value 0 NO_COMPU_METHOD 0 255 ECU_ADDRESS_EXTENSION 0x2 BYTE_ORDER MSB_LAST /end CHARACTERISTIC
/begin CHARACTERISTIC _g_PL_AD_fw_Radar_1R1V_rpc_LocBypassingRunnable_LocBypassingRunnable_m_pad_ensRLocationsPort_par_out_local.TChangeableMemPool._._._m_arrayPool._0_._elem._m_LocationList._Item._53_._idxAzimuthAmbiguityPeer "" VALUE 0xB00106D6 __UWord_Value 0 NO_COMPU_METHOD 0 65535 ECU_ADDRESS_EXTENSION 0x2 BYTE_ORDER MSB_LAST /end CHARACTERISTIC
/begin CHARACTERISTIC _g_PL_AD_fw_Radar_1R1V_rpc_LocBypassingRunnable_LocBypassingRunnable_m_pad_ensRLocationsPort_par_out_local.TChangeableMemPool._._._m_arrayPool._0_._elem._m_LocationList._Item._53_._measStatus "" VALUE 0xB00106D5 __UByte_Value 0 NO_COMPU_METHOD 0 255 ECU_ADDRESS_EXTENSION 0x2 BYTE_ORDER MSB_LAST /end CHARACTERISTIC
/begin CHARACTERISTIC _g_PL_AD_fw_Radar_1R1V_rpc_LocBypassingRunnable_LocBypassingRunnable_m_pad_ensRLocationsPort_par_out_local.TChangeableMemPool._._._m_arrayPool._0_._elem._m_LocationList._Item._53_._phi._m_value "" VALUE 0xB00106C8 __Float16_Value 0 NO_COMPU_METHOD -65504 65504 ECU_ADDRESS_EXTENSION 0x2 BYTE_ORDER MSB_LAST /end CHARACTERISTIC
/begin CHARACTERISTIC _g_PL_AD_fw_Radar_1R1V_rpc_LocBypassingRunnable_LocBypassingRunnable_m_pad_ensRLocationsPort_par_out_local.TChangeableMemPool._._._m_arrayPool._0_._elem._m_LocationList._Item._53_._phiQly "" VALUE 0xB00106CB __UByte_Value 0 NO_COMPU_METHOD 0 255 ECU_ADDRESS_EXTENSION 0x2 BYTE_ORDER MSB_LAST /end CHARACTERISTIC
/begin CHARACTERISTIC _g_PL_AD_fw_Radar_1R1V_rpc_LocBypassingRunnable_LocBypassingRunnable_m_pad_ensRLocationsPort_par_out_local.TChangeableMemPool._._._m_arrayPool._0_._elem._m_LocationList._Item._53_._phiVar._m_value "" VALUE 0xB00106CE __Float16_Value 0 NO_COMPU_METHOD -65504 65504 ECU_ADDRESS_EXTENSION 0x2 BYTE_ORDER MSB_LAST /end CHARACTERISTIC
/begin CHARACTERISTIC _g_PL_AD_fw_Radar_1R1V_rpc_LocBypassingRunnable_LocBypassingRunnable_m_pad_ensRLocationsPort_par_out_local.TChangeableMemPool._._._m_arrayPool._0_._elem._m_LocationList._Item._53_._theta._m_value "" VALUE 0xB00106C6 __Float16_Value 0 NO_COMPU_METHOD -65504 65504 ECU_ADDRESS_EXTENSION 0x2 BYTE_ORDER MSB_LAST /end CHARACTERISTIC
/begin CHARACTERISTIC _g_PL_AD_fw_Radar_1R1V_rpc_LocBypassingRunnable_LocBypassingRunnable_m_pad_ensRLocationsPort_par_out_local.TChangeableMemPool._._._m_arrayPool._0_._elem._m_LocationList._Item._53_._thetaQly "" VALUE 0xB00106CA __UByte_Value 0 NO_COMPU_METHOD 0 255 ECU_ADDRESS_EXTENSION 0x2 BYTE_ORDER MSB_LAST /end CHARACTERISTIC
/begin CHARACTERISTIC _g_PL_AD_fw_Radar_1R1V_rpc_LocBypassingRunnable_LocBypassingRunnable_m_pad_ensRLocationsPort_par_out_local.TChangeableMemPool._._._m_arrayPool._0_._elem._m_LocationList._Item._53_._thetaVar._m_value "" VALUE 0xB00106CC __Float16_Value 0 NO_COMPU_METHOD -65504 65504 ECU_ADDRESS_EXTENSION 0x2 BYTE_ORDER MSB_LAST /end CHARACTERISTIC
/begin CHARACTERISTIC _g_PL_AD_fw_Radar_1R1V_rpc_LocBypassingRunnable_LocBypassingRunnable_m_pad_ensRLocationsPort_par_out_local.TChangeableMemPool._._._m_arrayPool._0_._elem._m_LocationList._Item._53_._v "" VALUE 0xB00106BC __Float32_Value 0 NO_COMPU_METHOD -3.4028234663852886E+38 3.4028234663852886E+38 ECU_ADDRESS_EXTENSION 0x2 BYTE_ORDER MSB_LAST /end CHARACTERISTIC
/begin CHARACTERISTIC _g_PL_AD_fw_Radar_1R1V_rpc_LocBypassingRunnable_LocBypassingRunnable_m_pad_ensRLocationsPort_par_out_local.TChangeableMemPool._._._m_arrayPool._0_._elem._m_LocationList._Item._53_._vVar._m_value "" VALUE 0xB00106C2 __Float16_Value 0 NO_COMPU_METHOD -65504 65504 ECU_ADDRESS_EXTENSION 0x2 BYTE_ORDER MSB_LAST /end CHARACTERISTIC
/begin CHARACTERISTIC _g_PL_AD_fw_Radar_1R1V_rpc_LocBypassingRunnable_LocBypassingRunnable_m_pad_ensRLocationsPort_par_out_local.TChangeableMemPool._._._m_arrayPool._0_._elem._m_LocationList._Item._54_._Rcs._m_value "" VALUE 0xB00106F0 __Float16_Value 0 NO_COMPU_METHOD -65504 65504 ECU_ADDRESS_EXTENSION 0x2 BYTE_ORDER MSB_LAST /end CHARACTERISTIC
/begin CHARACTERISTIC _g_PL_AD_fw_Radar_1R1V_rpc_LocBypassingRunnable_LocBypassingRunnable_m_pad_ensRLocationsPort_par_out_local.TChangeableMemPool._._._m_arrayPool._0_._elem._m_LocationList._Item._54_._Rssi._m_value "" VALUE 0xB00106F2 __Float16_Value 0 NO_COMPU_METHOD -65504 65504 ECU_ADDRESS_EXTENSION 0x2 BYTE_ORDER MSB_LAST /end CHARACTERISTIC
/begin CHARACTERISTIC _g_PL_AD_fw_Radar_1R1V_rpc_LocBypassingRunnable_LocBypassingRunnable_m_pad_ensRLocationsPort_par_out_local.TChangeableMemPool._._._m_arrayPool._0_._elem._m_LocationList._Item._54_._d "" VALUE 0xB00106D8 __Float32_Value 0 NO_COMPU_METHOD -3.4028234663852886E+38 3.4028234663852886E+38 ECU_ADDRESS_EXTENSION 0x2 BYTE_ORDER MSB_LAST /end CHARACTERISTIC
/begin CHARACTERISTIC _g_PL_AD_fw_Radar_1R1V_rpc_LocBypassingRunnable_LocBypassingRunnable_m_pad_ensRLocationsPort_par_out_local.TChangeableMemPool._._._m_arrayPool._0_._elem._m_LocationList._Item._54_._dVar._m_value "" VALUE 0xB00106E0 __Float16_Value 0 NO_COMPU_METHOD -65504 65504 ECU_ADDRESS_EXTENSION 0x2 BYTE_ORDER MSB_LAST /end CHARACTERISTIC
/begin CHARACTERISTIC _g_PL_AD_fw_Radar_1R1V_rpc_LocBypassingRunnable_LocBypassingRunnable_m_pad_ensRLocationsPort_par_out_local.TChangeableMemPool._._._m_arrayPool._0_._elem._m_LocationList._Item._54_._dvCov._m_value "" VALUE 0xB00106E4 __Float16_Value 0 NO_COMPU_METHOD -65504 65504 ECU_ADDRESS_EXTENSION 0x2 BYTE_ORDER MSB_LAST /end CHARACTERISTIC
/begin CHARACTERISTIC _g_PL_AD_fw_Radar_1R1V_rpc_LocBypassingRunnable_LocBypassingRunnable_m_pad_ensRLocationsPort_par_out_local.TChangeableMemPool._._._m_arrayPool._0_._elem._m_LocationList._Item._54_._dvQly "" VALUE 0xB00106F4 __UByte_Value 0 NO_COMPU_METHOD 0 255 ECU_ADDRESS_EXTENSION 0x2 BYTE_ORDER MSB_LAST /end CHARACTERISTIC
/begin CHARACTERISTIC _g_PL_AD_fw_Radar_1R1V_rpc_LocBypassingRunnable_LocBypassingRunnable_m_pad_ensRLocationsPort_par_out_local.TChangeableMemPool._._._m_arrayPool._0_._elem._m_LocationList._Item._54_._idxAzimuthAmbiguityPeer "" VALUE 0xB00106F6 __UWord_Value 0 NO_COMPU_METHOD 0 65535 ECU_ADDRESS_EXTENSION 0x2 BYTE_ORDER MSB_LAST /end CHARACTERISTIC
/begin CHARACTERISTIC _g_PL_AD_fw_Radar_1R1V_rpc_LocBypassingRunnable_LocBypassingRunnable_m_pad_ensRLocationsPort_par_out_local.TChangeableMemPool._._._m_arrayPool._0_._elem._m_LocationList._Item._54_._measStatus "" VALUE 0xB00106F5 __UByte_Value 0 NO_COMPU_METHOD 0 255 ECU_ADDRESS_EXTENSION 0x2 BYTE_ORDER MSB_LAST /end CHARACTERISTIC
/begin CHARACTERISTIC _g_PL_AD_fw_Radar_1R1V_rpc_LocBypassingRunnable_LocBypassingRunnable_m_pad_ensRLocationsPort_par_out_local.TChangeableMemPool._._._m_arrayPool._0_._elem._m_LocationList._Item._54_._phi._m_value "" VALUE 0xB00106E8 __Float16_Value 0 NO_COMPU_METHOD -65504 65504 ECU_ADDRESS_EXTENSION 0x2 BYTE_ORDER MSB_LAST /end CHARACTERISTIC
/begin CHARACTERISTIC _g_PL_AD_fw_Radar_1R1V_rpc_LocBypassingRunnable_LocBypassingRunnable_m_pad_ensRLocationsPort_par_out_local.TChangeableMemPool._._._m_arrayPool._0_._elem._m_LocationList._Item._54_._phiQly "" VALUE 0xB00106EB __UByte_Value 0 NO_COMPU_METHOD 0 255 ECU_ADDRESS_EXTENSION 0x2 BYTE_ORDER MSB_LAST /end CHARACTERISTIC
/begin CHARACTERISTIC _g_PL_AD_fw_Radar_1R1V_rpc_LocBypassingRunnable_LocBypassingRunnable_m_pad_ensRLocationsPort_par_out_local.TChangeableMemPool._._._m_arrayPool._0_._elem._m_LocationList._Item._54_._phiVar._m_value "" VALUE 0xB00106EE __Float16_Value 0 NO_COMPU_METHOD -65504 65504 ECU_ADDRESS_EXTENSION 0x2 BYTE_ORDER MSB_LAST /end CHARACTERISTIC
/begin CHARACTERISTIC _g_PL_AD_fw_Radar_1R1V_rpc_LocBypassingRunnable_LocBypassingRunnable_m_pad_ensRLocationsPort_par_out_local.TChangeableMemPool._._._m_arrayPool._0_._elem._m_LocationList._Item._54_._theta._m_value "" VALUE 0xB00106E6 __Float16_Value 0 NO_COMPU_METHOD -65504 65504 ECU_ADDRESS_EXTENSION 0x2 BYTE_ORDER MSB_LAST /end CHARACTERISTIC
/begin CHARACTERISTIC _g_PL_AD_fw_Radar_1R1V_rpc_LocBypassingRunnable_LocBypassingRunnable_m_pad_ensRLocationsPort_par_out_local.TChangeableMemPool._._._m_arrayPool._0_._elem._m_LocationList._Item._54_._thetaQly "" VALUE 0xB00106EA __UByte_Value 0 NO_COMPU_METHOD 0 255 ECU_ADDRESS_EXTENSION 0x2 BYTE_ORDER MSB_LAST /end CHARACTERISTIC
/begin CHARACTERISTIC _g_PL_AD_fw_Radar_1R1V_rpc_LocBypassingRunnable_LocBypassingRunnable_m_pad_ensRLocationsPort_par_out_local.TChangeableMemPool._._._m_arrayPool._0_._elem._m_LocationList._Item._54_._thetaVar._m_value "" VALUE 0xB00106EC __Float16_Value 0 NO_COMPU_METHOD -65504 65504 ECU_ADDRESS_EXTENSION 0x2 BYTE_ORDER MSB_LAST /end CHARACTERISTIC
/begin CHARACTERISTIC _g_PL_AD_fw_Radar_1R1V_rpc_LocBypassingRunnable_LocBypassingRunnable_m_pad_ensRLocationsPort_par_out_local.TChangeableMemPool._._._m_arrayPool._0_._elem._m_LocationList._Item._54_._v "" VALUE 0xB00106DC __Float32_Value 0 NO_COMPU_METHOD -3.4028234663852886E+38 3.4028234663852886E+38 ECU_ADDRESS_EXTENSION 0x2 BYTE_ORDER MSB_LAST /end CHARACTERISTIC
/begin CHARACTERISTIC _g_PL_AD_fw_Radar_1R1V_rpc_LocBypassingRunnable_LocBypassingRunnable_m_pad_ensRLocationsPort_par_out_local.TChangeableMemPool._._._m_arrayPool._0_._elem._m_LocationList._Item._54_._vVar._m_value "" VALUE 0xB00106E2 __Float16_Value 0 NO_COMPU_METHOD -65504 65504 ECU_ADDRESS_EXTENSION 0x2 BYTE_ORDER MSB_LAST /end CHARACTERISTIC
/begin CHARACTERISTIC _g_PL_AD_fw_Radar_1R1V_rpc_LocBypassingRunnable_LocBypassingRunnable_m_pad_ensRLocationsPort_par_out_local.TChangeableMemPool._._._m_arrayPool._0_._elem._m_LocationList._Item._55_._Rcs._m_value "" VALUE 0xB0010710 __Float16_Value 0 NO_COMPU_METHOD -65504 65504 ECU_ADDRESS_EXTENSION 0x2 BYTE_ORDER MSB_LAST /end CHARACTERISTIC
/begin CHARACTERISTIC _g_PL_AD_fw_Radar_1R1V_rpc_LocBypassingRunnable_LocBypassingRunnable_m_pad_ensRLocationsPort_par_out_local.TChangeableMemPool._._._m_arrayPool._0_._elem._m_LocationList._Item._55_._Rssi._m_value "" VALUE 0xB0010712 __Float16_Value 0 NO_COMPU_METHOD -65504 65504 ECU_ADDRESS_EXTENSION 0x2 BYTE_ORDER MSB_LAST /end CHARACTERISTIC
/begin CHARACTERISTIC _g_PL_AD_fw_Radar_1R1V_rpc_LocBypassingRunnable_LocBypassingRunnable_m_pad_ensRLocationsPort_par_out_local.TChangeableMemPool._._._m_arrayPool._0_._elem._m_LocationList._Item._55_._d "" VALUE 0xB00106F8 __Float32_Value 0 NO_COMPU_METHOD -3.4028234663852886E+38 3.4028234663852886E+38 ECU_ADDRESS_EXTENSION 0x2 BYTE_ORDER MSB_LAST /end CHARACTERISTIC
/begin CHARACTERISTIC _g_PL_AD_fw_Radar_1R1V_rpc_LocBypassingRunnable_LocBypassingRunnable_m_pad_ensRLocationsPort_par_out_local.TChangeableMemPool._._._m_arrayPool._0_._elem._m_LocationList._Item._55_._dVar._m_value "" VALUE 0xB0010700 __Float16_Value 0 NO_COMPU_METHOD -65504 65504 ECU_ADDRESS_EXTENSION 0x2 BYTE_ORDER MSB_LAST /end CHARACTERISTIC
/begin CHARACTERISTIC _g_PL_AD_fw_Radar_1R1V_rpc_LocBypassingRunnable_LocBypassingRunnable_m_pad_ensRLocationsPort_par_out_local.TChangeableMemPool._._._m_arrayPool._0_._elem._m_LocationList._Item._55_._dvCov._m_value "" VALUE 0xB0010704 __Float16_Value 0 NO_COMPU_METHOD -65504 65504 ECU_ADDRESS_EXTENSION 0x2 BYTE_ORDER MSB_LAST /end CHARACTERISTIC
/begin CHARACTERISTIC _g_PL_AD_fw_Radar_1R1V_rpc_LocBypassingRunnable_LocBypassingRunnable_m_pad_ensRLocationsPort_par_out_local.TChangeableMemPool._._._m_arrayPool._0_._elem._m_LocationList._Item._55_._dvQly "" VALUE 0xB0010714 __UByte_Value 0 NO_COMPU_METHOD 0 255 ECU_ADDRESS_EXTENSION 0x2 BYTE_ORDER MSB_LAST /end CHARACTERISTIC
/begin CHARACTERISTIC _g_PL_AD_fw_Radar_1R1V_rpc_LocBypassingRunnable_LocBypassingRunnable_m_pad_ensRLocationsPort_par_out_local.TChangeableMemPool._._._m_arrayPool._0_._elem._m_LocationList._Item._55_._idxAzimuthAmbiguityPeer "" VALUE 0xB0010716 __UWord_Value 0 NO_COMPU_METHOD 0 65535 ECU_ADDRESS_EXTENSION 0x2 BYTE_ORDER MSB_LAST /end CHARACTERISTIC
/begin CHARACTERISTIC _g_PL_AD_fw_Radar_1R1V_rpc_LocBypassingRunnable_LocBypassingRunnable_m_pad_ensRLocationsPort_par_out_local.TChangeableMemPool._._._m_arrayPool._0_._elem._m_LocationList._Item._55_._measStatus "" VALUE 0xB0010715 __UByte_Value 0 NO_COMPU_METHOD 0 255 ECU_ADDRESS_EXTENSION 0x2 BYTE_ORDER MSB_LAST /end CHARACTERISTIC
/begin CHARACTERISTIC _g_PL_AD_fw_Radar_1R1V_rpc_LocBypassingRunnable_LocBypassingRunnable_m_pad_ensRLocationsPort_par_out_local.TChangeableMemPool._._._m_arrayPool._0_._elem._m_LocationList._Item._55_._phi._m_value "" VALUE 0xB0010708 __Float16_Value 0 NO_COMPU_METHOD -65504 65504 ECU_ADDRESS_EXTENSION 0x2 BYTE_ORDER MSB_LAST /end CHARACTERISTIC
/begin CHARACTERISTIC _g_PL_AD_fw_Radar_1R1V_rpc_LocBypassingRunnable_LocBypassingRunnable_m_pad_ensRLocationsPort_par_out_local.TChangeableMemPool._._._m_arrayPool._0_._elem._m_LocationList._Item._55_._phiQly "" VALUE 0xB001070B __UByte_Value 0 NO_COMPU_METHOD 0 255 ECU_ADDRESS_EXTENSION 0x2 BYTE_ORDER MSB_LAST /end CHARACTERISTIC
/begin COMPU_METHOD _Dcm_DsldGlobal_st._stDsdState_en.CONVERSION "@@@@RuleName created by CANape" TAB_VERB "%.0" "" COMPU_TAB_REF _Dcm_DsldGlobal_st._stDsdState_en.CONVERSION /end COMPU_METHOD
/begin COMPU_METHOD _Dcm_DsldGlobal_st._stResponseType_en.CONVERSION "@@@@RuleName created by CANape" TAB_VERB "%.0" "" COMPU_TAB_REF _Dcm_DsldGlobal_st._stResponseType_en.CONVERSION /end COMPU_METHOD
/begin COMPU_METHOD _Dcm_DsldTransmit_st._stDslNextState_en.CONVERSION "@@@@RuleName created by CANape" TAB_VERB "%.0" "" COMPU_TAB_REF _Dcm_DsldTransmit_st._stDslNextState_en.CONVERSION /end COMPU_METHOD
/begin COMPU_METHOD _Dcm_DspDataInfo_st._0_._usePort.CONVERSION "enumeration table" TAB_VERB "%.0" "" COMPU_TAB_REF _Dcm_DspDataInfo_st._0_._usePort.CONVERSION /end COMPU_METHOD
/begin COMPU_METHOD _Dcm_DspEcuResetType_cast._0_._resetForBoot.CONVERSION "@@@@RuleName created by CANape" TAB_VERB "%.0" "" COMPU_TAB_REF _Dcm_DspEcuResetType_cast._0_._resetForBoot.CONVERSION /end COMPU_METHOD
/begin COMPU_METHOD _Dcm_DspRDTCState_en.CONVERSION "@@@@RuleName created by CANape" TAB_VERB "%.0" "" COMPU_TAB_REF _Dcm_DspRDTCState_en.CONVERSION /end COMPU_METHOD
/begin COMPU_METHOD _Dcm_DspRDTCSubFunc_en.CONVERSION "@@@@RuleName created by CANape" TAB_VERB "%.0" "" COMPU_TAB_REF _Dcm_DspRDTCSubFunc_en.CONVERSION /end COMPU_METHOD
/begin COMPU_METHOD _Dcm_Dsp_Session._3_._sessionForBoot.CONVERSION "@@@@RuleName created by CANape" TAB_VERB "%.0" "" COMPU_TAB_REF _Dcm_Dsp_Session._3_._sessionForBoot.CONVERSION /end COMPU_METHOD
/begin COMPU_METHOD _Dcm_GetDataState_en.CONVERSION "@@@@RuleName created by CANape" TAB_VERB "%.0" "" COMPU_TAB_REF _Dcm_GetDataState_en.CONVERSION /end COMPU_METHOD
/begin COMPU_METHOD _Dcm_RoutineStatus_aen._2_.CONVERSION "@@@@RuleName created by CANape" TAB_VERB "%.0" "" COMPU_TAB_REF _Dcm_RoutineStatus_aen._2_.CONVERSION /end COMPU_METHOD
/begin COMPU_METHOD _Dcm_StLenCalc_en.CONVERSION "@@@@RuleName created by CANape" TAB_VERB "%.0" "" COMPU_TAB_REF _Dcm_StLenCalc_en.CONVERSION /end COMPU_METHOD
/begin COMPU_METHOD _Dcm_active_commode_e._0_._ComMState.CONVERSION "@@@@RuleName created by CANape" TAB_VERB "%.0" "" COMPU_TAB_REF _Dcm_active_commode_e._0_._ComMState.CONVERSION /end COMPU_METHOD
/begin COMPU_METHOD _Dcm_stDsc_en.CONVERSION "@@@@RuleName created by CANape" TAB_VERB "%.0" "" COMPU_TAB_REF _Dcm_stDsc_en.CONVERSION /end COMPU_METHOD
/begin COMPU_METHOD _Dcm_stDspRCState_en.CONVERSION "@@@@RuleName created by CANape" TAB_VERB "%.0" "" COMPU_TAB_REF _Dcm_stDspRCState_en.CONVERSION /end COMPU_METHOD
/begin COMPU_METHOD _Dcm_stDspStateWDBI_en.CONVERSION "@@@@RuleName created by CANape" TAB_VERB "%.0" "" COMPU_TAB_REF _Dcm_stDspStateWDBI_en.CONVERSION /end COMPU_METHOD
/begin COMPU_METHOD _Dcm_stEcuResetState_en.CONVERSION "@@@@RuleName created by CANape" TAB_VERB "%.0" "" COMPU_TAB_REF _Dcm_stEcuResetState_en.CONVERSION /end COMPU_METHOD
/begin COMPU_METHOD _Dcm_stRdbi_en.CONVERSION "@@@@RuleName created by CANape" TAB_VERB "%.0" "" COMPU_TAB_REF _Dcm_stRdbi_en.CONVERSION /end COMPU_METHOD
/begin COMPU_METHOD _EcuSh_RequestedState_N.CONVERSION "@@@@RuleName created by CANape" TAB_VERB "%.0" "" COMPU_TAB_REF _EcuSh_RequestedState_N.CONVERSION /end COMPU_METHOD
/begin COMPU_METHOD _Fee_Prv_DriverState_en.CONVERSION "enumeration table" TAB_VERB "%.0" "" COMPU_TAB_REF _Fee_Prv_DriverState_en.CONVERSION /end COMPU_METHOD
/begin COMPU_METHOD _Fee_Prv_MediumLoad_st._state_en.CONVERSION "@@@@RuleName created by CANape" TAB_VERB "%.0" "" COMPU_TAB_REF _Fee_Prv_MediumLoad_st._state_en.CONVERSION /end COMPU_METHOD
/begin COMPU_METHOD _Fee_Prv_MediumWrite_st._state_en.CONVERSION "@@@@RuleName created by CANape" TAB_VERB "%.0" "" COMPU_TAB_REF _Fee_Prv_MediumWrite_st._state_en.CONVERSION /end COMPU_METHOD
/begin COMPU_METHOD _Fee_Prv_Order_st._firstInitMigrationResult_aen._9_.CONVERSION "@@@@RuleName created by CANape" TAB_VERB "%.0" "" COMPU_TAB_REF _Fee_Prv_Order_st._firstInitMigrationResult_aen._9_.CONVERSION /end COMPU_METHOD
/begin COMPU_METHOD _Fee_Prv_Order_st._jobs_ast._2_._type_en.CONVERSION "@@@@RuleName created by CANape" TAB_VERB "%.0" "" COMPU_TAB_REF _Fee_Prv_Order_st._jobs_ast._2_._type_en.CONVERSION /end COMPU_METHOD
/begin COMPU_METHOD _Fee_stMain.CONVERSION "@@@@RuleName created by CANape" TAB_VERB "%.0" "" COMPU_TAB_REF _Fee_stMain.CONVERSION /end COMPU_METHOD
/begin COMPU_METHOD _Fls_Mode.CONVERSION "@@@@RuleName created by CANape" TAB_VERB "%.0" "" COMPU_TAB_REF _Fls_Mode.CONVERSION /end COMPU_METHOD
/begin COMPU_METHOD _Fls_Rb_Order_st._1_._OrderType_en.CONVERSION "@@@@RuleName created by CANape" TAB_VERB "%.0" "" COMPU_TAB_REF _Fls_Rb_Order_st._1_._OrderType_en.CONVERSION /end COMPU_METHOD
/begin COMPU_METHOD _Fls_Rb_stSuspend_en.CONVERSION "@@@@RuleName created by CANape" TAB_VERB "%.0" "" COMPU_TAB_REF _Fls_Rb_stSuspend_en.CONVERSION /end COMPU_METHOD
/begin COMPU_METHOD _Fls_stMain.CONVERSION "@@@@RuleName created by CANape" TAB_VERB "%.0" "" COMPU_TAB_REF _Fls_stMain.CONVERSION /end COMPU_METHOD
/begin COMPU_METHOD _IpduM_TxRamData._0_._TxState.CONVERSION "@@@@RuleName created by CANape" TAB_VERB "%.0" "" COMPU_TAB_REF _IpduM_TxRamData._0_._TxState.CONVERSION /end COMPU_METHOD
/begin COMPU_METHOD _IpduM_Uninit_Flag.CONVERSION "@@@@RuleName created by CANape" TAB_VERB "%.0" "" COMPU_TAB_REF _IpduM_Uninit_Flag.CONVERSION /end COMPU_METHOD
/begin COMPU_METHOD _NvM_Prv_AuxMigrationResult.CONVERSION "@@@@RuleName created by CANape" TAB_VERB "%.0" "" COMPU_TAB_REF _NvM_Prv_AuxMigrationResult.CONVERSION /end COMPU_METHOD
/begin COMPU_METHOD _NvM_Prv_BlockDescriptors_acst._9_._BlockManagementType_en.CONVERSION "@@@@RuleName created by CANape" TAB_VERB "%.0" "" COMPU_TAB_REF _NvM_Prv_BlockDescriptors_acst._9_._BlockManagementType_en.CONVERSION /end COMPU_METHOD
/begin COMPU_METHOD _NvM_Prv_Main_st._Activity_rAMwM_en.CONVERSION "@@@@RuleName created by CANape" TAB_VERB "%.0" "" COMPU_TAB_REF _NvM_Prv_Main_st._Activity_rAMwM_en.CONVERSION /end COMPU_METHOD
/begin COMPU_METHOD _NvM_Prv_Main_st._idActiveJob_rMwM_en.CONVERSION "@@@@RuleName created by CANape" TAB_VERB "%.0" "" COMPU_TAB_REF _NvM_Prv_Main_st._idActiveJob_rMwM_en.CONVERSION /end COMPU_METHOD
/begin COMPU_METHOD _NvM_Prv_Main_st._stActiveJobResult_rMwM_en.CONVERSION "@@@@RuleName created by CANape" TAB_VERB "%.0" "" COMPU_TAB_REF _NvM_Prv_Main_st._stActiveJobResult_rMwM_en.CONVERSION /end COMPU_METHOD
/begin COMPU_METHOD _Os_StackLog_st._Reason.CONVERSION "@@@@RuleName created by CANape" TAB_VERB "%.0" "" COMPU_TAB_REF _Os_StackLog_st._Reason.CONVERSION /end COMPU_METHOD
/begin COMPU_METHOD _Os_const_spinlocks._4_._extra_lock.CONVERSION "@@@@RuleName created by CANape" TAB_VERB "%.0" "" COMPU_TAB_REF _Os_const_spinlocks._4_._extra_lock.CONVERSION /end COMPU_METHOD
/begin COMPU_METHOD _Os_dyn_appstate._3_.CONVERSION "@@@@RuleName created by CANape" TAB_VERB "%.0" "" COMPU_TAB_REF _Os_dyn_appstate._3_.CONVERSION /end COMPU_METHOD
/begin COMPU_METHOD _PduR_State.CONVERSION "@@@@RuleName created by CANape" TAB_VERB "%.0" "" COMPU_TAB_REF _PduR_State.CONVERSION /end COMPU_METHOD
/begin COMPU_METHOD _Port_Detailled_Cfg._0_._iocr.CONVERSION "enumeration table" TAB_VERB "%.0" "" COMPU_TAB_REF _Port_Detailled_Cfg._0_._iocr.CONVERSION /end COMPU_METHOD
/begin COMPU_METHOD _StbM_Cfg_LocalTimeClockArray_ast._0_._StbMLocalTimeHardware_e.CONVERSION "enumeration table" TAB_VERB "%.0" "" COMPU_TAB_REF _StbM_Cfg_LocalTimeClockArray_ast._0_._StbMLocalTimeHardware_e.CONVERSION /end COMPU_METHOD
/begin COMPU_METHOD _StbM_Cfg_SynchronizedTimeBaseArray_ast._0_._StbMState_e.CONVERSION "enumeration table" TAB_VERB "%.0" "" COMPU_TAB_REF _StbM_Cfg_SynchronizedTimeBaseArray_ast._0_._StbMState_e.CONVERSION /end COMPU_METHOD
/begin COMPU_METHOD _StbM_Cfg_SynchronizedTimeBaseArray_ast._0_._StoreTimebaseNonVolatile_e.CONVERSION "enumeration table" TAB_VERB "%.0" "" COMPU_TAB_REF _StbM_Cfg_SynchronizedTimeBaseArray_ast._0_._StoreTimebaseNonVolatile_e.CONVERSION /end COMPU_METHOD
/begin COMPU_METHOD _Xcp_Cleared._0_._BgActivityState.CONVERSION "@@@@RuleName created by CANape" TAB_VERB "%.0" "" COMPU_TAB_REF _Xcp_Cleared._0_._BgActivityState.CONVERSION /end COMPU_METHOD
/begin COMPU_METHOD _Xcp_NoInit._0_._DaqConfig._DaqState_en.CONVERSION "@@@@RuleName created by CANape" TAB_VERB "%.0" "" COMPU_TAB_REF _Xcp_NoInit._0_._DaqConfig._DaqState_en.CONVERSION /end COMPU_METHOD
/begin COMPU_METHOD _Xcp_NoInit._0_._Session._XcpState_en.CONVERSION "enumeration table" TAB_VERB "%.0" "" COMPU_TAB_REF _Xcp_NoInit._0_._Session._XcpState_en.CONVERSION /end COMPU_METHOD
/begin COMPU_METHOD _Xcp_PlCfgConst._DaqRamCfg._0_._RamSectionType_en.CONVERSION "@@@@RuleName created by CANape" TAB_VERB "%.0" "" COMPU_TAB_REF _Xcp_PlCfgConst._DaqRamCfg._0_._RamSectionType_en.CONVERSION /end COMPU_METHOD
/begin COMPU_METHOD _Xcp_PlCfgConst._TlCfg._0_._Consistency_en.CONVERSION "enumeration table" TAB_VERB "%.0" "" COMPU_TAB_REF _Xcp_PlCfgConst._TlCfg._0_._Consistency_en.CONVERSION /end COMPU_METHOD
/begin COMPU_METHOD _Xcp_PlCfgConst._TlCfg._0_._IdFieldType_en.CONVERSION "@@@@RuleName created by CANape" TAB_VERB "%.0" "" COMPU_TAB_REF _Xcp_PlCfgConst._TlCfg._0_._IdFieldType_en.CONVERSION /end COMPU_METHOD
/begin COMPU_METHOD _Xcp_PlCfgConst._TlCfg._0_._OdtOptimizationType_en.CONVERSION "@@@@RuleName created by CANape" TAB_VERB "%.0" "" COMPU_TAB_REF _Xcp_PlCfgConst._TlCfg._0_._OdtOptimizationType_en.CONVERSION /end COMPU_METHOD
/begin COMPU_METHOD _Xcp_PlCfgConst._TlCfg._0_._OverloadType_en.CONVERSION "@@@@RuleName created by CANape" TAB_VERB "%.0" "" COMPU_TAB_REF _Xcp_PlCfgConst._TlCfg._0_._OverloadType_en.CONVERSION /end COMPU_METHOD
/begin COMPU_METHOD _Xcp_PlCfgConst._TlCfg._0_._TimestampType_en.CONVERSION "@@@@RuleName created by CANape" TAB_VERB "%.0" "" COMPU_TAB_REF _Xcp_PlCfgConst._TlCfg._0_._TimestampType_en.CONVERSION /end COMPU_METHOD
/begin COMPU_METHOD _bistmgr_DebugInfoAndStatus_st._lBist_en.CONVERSION "enumeration table" TAB_VERB "%.0" "" COMPU_TAB_REF _bistmgr_DebugInfoAndStatus_st._lBist_en.CONVERSION /end COMPU_METHOD
/begin COMPU_METHOD _bistmgr_DebugInfoAndStatus_st._mBist_en.CONVERSION "enumeration table" TAB_VERB "%.0" "" COMPU_TAB_REF _bistmgr_DebugInfoAndStatus_st._mBist_en.CONVERSION /end COMPU_METHOD
/begin COMPU_METHOD _bistmgr_DebugInfoAndStatus_st._monBist_en.CONVERSION "enumeration table" TAB_VERB "%.0" "" COMPU_TAB_REF _bistmgr_DebugInfoAndStatus_st._monBist_en.CONVERSION /end COMPU_METHOD
/begin COMPU_METHOD _bistmgr_State_en.CONVERSION "enumeration table" TAB_VERB "%.0" "" COMPU_TAB_REF _bistmgr_State_en.CONVERSION /end COMPU_METHOD
/begin COMPU_METHOD _g_1R1VApl_FCT_fsm_fsm._m_stateMachineController._m_accControlUnit._m_inputElementConfiguration._m_mainSwitch._m_currentAction.CONVERSION "@@@@RuleName created by CANape" TAB_VERB "%.0" "" COMPU_TAB_REF _g_1R1VApl_FCT_fsm_fsm._m_stateMachineController._m_accControlUnit._m_inputElementConfiguration._m_mainSwitch._m_currentAction.CONVERSION /end COMPU_METHOD
/begin COMPU_METHOD _g_1R1VApl_FCT_fsm_fsm._m_stateMachineController._m_accControlUnit._m_inputElementConfiguration._m_timeGapButton._m_currentAction.CONVERSION "@@@@RuleName created by CANape" TAB_VERB "%.0" "" COMPU_TAB_REF _g_1R1VApl_FCT_fsm_fsm._m_stateMachineController._m_accControlUnit._m_inputElementConfiguration._m_timeGapButton._m_currentAction.CONVERSION /end COMPU_METHOD
/begin COMPU_METHOD _g_1R1VApl_FCT_fsm_fsm._m_stateMachineController._m_accControlUnit._m_inputElementConfiguration._m_timeGapButton._m_previousSignal.CONVERSION "@@@@RuleName created by CANape" TAB_VERB "%.0" "" COMPU_TAB_REF _g_1R1VApl_FCT_fsm_fsm._m_stateMachineController._m_accControlUnit._m_inputElementConfiguration._m_timeGapButton._m_previousSignal.CONVERSION /end COMPU_METHOD
/begin COMPU_METHOD _g_1R1VApl_FCT_fsm_fsm._m_stateMachineController._m_accControlUnit._m_overloadResolver._m_resolutionStrategy.CONVERSION "@@@@RuleName created by CANape" TAB_VERB "%.0" "" COMPU_TAB_REF _g_1R1VApl_FCT_fsm_fsm._m_stateMachineController._m_accControlUnit._m_overloadResolver._m_resolutionStrategy.CONVERSION /end COMPU_METHOD
/begin COMPU_METHOD _g_1R1VApl_FCT_fsm_fsm._m_stateMachineController._m_accControlUnit._m_setspeedController._m_currentSpeedUnit.CONVERSION "@@@@RuleName created by CANape" TAB_VERB "%.0" "" COMPU_TAB_REF _g_1R1VApl_FCT_fsm_fsm._m_stateMachineController._m_accControlUnit._m_setspeedController._m_currentSpeedUnit.CONVERSION /end COMPU_METHOD
/begin COMPU_METHOD _g_1R1VApl_FCT_fsm_fsm._m_stateMachineController._m_accControlUnit._m_timeGapLevelController._m_behaviour.CONVERSION "@@@@RuleName created by CANape" TAB_VERB "%.0" "" COMPU_TAB_REF _g_1R1VApl_FCT_fsm_fsm._m_stateMachineController._m_accControlUnit._m_timeGapLevelController._m_behaviour.CONVERSION /end COMPU_METHOD
/begin COMPU_METHOD _g_1R1VApl_FCT_fsm_fsm._m_stateMachineController._m_functionalInputProcessor._m_daCoreStateNotificationCalculator._m_DaCoreState.CONVERSION "@@@@RuleName created by CANape" TAB_VERB "%.0" "" COMPU_TAB_REF _g_1R1VApl_FCT_fsm_fsm._m_stateMachineController._m_functionalInputProcessor._m_daCoreStateNotificationCalculator._m_DaCoreState.CONVERSION /end COMPU_METHOD
/begin COMPU_METHOD _g_1R1VApl_FCT_fsm_fsm._m_stateMachineController._m_longSmBehaviorList._m_memory._m_values._4_.CONVERSION "@@@@RuleName created by CANape" TAB_VERB "%.0" "" COMPU_TAB_REF _g_1R1VApl_FCT_fsm_fsm._m_stateMachineController._m_longSmBehaviorList._m_memory._m_values._4_.CONVERSION /end COMPU_METHOD
/begin COMPU_METHOD _g_1R1VApl_FCT_fsm_fsm._m_stateMachineController._m_longStateMachine.StateMachine._._m_stateMachineType.CONVERSION "@@@@RuleName created by CANape" TAB_VERB "%.0" "" COMPU_TAB_REF _g_1R1VApl_FCT_fsm_fsm._m_stateMachineController._m_longStateMachine.StateMachine._._m_stateMachineType.CONVERSION /end COMPU_METHOD
/begin COMPU_METHOD _g_1R1VApl_FCT_fsm_fsm_m_requestedBehaviorsTipl_local.TMemPool._._._m_pool._m_values._0_._elem._m_dynamicParameters._m_setSpeedConfiguration.CONVERSION "@@@@RuleName created by CANape" TAB_VERB "%.0" "" COMPU_TAB_REF _g_1R1VApl_FCT_fsm_fsm_m_requestedBehaviorsTipl_local.TMemPool._._._m_pool._m_values._0_._elem._m_dynamicParameters._m_setSpeedConfiguration.CONVERSION /end COMPU_METHOD
/begin COMPU_METHOD _g_DACore_RPM_CRPMExecution_CRPMExecution_m_portActiveWarnings_local.TMemPool._._._m_pool._m_values._0_._elem._m_activeWarnings._m_memory._m_values._2_._m_type.CONVERSION "@@@@RuleName created by CANape" TAB_VERB "%.0" "" COMPU_TAB_REF _g_DACore_RPM_CRPMExecution_CRPMExecution_m_portActiveWarnings_local.TMemPool._._._m_pool._m_values._0_._elem._m_activeWarnings._m_memory._m_values._2_._m_type.CONVERSION /end COMPU_METHOD
/begin COMPU_METHOD _g_DACore_SIT_RunnableBehaviorStrategyTIPL_RunnableBehaviorStrategyTIPL._m_behaviorStrategyTIPL._m_currentWorldModel._m_tiplObjects._m_value._9_.SitPredictedObject._._m_objectType.CONVERSION "@@@@RuleName created by CANape" TAB_VERB "%.0" "" COMPU_TAB_REF _g_DACore_SIT_RunnableBehaviorStrategyTIPL_RunnableBehaviorStrategyTIPL._m_behaviorStrategyTIPL._m_currentWorldModel._m_tiplObjects._m_value._9_.SitPredictedObject._._m_objectType.CONVERSION /end COMPU_METHOD
/begin COMPU_METHOD _g_DACore_SIT_RunnableBehaviorStrategyTIPL_RunnableBehaviorStrategyTIPL_m_environmentDataTipl_out_local.TMemPool._._._m_pool._m_values._0_._elem._m_egoData._m_vehicleStandStill.CONVERSION "@@@@RuleName created by CANape" TAB_VERB "%.0" "" COMPU_TAB_REF _g_DACore_SIT_RunnableBehaviorStrategyTIPL_RunnableBehaviorStrategyTIPL_m_environmentDataTipl_out_local.TMemPool._._._m_pool._m_values._0_._elem._m_egoData._m_vehicleStandStill.CONVERSION /end COMPU_METHOD
/begin COMPU_METHOD _g_DACore_SIT_RunnableBehaviorStrategyTIPL_RunnableBehaviorStrategyTIPL_m_environmentDataTipl_out_local.TMemPool._._._m_pool._m_values._0_._elem._m_predictedObjects._m_value._9_._m_driveByCorridor._m_objectBorderRelationRight._laneBorderId.CONVERSION "@@@@RuleName created by CANape" TAB_VERB "%.0" "" COMPU_TAB_REF _g_DACore_SIT_RunnableBehaviorStrategyTIPL_RunnableBehaviorStrategyTIPL_m_environmentDataTipl_out_local.TMemPool._._._m_pool._m_values._0_._elem._m_predictedObjects._m_value._9_._m_driveByCorridor._m_objectBorderRelationRight._laneBorderId.CONVERSION /end COMPU_METHOD
/begin COMPU_METHOD _g_DACore_SIT_RunnableBehaviorStrategyTIPL_RunnableBehaviorStrategyTIPL_m_environmentDataTipl_out_local.TMemPool._._._m_pool._m_values._0_._elem._m_predictedObjects._m_value._9_._m_drivingTaskInformation._m_drivingTask.CONVERSION "@@@@RuleName created by CANape" TAB_VERB "%.0" "" COMPU_TAB_REF _g_DACore_SIT_RunnableBehaviorStrategyTIPL_RunnableBehaviorStrategyTIPL_m_environmentDataTipl_out_local.TMemPool._._._m_pool._m_values._0_._elem._m_predictedObjects._m_value._9_._m_drivingTaskInformation._m_drivingTask.CONVERSION /end COMPU_METHOD
/begin COMPU_METHOD _g_DACore_SIT_RunnableBehaviorStrategyTIPL_RunnableBehaviorStrategyTIPL_m_environmentDataTipl_out_local.TMemPool._._._m_pool._m_values._0_._elem._m_predictedObjects._m_value._9_._m_drivingTaskInformation._m_targetLaneIndex.CONVERSION "@@@@RuleName created by CANape" TAB_VERB "%.0" "" COMPU_TAB_REF _g_DACore_SIT_RunnableBehaviorStrategyTIPL_RunnableBehaviorStrategyTIPL_m_environmentDataTipl_out_local.TMemPool._._._m_pool._m_values._0_._elem._m_predictedObjects._m_value._9_._m_drivingTaskInformation._m_targetLaneIndex.CONVERSION /end COMPU_METHOD
/begin COMPU_METHOD _g_DACore_SIT_RunnableDmi_RunnableDmi._m_hostVehicleLaneInteractionManager._m_drivingTaskRecognition._m_observables._m_directionIndicator.CONVERSION "@@@@RuleName created by CANape" TAB_VERB "%.0" "" COMPU_TAB_REF _g_DACore_SIT_RunnableDmi_RunnableDmi._m_hostVehicleLaneInteractionManager._m_drivingTaskRecognition._m_observables._m_directionIndicator.CONVERSION /end COMPU_METHOD
/begin COMPU_METHOD _g_DACore_SIT_RunnableImbaFollowPrecedingObject_RunnableImbaFollowPrecedingObject._m_behaviorFollowPrecedingObjectWithLateralControl._m_lockOnTargetBehaviorSelector.Behavior2ImitateDecider._._m_selectedBehavior2Imitate._m_relations._m_value._2_._m_relatableElementIdentifiers._m_value._1_._m_typeId.CONVERSION "@@@@RuleName created by CANape" TAB_VERB "%.0" "" COMPU_TAB_REF _g_DACore_SIT_RunnableImbaFollowPrecedingObject_RunnableImbaFollowPrecedingObject._m_behaviorFollowPrecedingObjectWithLateralControl._m_lockOnTargetBehaviorSelector.Behavior2ImitateDecider._._m_selectedBehavior2Imitate._m_relations._m_value._2_._m_relatableElementIdentifiers._m_value._1_._m_typeId.CONVERSION /end COMPU_METHOD
/begin COMPU_VTAB_RANGE _Dcm_DsldGlobal_st._stDsdState_en.CONVERSION "@@@@RuleName created by CANape" 5 0 0 "DSD_IDLE" 1 1 "DSD_VERIFY_DIAGNOSTIC_DATA" 2 2 "DSD_CALL_SERVICE" 3 3 "DSD_SEND" 4 4 "DSD_TX_CONFIRMATION" DEFAULT_VALUE "" /end COMPU_VTAB_RANGE
/begin COMPU_VTAB_RANGE _Dcm_DsldGlobal_st._stResponseType_en.CONVERSION "@@@@RuleName created by CANape" 2 0 0 "DCM_DSLD_POS_RESPONSE" 1 1 "DCM_DSLD_NEG_RESPONSE" DEFAULT_VALUE "" /end COMPU_VTAB_RANGE
/begin COMPU_VTAB_RANGE _Dcm_DsldTransmit_st._stDslNextState_en.CONVERSION "@@@@RuleName created by CANape" 15 0 0 "DSL_READY_FOR_RECEPTION" 1 1 "DSL_ROETYPE1_RECIEVED" 2 2 "DSL_RECEIVING" 3 3 "DSL_STOP_PROTOCOL" 4 4 "DSL_STOP_PROTOCOL_RECEIVING" 5 5 "DSL_STOP_ROE" 6 6 "DSL_REQUEST_RECEIVED" 7 7 "DSL_WAIT_FOR_P2MAX" 8 8 "DSL_SEND_WAITPEND" 9 9 "DSL_SEND_GENERAL_REJECT" 10 10 "DSL_SEND_FINAL_RESPONSE" 11 11 "DSL_WAIT_FOR_CONFIRMATION" 12 12 "DSL_WAIT_FOR_DATA" 13 13 "DSL_DATA_READY" 14 14 "DSL_WAIT_PAGE_TXCONFIRM" DEFAULT_VALUE "" /end COMPU_VTAB_RANGE
/begin COMPU_VTAB_RANGE _Dcm_DspDataInfo_st._0_._usePort.CONVERSION "" 8 0 0 "USE_BLOCK_ID" 1 1 "USE_DATA_ASYNCH_CLIENT_SERVER" 2 2 "USE_DATA_SENDER_RECEIVER" 3 3 "USE_DATA_SENDER_RECEIVER_AS_SERVICE" 4 4 "USE_DATA_SYNCH_CLIENT_SERVER" 5 5 "USE_ECU_SIGNAL" 6 6 "USE_DATA_SYNCH_FNC" 7 7 "USE_DATA_ASYNCH_FNC" DEFAULT_VALUE "" /end COMPU_VTAB_RANGE
/begin COMPU_VTAB_RANGE _Dcm_DspEcuResetType_cast._0_._resetForBoot.CONVERSION "@@@@RuleName created by CANape" 4 0 0 "DCM_RESET_NO_BOOT" 1 1 "DCM_RESET_OEM_BOOT" 2 2 "DCM_RESET_SYS_BOOT" 3 3 "DCM_RESET_DRIVE_TO_DRIVE" DEFAULT_VALUE "" /end COMPU_VTAB_RANGE
/begin COMPU_VTAB_RANGE _Dcm_DspRDTCState_en.CONVERSION "@@@@RuleName created by CANape" 3 0 0 "DSP_RDTC_UNINIT" 1 1 "DSP_RDTC_INIT" 2 2 "DSP_RDTC_CALLSERVICE" DEFAULT_VALUE "" /end COMPU_VTAB_RANGE
/begin COMPU_VTAB_RANGE _Dcm_DspRDTCSubFunc_en.CONVERSION "@@@@RuleName created by CANape" 4 0 0 "DSP_RDTC_SFUNINIT" 1 1 "DSP_RDTC_SFINIT" 2 2 "DSP_RDTC_SFCALCNUMDTC" 3 3 "DSP_RDTC_SFFILLRESP" DEFAULT_VALUE "" /end COMPU_VTAB_RANGE
/begin COMPU_VTAB_RANGE _Dcm_Dsp_Session._3_._sessionForBoot.CONVERSION "@@@@RuleName created by CANape" 3 0 0 "DCM_NO_BOOT" 1 1 "DCM_OEM_BOOT" 2 2 "DCM_SYS_BOOT" DEFAULT_VALUE "" /end COMPU_VTAB_RANGE
/begin COMPU_VTAB_RANGE _Dcm_GetDataState_en.CONVERSION "@@@@RuleName created by CANape" 3 0 0 "DCM_GETDATA_STATUS_INIT" 1 1 "DCM_GETDATA_STATUS_GETLENGTH" 2 2 "DCM_GETDATA_STATUS_GETDATA" DEFAULT_VALUE "" /end COMPU_VTAB_RANGE
/begin COMPU_VTAB_RANGE _Dcm_RoutineStatus_aen._2_.CONVERSION "@@@@RuleName created by CANape" 4 0 0 "DCM_ROUTINE_IDLE" 1 1 "DCM_ROUTINE_STOP" 2 2 "DCM_ROUTINE_STARTED" 3 3 "DCM_ROUTINE_STOP_PENDING" DEFAULT_VALUE "" /end COMPU_VTAB_RANGE
/begin COMPU_VTAB_RANGE _Dcm_StLenCalc_en.CONVERSION "@@@@RuleName created by CANape" 4 0 0 "DCM_LENCALC_STATUS_INIT" 1 1 "DCM_LENCALC_STATUS_GETINDEX" 2 2 "DCM_LENCALC_STATUS_GETLENGTH" 3 3 "DCM_LENCALC_STATUS_GETSUPPORT" DEFAULT_VALUE "" /end COMPU_VTAB_RANGE
/begin COMPU_VTAB_RANGE _Dcm_active_commode_e._0_._ComMState.CONVERSION "@@@@RuleName created by CANape" 3 0 0 "DCM_DSLD_NO_COM_MODE" 1 1 "DCM_DSLD_SILENT_COM_MODE" 2 2 "DCM_DSLD_FULL_COM_MODE" DEFAULT_VALUE "" /end COMPU_VTAB_RANGE
/begin COMPU_VTAB_RANGE _Dcm_stDsc_en.CONVERSION "@@@@RuleName created by CANape" 5 1 1 "DCM_DSP_DSC_INIT" 2 2 "DCM_DSP_DSC_WAIT" 3 3 "DCM_DSP_DSC_CHECK_PERMISSION" 4 4 "DCM_DSP_DSC_SEND_RESP" 5 5 "DCM_DSP_DSC_ERROR" DEFAULT_VALUE "" /end COMPU_VTAB_RANGE
/begin COMPU_VTAB_RANGE _Dcm_stDspRCState_en.CONVERSION "@@@@RuleName created by CANape" 3 1 1 "DCM_RC_IDLE" 2 2 "DCM_RC_PENDING" 3 3 "DCM_RC_CANCEL" DEFAULT_VALUE "" /end COMPU_VTAB_RANGE
/begin COMPU_VTAB_RANGE _Dcm_stDspStateWDBI_en.CONVERSION "@@@@RuleName created by CANape" 4 0 0 "DCM_DSP_WDBI_IDLE" 1 1 "DCM_DSP_WDBI_VALDATALEN" 2 2 "DCM_DSP_WDBI_CHECKACCESS" 3 3 "DCM_DSP_WDBI_WRITEDATAREC" DEFAULT_VALUE "" /end COMPU_VTAB_RANGE
/begin COMPU_VTAB_RANGE _Dcm_stEcuResetState_en.CONVERSION "@@@@RuleName created by CANape" 5 1 1 "DCM_ECURESET_IDLE" 2 2 "DCM_ECURESET_REQPERMISSION" 3 3 "DCM_ECURESET_WAIT" 4 4 "DCM_ECURESET_SENDRESPONSE" 5 5 "DCM_ECURESET_ERROR" DEFAULT_VALUE "" /end COMPU_VTAB_RANGE
/begin COMPU_VTAB_RANGE _Dcm_stRdbi_en.CONVERSION "@@@@RuleName created by CANape" 7 0 0 "DCM_RDBI_IDLE" 1 1 "DCM_RDBI_NEG_RESP" 2 2 "DCM_RDBI_PROCESS_NEW_DID" 3 3 "DCM_RDBI_CHECK_READACCESS" 4 4 "DCM_RDBI_CHECK_CONDITIONS" 5 5 "DCM_RDBI_GET_LENGTH" 6 6 "DCM_RDBI_GET_DATA" DEFAULT_VALUE "" /end COMPU_VTAB_RANGE
/begin COMPU_VTAB_RANGE _EcuSh_RequestedState_N.CONVERSION "@@@@RuleName created by CANape" 6 0 0 "EcuSh_StateNone_N" 1 1 "EcuSh_StateInit_N" 2 2 "EcuSh_StateStartup_N" 3 3 "EcuSh_StateRun_N" 4 4 "EcuSh_StatePostrun_N" 5 5 "EcuSh_StateShutdown_N" DEFAULT_VALUE "" /end COMPU_VTAB_RANGE
/begin COMPU_VTAB_RANGE _Fee_Prv_DriverState_en.CONVERSION "" 8 0 0 "FEE_PRV_DRIVERSTATE_UNINIT_E" 1 1 "FEE_PRV_DRIVERSTATE_INIT_E" 2 2 "FEE_PRV_DRIVERSTATE_BACKGROUND_E" 3 3 "FEE_PRV_DRIVERSTATE_IDLE_E" 4 4 "FEE_PRV_DRIVERSTATE_READ_E" 5 5 "FEE_PRV_DRIVERSTATE_WRITE_E" 6 6 "FEE_PRV_DRIVERSTATE_INVALIDATEBLOCK_E" 7 7 "FEE_PRV_DRIVERSTATE_BLOCKMAINTENANCE_E" DEFAULT_VALUE "" /end COMPU_VTAB_RANGE
/begin COMPU_VTAB_RANGE _Fee_Prv_MediumLoad_st._state_en.CONVERSION "@@@@RuleName created by CANape" 2 0 0 "FEE_PRV_LOAD_IDLE_E" 1 1 "FEE_PRV_LOAD_BUSY_E" DEFAULT_VALUE "" /end COMPU_VTAB_RANGE
/begin COMPU_VTAB_RANGE _Fee_Prv_MediumWrite_st._state_en.CONVERSION "@@@@RuleName created by CANape" 5 0 0 "FEE_PRV_MEDIUM_WRITE_IDLE_E" 1 1 "FEE_PRV_MEDIUM_WRITE_BLANKCHECK_E" 2 2 "FEE_PRV_MEDIUM_WRITE_PROGRAM_E" 3 3 "FEE_PRV_MEDIUM_WRITE_COMPARE_E" 4 4 "FEE_PRV_MEDIUM_WRITE_FINAL_E" DEFAULT_VALUE "" /end COMPU_VTAB_RANGE
/begin COMPU_VTAB_RANGE _Fee_Prv_Order_st._firstInitMigrationResult_aen._9_.CONVERSION "@@@@RuleName created by CANape" 6 0 0 "MEMIF_RB_MIGRATION_RESULT_INIT_E" 1 1 "MEMIF_RB_MIGRATION_RESULT_NOT_NECESSARY_E" 2 2 "MEMIF_RB_MIGRATION_RESULT_TO_SMALLER_SIZE_E" 3 3 "MEMIF_RB_MIGRATION_RESULT_TO_BIGGER_SIZE_E" 4 4 "MEMIF_RB_MIGRATION_RESULT_NOT_DONE_E" 5 5 "MEMIF_RB_MIGRATION_RESULT_DEACTIVATED_E" DEFAULT_VALUE "" /end COMPU_VTAB_RANGE
/begin COMPU_VTAB_RANGE _Fee_Prv_Order_st._jobs_ast._2_._type_en.CONVERSION "@@@@RuleName created by CANape" 5 0 0 "FEE_PRV_ORDERTYPE_NONE_E" 1 1 "FEE_PRV_ORDERTYPE_READ_E" 2 2 "FEE_PRV_ORDERTYPE_WRITE_E" 3 3 "FEE_PRV_ORDERTYPE_INVALIDATE_E" 4 4 "FEE_PRV_ORDERTYPE_BLOCKMAINTENANCE_E" DEFAULT_VALUE "" /end COMPU_VTAB_RANGE
/begin COMPU_VTAB_RANGE _Fee_stMain.CONVERSION "@@@@RuleName created by CANape" 2 0 0 "FEE_POLLING_MODE_E" 1 1 "FEE_NORMAL_MODE_E" DEFAULT_VALUE "" /end COMPU_VTAB_RANGE
/begin COMPU_VTAB_RANGE _Fls_Mode.CONVERSION "@@@@RuleName created by CANape" 2 0 0 "MEMIF_MODE_SLOW" 1 1 "MEMIF_MODE_FAST" DEFAULT_VALUE "" /end COMPU_VTAB_RANGE
/begin COMPU_VTAB_RANGE _Fls_Rb_Order_st._1_._OrderType_en.CONVERSION "@@@@RuleName created by CANape" 6 0 0 "FLS_RB_NO_ORDER_E" 1 1 "FLS_RB_READ_ORDER_E" 2 2 "FLS_RB_WRITE_ORDER_E" 3 3 "FLS_RB_ERASE_ORDER_E" 4 4 "FLS_RB_COMPARE_ORDER_E" 5 5 "FLS_RB_BLANK_CHECK_ORDER_E" DEFAULT_VALUE "" /end COMPU_VTAB_RANGE
/begin COMPU_VTAB_RANGE _Fls_Rb_stSuspend_en.CONVERSION "@@@@RuleName created by CANape" 6 0 0 "FLS_RB_ST_SUSPEND_IDLE_E" 1 1 "FLS_RB_ST_SUSPEND_REQUESTED_E" 2 2 "FLS_RB_ST_SUSPEND_DONE_E" 3 3 "FLS_RB_ST_SUSPEND_NOT_NECESSARY_E" 4 4 "FLS_RB_ST_SUSPEND_ACC_AND_EXEC_ORDERS_E" 5 5 "FLS_RB_ST_RESUME_REQUESTED_E" DEFAULT_VALUE "" /end COMPU_VTAB_RANGE
/begin COMPU_VTAB_RANGE _Fls_stMain.CONVERSION "@@@@RuleName created by CANape" 4 0 0 "MEMIF_UNINIT" 1 1 "MEMIF_IDLE" 2 2 "MEMIF_BUSY" 3 3 "MEMIF_BUSY_INTERNAL" DEFAULT_VALUE "" /end COMPU_VTAB_RANGE
/begin COMPU_VTAB_RANGE _IpduM_TxRamData._0_._TxState.CONVERSION "@@@@RuleName created by CANape" 2 0 0 "IPDUM_TX_READY" 1 1 "IPDUM_TX_REQUESTED" DEFAULT_VALUE "" /end COMPU_VTAB_RANGE
/begin COMPU_VTAB_RANGE _IpduM_Uninit_Flag.CONVERSION "@@@@RuleName created by CANape" 2 0 0 "IPDUM_UNINIT" 1 1 "IPDUM_INIT" DEFAULT_VALUE "" /end COMPU_VTAB_RANGE
/begin COMPU_VTAB_RANGE _NvM_Prv_AuxMigrationResult.CONVERSION "@@@@RuleName created by CANape" 6 0 0 "NVM_RB_MIGRATION_RESULT_INIT_E" 1 1 "NVM_RB_MIGRATION_RESULT_NOT_NECESSARY_E" 2 2 "NVM_RB_MIGRATION_RESULT_TO_SMALLER_SIZE_E" 3 3 "NVM_RB_MIGRATION_RESULT_TO_BIGGER_SIZE_E" 4 4 "NVM_RB_MIGRATION_RESULT_NOT_DONE_E" 5 5 "NVM_RB_MIGRATION_RESULT_DEACTIVATED_E" DEFAULT_VALUE "" /end COMPU_VTAB_RANGE
/begin COMPU_VTAB_RANGE _NvM_Prv_BlockDescriptors_acst._9_._BlockManagementType_en.CONVERSION "@@@@RuleName created by CANape" 3 0 0 "NVM_BLOCK_NATIVE" 1 1 "NVM_BLOCK_REDUNDANT" 2 2 "NVM_BLOCK_DATASET" DEFAULT_VALUE "" /end COMPU_VTAB_RANGE
/begin COMPU_VTAB_RANGE _NvM_Prv_Main_st._Activity_rAMwM_en.CONVERSION "@@@@RuleName created by CANape" 6 0 0 "NVM_PRV_ACTIVITY_NOT_INIT" 1 1 "NVM_PRV_ACTIVITY_IDLE" 2 2 "NVM_PRV_ACTIVITY_ARBITRATE" 3 3 "NVM_PRV_ACTIVITY_JOB_START" 4 4 "NVM_PRV_ACTIVITY_POLL_RESULT" 5 5 "NVM_PRV_ACTIVITY_RESULT_EVAL" DEFAULT_VALUE "" /end COMPU_VTAB_RANGE
/begin COMPU_VTAB_RANGE _NvM_Prv_Main_st._idActiveJob_rMwM_en.CONVERSION "@@@@RuleName created by CANape" 8 0 0 "NVM_PRV_JOB_ID_IDLE" 1 1 "NVM_PRV_JOB_ID_READ" 2 2 "NVM_PRV_JOB_ID_WRITE" 3 3 "NVM_PRV_JOB_ID_INVALIDATE" 4 4 "NVM_PRV_JOB_ID_ERASE" 5 5 "NVM_PRV_JOB_ID_RESTORE" 6 6 "NVM_PRV_JOB_ID_MAINTAIN" 7 7 "NVM_PRV_JOB_ID_VALIDATE" DEFAULT_VALUE "" /end COMPU_VTAB_RANGE
/begin COMPU_VTAB_RANGE _NvM_Prv_Main_st._stActiveJobResult_rMwM_en.CONVERSION "@@@@RuleName created by CANape" 6 0 0 "MEMIF_JOB_OK" 1 1 "MEMIF_JOB_FAILED" 2 2 "MEMIF_JOB_PENDING" 3 3 "MEMIF_JOB_CANCELED" 4 4 "MEMIF_BLOCK_INCONSISTENT" 5 5 "MEMIF_BLOCK_INVALID" DEFAULT_VALUE "" /end COMPU_VTAB_RANGE
/begin COMPU_VTAB_RANGE _Os_StackLog_st._Reason.CONVERSION "@@@@RuleName created by CANape" 4 0 0 "OS_BUDGET" 1 1 "OS_ECC_START" 2 2 "OS_ECC_RESUME" 3 3 "OS_ECC_WAIT" DEFAULT_VALUE "" /end COMPU_VTAB_RANGE
/begin COMPU_VTAB_RANGE _Os_const_spinlocks._4_._extra_lock.CONVERSION "@@@@RuleName created by CANape" 4 0 0 "OS_LOCK_NOTHING" 1 1 "OS_LOCK_ALL" 2 2 "OS_LOCK_OS" 3 3 "OS_LOCK_TASKS" DEFAULT_VALUE "" /end COMPU_VTAB_RANGE
/begin COMPU_VTAB_RANGE _Os_dyn_appstate._3_.CONVERSION "@@@@RuleName created by CANape" 3 0 0 "APPLICATION_ACCESSIBLE" 1 1 "APPLICATION_RESTARTING" 2 2 "APPLICATION_TERMINATED" DEFAULT_VALUE "" /end COMPU_VTAB_RANGE
/begin COMPU_VTAB_RANGE _PduR_State.CONVERSION "@@@@RuleName created by CANape" 3 0 0 "PDUR_UNINIT" 1 1 "PDUR_REDUCED" 2 2 "PDUR_ONLINE" DEFAULT_VALUE "" /end COMPU_VTAB_RANGE
/begin COMPU_VTAB_RANGE _Port_Detailled_Cfg._0_._iocr.CONVERSION "" 20 0 0 "PORT_PIN_INPUT_NODEVICE" 1 1 "PORT_PIN_INPUT_PULLDOWN" 2 2 "PORT_PIN_INPUT_PULLUP" 16 16 "PORT_PIN_OUTPUT_GPIO_PUSHPULL" 17 17 "PORT_PIN_OUTPUT_ALTOUT1_PUSHPULL" 18 18 "PORT_PIN_OUTPUT_ALTOUT2_PUSHPULL" 19 19 "PORT_PIN_OUTPUT_ALTOUT3_PUSHPULL" 20 20 "PORT_PIN_OUTPUT_ALTOUT4_PUSHPULL" 21 21 "PORT_PIN_OUTPUT_ALTOUT5_PUSHPULL" 22 22 "PORT_PIN_OUTPUT_ALTOUT6_PUSHPULL" 23 23 "PORT_PIN_OUTPUT_ALTOUT7_PUSHPULL" 24 24 "PORT_PIN_OUTPUT_GPIO_OPENDRAIN" 25 25 "PORT_PIN_OUTPUT_ALTOUT1_OPENDRAIN" 26 26 "PORT_PIN_OUTPUT_ALTOUT2_OPENDRAIN" 27 27 "PORT_PIN_OUTPUT_ALTOUT3_OPENDRAIN" 28 28 "PORT_PIN_OUTPUT_ALTOUT4_OPENDRAIN" 29 29 "PORT_PIN_OUTPUT_ALTOUT5_OPENDRAIN" 30 30 "PORT_PIN_OUTPUT_ALTOUT6_OPENDRAIN" 31 31 "PORT_PIN_OUTPUT_ALTOUT7_OPENDRAIN" 32 32 "PORT_PIN_MODE_MAX" DEFAULT_VALUE "" /end COMPU_VTAB_RANGE
/begin COMPU_VTAB _StbM_Cfg_LocalTimeClockArray_ast._0_._StbMLocalTimeHardware_e.CONVERSION "enumeration table" TAB_VERB 4 0 "OS" 1 "ETHTSYN" 2 "GPT" 3 "STBMLOCALTIMEHARDWARE_NOT_CONFIGURED" /end COMPU_VTAB
/begin COMPU_VTAB _StbM_Cfg_SynchronizedTimeBaseArray_ast._0_._StbMState_e.CONVERSION "enumeration table" TAB_VERB 3 0 "MASTER" 1 "SLAVE" 2 "GATEWAY" /end COMPU_VTAB
/begin COMPU_VTAB _StbM_Cfg_SynchronizedTimeBaseArray_ast._0_._StoreTimebaseNonVolatile_e.CONVERSION "enumeration table" TAB_VERB 3 0 "NO_STORAGE" 1 "STORAGE_AT_SHUTDOWN" 2 "NVM_NOT_CONFIGURED" /end COMPU_VTAB
/begin COMPU_VTAB_RANGE _Xcp_Cleared._0_._BgActivityState.CONVERSION "@@@@RuleName created by CANape" 4 0 0 "XCP_BG_IDLE" 1 1 "XCP_BG_CHKSUM" 2 2 "XCP_BG_MEM_WRITE" 3 3 "XCP_BG_CANCEL_REQ" DEFAULT_VALUE "" /end COMPU_VTAB_RANGE
/begin COMPU_VTAB_RANGE _Xcp_NoInit._0_._DaqConfig._DaqState_en.CONVERSION "@@@@RuleName created by CANape" 10 0 0 "XCP_DAQ_STATE_NO_DAQ" 1 1 "XCP_DAQ_STATE_FREE_DAQ" 2 2 "XCP_DAQ_STATE_ALLOC_DAQ" 3 3 "XCP_DAQ_STATE_ALLOC_ODT" 4 4 "XCP_DAQ_STATE_ALLOC_ODT_ENTRY" 5 5 "XCP_DAQ_STATE_WRITE_DAQ" 6 6 "XCP_DAQ_STATE_PREPARE_START" 7 7 "XCP_DAQ_STATE_SHIFTING" 8 8 "XCP_DAQ_STATE_READY_TO_RUN" 9 9 "XCP_DAQ_STATE_RUNNING" DEFAULT_VALUE "" /end COMPU_VTAB_RANGE
/begin COMPU_VTAB_RANGE _Xcp_NoInit._0_._Session._XcpState_en.CONVERSION "" 5 0 0 "XCP_STATE_DISCONNECTED" 1 1 "XCP_STATE_DISCONNECTING" 2 2 "XCP_STATE_CONNECTED" 3 3 "XCP_STATE_RESUME" 240 240 "XCP_STATE_DISABLED" DEFAULT_VALUE "" /end COMPU_VTAB_RANGE
/begin COMPU_VTAB_RANGE _Xcp_PlCfgConst._DaqRamCfg._0_._RamSectionType_en.CONVERSION "@@@@RuleName created by CANape" 3 0 0 "XCP_RAMSECTION_INVALID" 1 1 "XCP_RAMSECTION_PD" 2 2 "XCP_RAMSECTION_ED" DEFAULT_VALUE "" /end COMPU_VTAB_RANGE
/begin COMPU_VTAB_RANGE _Xcp_PlCfgConst._TlCfg._0_._Consistency_en.CONVERSION "" 4 0 0 "XCP_CONSISTENCY_ODT" 1 1 "XCP_CONSISTENCY_DAQ" 2 2 "XCP_CONSISTENCY_EVENT" 3 3 "XCP_CONSISTENCY_NONE" DEFAULT_VALUE "" /end COMPU_VTAB_RANGE
/begin COMPU_VTAB_RANGE _Xcp_PlCfgConst._TlCfg._0_._IdFieldType_en.CONVERSION "@@@@RuleName created by CANape" 4 1 1 "XCP_IDENTIFICATION_FIELD_TYPE_ABSOLUTE" 2 2 "XCP_IDENTIFICATION_FIELD_TYPE_RELATIVE_BYTE" 3 3 "XCP_IDENTIFICATION_FIELD_TYPE_RELATIVE_WORD" 4 4 "XCP_IDENTIFICATION_FIELD_TYPE_RELATIVE_WORD_ALIGNED" DEFAULT_VALUE "" /end COMPU_VTAB_RANGE
/begin COMPU_VTAB_RANGE _Xcp_PlCfgConst._TlCfg._0_._OdtOptimizationType_en.CONVERSION "@@@@RuleName created by CANape" 6 0 0 "XCP_ODT_OPTIMIZATION_OM_DEFAULT" 1 1 "XCP_ODT_OPTIMIZATION_OM_ODT_TYPE_16" 2 2 "XCP_ODT_OPTIMIZATION_OM_ODT_TYPE_32" 3 3 "XCP_ODT_OPTIMIZATION_OM_ODT_TYPE_64" 4 4 "XCP_ODT_OPTIMIZATION_OM_ODT_TYPE_ALIGNMENT" 5 5 "XCP_ODT_OPTIMIZATION_OM_MAX_ENTRY_SIZE" DEFAULT_VALUE "" /end COMPU_VTAB_RANGE
/begin COMPU_VTAB_RANGE _Xcp_PlCfgConst._TlCfg._0_._OverloadType_en.CONVERSION "@@@@RuleName created by CANape" 3 0 0 "XCP_DAQ_NO_OVERLOAD_INDICATION" 1 1 "XCP_DAQ_OVERLOAD_INDICATION_PID" 2 2 "XCP_DAQ_OVERLOAD_INDICATION_EVENT" DEFAULT_VALUE "" /end COMPU_VTAB_RANGE
/begin COMPU_VTAB_RANGE _Xcp_PlCfgConst._TlCfg._0_._TimestampType_en.CONVERSION "@@@@RuleName created by CANape" 4 0 0 "XCP_TIMESTAMP_TYPE_NO_TIME_STAMP" 1 1 "XCP_TIMESTAMP_TYPE_ONE_BYTE" 2 2 "XCP_TIMESTAMP_TYPE_TWO_BYTE" 4 4 "XCP_TIMESTAMP_TYPE_FOUR_BYTE" DEFAULT_VALUE "" /end COMPU_VTAB_RANGE
/begin COMPU_VTAB _bistmgr_DebugInfoAndStatus_st._lBist_en.CONVERSION "enumeration table" TAB_VERB 3 0 "lbist_NotTested_e" 1 "lbist_Fail_e" 2 "lbist_Pass_e" /end COMPU_VTAB
/begin COMPU_VTAB _bistmgr_DebugInfoAndStatus_st._mBist_en.CONVERSION "enumeration table" TAB_VERB 3 0 "mbist_NotTested_e" 1 "mbist_Passed_e" 2 "mbist_Failed_e" /end COMPU_VTAB
/begin COMPU_VTAB _bistmgr_DebugInfoAndStatus_st._monBist_en.CONVERSION "enumeration table" TAB_VERB 3 0 "rbMonBist_NotTested_e" 1 "rbMonBist_Pass_e" 2 "rbMonBist_Fail_e" /end COMPU_VTAB
/begin COMPU_VTAB _bistmgr_State_en.CONVERSION "enumeration table" TAB_VERB 4 0 "BISTMGR_COLLECTSTATUS_E" 1 "BISTMGR_NVMWRITEREQ_E" 2 "BISTMGR_POLLNVMANDREPORTSTATUS_E" 3 "BISTMGR_IDLE_E" /end COMPU_VTAB
/begin COMPU_VTAB_RANGE _g_1R1VApl_FCT_fsm_fsm._m_stateMachineController._m_accControlUnit._m_inputElementConfiguration._m_mainSwitch._m_currentAction.CONVERSION "@@@@RuleName created by CANape" 2 0 0 "on" 1 1 "off" DEFAULT_VALUE "" /end COMPU_VTAB_RANGE
/begin COMPU_VTAB_RANGE _g_1R1VApl_FCT_fsm_fsm._m_stateMachineController._m_accControlUnit._m_inputElementConfiguration._m_timeGapButton._m_currentAction.CONVERSION "@@@@RuleName created by CANape" 3 0 0 "none" 1 1 "risingEdge" 2 2 "longPress" DEFAULT_VALUE "" /end COMPU_VTAB_RANGE
/begin COMPU_VTAB_RANGE _g_1R1VApl_FCT_fsm_fsm._m_stateMachineController._m_accControlUnit._m_inputElementConfiguration._m_timeGapButton._m_previousSignal.CONVERSION "@@@@RuleName created by CANape" 2 0 0 "inactive" 1 1 "active" DEFAULT_VALUE "" /end COMPU_VTAB_RANGE
/begin COMPU_VTAB_RANGE _g_1R1VApl_FCT_fsm_fsm._m_stateMachineController._m_accControlUnit._m_overloadResolver._m_resolutionStrategy.CONVERSION "@@@@RuleName created by CANape" 6 0 0 "chooseResumeSetOverPlusMinus" 1 1 "choosePlusMinusOverResumeSet" 2 2 "disableResumeSetPlusMinus" 3 3 "chooseTimeGapOverSetSpeed" 4 4 "chooseSetSpeedOverTimeGap" 5 5 "disableAllButMainSwitch" DEFAULT_VALUE "" /end COMPU_VTAB_RANGE
/begin COMPU_VTAB_RANGE _g_1R1VApl_FCT_fsm_fsm._m_stateMachineController._m_accControlUnit._m_setspeedController._m_currentSpeedUnit.CONVERSION "@@@@RuleName created by CANape" 2 0 0 "kmh" 1 1 "mph" DEFAULT_VALUE "" /end COMPU_VTAB_RANGE
/begin COMPU_VTAB_RANGE _g_1R1VApl_FCT_fsm_fsm._m_stateMachineController._m_accControlUnit._m_timeGapLevelController._m_behaviour.CONVERSION "@@@@RuleName created by CANape" 2 0 0 "loopAround" 1 1 "limitToRange" DEFAULT_VALUE "" /end COMPU_VTAB_RANGE
/begin COMPU_VTAB_RANGE _g_1R1VApl_FCT_fsm_fsm._m_stateMachineController._m_functionalInputProcessor._m_daCoreStateNotificationCalculator._m_DaCoreState.CONVERSION "@@@@RuleName created by CANape" 6 0 0 "DC_INVALID" 1 1 "DC_NOT_INITIALIZED" 2 2 "DC_STARTUP" 3 3 "DC_SAFE" 4 4 "DC_SHUTDOWN" 5 5 "DC_OOS" DEFAULT_VALUE "" /end COMPU_VTAB_RANGE
/begin COMPU_VTAB_RANGE _g_1R1VApl_FCT_fsm_fsm._m_stateMachineController._m_longSmBehaviorList._m_memory._m_values._4_.CONVERSION "@@@@RuleName created by CANape" 7 0 0 "AccTipl" 1 1 "AebFullBrakeTipl" 2 2 "FcwTipl" 3 3 "AebFullBrakeFm" 4 4 "AebPartialBrakeTipl" 5 5 "AccImba" 6 6 "FtaTipl" DEFAULT_VALUE "" /end COMPU_VTAB_RANGE
/begin COMPU_VTAB_RANGE _g_1R1VApl_FCT_fsm_fsm._m_stateMachineController._m_longStateMachine.StateMachine._._m_stateMachineType.CONVERSION "@@@@RuleName created by CANape" 7 0 0 "Longitudinal" 1 1 "SafetyFunctions" 2 2 "AebFullBrake" 3 3 "AebPartialBrake" 4 4 "ForwardCollisionWarning" 5 5 "AebPedestrian" 6 6 "FarsideTurnAssist" DEFAULT_VALUE "" /end COMPU_VTAB_RANGE
/begin COMPU_VTAB_RANGE _g_1R1VApl_FCT_fsm_fsm_m_requestedBehaviorsTipl_local.TMemPool._._._m_pool._m_values._0_._elem._m_dynamicParameters._m_setSpeedConfiguration.CONVERSION "@@@@RuleName created by CANape" 3 0 0 "off" 1 1 "cruiseControl" 2 2 "adaptiveCruiseControl" DEFAULT_VALUE "" /end COMPU_VTAB_RANGE
/begin COMPU_VTAB_RANGE _g_DACore_RPM_CRPMExecution_CRPMExecution_m_portActiveWarnings_local.TMemPool._._._m_pool._m_values._0_._elem._m_activeWarnings._m_memory._m_values._2_._m_type.CONVERSION "@@@@RuleName created by CANape" 5 0 0 "UNDEFINED" 1 1 "FORWARD_COLLISION_WARNING" 2 2 "LANE_DEPARTURE_WARNING" 3 3 "LANE_CHANGE_WARNING" 4 4 "REAR_CROSS_TRAFFIC_WARNING" DEFAULT_VALUE "" /end COMPU_VTAB_RANGE
/begin COMPU_VTAB_RANGE _g_DACore_SIT_RunnableBehaviorStrategyTIPL_RunnableBehaviorStrategyTIPL._m_behaviorStrategyTIPL._m_currentWorldModel._m_tiplObjects._m_value._9_.SitPredictedObject._._m_objectType.CONVERSION "@@@@RuleName created by CANape" 3 0 0 "OT_UNKNOWN" 1 1 "OT_VEHICLE" 2 2 "OT_VULNERABLE_ROAD_USER" DEFAULT_VALUE "" /end COMPU_VTAB_RANGE
/begin COMPU_VTAB_RANGE _g_DACore_SIT_RunnableBehaviorStrategyTIPL_RunnableBehaviorStrategyTIPL_m_environmentDataTipl_out_local.TMemPool._._._m_pool._m_values._0_._elem._m_egoData._m_vehicleStandStill.CONVERSION "@@@@RuleName created by CANape" 3 0 0 "moving" 1 1 "standstillNotReliable" 3 3 "standstillReliable" DEFAULT_VALUE "" /end COMPU_VTAB_RANGE
/begin COMPU_VTAB_RANGE _g_DACore_SIT_RunnableBehaviorStrategyTIPL_RunnableBehaviorStrategyTIPL_m_environmentDataTipl_out_local.TMemPool._._._m_pool._m_values._0_._elem._m_predictedObjects._m_value._9_._m_driveByCorridor._m_objectBorderRelationRight._laneBorderId.CONVERSION "@@@@RuleName created by CANape" 5 0 0 "borderLane0" 1 1 "borderLane01" 2 2 "borderLane12" 3 3 "borderLane2" 4 4 "borderLaneUnassigned" DEFAULT_VALUE "" /end COMPU_VTAB_RANGE
/begin COMPU_VTAB_RANGE _g_DACore_SIT_RunnableBehaviorStrategyTIPL_RunnableBehaviorStrategyTIPL_m_environmentDataTipl_out_local.TMemPool._._._m_pool._m_values._0_._elem._m_predictedObjects._m_value._9_._m_drivingTaskInformation._m_drivingTask.CONVERSION "@@@@RuleName created by CANape" 10 0 0 "laneKeeping0" 1 1 "laneKeeping1" 2 2 "laneKeeping2" 3 3 "laneChange01" 4 4 "laneChange10" 5 5 "laneChange12" 6 6 "laneChange21" 7 7 "outOfBoundsLeft" 8 8 "outOfBoundsRight" 9 9 "unknown" DEFAULT_VALUE "" /end COMPU_VTAB_RANGE
/begin COMPU_VTAB_RANGE _g_DACore_SIT_RunnableBehaviorStrategyTIPL_RunnableBehaviorStrategyTIPL_m_environmentDataTipl_out_local.TMemPool._._._m_pool._m_values._0_._elem._m_predictedObjects._m_value._9_._m_drivingTaskInformation._m_targetLaneIndex.CONVERSION "@@@@RuleName created by CANape" 4 0 0 "laneLeft" 1 1 "laneMiddle" 2 2 "laneRight" 255 255 "invalid" DEFAULT_VALUE "" /end COMPU_VTAB_RANGE
/begin COMPU_VTAB_RANGE _g_DACore_SIT_RunnableDmi_RunnableDmi._m_hostVehicleLaneInteractionManager._m_drivingTaskRecognition._m_observables._m_directionIndicator.CONVERSION "@@@@RuleName created by CANape" 3 0 0 "left" 1 1 "off" 2 2 "right" DEFAULT_VALUE "" /end COMPU_VTAB_RANGE
/begin COMPU_VTAB_RANGE _g_DACore_SIT_RunnableImbaFollowPrecedingObject_RunnableImbaFollowPrecedingObject._m_behaviorFollowPrecedingObjectWithLateralControl._m_lockOnTargetBehaviorSelector.Behavior2ImitateDecider._._m_selectedBehavior2Imitate._m_relations._m_value._2_._m_relatableElementIdentifiers._m_value._1_._m_typeId.CONVERSION "@@@@RuleName created by CANape" 5 0 0 "unknown" 1 1 "objectImba" 2 2 "egoVehicle" 3 3 "trajectory" 4 4 "polyline" DEFAULT_VALUE "" /end COMPU_VTAB_RANGE
/begin RECORD_LAYOUT __Float16_Value FNC_VALUES 1 FLOAT16_IEEE ROW_DIR DIRECT /end RECORD_LAYOUT
/begin RECORD_LAYOUT __Float32_Value FNC_VALUES 1 FLOAT32_IEEE ROW_DIR DIRECT /end RECORD_LAYOUT
/begin RECORD_LAYOUT __UByte_Value FNC_VALUES 1 UBYTE ROW_DIR DIRECT /end RECORD_LAYOUT
/begin RECORD_LAYOUT __UWord_Value FNC_VALUES 1 UWORD ROW_DIR DIRECT /end RECORD_LAYOUT
/end MODULE
/end PROJECT
