ASAP2_VERSION 1 71
/begin PROJECT RADAR_GEN5 ""
/begin HEADER "" VERSION "TO_BE_FILLED" /end HEADER
/begin MODULE RADAR_GEN5 ""
/begin MOD_COMMON "" ALIGNMENT_BYTE 1 ALIGNMENT_WORD 2 ALIGNMENT_LONG 4 ALIGNMENT_FLOAT16_IEEE 2 ALIGNMENT_FLOAT32_IEEE 4 ALIGNMENT_FLOAT64_IEEE 4 ALIGNMENT_INT64 4 /end MOD_COMMON
/begin CHARACTERISTIC _g_PL_AD_fw_Radar_1R1V_rpc_LocBypassingRunnable_LocBypassingRunnable_m_pad_ensRLocationsPort_par_out_local.TChangeableMemPool._._._m_arrayPool._0_._elem._m_LocationList._Item._77_._Rssi._m_value "" VALUE 0xB00109D2 __Float16_Value 0 NO_COMPU_METHOD -65504 65504 ECU_ADDRESS_EXTENSION 0x2 BYTE_ORDER MSB_LAST /end CHARACTERISTIC
/begin CHARACTERISTIC _g_PL_AD_fw_Radar_1R1V_rpc_LocBypassingRunnable_LocBypassingRunnable_m_pad_ensRLocationsPort_par_out_local.TChangeableMemPool._._._m_arrayPool._0_._elem._m_LocationList._Item._77_._d "" VALUE 0xB00109B8 __Float32_Value 0 NO_COMPU_METHOD -3.4028234663852886E+38 3.4028234663852886E+38 ECU_ADDRESS_EXTENSION 0x2 BYTE_ORDER MSB_LAST /end CHARACTERISTIC
/begin CHARACTERISTIC _g_PL_AD_fw_Radar_1R1V_rpc_LocBypassingRunnable_LocBypassingRunnable_m_pad_ensRLocationsPort_par_out_local.TChangeableMemPool._._._m_arrayPool._0_._elem._m_LocationList._Item._77_._dVar._m_value "" VALUE 0xB00109C0 __Float16_Value 0 NO_COMPU_METHOD -65504 65504 ECU_ADDRESS_EXTENSION 0x2 BYTE_ORDER MSB_LAST /end CHARACTERISTIC
/begin CHARACTERISTIC _g_PL_AD_fw_Radar_1R1V_rpc_LocBypassingRunnable_LocBypassingRunnable_m_pad_ensRLocationsPort_par_out_local.TChangeableMemPool._._._m_arrayPool._0_._elem._m_LocationList._Item._77_._dvCov._m_value "" VALUE 0xB00109C4 __Float16_Value 0 NO_COMPU_METHOD -65504 65504 ECU_ADDRESS_EXTENSION 0x2 BYTE_ORDER MSB_LAST /end CHARACTERISTIC
/begin CHARACTERISTIC _g_PL_AD_fw_Radar_1R1V_rpc_LocBypassingRunnable_LocBypassingRunnable_m_pad_ensRLocationsPort_par_out_local.TChangeableMemPool._._._m_arrayPool._0_._elem._m_LocationList._Item._77_._dvQly "" VALUE 0xB00109D4 __UByte_Value 0 NO_COMPU_METHOD 0 255 ECU_ADDRESS_EXTENSION 0x2 BYTE_ORDER MSB_LAST /end CHARACTERISTIC
/begin CHARACTERISTIC _g_PL_AD_fw_Radar_1R1V_rpc_LocBypassingRunnable_LocBypassingRunnable_m_pad_ensRLocationsPort_par_out_local.TChangeableMemPool._._._m_arrayPool._0_._elem._m_LocationList._Item._77_._idxAzimuthAmbiguityPeer "" VALUE 0xB00109D6 __UWord_Value 0 NO_COMPU_METHOD 0 65535 ECU_ADDRESS_EXTENSION 0x2 BYTE_ORDER MSB_LAST /end CHARACTERISTIC
/begin CHARACTERISTIC _g_PL_AD_fw_Radar_1R1V_rpc_LocBypassingRunnable_LocBypassingRunnable_m_pad_ensRLocationsPort_par_out_local.TChangeableMemPool._._._m_arrayPool._0_._elem._m_LocationList._Item._77_._measStatus "" VALUE 0xB00109D5 __UByte_Value 0 NO_COMPU_METHOD 0 255 ECU_ADDRESS_EXTENSION 0x2 BYTE_ORDER MSB_LAST /end CHARACTERISTIC
/begin CHARACTERISTIC _g_PL_AD_fw_Radar_1R1V_rpc_LocBypassingRunnable_LocBypassingRunnable_m_pad_ensRLocationsPort_par_out_local.TChangeableMemPool._._._m_arrayPool._0_._elem._m_LocationList._Item._77_._phi._m_value "" VALUE 0xB00109C8 __Float16_Value 0 NO_COMPU_METHOD -65504 65504 ECU_ADDRESS_EXTENSION 0x2 BYTE_ORDER MSB_LAST /end CHARACTERISTIC
/begin CHARACTERISTIC _g_PL_AD_fw_Radar_1R1V_rpc_LocBypassingRunnable_LocBypassingRunnable_m_pad_ensRLocationsPort_par_out_local.TChangeableMemPool._._._m_arrayPool._0_._elem._m_LocationList._Item._77_._phiQly "" VALUE 0xB00109CB __UByte_Value 0 NO_COMPU_METHOD 0 255 ECU_ADDRESS_EXTENSION 0x2 BYTE_ORDER MSB_LAST /end CHARACTERISTIC
/begin CHARACTERISTIC _g_PL_AD_fw_Radar_1R1V_rpc_LocBypassingRunnable_LocBypassingRunnable_m_pad_ensRLocationsPort_par_out_local.TChangeableMemPool._._._m_arrayPool._0_._elem._m_LocationList._Item._77_._phiVar._m_value "" VALUE 0xB00109CE __Float16_Value 0 NO_COMPU_METHOD -65504 65504 ECU_ADDRESS_EXTENSION 0x2 BYTE_ORDER MSB_LAST /end CHARACTERISTIC
/begin CHARACTERISTIC _g_PL_AD_fw_Radar_1R1V_rpc_LocBypassingRunnable_LocBypassingRunnable_m_pad_ensRLocationsPort_par_out_local.TChangeableMemPool._._._m_arrayPool._0_._elem._m_LocationList._Item._77_._theta._m_value "" VALUE 0xB00109C6 __Float16_Value 0 NO_COMPU_METHOD -65504 65504 ECU_ADDRESS_EXTENSION 0x2 BYTE_ORDER MSB_LAST /end CHARACTERISTIC
/begin CHARACTERISTIC _g_PL_AD_fw_Radar_1R1V_rpc_LocBypassingRunnable_LocBypassingRunnable_m_pad_ensRLocationsPort_par_out_local.TChangeableMemPool._._._m_arrayPool._0_._elem._m_LocationList._Item._77_._thetaQly "" VALUE 0xB00109CA __UByte_Value 0 NO_COMPU_METHOD 0 255 ECU_ADDRESS_EXTENSION 0x2 BYTE_ORDER MSB_LAST /end CHARACTERISTIC
/begin CHARACTERISTIC _g_PL_AD_fw_Radar_1R1V_rpc_LocBypassingRunnable_LocBypassingRunnable_m_pad_ensRLocationsPort_par_out_local.TChangeableMemPool._._._m_arrayPool._0_._elem._m_LocationList._Item._77_._thetaVar._m_value "" VALUE 0xB00109CC __Float16_Value 0 NO_COMPU_METHOD -65504 65504 ECU_ADDRESS_EXTENSION 0x2 BYTE_ORDER MSB_LAST /end CHARACTERISTIC
/begin CHARACTERISTIC _g_PL_AD_fw_Radar_1R1V_rpc_LocBypassingRunnable_LocBypassingRunnable_m_pad_ensRLocationsPort_par_out_local.TChangeableMemPool._._._m_arrayPool._0_._elem._m_LocationList._Item._77_._v "" VALUE 0xB00109BC __Float32_Value 0 NO_COMPU_METHOD -3.4028234663852886E+38 3.4028234663852886E+38 ECU_ADDRESS_EXTENSION 0x2 BYTE_ORDER MSB_LAST /end CHARACTERISTIC
/begin CHARACTERISTIC _g_PL_AD_fw_Radar_1R1V_rpc_LocBypassingRunnable_LocBypassingRunnable_m_pad_ensRLocationsPort_par_out_local.TChangeableMemPool._._._m_arrayPool._0_._elem._m_LocationList._Item._77_._vVar._m_value "" VALUE 0xB00109C2 __Float16_Value 0 NO_COMPU_METHOD -65504 65504 ECU_ADDRESS_EXTENSION 0x2 BYTE_ORDER MSB_LAST /end CHARACTERISTIC
/begin CHARACTERISTIC _g_PL_AD_fw_Radar_1R1V_rpc_LocBypassingRunnable_LocBypassingRunnable_m_pad_ensRLocationsPort_par_out_local.TChangeableMemPool._._._m_arrayPool._0_._elem._m_LocationList._Item._78_._Rcs._m_value "" VALUE 0xB00109F0 __Float16_Value 0 NO_COMPU_METHOD -65504 65504 ECU_ADDRESS_EXTENSION 0x2 BYTE_ORDER MSB_LAST /end CHARACTERISTIC
/begin CHARACTERISTIC _g_PL_AD_fw_Radar_1R1V_rpc_LocBypassingRunnable_LocBypassingRunnable_m_pad_ensRLocationsPort_par_out_local.TChangeableMemPool._._._m_arrayPool._0_._elem._m_LocationList._Item._78_._Rssi._m_value "" VALUE 0xB00109F2 __Float16_Value 0 NO_COMPU_METHOD -65504 65504 ECU_ADDRESS_EXTENSION 0x2 BYTE_ORDER MSB_LAST /end CHARACTERISTIC
/begin CHARACTERISTIC _g_PL_AD_fw_Radar_1R1V_rpc_LocBypassingRunnable_LocBypassingRunnable_m_pad_ensRLocationsPort_par_out_local.TChangeableMemPool._._._m_arrayPool._0_._elem._m_LocationList._Item._78_._d "" VALUE 0xB00109D8 __Float32_Value 0 NO_COMPU_METHOD -3.4028234663852886E+38 3.4028234663852886E+38 ECU_ADDRESS_EXTENSION 0x2 BYTE_ORDER MSB_LAST /end CHARACTERISTIC
/begin CHARACTERISTIC _g_PL_AD_fw_Radar_1R1V_rpc_LocBypassingRunnable_LocBypassingRunnable_m_pad_ensRLocationsPort_par_out_local.TChangeableMemPool._._._m_arrayPool._0_._elem._m_LocationList._Item._78_._dVar._m_value "" VALUE 0xB00109E0 __Float16_Value 0 NO_COMPU_METHOD -65504 65504 ECU_ADDRESS_EXTENSION 0x2 BYTE_ORDER MSB_LAST /end CHARACTERISTIC
/begin CHARACTERISTIC _g_PL_AD_fw_Radar_1R1V_rpc_LocBypassingRunnable_LocBypassingRunnable_m_pad_ensRLocationsPort_par_out_local.TChangeableMemPool._._._m_arrayPool._0_._elem._m_LocationList._Item._78_._dvCov._m_value "" VALUE 0xB00109E4 __Float16_Value 0 NO_COMPU_METHOD -65504 65504 ECU_ADDRESS_EXTENSION 0x2 BYTE_ORDER MSB_LAST /end CHARACTERISTIC
/begin CHARACTERISTIC _g_PL_AD_fw_Radar_1R1V_rpc_LocBypassingRunnable_LocBypassingRunnable_m_pad_ensRLocationsPort_par_out_local.TChangeableMemPool._._._m_arrayPool._0_._elem._m_LocationList._Item._78_._dvQly "" VALUE 0xB00109F4 __UByte_Value 0 NO_COMPU_METHOD 0 255 ECU_ADDRESS_EXTENSION 0x2 BYTE_ORDER MSB_LAST /end CHARACTERISTIC
/begin CHARACTERISTIC _g_PL_AD_fw_Radar_1R1V_rpc_LocBypassingRunnable_LocBypassingRunnable_m_pad_ensRLocationsPort_par_out_local.TChangeableMemPool._._._m_arrayPool._0_._elem._m_LocationList._Item._78_._idxAzimuthAmbiguityPeer "" VALUE 0xB00109F6 __UWord_Value 0 NO_COMPU_METHOD 0 65535 ECU_ADDRESS_EXTENSION 0x2 BYTE_ORDER MSB_LAST /end CHARACTERISTIC
/begin CHARACTERISTIC _g_PL_AD_fw_Radar_1R1V_rpc_LocBypassingRunnable_LocBypassingRunnable_m_pad_ensRLocationsPort_par_out_local.TChangeableMemPool._._._m_arrayPool._0_._elem._m_LocationList._Item._78_._measStatus "" VALUE 0xB00109F5 __UByte_Value 0 NO_COMPU_METHOD 0 255 ECU_ADDRESS_EXTENSION 0x2 BYTE_ORDER MSB_LAST /end CHARACTERISTIC
/begin CHARACTERISTIC _g_PL_AD_fw_Radar_1R1V_rpc_LocBypassingRunnable_LocBypassingRunnable_m_pad_ensRLocationsPort_par_out_local.TChangeableMemPool._._._m_arrayPool._0_._elem._m_LocationList._Item._78_._phi._m_value "" VALUE 0xB00109E8 __Float16_Value 0 NO_COMPU_METHOD -65504 65504 ECU_ADDRESS_EXTENSION 0x2 BYTE_ORDER MSB_LAST /end CHARACTERISTIC
/begin CHARACTERISTIC _g_PL_AD_fw_Radar_1R1V_rpc_LocBypassingRunnable_LocBypassingRunnable_m_pad_ensRLocationsPort_par_out_local.TChangeableMemPool._._._m_arrayPool._0_._elem._m_LocationList._Item._78_._phiQly "" VALUE 0xB00109EB __UByte_Value 0 NO_COMPU_METHOD 0 255 ECU_ADDRESS_EXTENSION 0x2 BYTE_ORDER MSB_LAST /end CHARACTERISTIC
/begin CHARACTERISTIC _g_PL_AD_fw_Radar_1R1V_rpc_LocBypassingRunnable_LocBypassingRunnable_m_pad_ensRLocationsPort_par_out_local.TChangeableMemPool._._._m_arrayPool._0_._elem._m_LocationList._Item._78_._phiVar._m_value "" VALUE 0xB00109EE __Float16_Value 0 NO_COMPU_METHOD -65504 65504 ECU_ADDRESS_EXTENSION 0x2 BYTE_ORDER MSB_LAST /end CHARACTERISTIC
/begin CHARACTERISTIC _g_PL_AD_fw_Radar_1R1V_rpc_LocBypassingRunnable_LocBypassingRunnable_m_pad_ensRLocationsPort_par_out_local.TChangeableMemPool._._._m_arrayPool._0_._elem._m_LocationList._Item._78_._theta._m_value "" VALUE 0xB00109E6 __Float16_Value 0 NO_COMPU_METHOD -65504 65504 ECU_ADDRESS_EXTENSION 0x2 BYTE_ORDER MSB_LAST /end CHARACTERISTIC
/begin CHARACTERISTIC _g_PL_AD_fw_Radar_1R1V_rpc_LocBypassingRunnable_LocBypassingRunnable_m_pad_ensRLocationsPort_par_out_local.TChangeableMemPool._._._m_arrayPool._0_._elem._m_LocationList._Item._78_._thetaQly "" VALUE 0xB00109EA __UByte_Value 0 NO_COMPU_METHOD 0 255 ECU_ADDRESS_EXTENSION 0x2 BYTE_ORDER MSB_LAST /end CHARACTERISTIC
/begin CHARACTERISTIC _g_PL_AD_fw_Radar_1R1V_rpc_LocBypassingRunnable_LocBypassingRunnable_m_pad_ensRLocationsPort_par_out_local.TChangeableMemPool._._._m_arrayPool._0_._elem._m_LocationList._Item._78_._thetaVar._m_value "" VALUE 0xB00109EC __Float16_Value 0 NO_COMPU_METHOD -65504 65504 ECU_ADDRESS_EXTENSION 0x2 BYTE_ORDER MSB_LAST /end CHARACTERISTIC
/begin CHARACTERISTIC _g_PL_AD_fw_Radar_1R1V_rpc_LocBypassingRunnable_LocBypassingRunnable_m_pad_ensRLocationsPort_par_out_local.TChangeableMemPool._._._m_arrayPool._0_._elem._m_LocationList._Item._78_._v "" VALUE 0xB00109DC __Float32_Value 0 NO_COMPU_METHOD -3.4028234663852886E+38 3.4028234663852886E+38 ECU_ADDRESS_EXTENSION 0x2 BYTE_ORDER MSB_LAST /end CHARACTERISTIC
/begin CHARACTERISTIC _g_PL_AD_fw_Radar_1R1V_rpc_LocBypassingRunnable_LocBypassingRunnable_m_pad_ensRLocationsPort_par_out_local.TChangeableMemPool._._._m_arrayPool._0_._elem._m_LocationList._Item._78_._vVar._m_value "" VALUE 0xB00109E2 __Float16_Value 0 NO_COMPU_METHOD -65504 65504 ECU_ADDRESS_EXTENSION 0x2 BYTE_ORDER MSB_LAST /end CHARACTERISTIC
/begin CHARACTERISTIC _g_PL_AD_fw_Radar_1R1V_rpc_LocBypassingRunnable_LocBypassingRunnable_m_pad_ensRLocationsPort_par_out_local.TChangeableMemPool._._._m_arrayPool._0_._elem._m_LocationList._Item._79_._Rcs._m_value "" VALUE 0xB0010A10 __Float16_Value 0 NO_COMPU_METHOD -65504 65504 ECU_ADDRESS_EXTENSION 0x2 BYTE_ORDER MSB_LAST /end CHARACTERISTIC
/begin CHARACTERISTIC _g_PL_AD_fw_Radar_1R1V_rpc_LocBypassingRunnable_LocBypassingRunnable_m_pad_ensRLocationsPort_par_out_local.TChangeableMemPool._._._m_arrayPool._0_._elem._m_LocationList._Item._79_._Rssi._m_value "" VALUE 0xB0010A12 __Float16_Value 0 NO_COMPU_METHOD -65504 65504 ECU_ADDRESS_EXTENSION 0x2 BYTE_ORDER MSB_LAST /end CHARACTERISTIC
/begin CHARACTERISTIC _g_PL_AD_fw_Radar_1R1V_rpc_LocBypassingRunnable_LocBypassingRunnable_m_pad_ensRLocationsPort_par_out_local.TChangeableMemPool._._._m_arrayPool._0_._elem._m_LocationList._Item._79_._d "" VALUE 0xB00109F8 __Float32_Value 0 NO_COMPU_METHOD -3.4028234663852886E+38 3.4028234663852886E+38 ECU_ADDRESS_EXTENSION 0x2 BYTE_ORDER MSB_LAST /end CHARACTERISTIC
/begin CHARACTERISTIC _g_PL_AD_fw_Radar_1R1V_rpc_LocBypassingRunnable_LocBypassingRunnable_m_pad_ensRLocationsPort_par_out_local.TChangeableMemPool._._._m_arrayPool._0_._elem._m_LocationList._Item._79_._dVar._m_value "" VALUE 0xB0010A00 __Float16_Value 0 NO_COMPU_METHOD -65504 65504 ECU_ADDRESS_EXTENSION 0x2 BYTE_ORDER MSB_LAST /end CHARACTERISTIC
/begin CHARACTERISTIC _g_PL_AD_fw_Radar_1R1V_rpc_LocBypassingRunnable_LocBypassingRunnable_m_pad_ensRLocationsPort_par_out_local.TChangeableMemPool._._._m_arrayPool._0_._elem._m_LocationList._Item._79_._dvCov._m_value "" VALUE 0xB0010A04 __Float16_Value 0 NO_COMPU_METHOD -65504 65504 ECU_ADDRESS_EXTENSION 0x2 BYTE_ORDER MSB_LAST /end CHARACTERISTIC
/begin CHARACTERISTIC _g_PL_AD_fw_Radar_1R1V_rpc_LocBypassingRunnable_LocBypassingRunnable_m_pad_ensRLocationsPort_par_out_local.TChangeableMemPool._._._m_arrayPool._0_._elem._m_LocationList._Item._79_._dvQly "" VALUE 0xB0010A14 __UByte_Value 0 NO_COMPU_METHOD 0 255 ECU_ADDRESS_EXTENSION 0x2 BYTE_ORDER MSB_LAST /end CHARACTERISTIC
/begin CHARACTERISTIC _g_PL_AD_fw_Radar_1R1V_rpc_LocBypassingRunnable_LocBypassingRunnable_m_pad_ensRLocationsPort_par_out_local.TChangeableMemPool._._._m_arrayPool._0_._elem._m_LocationList._Item._79_._idxAzimuthAmbiguityPeer "" VALUE 0xB0010A16 __UWord_Value 0 NO_COMPU_METHOD 0 65535 ECU_ADDRESS_EXTENSION 0x2 BYTE_ORDER MSB_LAST /end CHARACTERISTIC
/begin CHARACTERISTIC _g_PL_AD_fw_Radar_1R1V_rpc_LocBypassingRunnable_LocBypassingRunnable_m_pad_ensRLocationsPort_par_out_local.TChangeableMemPool._._._m_arrayPool._0_._elem._m_LocationList._Item._79_._measStatus "" VALUE 0xB0010A15 __UByte_Value 0 NO_COMPU_METHOD 0 255 ECU_ADDRESS_EXTENSION 0x2 BYTE_ORDER MSB_LAST /end CHARACTERISTIC
/begin CHARACTERISTIC _g_PL_AD_fw_Radar_1R1V_rpc_LocBypassingRunnable_LocBypassingRunnable_m_pad_ensRLocationsPort_par_out_local.TChangeableMemPool._._._m_arrayPool._0_._elem._m_LocationList._Item._79_._phi._m_value "" VALUE 0xB0010A08 __Float16_Value 0 NO_COMPU_METHOD -65504 65504 ECU_ADDRESS_EXTENSION 0x2 BYTE_ORDER MSB_LAST /end CHARACTERISTIC
/begin CHARACTERISTIC _g_PL_AD_fw_Radar_1R1V_rpc_LocBypassingRunnable_LocBypassingRunnable_m_pad_ensRLocationsPort_par_out_local.TChangeableMemPool._._._m_arrayPool._0_._elem._m_LocationList._Item._79_._phiQly "" VALUE 0xB0010A0B __UByte_Value 0 NO_COMPU_METHOD 0 255 ECU_ADDRESS_EXTENSION 0x2 BYTE_ORDER MSB_LAST /end CHARACTERISTIC
/begin CHARACTERISTIC _g_PL_AD_fw_Radar_1R1V_rpc_LocBypassingRunnable_LocBypassingRunnable_m_pad_ensRLocationsPort_par_out_local.TChangeableMemPool._._._m_arrayPool._0_._elem._m_LocationList._Item._79_._phiVar._m_value "" VALUE 0xB0010A0E __Float16_Value 0 NO_COMPU_METHOD -65504 65504 ECU_ADDRESS_EXTENSION 0x2 BYTE_ORDER MSB_LAST /end CHARACTERISTIC
/begin CHARACTERISTIC _g_PL_AD_fw_Radar_1R1V_rpc_LocBypassingRunnable_LocBypassingRunnable_m_pad_ensRLocationsPort_par_out_local.TChangeableMemPool._._._m_arrayPool._0_._elem._m_LocationList._Item._79_._theta._m_value "" VALUE 0xB0010A06 __Float16_Value 0 NO_COMPU_METHOD -65504 65504 ECU_ADDRESS_EXTENSION 0x2 BYTE_ORDER MSB_LAST /end CHARACTERISTIC
/begin CHARACTERISTIC _g_PL_AD_fw_Radar_1R1V_rpc_LocBypassingRunnable_LocBypassingRunnable_m_pad_ensRLocationsPort_par_out_local.TChangeableMemPool._._._m_arrayPool._0_._elem._m_LocationList._Item._79_._thetaQly "" VALUE 0xB0010A0A __UByte_Value 0 NO_COMPU_METHOD 0 255 ECU_ADDRESS_EXTENSION 0x2 BYTE_ORDER MSB_LAST /end CHARACTERISTIC
/begin CHARACTERISTIC _g_PL_AD_fw_Radar_1R1V_rpc_LocBypassingRunnable_LocBypassingRunnable_m_pad_ensRLocationsPort_par_out_local.TChangeableMemPool._._._m_arrayPool._0_._elem._m_LocationList._Item._79_._thetaVar._m_value "" VALUE 0xB0010A0C __Float16_Value 0 NO_COMPU_METHOD -65504 65504 ECU_ADDRESS_EXTENSION 0x2 BYTE_ORDER MSB_LAST /end CHARACTERISTIC
/begin CHARACTERISTIC _g_PL_AD_fw_Radar_1R1V_rpc_LocBypassingRunnable_LocBypassingRunnable_m_pad_ensRLocationsPort_par_out_local.TChangeableMemPool._._._m_arrayPool._0_._elem._m_LocationList._Item._79_._v "" VALUE 0xB00109FC __Float32_Value 0 NO_COMPU_METHOD -3.4028234663852886E+38 3.4028234663852886E+38 ECU_ADDRESS_EXTENSION 0x2 BYTE_ORDER MSB_LAST /end CHARACTERISTIC
/begin CHARACTERISTIC _g_PL_AD_fw_Radar_1R1V_rpc_LocBypassingRunnable_LocBypassingRunnable_m_pad_ensRLocationsPort_par_out_local.TChangeableMemPool._._._m_arrayPool._0_._elem._m_LocationList._Item._79_._vVar._m_value "" VALUE 0xB0010A02 __Float16_Value 0 NO_COMPU_METHOD -65504 65504 ECU_ADDRESS_EXTENSION 0x2 BYTE_ORDER MSB_LAST /end CHARACTERISTIC
/begin CHARACTERISTIC _g_PL_AD_fw_Radar_1R1V_rpc_LocBypassingRunnable_LocBypassingRunnable_m_pad_ensRLocationsPort_par_out_local.TChangeableMemPool._._._m_arrayPool._0_._elem._m_LocationList._Item._7_._Rcs._m_value "" VALUE 0xB0010110 __Float16_Value 0 NO_COMPU_METHOD -65504 65504 ECU_ADDRESS_EXTENSION 0x2 BYTE_ORDER MSB_LAST /end CHARACTERISTIC
/begin CHARACTERISTIC _g_PL_AD_fw_Radar_1R1V_rpc_LocBypassingRunnable_LocBypassingRunnable_m_pad_ensRLocationsPort_par_out_local.TChangeableMemPool._._._m_arrayPool._0_._elem._m_LocationList._Item._7_._Rssi._m_value "" VALUE 0xB0010112 __Float16_Value 0 NO_COMPU_METHOD -65504 65504 ECU_ADDRESS_EXTENSION 0x2 BYTE_ORDER MSB_LAST /end CHARACTERISTIC
/begin CHARACTERISTIC _g_PL_AD_fw_Radar_1R1V_rpc_LocBypassingRunnable_LocBypassingRunnable_m_pad_ensRLocationsPort_par_out_local.TChangeableMemPool._._._m_arrayPool._0_._elem._m_LocationList._Item._7_._d "" VALUE 0xB00100F8 __Float32_Value 0 NO_COMPU_METHOD -3.4028234663852886E+38 3.4028234663852886E+38 ECU_ADDRESS_EXTENSION 0x2 BYTE_ORDER MSB_LAST /end CHARACTERISTIC
/begin CHARACTERISTIC _g_PL_AD_fw_Radar_1R1V_rpc_LocBypassingRunnable_LocBypassingRunnable_m_pad_ensRLocationsPort_par_out_local.TChangeableMemPool._._._m_arrayPool._0_._elem._m_LocationList._Item._7_._dVar._m_value "" VALUE 0xB0010100 __Float16_Value 0 NO_COMPU_METHOD -65504 65504 ECU_ADDRESS_EXTENSION 0x2 BYTE_ORDER MSB_LAST /end CHARACTERISTIC
/begin CHARACTERISTIC _g_PL_AD_fw_Radar_1R1V_rpc_LocBypassingRunnable_LocBypassingRunnable_m_pad_ensRLocationsPort_par_out_local.TChangeableMemPool._._._m_arrayPool._0_._elem._m_LocationList._Item._7_._dvCov._m_value "" VALUE 0xB0010104 __Float16_Value 0 NO_COMPU_METHOD -65504 65504 ECU_ADDRESS_EXTENSION 0x2 BYTE_ORDER MSB_LAST /end CHARACTERISTIC
/begin CHARACTERISTIC _g_PL_AD_fw_Radar_1R1V_rpc_LocBypassingRunnable_LocBypassingRunnable_m_pad_ensRLocationsPort_par_out_local.TChangeableMemPool._._._m_arrayPool._0_._elem._m_LocationList._Item._7_._dvQly "" VALUE 0xB0010114 __UByte_Value 0 NO_COMPU_METHOD 0 255 ECU_ADDRESS_EXTENSION 0x2 BYTE_ORDER MSB_LAST /end CHARACTERISTIC
/begin CHARACTERISTIC _g_PL_AD_fw_Radar_1R1V_rpc_LocBypassingRunnable_LocBypassingRunnable_m_pad_ensRLocationsPort_par_out_local.TChangeableMemPool._._._m_arrayPool._0_._elem._m_LocationList._Item._7_._idxAzimuthAmbiguityPeer "" VALUE 0xB0010116 __UWord_Value 0 NO_COMPU_METHOD 0 65535 ECU_ADDRESS_EXTENSION 0x2 BYTE_ORDER MSB_LAST /end CHARACTERISTIC
/begin CHARACTERISTIC _g_PL_AD_fw_Radar_1R1V_rpc_LocBypassingRunnable_LocBypassingRunnable_m_pad_ensRLocationsPort_par_out_local.TChangeableMemPool._._._m_arrayPool._0_._elem._m_LocationList._Item._7_._measStatus "" VALUE 0xB0010115 __UByte_Value 0 NO_COMPU_METHOD 0 255 ECU_ADDRESS_EXTENSION 0x2 BYTE_ORDER MSB_LAST /end CHARACTERISTIC
/begin CHARACTERISTIC _g_PL_AD_fw_Radar_1R1V_rpc_LocBypassingRunnable_LocBypassingRunnable_m_pad_ensRLocationsPort_par_out_local.TChangeableMemPool._._._m_arrayPool._0_._elem._m_LocationList._Item._7_._phi._m_value "" VALUE 0xB0010108 __Float16_Value 0 NO_COMPU_METHOD -65504 65504 ECU_ADDRESS_EXTENSION 0x2 BYTE_ORDER MSB_LAST /end CHARACTERISTIC
/begin CHARACTERISTIC _g_PL_AD_fw_Radar_1R1V_rpc_LocBypassingRunnable_LocBypassingRunnable_m_pad_ensRLocationsPort_par_out_local.TChangeableMemPool._._._m_arrayPool._0_._elem._m_LocationList._Item._7_._phiQly "" VALUE 0xB001010B __UByte_Value 0 NO_COMPU_METHOD 0 255 ECU_ADDRESS_EXTENSION 0x2 BYTE_ORDER MSB_LAST /end CHARACTERISTIC
/begin CHARACTERISTIC _g_PL_AD_fw_Radar_1R1V_rpc_LocBypassingRunnable_LocBypassingRunnable_m_pad_ensRLocationsPort_par_out_local.TChangeableMemPool._._._m_arrayPool._0_._elem._m_LocationList._Item._7_._phiVar._m_value "" VALUE 0xB001010E __Float16_Value 0 NO_COMPU_METHOD -65504 65504 ECU_ADDRESS_EXTENSION 0x2 BYTE_ORDER MSB_LAST /end CHARACTERISTIC
/begin CHARACTERISTIC _g_PL_AD_fw_Radar_1R1V_rpc_LocBypassingRunnable_LocBypassingRunnable_m_pad_ensRLocationsPort_par_out_local.TChangeableMemPool._._._m_arrayPool._0_._elem._m_LocationList._Item._7_._theta._m_value "" VALUE 0xB0010106 __Float16_Value 0 NO_COMPU_METHOD -65504 65504 ECU_ADDRESS_EXTENSION 0x2 BYTE_ORDER MSB_LAST /end CHARACTERISTIC
/begin CHARACTERISTIC _g_PL_AD_fw_Radar_1R1V_rpc_LocBypassingRunnable_LocBypassingRunnable_m_pad_ensRLocationsPort_par_out_local.TChangeableMemPool._._._m_arrayPool._0_._elem._m_LocationList._Item._7_._thetaQly "" VALUE 0xB001010A __UByte_Value 0 NO_COMPU_METHOD 0 255 ECU_ADDRESS_EXTENSION 0x2 BYTE_ORDER MSB_LAST /end CHARACTERISTIC
/begin CHARACTERISTIC _g_PL_AD_fw_Radar_1R1V_rpc_LocBypassingRunnable_LocBypassingRunnable_m_pad_ensRLocationsPort_par_out_local.TChangeableMemPool._._._m_arrayPool._0_._elem._m_LocationList._Item._7_._thetaVar._m_value "" VALUE 0xB001010C __Float16_Value 0 NO_COMPU_METHOD -65504 65504 ECU_ADDRESS_EXTENSION 0x2 BYTE_ORDER MSB_LAST /end CHARACTERISTIC
/begin CHARACTERISTIC _g_PL_AD_fw_Radar_1R1V_rpc_LocBypassingRunnable_LocBypassingRunnable_m_pad_ensRLocationsPort_par_out_local.TChangeableMemPool._._._m_arrayPool._0_._elem._m_LocationList._Item._7_._v "" VALUE 0xB00100FC __Float32_Value 0 NO_COMPU_METHOD -3.4028234663852886E+38 3.4028234663852886E+38 ECU_ADDRESS_EXTENSION 0x2 BYTE_ORDER MSB_LAST /end CHARACTERISTIC
/begin CHARACTERISTIC _g_PL_AD_fw_Radar_1R1V_rpc_LocBypassingRunnable_LocBypassingRunnable_m_pad_ensRLocationsPort_par_out_local.TChangeableMemPool._._._m_arrayPool._0_._elem._m_LocationList._Item._7_._vVar._m_value "" VALUE 0xB0010102 __Float16_Value 0 NO_COMPU_METHOD -65504 65504 ECU_ADDRESS_EXTENSION 0x2 BYTE_ORDER MSB_LAST /end CHARACTERISTIC
/begin CHARACTERISTIC _g_PL_AD_fw_Radar_1R1V_rpc_LocBypassingRunnable_LocBypassingRunnable_m_pad_ensRLocationsPort_par_out_local.TChangeableMemPool._._._m_arrayPool._0_._elem._m_LocationList._Item._80_._Rcs._m_value "" VALUE 0xB0010A30 __Float16_Value 0 NO_COMPU_METHOD -65504 65504 ECU_ADDRESS_EXTENSION 0x2 BYTE_ORDER MSB_LAST /end CHARACTERISTIC
/begin CHARACTERISTIC _g_PL_AD_fw_Radar_1R1V_rpc_LocBypassingRunnable_LocBypassingRunnable_m_pad_ensRLocationsPort_par_out_local.TChangeableMemPool._._._m_arrayPool._0_._elem._m_LocationList._Item._80_._Rssi._m_value "" VALUE 0xB0010A32 __Float16_Value 0 NO_COMPU_METHOD -65504 65504 ECU_ADDRESS_EXTENSION 0x2 BYTE_ORDER MSB_LAST /end CHARACTERISTIC
/begin CHARACTERISTIC _g_PL_AD_fw_Radar_1R1V_rpc_LocBypassingRunnable_LocBypassingRunnable_m_pad_ensRLocationsPort_par_out_local.TChangeableMemPool._._._m_arrayPool._0_._elem._m_LocationList._Item._80_._d "" VALUE 0xB0010A18 __Float32_Value 0 NO_COMPU_METHOD -3.4028234663852886E+38 3.4028234663852886E+38 ECU_ADDRESS_EXTENSION 0x2 BYTE_ORDER MSB_LAST /end CHARACTERISTIC
/begin CHARACTERISTIC _g_PL_AD_fw_Radar_1R1V_rpc_LocBypassingRunnable_LocBypassingRunnable_m_pad_ensRLocationsPort_par_out_local.TChangeableMemPool._._._m_arrayPool._0_._elem._m_LocationList._Item._80_._dVar._m_value "" VALUE 0xB0010A20 __Float16_Value 0 NO_COMPU_METHOD -65504 65504 ECU_ADDRESS_EXTENSION 0x2 BYTE_ORDER MSB_LAST /end CHARACTERISTIC
/begin CHARACTERISTIC _g_PL_AD_fw_Radar_1R1V_rpc_LocBypassingRunnable_LocBypassingRunnable_m_pad_ensRLocationsPort_par_out_local.TChangeableMemPool._._._m_arrayPool._0_._elem._m_LocationList._Item._80_._dvCov._m_value "" VALUE 0xB0010A24 __Float16_Value 0 NO_COMPU_METHOD -65504 65504 ECU_ADDRESS_EXTENSION 0x2 BYTE_ORDER MSB_LAST /end CHARACTERISTIC
/begin CHARACTERISTIC _g_PL_AD_fw_Radar_1R1V_rpc_LocBypassingRunnable_LocBypassingRunnable_m_pad_ensRLocationsPort_par_out_local.TChangeableMemPool._._._m_arrayPool._0_._elem._m_LocationList._Item._80_._dvQly "" VALUE 0xB0010A34 __UByte_Value 0 NO_COMPU_METHOD 0 255 ECU_ADDRESS_EXTENSION 0x2 BYTE_ORDER MSB_LAST /end CHARACTERISTIC
/begin CHARACTERISTIC _g_PL_AD_fw_Radar_1R1V_rpc_LocBypassingRunnable_LocBypassingRunnable_m_pad_ensRLocationsPort_par_out_local.TChangeableMemPool._._._m_arrayPool._0_._elem._m_LocationList._Item._80_._idxAzimuthAmbiguityPeer "" VALUE 0xB0010A36 __UWord_Value 0 NO_COMPU_METHOD 0 65535 ECU_ADDRESS_EXTENSION 0x2 BYTE_ORDER MSB_LAST /end CHARACTERISTIC
/begin CHARACTERISTIC _g_PL_AD_fw_Radar_1R1V_rpc_LocBypassingRunnable_LocBypassingRunnable_m_pad_ensRLocationsPort_par_out_local.TChangeableMemPool._._._m_arrayPool._0_._elem._m_LocationList._Item._80_._measStatus "" VALUE 0xB0010A35 __UByte_Value 0 NO_COMPU_METHOD 0 255 ECU_ADDRESS_EXTENSION 0x2 BYTE_ORDER MSB_LAST /end CHARACTERISTIC
/begin CHARACTERISTIC _g_PL_AD_fw_Radar_1R1V_rpc_LocBypassingRunnable_LocBypassingRunnable_m_pad_ensRLocationsPort_par_out_local.TChangeableMemPool._._._m_arrayPool._0_._elem._m_LocationList._Item._80_._phi._m_value "" VALUE 0xB0010A28 __Float16_Value 0 NO_COMPU_METHOD -65504 65504 ECU_ADDRESS_EXTENSION 0x2 BYTE_ORDER MSB_LAST /end CHARACTERISTIC
/begin CHARACTERISTIC _g_PL_AD_fw_Radar_1R1V_rpc_LocBypassingRunnable_LocBypassingRunnable_m_pad_ensRLocationsPort_par_out_local.TChangeableMemPool._._._m_arrayPool._0_._elem._m_LocationList._Item._80_._phiQly "" VALUE 0xB0010A2B __UByte_Value 0 NO_COMPU_METHOD 0 255 ECU_ADDRESS_EXTENSION 0x2 BYTE_ORDER MSB_LAST /end CHARACTERISTIC
/begin CHARACTERISTIC _g_PL_AD_fw_Radar_1R1V_rpc_LocBypassingRunnable_LocBypassingRunnable_m_pad_ensRLocationsPort_par_out_local.TChangeableMemPool._._._m_arrayPool._0_._elem._m_LocationList._Item._80_._phiVar._m_value "" VALUE 0xB0010A2E __Float16_Value 0 NO_COMPU_METHOD -65504 65504 ECU_ADDRESS_EXTENSION 0x2 BYTE_ORDER MSB_LAST /end CHARACTERISTIC
/begin CHARACTERISTIC _g_PL_AD_fw_Radar_1R1V_rpc_LocBypassingRunnable_LocBypassingRunnable_m_pad_ensRLocationsPort_par_out_local.TChangeableMemPool._._._m_arrayPool._0_._elem._m_LocationList._Item._80_._theta._m_value "" VALUE 0xB0010A26 __Float16_Value 0 NO_COMPU_METHOD -65504 65504 ECU_ADDRESS_EXTENSION 0x2 BYTE_ORDER MSB_LAST /end CHARACTERISTIC
/begin CHARACTERISTIC _g_PL_AD_fw_Radar_1R1V_rpc_LocBypassingRunnable_LocBypassingRunnable_m_pad_ensRLocationsPort_par_out_local.TChangeableMemPool._._._m_arrayPool._0_._elem._m_LocationList._Item._80_._thetaQly "" VALUE 0xB0010A2A __UByte_Value 0 NO_COMPU_METHOD 0 255 ECU_ADDRESS_EXTENSION 0x2 BYTE_ORDER MSB_LAST /end CHARACTERISTIC
/begin CHARACTERISTIC _g_PL_AD_fw_Radar_1R1V_rpc_LocBypassingRunnable_LocBypassingRunnable_m_pad_ensRLocationsPort_par_out_local.TChangeableMemPool._._._m_arrayPool._0_._elem._m_LocationList._Item._80_._thetaVar._m_value "" VALUE 0xB0010A2C __Float16_Value 0 NO_COMPU_METHOD -65504 65504 ECU_ADDRESS_EXTENSION 0x2 BYTE_ORDER MSB_LAST /end CHARACTERISTIC
/begin CHARACTERISTIC _g_PL_AD_fw_Radar_1R1V_rpc_LocBypassingRunnable_LocBypassingRunnable_m_pad_ensRLocationsPort_par_out_local.TChangeableMemPool._._._m_arrayPool._0_._elem._m_LocationList._Item._80_._v "" VALUE 0xB0010A1C __Float32_Value 0 NO_COMPU_METHOD -3.4028234663852886E+38 3.4028234663852886E+38 ECU_ADDRESS_EXTENSION 0x2 BYTE_ORDER MSB_LAST /end CHARACTERISTIC
/begin CHARACTERISTIC _g_PL_AD_fw_Radar_1R1V_rpc_LocBypassingRunnable_LocBypassingRunnable_m_pad_ensRLocationsPort_par_out_local.TChangeableMemPool._._._m_arrayPool._0_._elem._m_LocationList._Item._80_._vVar._m_value "" VALUE 0xB0010A22 __Float16_Value 0 NO_COMPU_METHOD -65504 65504 ECU_ADDRESS_EXTENSION 0x2 BYTE_ORDER MSB_LAST /end CHARACTERISTIC
/begin CHARACTERISTIC _g_PL_AD_fw_Radar_1R1V_rpc_LocBypassingRunnable_LocBypassingRunnable_m_pad_ensRLocationsPort_par_out_local.TChangeableMemPool._._._m_arrayPool._0_._elem._m_LocationList._Item._81_._Rcs._m_value "" VALUE 0xB0010A50 __Float16_Value 0 NO_COMPU_METHOD -65504 65504 ECU_ADDRESS_EXTENSION 0x2 BYTE_ORDER MSB_LAST /end CHARACTERISTIC
/begin CHARACTERISTIC _g_PL_AD_fw_Radar_1R1V_rpc_LocBypassingRunnable_LocBypassingRunnable_m_pad_ensRLocationsPort_par_out_local.TChangeableMemPool._._._m_arrayPool._0_._elem._m_LocationList._Item._81_._Rssi._m_value "" VALUE 0xB0010A52 __Float16_Value 0 NO_COMPU_METHOD -65504 65504 ECU_ADDRESS_EXTENSION 0x2 BYTE_ORDER MSB_LAST /end CHARACTERISTIC
/begin CHARACTERISTIC _g_PL_AD_fw_Radar_1R1V_rpc_LocBypassingRunnable_LocBypassingRunnable_m_pad_ensRLocationsPort_par_out_local.TChangeableMemPool._._._m_arrayPool._0_._elem._m_LocationList._Item._81_._d "" VALUE 0xB0010A38 __Float32_Value 0 NO_COMPU_METHOD -3.4028234663852886E+38 3.4028234663852886E+38 ECU_ADDRESS_EXTENSION 0x2 BYTE_ORDER MSB_LAST /end CHARACTERISTIC
/begin CHARACTERISTIC _g_PL_AD_fw_Radar_1R1V_rpc_LocBypassingRunnable_LocBypassingRunnable_m_pad_ensRLocationsPort_par_out_local.TChangeableMemPool._._._m_arrayPool._0_._elem._m_LocationList._Item._81_._dVar._m_value "" VALUE 0xB0010A40 __Float16_Value 0 NO_COMPU_METHOD -65504 65504 ECU_ADDRESS_EXTENSION 0x2 BYTE_ORDER MSB_LAST /end CHARACTERISTIC
/begin CHARACTERISTIC _g_PL_AD_fw_Radar_1R1V_rpc_LocBypassingRunnable_LocBypassingRunnable_m_pad_ensRLocationsPort_par_out_local.TChangeableMemPool._._._m_arrayPool._0_._elem._m_LocationList._Item._81_._dvCov._m_value "" VALUE 0xB0010A44 __Float16_Value 0 NO_COMPU_METHOD -65504 65504 ECU_ADDRESS_EXTENSION 0x2 BYTE_ORDER MSB_LAST /end CHARACTERISTIC
/begin CHARACTERISTIC _g_PL_AD_fw_Radar_1R1V_rpc_LocBypassingRunnable_LocBypassingRunnable_m_pad_ensRLocationsPort_par_out_local.TChangeableMemPool._._._m_arrayPool._0_._elem._m_LocationList._Item._81_._dvQly "" VALUE 0xB0010A54 __UByte_Value 0 NO_COMPU_METHOD 0 255 ECU_ADDRESS_EXTENSION 0x2 BYTE_ORDER MSB_LAST /end CHARACTERISTIC
/begin CHARACTERISTIC _g_PL_AD_fw_Radar_1R1V_rpc_LocBypassingRunnable_LocBypassingRunnable_m_pad_ensRLocationsPort_par_out_local.TChangeableMemPool._._._m_arrayPool._0_._elem._m_LocationList._Item._81_._idxAzimuthAmbiguityPeer "" VALUE 0xB0010A56 __UWord_Value 0 NO_COMPU_METHOD 0 65535 ECU_ADDRESS_EXTENSION 0x2 BYTE_ORDER MSB_LAST /end CHARACTERISTIC
/begin CHARACTERISTIC _g_PL_AD_fw_Radar_1R1V_rpc_LocBypassingRunnable_LocBypassingRunnable_m_pad_ensRLocationsPort_par_out_local.TChangeableMemPool._._._m_arrayPool._0_._elem._m_LocationList._Item._81_._measStatus "" VALUE 0xB0010A55 __UByte_Value 0 NO_COMPU_METHOD 0 255 ECU_ADDRESS_EXTENSION 0x2 BYTE_ORDER MSB_LAST /end CHARACTERISTIC
/begin CHARACTERISTIC _g_PL_AD_fw_Radar_1R1V_rpc_LocBypassingRunnable_LocBypassingRunnable_m_pad_ensRLocationsPort_par_out_local.TChangeableMemPool._._._m_arrayPool._0_._elem._m_LocationList._Item._81_._phi._m_value "" VALUE 0xB0010A48 __Float16_Value 0 NO_COMPU_METHOD -65504 65504 ECU_ADDRESS_EXTENSION 0x2 BYTE_ORDER MSB_LAST /end CHARACTERISTIC
/begin CHARACTERISTIC _g_PL_AD_fw_Radar_1R1V_rpc_LocBypassingRunnable_LocBypassingRunnable_m_pad_ensRLocationsPort_par_out_local.TChangeableMemPool._._._m_arrayPool._0_._elem._m_LocationList._Item._81_._phiQly "" VALUE 0xB0010A4B __UByte_Value 0 NO_COMPU_METHOD 0 255 ECU_ADDRESS_EXTENSION 0x2 BYTE_ORDER MSB_LAST /end CHARACTERISTIC
/begin CHARACTERISTIC _g_PL_AD_fw_Radar_1R1V_rpc_LocBypassingRunnable_LocBypassingRunnable_m_pad_ensRLocationsPort_par_out_local.TChangeableMemPool._._._m_arrayPool._0_._elem._m_LocationList._Item._81_._phiVar._m_value "" VALUE 0xB0010A4E __Float16_Value 0 NO_COMPU_METHOD -65504 65504 ECU_ADDRESS_EXTENSION 0x2 BYTE_ORDER MSB_LAST /end CHARACTERISTIC
/begin CHARACTERISTIC _g_PL_AD_fw_Radar_1R1V_rpc_LocBypassingRunnable_LocBypassingRunnable_m_pad_ensRLocationsPort_par_out_local.TChangeableMemPool._._._m_arrayPool._0_._elem._m_LocationList._Item._81_._theta._m_value "" VALUE 0xB0010A46 __Float16_Value 0 NO_COMPU_METHOD -65504 65504 ECU_ADDRESS_EXTENSION 0x2 BYTE_ORDER MSB_LAST /end CHARACTERISTIC
/begin CHARACTERISTIC _g_PL_AD_fw_Radar_1R1V_rpc_LocBypassingRunnable_LocBypassingRunnable_m_pad_ensRLocationsPort_par_out_local.TChangeableMemPool._._._m_arrayPool._0_._elem._m_LocationList._Item._81_._thetaQly "" VALUE 0xB0010A4A __UByte_Value 0 NO_COMPU_METHOD 0 255 ECU_ADDRESS_EXTENSION 0x2 BYTE_ORDER MSB_LAST /end CHARACTERISTIC
/begin CHARACTERISTIC _g_PL_AD_fw_Radar_1R1V_rpc_LocBypassingRunnable_LocBypassingRunnable_m_pad_ensRLocationsPort_par_out_local.TChangeableMemPool._._._m_arrayPool._0_._elem._m_LocationList._Item._81_._thetaVar._m_value "" VALUE 0xB0010A4C __Float16_Value 0 NO_COMPU_METHOD -65504 65504 ECU_ADDRESS_EXTENSION 0x2 BYTE_ORDER MSB_LAST /end CHARACTERISTIC
/begin CHARACTERISTIC _g_PL_AD_fw_Radar_1R1V_rpc_LocBypassingRunnable_LocBypassingRunnable_m_pad_ensRLocationsPort_par_out_local.TChangeableMemPool._._._m_arrayPool._0_._elem._m_LocationList._Item._81_._v "" VALUE 0xB0010A3C __Float32_Value 0 NO_COMPU_METHOD -3.4028234663852886E+38 3.4028234663852886E+38 ECU_ADDRESS_EXTENSION 0x2 BYTE_ORDER MSB_LAST /end CHARACTERISTIC
/begin CHARACTERISTIC _g_PL_AD_fw_Radar_1R1V_rpc_LocBypassingRunnable_LocBypassingRunnable_m_pad_ensRLocationsPort_par_out_local.TChangeableMemPool._._._m_arrayPool._0_._elem._m_LocationList._Item._81_._vVar._m_value "" VALUE 0xB0010A42 __Float16_Value 0 NO_COMPU_METHOD -65504 65504 ECU_ADDRESS_EXTENSION 0x2 BYTE_ORDER MSB_LAST /end CHARACTERISTIC
/begin CHARACTERISTIC _g_PL_AD_fw_Radar_1R1V_rpc_LocBypassingRunnable_LocBypassingRunnable_m_pad_ensRLocationsPort_par_out_local.TChangeableMemPool._._._m_arrayPool._0_._elem._m_LocationList._Item._82_._Rcs._m_value "" VALUE 0xB0010A70 __Float16_Value 0 NO_COMPU_METHOD -65504 65504 ECU_ADDRESS_EXTENSION 0x2 BYTE_ORDER MSB_LAST /end CHARACTERISTIC
/begin CHARACTERISTIC _g_PL_AD_fw_Radar_1R1V_rpc_LocBypassingRunnable_LocBypassingRunnable_m_pad_ensRLocationsPort_par_out_local.TChangeableMemPool._._._m_arrayPool._0_._elem._m_LocationList._Item._82_._Rssi._m_value "" VALUE 0xB0010A72 __Float16_Value 0 NO_COMPU_METHOD -65504 65504 ECU_ADDRESS_EXTENSION 0x2 BYTE_ORDER MSB_LAST /end CHARACTERISTIC
/begin CHARACTERISTIC _g_PL_AD_fw_Radar_1R1V_rpc_LocBypassingRunnable_LocBypassingRunnable_m_pad_ensRLocationsPort_par_out_local.TChangeableMemPool._._._m_arrayPool._0_._elem._m_LocationList._Item._82_._d "" VALUE 0xB0010A58 __Float32_Value 0 NO_COMPU_METHOD -3.4028234663852886E+38 3.4028234663852886E+38 ECU_ADDRESS_EXTENSION 0x2 BYTE_ORDER MSB_LAST /end CHARACTERISTIC
/begin CHARACTERISTIC _g_PL_AD_fw_Radar_1R1V_rpc_LocBypassingRunnable_LocBypassingRunnable_m_pad_ensRLocationsPort_par_out_local.TChangeableMemPool._._._m_arrayPool._0_._elem._m_LocationList._Item._82_._dVar._m_value "" VALUE 0xB0010A60 __Float16_Value 0 NO_COMPU_METHOD -65504 65504 ECU_ADDRESS_EXTENSION 0x2 BYTE_ORDER MSB_LAST /end CHARACTERISTIC
/begin CHARACTERISTIC _g_PL_AD_fw_Radar_1R1V_rpc_LocBypassingRunnable_LocBypassingRunnable_m_pad_ensRLocationsPort_par_out_local.TChangeableMemPool._._._m_arrayPool._0_._elem._m_LocationList._Item._82_._dvCov._m_value "" VALUE 0xB0010A64 __Float16_Value 0 NO_COMPU_METHOD -65504 65504 ECU_ADDRESS_EXTENSION 0x2 BYTE_ORDER MSB_LAST /end CHARACTERISTIC
/begin CHARACTERISTIC _g_PL_AD_fw_Radar_1R1V_rpc_LocBypassingRunnable_LocBypassingRunnable_m_pad_ensRLocationsPort_par_out_local.TChangeableMemPool._._._m_arrayPool._0_._elem._m_LocationList._Item._82_._dvQly "" VALUE 0xB0010A74 __UByte_Value 0 NO_COMPU_METHOD 0 255 ECU_ADDRESS_EXTENSION 0x2 BYTE_ORDER MSB_LAST /end CHARACTERISTIC
/begin CHARACTERISTIC _g_PL_AD_fw_Radar_1R1V_rpc_LocBypassingRunnable_LocBypassingRunnable_m_pad_ensRLocationsPort_par_out_local.TChangeableMemPool._._._m_arrayPool._0_._elem._m_LocationList._Item._82_._idxAzimuthAmbiguityPeer "" VALUE 0xB0010A76 __UWord_Value 0 NO_COMPU_METHOD 0 65535 ECU_ADDRESS_EXTENSION 0x2 BYTE_ORDER MSB_LAST /end CHARACTERISTIC
/begin CHARACTERISTIC _g_PL_AD_fw_Radar_1R1V_rpc_LocBypassingRunnable_LocBypassingRunnable_m_pad_ensRLocationsPort_par_out_local.TChangeableMemPool._._._m_arrayPool._0_._elem._m_LocationList._Item._82_._measStatus "" VALUE 0xB0010A75 __UByte_Value 0 NO_COMPU_METHOD 0 255 ECU_ADDRESS_EXTENSION 0x2 BYTE_ORDER MSB_LAST /end CHARACTERISTIC
/begin CHARACTERISTIC _g_PL_AD_fw_Radar_1R1V_rpc_LocBypassingRunnable_LocBypassingRunnable_m_pad_ensRLocationsPort_par_out_local.TChangeableMemPool._._._m_arrayPool._0_._elem._m_LocationList._Item._82_._phi._m_value "" VALUE 0xB0010A68 __Float16_Value 0 NO_COMPU_METHOD -65504 65504 ECU_ADDRESS_EXTENSION 0x2 BYTE_ORDER MSB_LAST /end CHARACTERISTIC
/begin CHARACTERISTIC _g_PL_AD_fw_Radar_1R1V_rpc_LocBypassingRunnable_LocBypassingRunnable_m_pad_ensRLocationsPort_par_out_local.TChangeableMemPool._._._m_arrayPool._0_._elem._m_LocationList._Item._82_._phiQly "" VALUE 0xB0010A6B __UByte_Value 0 NO_COMPU_METHOD 0 255 ECU_ADDRESS_EXTENSION 0x2 BYTE_ORDER MSB_LAST /end CHARACTERISTIC
/begin CHARACTERISTIC _g_PL_AD_fw_Radar_1R1V_rpc_LocBypassingRunnable_LocBypassingRunnable_m_pad_ensRLocationsPort_par_out_local.TChangeableMemPool._._._m_arrayPool._0_._elem._m_LocationList._Item._82_._phiVar._m_value "" VALUE 0xB0010A6E __Float16_Value 0 NO_COMPU_METHOD -65504 65504 ECU_ADDRESS_EXTENSION 0x2 BYTE_ORDER MSB_LAST /end CHARACTERISTIC
/begin CHARACTERISTIC _g_PL_AD_fw_Radar_1R1V_rpc_LocBypassingRunnable_LocBypassingRunnable_m_pad_ensRLocationsPort_par_out_local.TChangeableMemPool._._._m_arrayPool._0_._elem._m_LocationList._Item._82_._theta._m_value "" VALUE 0xB0010A66 __Float16_Value 0 NO_COMPU_METHOD -65504 65504 ECU_ADDRESS_EXTENSION 0x2 BYTE_ORDER MSB_LAST /end CHARACTERISTIC
/begin CHARACTERISTIC _g_PL_AD_fw_Radar_1R1V_rpc_LocBypassingRunnable_LocBypassingRunnable_m_pad_ensRLocationsPort_par_out_local.TChangeableMemPool._._._m_arrayPool._0_._elem._m_LocationList._Item._82_._thetaQly "" VALUE 0xB0010A6A __UByte_Value 0 NO_COMPU_METHOD 0 255 ECU_ADDRESS_EXTENSION 0x2 BYTE_ORDER MSB_LAST /end CHARACTERISTIC
/begin CHARACTERISTIC _g_PL_AD_fw_Radar_1R1V_rpc_LocBypassingRunnable_LocBypassingRunnable_m_pad_ensRLocationsPort_par_out_local.TChangeableMemPool._._._m_arrayPool._0_._elem._m_LocationList._Item._82_._thetaVar._m_value "" VALUE 0xB0010A6C __Float16_Value 0 NO_COMPU_METHOD -65504 65504 ECU_ADDRESS_EXTENSION 0x2 BYTE_ORDER MSB_LAST /end CHARACTERISTIC
/begin CHARACTERISTIC _g_PL_AD_fw_Radar_1R1V_rpc_LocBypassingRunnable_LocBypassingRunnable_m_pad_ensRLocationsPort_par_out_local.TChangeableMemPool._._._m_arrayPool._0_._elem._m_LocationList._Item._82_._v "" VALUE 0xB0010A5C __Float32_Value 0 NO_COMPU_METHOD -3.4028234663852886E+38 3.4028234663852886E+38 ECU_ADDRESS_EXTENSION 0x2 BYTE_ORDER MSB_LAST /end CHARACTERISTIC
/begin CHARACTERISTIC _g_PL_AD_fw_Radar_1R1V_rpc_LocBypassingRunnable_LocBypassingRunnable_m_pad_ensRLocationsPort_par_out_local.TChangeableMemPool._._._m_arrayPool._0_._elem._m_LocationList._Item._82_._vVar._m_value "" VALUE 0xB0010A62 __Float16_Value 0 NO_COMPU_METHOD -65504 65504 ECU_ADDRESS_EXTENSION 0x2 BYTE_ORDER MSB_LAST /end CHARACTERISTIC
/begin CHARACTERISTIC _g_PL_AD_fw_Radar_1R1V_rpc_LocBypassingRunnable_LocBypassingRunnable_m_pad_ensRLocationsPort_par_out_local.TChangeableMemPool._._._m_arrayPool._0_._elem._m_LocationList._Item._83_._Rcs._m_value "" VALUE 0xB0010A90 __Float16_Value 0 NO_COMPU_METHOD -65504 65504 ECU_ADDRESS_EXTENSION 0x2 BYTE_ORDER MSB_LAST /end CHARACTERISTIC
/begin CHARACTERISTIC _g_PL_AD_fw_Radar_1R1V_rpc_LocBypassingRunnable_LocBypassingRunnable_m_pad_ensRLocationsPort_par_out_local.TChangeableMemPool._._._m_arrayPool._0_._elem._m_LocationList._Item._83_._Rssi._m_value "" VALUE 0xB0010A92 __Float16_Value 0 NO_COMPU_METHOD -65504 65504 ECU_ADDRESS_EXTENSION 0x2 BYTE_ORDER MSB_LAST /end CHARACTERISTIC
/begin CHARACTERISTIC _g_PL_AD_fw_Radar_1R1V_rpc_LocBypassingRunnable_LocBypassingRunnable_m_pad_ensRLocationsPort_par_out_local.TChangeableMemPool._._._m_arrayPool._0_._elem._m_LocationList._Item._83_._d "" VALUE 0xB0010A78 __Float32_Value 0 NO_COMPU_METHOD -3.4028234663852886E+38 3.4028234663852886E+38 ECU_ADDRESS_EXTENSION 0x2 BYTE_ORDER MSB_LAST /end CHARACTERISTIC
/begin CHARACTERISTIC _g_PL_AD_fw_Radar_1R1V_rpc_LocBypassingRunnable_LocBypassingRunnable_m_pad_ensRLocationsPort_par_out_local.TChangeableMemPool._._._m_arrayPool._0_._elem._m_LocationList._Item._83_._dVar._m_value "" VALUE 0xB0010A80 __Float16_Value 0 NO_COMPU_METHOD -65504 65504 ECU_ADDRESS_EXTENSION 0x2 BYTE_ORDER MSB_LAST /end CHARACTERISTIC
/begin CHARACTERISTIC _g_PL_AD_fw_Radar_1R1V_rpc_LocBypassingRunnable_LocBypassingRunnable_m_pad_ensRLocationsPort_par_out_local.TChangeableMemPool._._._m_arrayPool._0_._elem._m_LocationList._Item._83_._dvCov._m_value "" VALUE 0xB0010A84 __Float16_Value 0 NO_COMPU_METHOD -65504 65504 ECU_ADDRESS_EXTENSION 0x2 BYTE_ORDER MSB_LAST /end CHARACTERISTIC
/begin CHARACTERISTIC _g_PL_AD_fw_Radar_1R1V_rpc_LocBypassingRunnable_LocBypassingRunnable_m_pad_ensRLocationsPort_par_out_local.TChangeableMemPool._._._m_arrayPool._0_._elem._m_LocationList._Item._83_._dvQly "" VALUE 0xB0010A94 __UByte_Value 0 NO_COMPU_METHOD 0 255 ECU_ADDRESS_EXTENSION 0x2 BYTE_ORDER MSB_LAST /end CHARACTERISTIC
/begin CHARACTERISTIC _g_PL_AD_fw_Radar_1R1V_rpc_LocBypassingRunnable_LocBypassingRunnable_m_pad_ensRLocationsPort_par_out_local.TChangeableMemPool._._._m_arrayPool._0_._elem._m_LocationList._Item._83_._idxAzimuthAmbiguityPeer "" VALUE 0xB0010A96 __UWord_Value 0 NO_COMPU_METHOD 0 65535 ECU_ADDRESS_EXTENSION 0x2 BYTE_ORDER MSB_LAST /end CHARACTERISTIC
/begin CHARACTERISTIC _g_PL_AD_fw_Radar_1R1V_rpc_LocBypassingRunnable_LocBypassingRunnable_m_pad_ensRLocationsPort_par_out_local.TChangeableMemPool._._._m_arrayPool._0_._elem._m_LocationList._Item._83_._measStatus "" VALUE 0xB0010A95 __UByte_Value 0 NO_COMPU_METHOD 0 255 ECU_ADDRESS_EXTENSION 0x2 BYTE_ORDER MSB_LAST /end CHARACTERISTIC
/begin CHARACTERISTIC _g_PL_AD_fw_Radar_1R1V_rpc_LocBypassingRunnable_LocBypassingRunnable_m_pad_ensRLocationsPort_par_out_local.TChangeableMemPool._._._m_arrayPool._0_._elem._m_LocationList._Item._83_._phi._m_value "" VALUE 0xB0010A88 __Float16_Value 0 NO_COMPU_METHOD -65504 65504 ECU_ADDRESS_EXTENSION 0x2 BYTE_ORDER MSB_LAST /end CHARACTERISTIC
/begin CHARACTERISTIC _g_PL_AD_fw_Radar_1R1V_rpc_LocBypassingRunnable_LocBypassingRunnable_m_pad_ensRLocationsPort_par_out_local.TChangeableMemPool._._._m_arrayPool._0_._elem._m_LocationList._Item._83_._phiQly "" VALUE 0xB0010A8B __UByte_Value 0 NO_COMPU_METHOD 0 255 ECU_ADDRESS_EXTENSION 0x2 BYTE_ORDER MSB_LAST /end CHARACTERISTIC
/begin CHARACTERISTIC _g_PL_AD_fw_Radar_1R1V_rpc_LocBypassingRunnable_LocBypassingRunnable_m_pad_ensRLocationsPort_par_out_local.TChangeableMemPool._._._m_arrayPool._0_._elem._m_LocationList._Item._83_._phiVar._m_value "" VALUE 0xB0010A8E __Float16_Value 0 NO_COMPU_METHOD -65504 65504 ECU_ADDRESS_EXTENSION 0x2 BYTE_ORDER MSB_LAST /end CHARACTERISTIC
/begin CHARACTERISTIC _g_PL_AD_fw_Radar_1R1V_rpc_LocBypassingRunnable_LocBypassingRunnable_m_pad_ensRLocationsPort_par_out_local.TChangeableMemPool._._._m_arrayPool._0_._elem._m_LocationList._Item._83_._theta._m_value "" VALUE 0xB0010A86 __Float16_Value 0 NO_COMPU_METHOD -65504 65504 ECU_ADDRESS_EXTENSION 0x2 BYTE_ORDER MSB_LAST /end CHARACTERISTIC
/begin CHARACTERISTIC _g_PL_AD_fw_Radar_1R1V_rpc_LocBypassingRunnable_LocBypassingRunnable_m_pad_ensRLocationsPort_par_out_local.TChangeableMemPool._._._m_arrayPool._0_._elem._m_LocationList._Item._83_._thetaQly "" VALUE 0xB0010A8A __UByte_Value 0 NO_COMPU_METHOD 0 255 ECU_ADDRESS_EXTENSION 0x2 BYTE_ORDER MSB_LAST /end CHARACTERISTIC
/begin CHARACTERISTIC _g_PL_AD_fw_Radar_1R1V_rpc_LocBypassingRunnable_LocBypassingRunnable_m_pad_ensRLocationsPort_par_out_local.TChangeableMemPool._._._m_arrayPool._0_._elem._m_LocationList._Item._83_._thetaVar._m_value "" VALUE 0xB0010A8C __Float16_Value 0 NO_COMPU_METHOD -65504 65504 ECU_ADDRESS_EXTENSION 0x2 BYTE_ORDER MSB_LAST /end CHARACTERISTIC
/begin CHARACTERISTIC _g_PL_AD_fw_Radar_1R1V_rpc_LocBypassingRunnable_LocBypassingRunnable_m_pad_ensRLocationsPort_par_out_local.TChangeableMemPool._._._m_arrayPool._0_._elem._m_LocationList._Item._83_._v "" VALUE 0xB0010A7C __Float32_Value 0 NO_COMPU_METHOD -3.4028234663852886E+38 3.4028234663852886E+38 ECU_ADDRESS_EXTENSION 0x2 BYTE_ORDER MSB_LAST /end CHARACTERISTIC
/begin CHARACTERISTIC _g_PL_AD_fw_Radar_1R1V_rpc_LocBypassingRunnable_LocBypassingRunnable_m_pad_ensRLocationsPort_par_out_local.TChangeableMemPool._._._m_arrayPool._0_._elem._m_LocationList._Item._83_._vVar._m_value "" VALUE 0xB0010A82 __Float16_Value 0 NO_COMPU_METHOD -65504 65504 ECU_ADDRESS_EXTENSION 0x2 BYTE_ORDER MSB_LAST /end CHARACTERISTIC
/begin CHARACTERISTIC _g_PL_AD_fw_Radar_1R1V_rpc_LocBypassingRunnable_LocBypassingRunnable_m_pad_ensRLocationsPort_par_out_local.TChangeableMemPool._._._m_arrayPool._0_._elem._m_LocationList._Item._84_._Rcs._m_value "" VALUE 0xB0010AB0 __Float16_Value 0 NO_COMPU_METHOD -65504 65504 ECU_ADDRESS_EXTENSION 0x2 BYTE_ORDER MSB_LAST /end CHARACTERISTIC
/begin CHARACTERISTIC _g_PL_AD_fw_Radar_1R1V_rpc_LocBypassingRunnable_LocBypassingRunnable_m_pad_ensRLocationsPort_par_out_local.TChangeableMemPool._._._m_arrayPool._0_._elem._m_LocationList._Item._84_._Rssi._m_value "" VALUE 0xB0010AB2 __Float16_Value 0 NO_COMPU_METHOD -65504 65504 ECU_ADDRESS_EXTENSION 0x2 BYTE_ORDER MSB_LAST /end CHARACTERISTIC
/begin CHARACTERISTIC _g_PL_AD_fw_Radar_1R1V_rpc_LocBypassingRunnable_LocBypassingRunnable_m_pad_ensRLocationsPort_par_out_local.TChangeableMemPool._._._m_arrayPool._0_._elem._m_LocationList._Item._84_._d "" VALUE 0xB0010A98 __Float32_Value 0 NO_COMPU_METHOD -3.4028234663852886E+38 3.4028234663852886E+38 ECU_ADDRESS_EXTENSION 0x2 BYTE_ORDER MSB_LAST /end CHARACTERISTIC
/begin CHARACTERISTIC _g_PL_AD_fw_Radar_1R1V_rpc_LocBypassingRunnable_LocBypassingRunnable_m_pad_ensRLocationsPort_par_out_local.TChangeableMemPool._._._m_arrayPool._0_._elem._m_LocationList._Item._84_._dVar._m_value "" VALUE 0xB0010AA0 __Float16_Value 0 NO_COMPU_METHOD -65504 65504 ECU_ADDRESS_EXTENSION 0x2 BYTE_ORDER MSB_LAST /end CHARACTERISTIC
/begin CHARACTERISTIC _g_PL_AD_fw_Radar_1R1V_rpc_LocBypassingRunnable_LocBypassingRunnable_m_pad_ensRLocationsPort_par_out_local.TChangeableMemPool._._._m_arrayPool._0_._elem._m_LocationList._Item._84_._dvCov._m_value "" VALUE 0xB0010AA4 __Float16_Value 0 NO_COMPU_METHOD -65504 65504 ECU_ADDRESS_EXTENSION 0x2 BYTE_ORDER MSB_LAST /end CHARACTERISTIC
/begin CHARACTERISTIC _g_PL_AD_fw_Radar_1R1V_rpc_LocBypassingRunnable_LocBypassingRunnable_m_pad_ensRLocationsPort_par_out_local.TChangeableMemPool._._._m_arrayPool._0_._elem._m_LocationList._Item._84_._dvQly "" VALUE 0xB0010AB4 __UByte_Value 0 NO_COMPU_METHOD 0 255 ECU_ADDRESS_EXTENSION 0x2 BYTE_ORDER MSB_LAST /end CHARACTERISTIC
/begin CHARACTERISTIC _g_PL_AD_fw_Radar_1R1V_rpc_LocBypassingRunnable_LocBypassingRunnable_m_pad_ensRLocationsPort_par_out_local.TChangeableMemPool._._._m_arrayPool._0_._elem._m_LocationList._Item._84_._idxAzimuthAmbiguityPeer "" VALUE 0xB0010AB6 __UWord_Value 0 NO_COMPU_METHOD 0 65535 ECU_ADDRESS_EXTENSION 0x2 BYTE_ORDER MSB_LAST /end CHARACTERISTIC
/begin CHARACTERISTIC _g_PL_AD_fw_Radar_1R1V_rpc_LocBypassingRunnable_LocBypassingRunnable_m_pad_ensRLocationsPort_par_out_local.TChangeableMemPool._._._m_arrayPool._0_._elem._m_LocationList._Item._84_._measStatus "" VALUE 0xB0010AB5 __UByte_Value 0 NO_COMPU_METHOD 0 255 ECU_ADDRESS_EXTENSION 0x2 BYTE_ORDER MSB_LAST /end CHARACTERISTIC
/begin CHARACTERISTIC _g_PL_AD_fw_Radar_1R1V_rpc_LocBypassingRunnable_LocBypassingRunnable_m_pad_ensRLocationsPort_par_out_local.TChangeableMemPool._._._m_arrayPool._0_._elem._m_LocationList._Item._84_._phi._m_value "" VALUE 0xB0010AA8 __Float16_Value 0 NO_COMPU_METHOD -65504 65504 ECU_ADDRESS_EXTENSION 0x2 BYTE_ORDER MSB_LAST /end CHARACTERISTIC
/begin CHARACTERISTIC _g_PL_AD_fw_Radar_1R1V_rpc_LocBypassingRunnable_LocBypassingRunnable_m_pad_ensRLocationsPort_par_out_local.TChangeableMemPool._._._m_arrayPool._0_._elem._m_LocationList._Item._84_._phiQly "" VALUE 0xB0010AAB __UByte_Value 0 NO_COMPU_METHOD 0 255 ECU_ADDRESS_EXTENSION 0x2 BYTE_ORDER MSB_LAST /end CHARACTERISTIC
/begin CHARACTERISTIC _g_PL_AD_fw_Radar_1R1V_rpc_LocBypassingRunnable_LocBypassingRunnable_m_pad_ensRLocationsPort_par_out_local.TChangeableMemPool._._._m_arrayPool._0_._elem._m_LocationList._Item._84_._phiVar._m_value "" VALUE 0xB0010AAE __Float16_Value 0 NO_COMPU_METHOD -65504 65504 ECU_ADDRESS_EXTENSION 0x2 BYTE_ORDER MSB_LAST /end CHARACTERISTIC
/begin CHARACTERISTIC _g_PL_AD_fw_Radar_1R1V_rpc_LocBypassingRunnable_LocBypassingRunnable_m_pad_ensRLocationsPort_par_out_local.TChangeableMemPool._._._m_arrayPool._0_._elem._m_LocationList._Item._84_._theta._m_value "" VALUE 0xB0010AA6 __Float16_Value 0 NO_COMPU_METHOD -65504 65504 ECU_ADDRESS_EXTENSION 0x2 BYTE_ORDER MSB_LAST /end CHARACTERISTIC
/begin CHARACTERISTIC _g_PL_AD_fw_Radar_1R1V_rpc_LocBypassingRunnable_LocBypassingRunnable_m_pad_ensRLocationsPort_par_out_local.TChangeableMemPool._._._m_arrayPool._0_._elem._m_LocationList._Item._84_._thetaQly "" VALUE 0xB0010AAA __UByte_Value 0 NO_COMPU_METHOD 0 255 ECU_ADDRESS_EXTENSION 0x2 BYTE_ORDER MSB_LAST /end CHARACTERISTIC
/begin CHARACTERISTIC _g_PL_AD_fw_Radar_1R1V_rpc_LocBypassingRunnable_LocBypassingRunnable_m_pad_ensRLocationsPort_par_out_local.TChangeableMemPool._._._m_arrayPool._0_._elem._m_LocationList._Item._84_._thetaVar._m_value "" VALUE 0xB0010AAC __Float16_Value 0 NO_COMPU_METHOD -65504 65504 ECU_ADDRESS_EXTENSION 0x2 BYTE_ORDER MSB_LAST /end CHARACTERISTIC
/begin CHARACTERISTIC _g_PL_AD_fw_Radar_1R1V_rpc_LocBypassingRunnable_LocBypassingRunnable_m_pad_ensRLocationsPort_par_out_local.TChangeableMemPool._._._m_arrayPool._0_._elem._m_LocationList._Item._84_._v "" VALUE 0xB0010A9C __Float32_Value 0 NO_COMPU_METHOD -3.4028234663852886E+38 3.4028234663852886E+38 ECU_ADDRESS_EXTENSION 0x2 BYTE_ORDER MSB_LAST /end CHARACTERISTIC
/begin CHARACTERISTIC _g_PL_AD_fw_Radar_1R1V_rpc_LocBypassingRunnable_LocBypassingRunnable_m_pad_ensRLocationsPort_par_out_local.TChangeableMemPool._._._m_arrayPool._0_._elem._m_LocationList._Item._84_._vVar._m_value "" VALUE 0xB0010AA2 __Float16_Value 0 NO_COMPU_METHOD -65504 65504 ECU_ADDRESS_EXTENSION 0x2 BYTE_ORDER MSB_LAST /end CHARACTERISTIC
/begin CHARACTERISTIC _g_PL_AD_fw_Radar_1R1V_rpc_LocBypassingRunnable_LocBypassingRunnable_m_pad_ensRLocationsPort_par_out_local.TChangeableMemPool._._._m_arrayPool._0_._elem._m_LocationList._Item._85_._Rcs._m_value "" VALUE 0xB0010AD0 __Float16_Value 0 NO_COMPU_METHOD -65504 65504 ECU_ADDRESS_EXTENSION 0x2 BYTE_ORDER MSB_LAST /end CHARACTERISTIC
/begin CHARACTERISTIC _g_PL_AD_fw_Radar_1R1V_rpc_LocBypassingRunnable_LocBypassingRunnable_m_pad_ensRLocationsPort_par_out_local.TChangeableMemPool._._._m_arrayPool._0_._elem._m_LocationList._Item._85_._Rssi._m_value "" VALUE 0xB0010AD2 __Float16_Value 0 NO_COMPU_METHOD -65504 65504 ECU_ADDRESS_EXTENSION 0x2 BYTE_ORDER MSB_LAST /end CHARACTERISTIC
/begin CHARACTERISTIC _g_PL_AD_fw_Radar_1R1V_rpc_LocBypassingRunnable_LocBypassingRunnable_m_pad_ensRLocationsPort_par_out_local.TChangeableMemPool._._._m_arrayPool._0_._elem._m_LocationList._Item._85_._d "" VALUE 0xB0010AB8 __Float32_Value 0 NO_COMPU_METHOD -3.4028234663852886E+38 3.4028234663852886E+38 ECU_ADDRESS_EXTENSION 0x2 BYTE_ORDER MSB_LAST /end CHARACTERISTIC
/begin CHARACTERISTIC _g_PL_AD_fw_Radar_1R1V_rpc_LocBypassingRunnable_LocBypassingRunnable_m_pad_ensRLocationsPort_par_out_local.TChangeableMemPool._._._m_arrayPool._0_._elem._m_LocationList._Item._85_._dVar._m_value "" VALUE 0xB0010AC0 __Float16_Value 0 NO_COMPU_METHOD -65504 65504 ECU_ADDRESS_EXTENSION 0x2 BYTE_ORDER MSB_LAST /end CHARACTERISTIC
/begin CHARACTERISTIC _g_PL_AD_fw_Radar_1R1V_rpc_LocBypassingRunnable_LocBypassingRunnable_m_pad_ensRLocationsPort_par_out_local.TChangeableMemPool._._._m_arrayPool._0_._elem._m_LocationList._Item._85_._dvCov._m_value "" VALUE 0xB0010AC4 __Float16_Value 0 NO_COMPU_METHOD -65504 65504 ECU_ADDRESS_EXTENSION 0x2 BYTE_ORDER MSB_LAST /end CHARACTERISTIC
/begin CHARACTERISTIC _g_PL_AD_fw_Radar_1R1V_rpc_LocBypassingRunnable_LocBypassingRunnable_m_pad_ensRLocationsPort_par_out_local.TChangeableMemPool._._._m_arrayPool._0_._elem._m_LocationList._Item._85_._dvQly "" VALUE 0xB0010AD4 __UByte_Value 0 NO_COMPU_METHOD 0 255 ECU_ADDRESS_EXTENSION 0x2 BYTE_ORDER MSB_LAST /end CHARACTERISTIC
/begin CHARACTERISTIC _g_PL_AD_fw_Radar_1R1V_rpc_LocBypassingRunnable_LocBypassingRunnable_m_pad_ensRLocationsPort_par_out_local.TChangeableMemPool._._._m_arrayPool._0_._elem._m_LocationList._Item._85_._idxAzimuthAmbiguityPeer "" VALUE 0xB0010AD6 __UWord_Value 0 NO_COMPU_METHOD 0 65535 ECU_ADDRESS_EXTENSION 0x2 BYTE_ORDER MSB_LAST /end CHARACTERISTIC
/begin CHARACTERISTIC _g_PL_AD_fw_Radar_1R1V_rpc_LocBypassingRunnable_LocBypassingRunnable_m_pad_ensRLocationsPort_par_out_local.TChangeableMemPool._._._m_arrayPool._0_._elem._m_LocationList._Item._85_._measStatus "" VALUE 0xB0010AD5 __UByte_Value 0 NO_COMPU_METHOD 0 255 ECU_ADDRESS_EXTENSION 0x2 BYTE_ORDER MSB_LAST /end CHARACTERISTIC
/begin CHARACTERISTIC _g_PL_AD_fw_Radar_1R1V_rpc_LocBypassingRunnable_LocBypassingRunnable_m_pad_ensRLocationsPort_par_out_local.TChangeableMemPool._._._m_arrayPool._0_._elem._m_LocationList._Item._85_._phi._m_value "" VALUE 0xB0010AC8 __Float16_Value 0 NO_COMPU_METHOD -65504 65504 ECU_ADDRESS_EXTENSION 0x2 BYTE_ORDER MSB_LAST /end CHARACTERISTIC
/begin CHARACTERISTIC _g_PL_AD_fw_Radar_1R1V_rpc_LocBypassingRunnable_LocBypassingRunnable_m_pad_ensRLocationsPort_par_out_local.TChangeableMemPool._._._m_arrayPool._0_._elem._m_LocationList._Item._85_._phiQly "" VALUE 0xB0010ACB __UByte_Value 0 NO_COMPU_METHOD 0 255 ECU_ADDRESS_EXTENSION 0x2 BYTE_ORDER MSB_LAST /end CHARACTERISTIC
/begin CHARACTERISTIC _g_PL_AD_fw_Radar_1R1V_rpc_LocBypassingRunnable_LocBypassingRunnable_m_pad_ensRLocationsPort_par_out_local.TChangeableMemPool._._._m_arrayPool._0_._elem._m_LocationList._Item._85_._phiVar._m_value "" VALUE 0xB0010ACE __Float16_Value 0 NO_COMPU_METHOD -65504 65504 ECU_ADDRESS_EXTENSION 0x2 BYTE_ORDER MSB_LAST /end CHARACTERISTIC
/begin CHARACTERISTIC _g_PL_AD_fw_Radar_1R1V_rpc_LocBypassingRunnable_LocBypassingRunnable_m_pad_ensRLocationsPort_par_out_local.TChangeableMemPool._._._m_arrayPool._0_._elem._m_LocationList._Item._85_._theta._m_value "" VALUE 0xB0010AC6 __Float16_Value 0 NO_COMPU_METHOD -65504 65504 ECU_ADDRESS_EXTENSION 0x2 BYTE_ORDER MSB_LAST /end CHARACTERISTIC
/begin CHARACTERISTIC _g_PL_AD_fw_Radar_1R1V_rpc_LocBypassingRunnable_LocBypassingRunnable_m_pad_ensRLocationsPort_par_out_local.TChangeableMemPool._._._m_arrayPool._0_._elem._m_LocationList._Item._85_._thetaQly "" VALUE 0xB0010ACA __UByte_Value 0 NO_COMPU_METHOD 0 255 ECU_ADDRESS_EXTENSION 0x2 BYTE_ORDER MSB_LAST /end CHARACTERISTIC
/begin CHARACTERISTIC _g_PL_AD_fw_Radar_1R1V_rpc_LocBypassingRunnable_LocBypassingRunnable_m_pad_ensRLocationsPort_par_out_local.TChangeableMemPool._._._m_arrayPool._0_._elem._m_LocationList._Item._85_._thetaVar._m_value "" VALUE 0xB0010ACC __Float16_Value 0 NO_COMPU_METHOD -65504 65504 ECU_ADDRESS_EXTENSION 0x2 BYTE_ORDER MSB_LAST /end CHARACTERISTIC
/begin CHARACTERISTIC _g_PL_AD_fw_Radar_1R1V_rpc_LocBypassingRunnable_LocBypassingRunnable_m_pad_ensRLocationsPort_par_out_local.TChangeableMemPool._._._m_arrayPool._0_._elem._m_LocationList._Item._85_._v "" VALUE 0xB0010ABC __Float32_Value 0 NO_COMPU_METHOD -3.4028234663852886E+38 3.4028234663852886E+38 ECU_ADDRESS_EXTENSION 0x2 BYTE_ORDER MSB_LAST /end CHARACTERISTIC
/begin CHARACTERISTIC _g_PL_AD_fw_Radar_1R1V_rpc_LocBypassingRunnable_LocBypassingRunnable_m_pad_ensRLocationsPort_par_out_local.TChangeableMemPool._._._m_arrayPool._0_._elem._m_LocationList._Item._85_._vVar._m_value "" VALUE 0xB0010AC2 __Float16_Value 0 NO_COMPU_METHOD -65504 65504 ECU_ADDRESS_EXTENSION 0x2 BYTE_ORDER MSB_LAST /end CHARACTERISTIC
/begin CHARACTERISTIC _g_PL_AD_fw_Radar_1R1V_rpc_LocBypassingRunnable_LocBypassingRunnable_m_pad_ensRLocationsPort_par_out_local.TChangeableMemPool._._._m_arrayPool._0_._elem._m_LocationList._Item._86_._Rcs._m_value "" VALUE 0xB0010AF0 __Float16_Value 0 NO_COMPU_METHOD -65504 65504 ECU_ADDRESS_EXTENSION 0x2 BYTE_ORDER MSB_LAST /end CHARACTERISTIC
/begin CHARACTERISTIC _g_PL_AD_fw_Radar_1R1V_rpc_LocBypassingRunnable_LocBypassingRunnable_m_pad_ensRLocationsPort_par_out_local.TChangeableMemPool._._._m_arrayPool._0_._elem._m_LocationList._Item._86_._Rssi._m_value "" VALUE 0xB0010AF2 __Float16_Value 0 NO_COMPU_METHOD -65504 65504 ECU_ADDRESS_EXTENSION 0x2 BYTE_ORDER MSB_LAST /end CHARACTERISTIC
/begin CHARACTERISTIC _g_PL_AD_fw_Radar_1R1V_rpc_LocBypassingRunnable_LocBypassingRunnable_m_pad_ensRLocationsPort_par_out_local.TChangeableMemPool._._._m_arrayPool._0_._elem._m_LocationList._Item._86_._d "" VALUE 0xB0010AD8 __Float32_Value 0 NO_COMPU_METHOD -3.4028234663852886E+38 3.4028234663852886E+38 ECU_ADDRESS_EXTENSION 0x2 BYTE_ORDER MSB_LAST /end CHARACTERISTIC
/begin CHARACTERISTIC _g_PL_AD_fw_Radar_1R1V_rpc_LocBypassingRunnable_LocBypassingRunnable_m_pad_ensRLocationsPort_par_out_local.TChangeableMemPool._._._m_arrayPool._0_._elem._m_LocationList._Item._86_._dVar._m_value "" VALUE 0xB0010AE0 __Float16_Value 0 NO_COMPU_METHOD -65504 65504 ECU_ADDRESS_EXTENSION 0x2 BYTE_ORDER MSB_LAST /end CHARACTERISTIC
/begin CHARACTERISTIC _g_PL_AD_fw_Radar_1R1V_rpc_LocBypassingRunnable_LocBypassingRunnable_m_pad_ensRLocationsPort_par_out_local.TChangeableMemPool._._._m_arrayPool._0_._elem._m_LocationList._Item._86_._dvCov._m_value "" VALUE 0xB0010AE4 __Float16_Value 0 NO_COMPU_METHOD -65504 65504 ECU_ADDRESS_EXTENSION 0x2 BYTE_ORDER MSB_LAST /end CHARACTERISTIC
/begin CHARACTERISTIC _g_PL_AD_fw_Radar_1R1V_rpc_LocBypassingRunnable_LocBypassingRunnable_m_pad_ensRLocationsPort_par_out_local.TChangeableMemPool._._._m_arrayPool._0_._elem._m_LocationList._Item._86_._dvQly "" VALUE 0xB0010AF4 __UByte_Value 0 NO_COMPU_METHOD 0 255 ECU_ADDRESS_EXTENSION 0x2 BYTE_ORDER MSB_LAST /end CHARACTERISTIC
/begin CHARACTERISTIC _g_PL_AD_fw_Radar_1R1V_rpc_LocBypassingRunnable_LocBypassingRunnable_m_pad_ensRLocationsPort_par_out_local.TChangeableMemPool._._._m_arrayPool._0_._elem._m_LocationList._Item._86_._idxAzimuthAmbiguityPeer "" VALUE 0xB0010AF6 __UWord_Value 0 NO_COMPU_METHOD 0 65535 ECU_ADDRESS_EXTENSION 0x2 BYTE_ORDER MSB_LAST /end CHARACTERISTIC
/begin CHARACTERISTIC _g_PL_AD_fw_Radar_1R1V_rpc_LocBypassingRunnable_LocBypassingRunnable_m_pad_ensRLocationsPort_par_out_local.TChangeableMemPool._._._m_arrayPool._0_._elem._m_LocationList._Item._86_._measStatus "" VALUE 0xB0010AF5 __UByte_Value 0 NO_COMPU_METHOD 0 255 ECU_ADDRESS_EXTENSION 0x2 BYTE_ORDER MSB_LAST /end CHARACTERISTIC
/begin CHARACTERISTIC _g_PL_AD_fw_Radar_1R1V_rpc_LocBypassingRunnable_LocBypassingRunnable_m_pad_ensRLocationsPort_par_out_local.TChangeableMemPool._._._m_arrayPool._0_._elem._m_LocationList._Item._86_._phi._m_value "" VALUE 0xB0010AE8 __Float16_Value 0 NO_COMPU_METHOD -65504 65504 ECU_ADDRESS_EXTENSION 0x2 BYTE_ORDER MSB_LAST /end CHARACTERISTIC
/begin CHARACTERISTIC _g_PL_AD_fw_Radar_1R1V_rpc_LocBypassingRunnable_LocBypassingRunnable_m_pad_ensRLocationsPort_par_out_local.TChangeableMemPool._._._m_arrayPool._0_._elem._m_LocationList._Item._86_._phiQly "" VALUE 0xB0010AEB __UByte_Value 0 NO_COMPU_METHOD 0 255 ECU_ADDRESS_EXTENSION 0x2 BYTE_ORDER MSB_LAST /end CHARACTERISTIC
/begin CHARACTERISTIC _g_PL_AD_fw_Radar_1R1V_rpc_LocBypassingRunnable_LocBypassingRunnable_m_pad_ensRLocationsPort_par_out_local.TChangeableMemPool._._._m_arrayPool._0_._elem._m_LocationList._Item._86_._phiVar._m_value "" VALUE 0xB0010AEE __Float16_Value 0 NO_COMPU_METHOD -65504 65504 ECU_ADDRESS_EXTENSION 0x2 BYTE_ORDER MSB_LAST /end CHARACTERISTIC
/begin CHARACTERISTIC _g_PL_AD_fw_Radar_1R1V_rpc_LocBypassingRunnable_LocBypassingRunnable_m_pad_ensRLocationsPort_par_out_local.TChangeableMemPool._._._m_arrayPool._0_._elem._m_LocationList._Item._86_._theta._m_value "" VALUE 0xB0010AE6 __Float16_Value 0 NO_COMPU_METHOD -65504 65504 ECU_ADDRESS_EXTENSION 0x2 BYTE_ORDER MSB_LAST /end CHARACTERISTIC
/begin CHARACTERISTIC _g_PL_AD_fw_Radar_1R1V_rpc_LocBypassingRunnable_LocBypassingRunnable_m_pad_ensRLocationsPort_par_out_local.TChangeableMemPool._._._m_arrayPool._0_._elem._m_LocationList._Item._86_._thetaQly "" VALUE 0xB0010AEA __UByte_Value 0 NO_COMPU_METHOD 0 255 ECU_ADDRESS_EXTENSION 0x2 BYTE_ORDER MSB_LAST /end CHARACTERISTIC
/begin CHARACTERISTIC _g_PL_AD_fw_Radar_1R1V_rpc_LocBypassingRunnable_LocBypassingRunnable_m_pad_ensRLocationsPort_par_out_local.TChangeableMemPool._._._m_arrayPool._0_._elem._m_LocationList._Item._86_._thetaVar._m_value "" VALUE 0xB0010AEC __Float16_Value 0 NO_COMPU_METHOD -65504 65504 ECU_ADDRESS_EXTENSION 0x2 BYTE_ORDER MSB_LAST /end CHARACTERISTIC
/begin CHARACTERISTIC _g_PL_AD_fw_Radar_1R1V_rpc_LocBypassingRunnable_LocBypassingRunnable_m_pad_ensRLocationsPort_par_out_local.TChangeableMemPool._._._m_arrayPool._0_._elem._m_LocationList._Item._86_._v "" VALUE 0xB0010ADC __Float32_Value 0 NO_COMPU_METHOD -3.4028234663852886E+38 3.4028234663852886E+38 ECU_ADDRESS_EXTENSION 0x2 BYTE_ORDER MSB_LAST /end CHARACTERISTIC
/begin CHARACTERISTIC _g_PL_AD_fw_Radar_1R1V_rpc_LocBypassingRunnable_LocBypassingRunnable_m_pad_ensRLocationsPort_par_out_local.TChangeableMemPool._._._m_arrayPool._0_._elem._m_LocationList._Item._86_._vVar._m_value "" VALUE 0xB0010AE2 __Float16_Value 0 NO_COMPU_METHOD -65504 65504 ECU_ADDRESS_EXTENSION 0x2 BYTE_ORDER MSB_LAST /end CHARACTERISTIC
/begin CHARACTERISTIC _g_PL_AD_fw_Radar_1R1V_rpc_LocBypassingRunnable_LocBypassingRunnable_m_pad_ensRLocationsPort_par_out_local.TChangeableMemPool._._._m_arrayPool._0_._elem._m_LocationList._Item._87_._Rcs._m_value "" VALUE 0xB0010B10 __Float16_Value 0 NO_COMPU_METHOD -65504 65504 ECU_ADDRESS_EXTENSION 0x2 BYTE_ORDER MSB_LAST /end CHARACTERISTIC
/begin CHARACTERISTIC _g_PL_AD_fw_Radar_1R1V_rpc_LocBypassingRunnable_LocBypassingRunnable_m_pad_ensRLocationsPort_par_out_local.TChangeableMemPool._._._m_arrayPool._0_._elem._m_LocationList._Item._87_._Rssi._m_value "" VALUE 0xB0010B12 __Float16_Value 0 NO_COMPU_METHOD -65504 65504 ECU_ADDRESS_EXTENSION 0x2 BYTE_ORDER MSB_LAST /end CHARACTERISTIC
/begin CHARACTERISTIC _g_PL_AD_fw_Radar_1R1V_rpc_LocBypassingRunnable_LocBypassingRunnable_m_pad_ensRLocationsPort_par_out_local.TChangeableMemPool._._._m_arrayPool._0_._elem._m_LocationList._Item._87_._d "" VALUE 0xB0010AF8 __Float32_Value 0 NO_COMPU_METHOD -3.4028234663852886E+38 3.4028234663852886E+38 ECU_ADDRESS_EXTENSION 0x2 BYTE_ORDER MSB_LAST /end CHARACTERISTIC
/begin CHARACTERISTIC _g_PL_AD_fw_Radar_1R1V_rpc_LocBypassingRunnable_LocBypassingRunnable_m_pad_ensRLocationsPort_par_out_local.TChangeableMemPool._._._m_arrayPool._0_._elem._m_LocationList._Item._87_._dVar._m_value "" VALUE 0xB0010B00 __Float16_Value 0 NO_COMPU_METHOD -65504 65504 ECU_ADDRESS_EXTENSION 0x2 BYTE_ORDER MSB_LAST /end CHARACTERISTIC
/begin CHARACTERISTIC _g_PL_AD_fw_Radar_1R1V_rpc_LocBypassingRunnable_LocBypassingRunnable_m_pad_ensRLocationsPort_par_out_local.TChangeableMemPool._._._m_arrayPool._0_._elem._m_LocationList._Item._87_._dvCov._m_value "" VALUE 0xB0010B04 __Float16_Value 0 NO_COMPU_METHOD -65504 65504 ECU_ADDRESS_EXTENSION 0x2 BYTE_ORDER MSB_LAST /end CHARACTERISTIC
/begin CHARACTERISTIC _g_PL_AD_fw_Radar_1R1V_rpc_LocBypassingRunnable_LocBypassingRunnable_m_pad_ensRLocationsPort_par_out_local.TChangeableMemPool._._._m_arrayPool._0_._elem._m_LocationList._Item._87_._dvQly "" VALUE 0xB0010B14 __UByte_Value 0 NO_COMPU_METHOD 0 255 ECU_ADDRESS_EXTENSION 0x2 BYTE_ORDER MSB_LAST /end CHARACTERISTIC
/begin CHARACTERISTIC _g_PL_AD_fw_Radar_1R1V_rpc_LocBypassingRunnable_LocBypassingRunnable_m_pad_ensRLocationsPort_par_out_local.TChangeableMemPool._._._m_arrayPool._0_._elem._m_LocationList._Item._87_._idxAzimuthAmbiguityPeer "" VALUE 0xB0010B16 __UWord_Value 0 NO_COMPU_METHOD 0 65535 ECU_ADDRESS_EXTENSION 0x2 BYTE_ORDER MSB_LAST /end CHARACTERISTIC
/begin CHARACTERISTIC _g_PL_AD_fw_Radar_1R1V_rpc_LocBypassingRunnable_LocBypassingRunnable_m_pad_ensRLocationsPort_par_out_local.TChangeableMemPool._._._m_arrayPool._0_._elem._m_LocationList._Item._87_._measStatus "" VALUE 0xB0010B15 __UByte_Value 0 NO_COMPU_METHOD 0 255 ECU_ADDRESS_EXTENSION 0x2 BYTE_ORDER MSB_LAST /end CHARACTERISTIC
/begin CHARACTERISTIC _g_PL_AD_fw_Radar_1R1V_rpc_LocBypassingRunnable_LocBypassingRunnable_m_pad_ensRLocationsPort_par_out_local.TChangeableMemPool._._._m_arrayPool._0_._elem._m_LocationList._Item._87_._phi._m_value "" VALUE 0xB0010B08 __Float16_Value 0 NO_COMPU_METHOD -65504 65504 ECU_ADDRESS_EXTENSION 0x2 BYTE_ORDER MSB_LAST /end CHARACTERISTIC
/begin CHARACTERISTIC _g_PL_AD_fw_Radar_1R1V_rpc_LocBypassingRunnable_LocBypassingRunnable_m_pad_ensRLocationsPort_par_out_local.TChangeableMemPool._._._m_arrayPool._0_._elem._m_LocationList._Item._87_._phiQly "" VALUE 0xB0010B0B __UByte_Value 0 NO_COMPU_METHOD 0 255 ECU_ADDRESS_EXTENSION 0x2 BYTE_ORDER MSB_LAST /end CHARACTERISTIC
/begin CHARACTERISTIC _g_PL_AD_fw_Radar_1R1V_rpc_LocBypassingRunnable_LocBypassingRunnable_m_pad_ensRLocationsPort_par_out_local.TChangeableMemPool._._._m_arrayPool._0_._elem._m_LocationList._Item._87_._phiVar._m_value "" VALUE 0xB0010B0E __Float16_Value 0 NO_COMPU_METHOD -65504 65504 ECU_ADDRESS_EXTENSION 0x2 BYTE_ORDER MSB_LAST /end CHARACTERISTIC
/begin CHARACTERISTIC _g_PL_AD_fw_Radar_1R1V_rpc_LocBypassingRunnable_LocBypassingRunnable_m_pad_ensRLocationsPort_par_out_local.TChangeableMemPool._._._m_arrayPool._0_._elem._m_LocationList._Item._87_._theta._m_value "" VALUE 0xB0010B06 __Float16_Value 0 NO_COMPU_METHOD -65504 65504 ECU_ADDRESS_EXTENSION 0x2 BYTE_ORDER MSB_LAST /end CHARACTERISTIC
/begin CHARACTERISTIC _g_PL_AD_fw_Radar_1R1V_rpc_LocBypassingRunnable_LocBypassingRunnable_m_pad_ensRLocationsPort_par_out_local.TChangeableMemPool._._._m_arrayPool._0_._elem._m_LocationList._Item._87_._thetaQly "" VALUE 0xB0010B0A __UByte_Value 0 NO_COMPU_METHOD 0 255 ECU_ADDRESS_EXTENSION 0x2 BYTE_ORDER MSB_LAST /end CHARACTERISTIC
/begin CHARACTERISTIC _g_PL_AD_fw_Radar_1R1V_rpc_LocBypassingRunnable_LocBypassingRunnable_m_pad_ensRLocationsPort_par_out_local.TChangeableMemPool._._._m_arrayPool._0_._elem._m_LocationList._Item._87_._thetaVar._m_value "" VALUE 0xB0010B0C __Float16_Value 0 NO_COMPU_METHOD -65504 65504 ECU_ADDRESS_EXTENSION 0x2 BYTE_ORDER MSB_LAST /end CHARACTERISTIC
/begin CHARACTERISTIC _g_PL_AD_fw_Radar_1R1V_rpc_LocBypassingRunnable_LocBypassingRunnable_m_pad_ensRLocationsPort_par_out_local.TChangeableMemPool._._._m_arrayPool._0_._elem._m_LocationList._Item._87_._v "" VALUE 0xB0010AFC __Float32_Value 0 NO_COMPU_METHOD -3.4028234663852886E+38 3.4028234663852886E+38 ECU_ADDRESS_EXTENSION 0x2 BYTE_ORDER MSB_LAST /end CHARACTERISTIC
/begin CHARACTERISTIC _g_PL_AD_fw_Radar_1R1V_rpc_LocBypassingRunnable_LocBypassingRunnable_m_pad_ensRLocationsPort_par_out_local.TChangeableMemPool._._._m_arrayPool._0_._elem._m_LocationList._Item._87_._vVar._m_value "" VALUE 0xB0010B02 __Float16_Value 0 NO_COMPU_METHOD -65504 65504 ECU_ADDRESS_EXTENSION 0x2 BYTE_ORDER MSB_LAST /end CHARACTERISTIC
/begin CHARACTERISTIC _g_PL_AD_fw_Radar_1R1V_rpc_LocBypassingRunnable_LocBypassingRunnable_m_pad_ensRLocationsPort_par_out_local.TChangeableMemPool._._._m_arrayPool._0_._elem._m_LocationList._Item._88_._Rcs._m_value "" VALUE 0xB0010B30 __Float16_Value 0 NO_COMPU_METHOD -65504 65504 ECU_ADDRESS_EXTENSION 0x2 BYTE_ORDER MSB_LAST /end CHARACTERISTIC
/begin CHARACTERISTIC _g_PL_AD_fw_Radar_1R1V_rpc_LocBypassingRunnable_LocBypassingRunnable_m_pad_ensRLocationsPort_par_out_local.TChangeableMemPool._._._m_arrayPool._0_._elem._m_LocationList._Item._88_._Rssi._m_value "" VALUE 0xB0010B32 __Float16_Value 0 NO_COMPU_METHOD -65504 65504 ECU_ADDRESS_EXTENSION 0x2 BYTE_ORDER MSB_LAST /end CHARACTERISTIC
/begin CHARACTERISTIC _g_PL_AD_fw_Radar_1R1V_rpc_LocBypassingRunnable_LocBypassingRunnable_m_pad_ensRLocationsPort_par_out_local.TChangeableMemPool._._._m_arrayPool._0_._elem._m_LocationList._Item._88_._d "" VALUE 0xB0010B18 __Float32_Value 0 NO_COMPU_METHOD -3.4028234663852886E+38 3.4028234663852886E+38 ECU_ADDRESS_EXTENSION 0x2 BYTE_ORDER MSB_LAST /end CHARACTERISTIC
/begin CHARACTERISTIC _g_PL_AD_fw_Radar_1R1V_rpc_LocBypassingRunnable_LocBypassingRunnable_m_pad_ensRLocationsPort_par_out_local.TChangeableMemPool._._._m_arrayPool._0_._elem._m_LocationList._Item._88_._dVar._m_value "" VALUE 0xB0010B20 __Float16_Value 0 NO_COMPU_METHOD -65504 65504 ECU_ADDRESS_EXTENSION 0x2 BYTE_ORDER MSB_LAST /end CHARACTERISTIC
/begin CHARACTERISTIC _g_PL_AD_fw_Radar_1R1V_rpc_LocBypassingRunnable_LocBypassingRunnable_m_pad_ensRLocationsPort_par_out_local.TChangeableMemPool._._._m_arrayPool._0_._elem._m_LocationList._Item._88_._dvCov._m_value "" VALUE 0xB0010B24 __Float16_Value 0 NO_COMPU_METHOD -65504 65504 ECU_ADDRESS_EXTENSION 0x2 BYTE_ORDER MSB_LAST /end CHARACTERISTIC
/begin CHARACTERISTIC _g_PL_AD_fw_Radar_1R1V_rpc_LocBypassingRunnable_LocBypassingRunnable_m_pad_ensRLocationsPort_par_out_local.TChangeableMemPool._._._m_arrayPool._0_._elem._m_LocationList._Item._88_._dvQly "" VALUE 0xB0010B34 __UByte_Value 0 NO_COMPU_METHOD 0 255 ECU_ADDRESS_EXTENSION 0x2 BYTE_ORDER MSB_LAST /end CHARACTERISTIC
/begin CHARACTERISTIC _g_PL_AD_fw_Radar_1R1V_rpc_LocBypassingRunnable_LocBypassingRunnable_m_pad_ensRLocationsPort_par_out_local.TChangeableMemPool._._._m_arrayPool._0_._elem._m_LocationList._Item._88_._idxAzimuthAmbiguityPeer "" VALUE 0xB0010B36 __UWord_Value 0 NO_COMPU_METHOD 0 65535 ECU_ADDRESS_EXTENSION 0x2 BYTE_ORDER MSB_LAST /end CHARACTERISTIC
/begin CHARACTERISTIC _g_PL_AD_fw_Radar_1R1V_rpc_LocBypassingRunnable_LocBypassingRunnable_m_pad_ensRLocationsPort_par_out_local.TChangeableMemPool._._._m_arrayPool._0_._elem._m_LocationList._Item._88_._measStatus "" VALUE 0xB0010B35 __UByte_Value 0 NO_COMPU_METHOD 0 255 ECU_ADDRESS_EXTENSION 0x2 BYTE_ORDER MSB_LAST /end CHARACTERISTIC
/begin CHARACTERISTIC _g_PL_AD_fw_Radar_1R1V_rpc_LocBypassingRunnable_LocBypassingRunnable_m_pad_ensRLocationsPort_par_out_local.TChangeableMemPool._._._m_arrayPool._0_._elem._m_LocationList._Item._88_._phi._m_value "" VALUE 0xB0010B28 __Float16_Value 0 NO_COMPU_METHOD -65504 65504 ECU_ADDRESS_EXTENSION 0x2 BYTE_ORDER MSB_LAST /end CHARACTERISTIC
/begin CHARACTERISTIC _g_PL_AD_fw_Radar_1R1V_rpc_LocBypassingRunnable_LocBypassingRunnable_m_pad_ensRLocationsPort_par_out_local.TChangeableMemPool._._._m_arrayPool._0_._elem._m_LocationList._Item._88_._phiQly "" VALUE 0xB0010B2B __UByte_Value 0 NO_COMPU_METHOD 0 255 ECU_ADDRESS_EXTENSION 0x2 BYTE_ORDER MSB_LAST /end CHARACTERISTIC
/begin CHARACTERISTIC _g_PL_AD_fw_Radar_1R1V_rpc_LocBypassingRunnable_LocBypassingRunnable_m_pad_ensRLocationsPort_par_out_local.TChangeableMemPool._._._m_arrayPool._0_._elem._m_LocationList._Item._88_._phiVar._m_value "" VALUE 0xB0010B2E __Float16_Value 0 NO_COMPU_METHOD -65504 65504 ECU_ADDRESS_EXTENSION 0x2 BYTE_ORDER MSB_LAST /end CHARACTERISTIC
/begin CHARACTERISTIC _g_PL_AD_fw_Radar_1R1V_rpc_LocBypassingRunnable_LocBypassingRunnable_m_pad_ensRLocationsPort_par_out_local.TChangeableMemPool._._._m_arrayPool._0_._elem._m_LocationList._Item._88_._theta._m_value "" VALUE 0xB0010B26 __Float16_Value 0 NO_COMPU_METHOD -65504 65504 ECU_ADDRESS_EXTENSION 0x2 BYTE_ORDER MSB_LAST /end CHARACTERISTIC
/begin CHARACTERISTIC _g_PL_AD_fw_Radar_1R1V_rpc_LocBypassingRunnable_LocBypassingRunnable_m_pad_ensRLocationsPort_par_out_local.TChangeableMemPool._._._m_arrayPool._0_._elem._m_LocationList._Item._88_._thetaQly "" VALUE 0xB0010B2A __UByte_Value 0 NO_COMPU_METHOD 0 255 ECU_ADDRESS_EXTENSION 0x2 BYTE_ORDER MSB_LAST /end CHARACTERISTIC
/begin CHARACTERISTIC _g_PL_AD_fw_Radar_1R1V_rpc_LocBypassingRunnable_LocBypassingRunnable_m_pad_ensRLocationsPort_par_out_local.TChangeableMemPool._._._m_arrayPool._0_._elem._m_LocationList._Item._88_._thetaVar._m_value "" VALUE 0xB0010B2C __Float16_Value 0 NO_COMPU_METHOD -65504 65504 ECU_ADDRESS_EXTENSION 0x2 BYTE_ORDER MSB_LAST /end CHARACTERISTIC
/begin CHARACTERISTIC _g_PL_AD_fw_Radar_1R1V_rpc_LocBypassingRunnable_LocBypassingRunnable_m_pad_ensRLocationsPort_par_out_local.TChangeableMemPool._._._m_arrayPool._0_._elem._m_LocationList._Item._88_._v "" VALUE 0xB0010B1C __Float32_Value 0 NO_COMPU_METHOD -3.4028234663852886E+38 3.4028234663852886E+38 ECU_ADDRESS_EXTENSION 0x2 BYTE_ORDER MSB_LAST /end CHARACTERISTIC
/begin CHARACTERISTIC _g_PL_AD_fw_Radar_1R1V_rpc_LocBypassingRunnable_LocBypassingRunnable_m_pad_ensRLocationsPort_par_out_local.TChangeableMemPool._._._m_arrayPool._0_._elem._m_LocationList._Item._88_._vVar._m_value "" VALUE 0xB0010B22 __Float16_Value 0 NO_COMPU_METHOD -65504 65504 ECU_ADDRESS_EXTENSION 0x2 BYTE_ORDER MSB_LAST /end CHARACTERISTIC
/begin CHARACTERISTIC _g_PL_AD_fw_Radar_1R1V_rpc_LocBypassingRunnable_LocBypassingRunnable_m_pad_ensRLocationsPort_par_out_local.TChangeableMemPool._._._m_arrayPool._0_._elem._m_LocationList._Item._89_._Rcs._m_value "" VALUE 0xB0010B50 __Float16_Value 0 NO_COMPU_METHOD -65504 65504 ECU_ADDRESS_EXTENSION 0x2 BYTE_ORDER MSB_LAST /end CHARACTERISTIC
/begin CHARACTERISTIC _g_PL_AD_fw_Radar_1R1V_rpc_LocBypassingRunnable_LocBypassingRunnable_m_pad_ensRLocationsPort_par_out_local.TChangeableMemPool._._._m_arrayPool._0_._elem._m_LocationList._Item._89_._Rssi._m_value "" VALUE 0xB0010B52 __Float16_Value 0 NO_COMPU_METHOD -65504 65504 ECU_ADDRESS_EXTENSION 0x2 BYTE_ORDER MSB_LAST /end CHARACTERISTIC
/begin CHARACTERISTIC _g_PL_AD_fw_Radar_1R1V_rpc_LocBypassingRunnable_LocBypassingRunnable_m_pad_ensRLocationsPort_par_out_local.TChangeableMemPool._._._m_arrayPool._0_._elem._m_LocationList._Item._89_._d "" VALUE 0xB0010B38 __Float32_Value 0 NO_COMPU_METHOD -3.4028234663852886E+38 3.4028234663852886E+38 ECU_ADDRESS_EXTENSION 0x2 BYTE_ORDER MSB_LAST /end CHARACTERISTIC
/begin CHARACTERISTIC _g_PL_AD_fw_Radar_1R1V_rpc_LocBypassingRunnable_LocBypassingRunnable_m_pad_ensRLocationsPort_par_out_local.TChangeableMemPool._._._m_arrayPool._0_._elem._m_LocationList._Item._89_._dVar._m_value "" VALUE 0xB0010B40 __Float16_Value 0 NO_COMPU_METHOD -65504 65504 ECU_ADDRESS_EXTENSION 0x2 BYTE_ORDER MSB_LAST /end CHARACTERISTIC
/begin CHARACTERISTIC _g_PL_AD_fw_Radar_1R1V_rpc_LocBypassingRunnable_LocBypassingRunnable_m_pad_ensRLocationsPort_par_out_local.TChangeableMemPool._._._m_arrayPool._0_._elem._m_LocationList._Item._89_._dvCov._m_value "" VALUE 0xB0010B44 __Float16_Value 0 NO_COMPU_METHOD -65504 65504 ECU_ADDRESS_EXTENSION 0x2 BYTE_ORDER MSB_LAST /end CHARACTERISTIC
/begin CHARACTERISTIC _g_PL_AD_fw_Radar_1R1V_rpc_LocBypassingRunnable_LocBypassingRunnable_m_pad_ensRLocationsPort_par_out_local.TChangeableMemPool._._._m_arrayPool._0_._elem._m_LocationList._Item._89_._dvQly "" VALUE 0xB0010B54 __UByte_Value 0 NO_COMPU_METHOD 0 255 ECU_ADDRESS_EXTENSION 0x2 BYTE_ORDER MSB_LAST /end CHARACTERISTIC
/begin CHARACTERISTIC _g_PL_AD_fw_Radar_1R1V_rpc_LocBypassingRunnable_LocBypassingRunnable_m_pad_ensRLocationsPort_par_out_local.TChangeableMemPool._._._m_arrayPool._0_._elem._m_LocationList._Item._89_._idxAzimuthAmbiguityPeer "" VALUE 0xB0010B56 __UWord_Value 0 NO_COMPU_METHOD 0 65535 ECU_ADDRESS_EXTENSION 0x2 BYTE_ORDER MSB_LAST /end CHARACTERISTIC
/begin CHARACTERISTIC _g_PL_AD_fw_Radar_1R1V_rpc_LocBypassingRunnable_LocBypassingRunnable_m_pad_ensRLocationsPort_par_out_local.TChangeableMemPool._._._m_arrayPool._0_._elem._m_LocationList._Item._89_._measStatus "" VALUE 0xB0010B55 __UByte_Value 0 NO_COMPU_METHOD 0 255 ECU_ADDRESS_EXTENSION 0x2 BYTE_ORDER MSB_LAST /end CHARACTERISTIC
/begin CHARACTERISTIC _g_PL_AD_fw_Radar_1R1V_rpc_LocBypassingRunnable_LocBypassingRunnable_m_pad_ensRLocationsPort_par_out_local.TChangeableMemPool._._._m_arrayPool._0_._elem._m_LocationList._Item._89_._phi._m_value "" VALUE 0xB0010B48 __Float16_Value 0 NO_COMPU_METHOD -65504 65504 ECU_ADDRESS_EXTENSION 0x2 BYTE_ORDER MSB_LAST /end CHARACTERISTIC
/begin CHARACTERISTIC _g_PL_AD_fw_Radar_1R1V_rpc_LocBypassingRunnable_LocBypassingRunnable_m_pad_ensRLocationsPort_par_out_local.TChangeableMemPool._._._m_arrayPool._0_._elem._m_LocationList._Item._89_._phiQly "" VALUE 0xB0010B4B __UByte_Value 0 NO_COMPU_METHOD 0 255 ECU_ADDRESS_EXTENSION 0x2 BYTE_ORDER MSB_LAST /end CHARACTERISTIC
/begin CHARACTERISTIC _g_PL_AD_fw_Radar_1R1V_rpc_LocBypassingRunnable_LocBypassingRunnable_m_pad_ensRLocationsPort_par_out_local.TChangeableMemPool._._._m_arrayPool._0_._elem._m_LocationList._Item._89_._phiVar._m_value "" VALUE 0xB0010B4E __Float16_Value 0 NO_COMPU_METHOD -65504 65504 ECU_ADDRESS_EXTENSION 0x2 BYTE_ORDER MSB_LAST /end CHARACTERISTIC
/begin CHARACTERISTIC _g_PL_AD_fw_Radar_1R1V_rpc_LocBypassingRunnable_LocBypassingRunnable_m_pad_ensRLocationsPort_par_out_local.TChangeableMemPool._._._m_arrayPool._0_._elem._m_LocationList._Item._89_._theta._m_value "" VALUE 0xB0010B46 __Float16_Value 0 NO_COMPU_METHOD -65504 65504 ECU_ADDRESS_EXTENSION 0x2 BYTE_ORDER MSB_LAST /end CHARACTERISTIC
/begin CHARACTERISTIC _g_PL_AD_fw_Radar_1R1V_rpc_LocBypassingRunnable_LocBypassingRunnable_m_pad_ensRLocationsPort_par_out_local.TChangeableMemPool._._._m_arrayPool._0_._elem._m_LocationList._Item._89_._thetaQly "" VALUE 0xB0010B4A __UByte_Value 0 NO_COMPU_METHOD 0 255 ECU_ADDRESS_EXTENSION 0x2 BYTE_ORDER MSB_LAST /end CHARACTERISTIC
/begin CHARACTERISTIC _g_PL_AD_fw_Radar_1R1V_rpc_LocBypassingRunnable_LocBypassingRunnable_m_pad_ensRLocationsPort_par_out_local.TChangeableMemPool._._._m_arrayPool._0_._elem._m_LocationList._Item._89_._thetaVar._m_value "" VALUE 0xB0010B4C __Float16_Value 0 NO_COMPU_METHOD -65504 65504 ECU_ADDRESS_EXTENSION 0x2 BYTE_ORDER MSB_LAST /end CHARACTERISTIC
/begin CHARACTERISTIC _g_PL_AD_fw_Radar_1R1V_rpc_LocBypassingRunnable_LocBypassingRunnable_m_pad_ensRLocationsPort_par_out_local.TChangeableMemPool._._._m_arrayPool._0_._elem._m_LocationList._Item._89_._v "" VALUE 0xB0010B3C __Float32_Value 0 NO_COMPU_METHOD -3.4028234663852886E+38 3.4028234663852886E+38 ECU_ADDRESS_EXTENSION 0x2 BYTE_ORDER MSB_LAST /end CHARACTERISTIC
/begin CHARACTERISTIC _g_PL_AD_fw_Radar_1R1V_rpc_LocBypassingRunnable_LocBypassingRunnable_m_pad_ensRLocationsPort_par_out_local.TChangeableMemPool._._._m_arrayPool._0_._elem._m_LocationList._Item._89_._vVar._m_value "" VALUE 0xB0010B42 __Float16_Value 0 NO_COMPU_METHOD -65504 65504 ECU_ADDRESS_EXTENSION 0x2 BYTE_ORDER MSB_LAST /end CHARACTERISTIC
/begin CHARACTERISTIC _g_PL_AD_fw_Radar_1R1V_rpc_LocBypassingRunnable_LocBypassingRunnable_m_pad_ensRLocationsPort_par_out_local.TChangeableMemPool._._._m_arrayPool._0_._elem._m_LocationList._Item._8_._Rcs._m_value "" VALUE 0xB0010130 __Float16_Value 0 NO_COMPU_METHOD -65504 65504 ECU_ADDRESS_EXTENSION 0x2 BYTE_ORDER MSB_LAST /end CHARACTERISTIC
/begin CHARACTERISTIC _g_PL_AD_fw_Radar_1R1V_rpc_LocBypassingRunnable_LocBypassingRunnable_m_pad_ensRLocationsPort_par_out_local.TChangeableMemPool._._._m_arrayPool._0_._elem._m_LocationList._Item._8_._Rssi._m_value "" VALUE 0xB0010132 __Float16_Value 0 NO_COMPU_METHOD -65504 65504 ECU_ADDRESS_EXTENSION 0x2 BYTE_ORDER MSB_LAST /end CHARACTERISTIC
/begin CHARACTERISTIC _g_PL_AD_fw_Radar_1R1V_rpc_LocBypassingRunnable_LocBypassingRunnable_m_pad_ensRLocationsPort_par_out_local.TChangeableMemPool._._._m_arrayPool._0_._elem._m_LocationList._Item._8_._d "" VALUE 0xB0010118 __Float32_Value 0 NO_COMPU_METHOD -3.4028234663852886E+38 3.4028234663852886E+38 ECU_ADDRESS_EXTENSION 0x2 BYTE_ORDER MSB_LAST /end CHARACTERISTIC
/begin CHARACTERISTIC _g_PL_AD_fw_Radar_1R1V_rpc_LocBypassingRunnable_LocBypassingRunnable_m_pad_ensRLocationsPort_par_out_local.TChangeableMemPool._._._m_arrayPool._0_._elem._m_LocationList._Item._8_._dVar._m_value "" VALUE 0xB0010120 __Float16_Value 0 NO_COMPU_METHOD -65504 65504 ECU_ADDRESS_EXTENSION 0x2 BYTE_ORDER MSB_LAST /end CHARACTERISTIC
/begin CHARACTERISTIC _g_PL_AD_fw_Radar_1R1V_rpc_LocBypassingRunnable_LocBypassingRunnable_m_pad_ensRLocationsPort_par_out_local.TChangeableMemPool._._._m_arrayPool._0_._elem._m_LocationList._Item._8_._dvCov._m_value "" VALUE 0xB0010124 __Float16_Value 0 NO_COMPU_METHOD -65504 65504 ECU_ADDRESS_EXTENSION 0x2 BYTE_ORDER MSB_LAST /end CHARACTERISTIC
/begin CHARACTERISTIC _g_PL_AD_fw_Radar_1R1V_rpc_LocBypassingRunnable_LocBypassingRunnable_m_pad_ensRLocationsPort_par_out_local.TChangeableMemPool._._._m_arrayPool._0_._elem._m_LocationList._Item._8_._dvQly "" VALUE 0xB0010134 __UByte_Value 0 NO_COMPU_METHOD 0 255 ECU_ADDRESS_EXTENSION 0x2 BYTE_ORDER MSB_LAST /end CHARACTERISTIC
/begin CHARACTERISTIC _g_PL_AD_fw_Radar_1R1V_rpc_LocBypassingRunnable_LocBypassingRunnable_m_pad_ensRLocationsPort_par_out_local.TChangeableMemPool._._._m_arrayPool._0_._elem._m_LocationList._Item._8_._idxAzimuthAmbiguityPeer "" VALUE 0xB0010136 __UWord_Value 0 NO_COMPU_METHOD 0 65535 ECU_ADDRESS_EXTENSION 0x2 BYTE_ORDER MSB_LAST /end CHARACTERISTIC
/begin CHARACTERISTIC _g_PL_AD_fw_Radar_1R1V_rpc_LocBypassingRunnable_LocBypassingRunnable_m_pad_ensRLocationsPort_par_out_local.TChangeableMemPool._._._m_arrayPool._0_._elem._m_LocationList._Item._8_._measStatus "" VALUE 0xB0010135 __UByte_Value 0 NO_COMPU_METHOD 0 255 ECU_ADDRESS_EXTENSION 0x2 BYTE_ORDER MSB_LAST /end CHARACTERISTIC
/begin CHARACTERISTIC _g_PL_AD_fw_Radar_1R1V_rpc_LocBypassingRunnable_LocBypassingRunnable_m_pad_ensRLocationsPort_par_out_local.TChangeableMemPool._._._m_arrayPool._0_._elem._m_LocationList._Item._8_._phi._m_value "" VALUE 0xB0010128 __Float16_Value 0 NO_COMPU_METHOD -65504 65504 ECU_ADDRESS_EXTENSION 0x2 BYTE_ORDER MSB_LAST /end CHARACTERISTIC
/begin CHARACTERISTIC _g_PL_AD_fw_Radar_1R1V_rpc_LocBypassingRunnable_LocBypassingRunnable_m_pad_ensRLocationsPort_par_out_local.TChangeableMemPool._._._m_arrayPool._0_._elem._m_LocationList._Item._8_._phiQly "" VALUE 0xB001012B __UByte_Value 0 NO_COMPU_METHOD 0 255 ECU_ADDRESS_EXTENSION 0x2 BYTE_ORDER MSB_LAST /end CHARACTERISTIC
/begin CHARACTERISTIC _g_PL_AD_fw_Radar_1R1V_rpc_LocBypassingRunnable_LocBypassingRunnable_m_pad_ensRLocationsPort_par_out_local.TChangeableMemPool._._._m_arrayPool._0_._elem._m_LocationList._Item._8_._phiVar._m_value "" VALUE 0xB001012E __Float16_Value 0 NO_COMPU_METHOD -65504 65504 ECU_ADDRESS_EXTENSION 0x2 BYTE_ORDER MSB_LAST /end CHARACTERISTIC
/begin CHARACTERISTIC _g_PL_AD_fw_Radar_1R1V_rpc_LocBypassingRunnable_LocBypassingRunnable_m_pad_ensRLocationsPort_par_out_local.TChangeableMemPool._._._m_arrayPool._0_._elem._m_LocationList._Item._8_._theta._m_value "" VALUE 0xB0010126 __Float16_Value 0 NO_COMPU_METHOD -65504 65504 ECU_ADDRESS_EXTENSION 0x2 BYTE_ORDER MSB_LAST /end CHARACTERISTIC
/begin CHARACTERISTIC _g_PL_AD_fw_Radar_1R1V_rpc_LocBypassingRunnable_LocBypassingRunnable_m_pad_ensRLocationsPort_par_out_local.TChangeableMemPool._._._m_arrayPool._0_._elem._m_LocationList._Item._8_._thetaQly "" VALUE 0xB001012A __UByte_Value 0 NO_COMPU_METHOD 0 255 ECU_ADDRESS_EXTENSION 0x2 BYTE_ORDER MSB_LAST /end CHARACTERISTIC
/begin CHARACTERISTIC _g_PL_AD_fw_Radar_1R1V_rpc_LocBypassingRunnable_LocBypassingRunnable_m_pad_ensRLocationsPort_par_out_local.TChangeableMemPool._._._m_arrayPool._0_._elem._m_LocationList._Item._8_._thetaVar._m_value "" VALUE 0xB001012C __Float16_Value 0 NO_COMPU_METHOD -65504 65504 ECU_ADDRESS_EXTENSION 0x2 BYTE_ORDER MSB_LAST /end CHARACTERISTIC
/begin CHARACTERISTIC _g_PL_AD_fw_Radar_1R1V_rpc_LocBypassingRunnable_LocBypassingRunnable_m_pad_ensRLocationsPort_par_out_local.TChangeableMemPool._._._m_arrayPool._0_._elem._m_LocationList._Item._8_._v "" VALUE 0xB001011C __Float32_Value 0 NO_COMPU_METHOD -3.4028234663852886E+38 3.4028234663852886E+38 ECU_ADDRESS_EXTENSION 0x2 BYTE_ORDER MSB_LAST /end CHARACTERISTIC
/begin CHARACTERISTIC _g_PL_AD_fw_Radar_1R1V_rpc_LocBypassingRunnable_LocBypassingRunnable_m_pad_ensRLocationsPort_par_out_local.TChangeableMemPool._._._m_arrayPool._0_._elem._m_LocationList._Item._8_._vVar._m_value "" VALUE 0xB0010122 __Float16_Value 0 NO_COMPU_METHOD -65504 65504 ECU_ADDRESS_EXTENSION 0x2 BYTE_ORDER MSB_LAST /end CHARACTERISTIC
/begin CHARACTERISTIC _g_PL_AD_fw_Radar_1R1V_rpc_LocBypassingRunnable_LocBypassingRunnable_m_pad_ensRLocationsPort_par_out_local.TChangeableMemPool._._._m_arrayPool._0_._elem._m_LocationList._Item._90_._Rcs._m_value "" VALUE 0xB0010B70 __Float16_Value 0 NO_COMPU_METHOD -65504 65504 ECU_ADDRESS_EXTENSION 0x2 BYTE_ORDER MSB_LAST /end CHARACTERISTIC
/begin CHARACTERISTIC _g_PL_AD_fw_Radar_1R1V_rpc_LocBypassingRunnable_LocBypassingRunnable_m_pad_ensRLocationsPort_par_out_local.TChangeableMemPool._._._m_arrayPool._0_._elem._m_LocationList._Item._90_._Rssi._m_value "" VALUE 0xB0010B72 __Float16_Value 0 NO_COMPU_METHOD -65504 65504 ECU_ADDRESS_EXTENSION 0x2 BYTE_ORDER MSB_LAST /end CHARACTERISTIC
/begin CHARACTERISTIC _g_PL_AD_fw_Radar_1R1V_rpc_LocBypassingRunnable_LocBypassingRunnable_m_pad_ensRLocationsPort_par_out_local.TChangeableMemPool._._._m_arrayPool._0_._elem._m_LocationList._Item._90_._d "" VALUE 0xB0010B58 __Float32_Value 0 NO_COMPU_METHOD -3.4028234663852886E+38 3.4028234663852886E+38 ECU_ADDRESS_EXTENSION 0x2 BYTE_ORDER MSB_LAST /end CHARACTERISTIC
/begin CHARACTERISTIC _g_PL_AD_fw_Radar_1R1V_rpc_LocBypassingRunnable_LocBypassingRunnable_m_pad_ensRLocationsPort_par_out_local.TChangeableMemPool._._._m_arrayPool._0_._elem._m_LocationList._Item._90_._dVar._m_value "" VALUE 0xB0010B60 __Float16_Value 0 NO_COMPU_METHOD -65504 65504 ECU_ADDRESS_EXTENSION 0x2 BYTE_ORDER MSB_LAST /end CHARACTERISTIC
/begin CHARACTERISTIC _g_PL_AD_fw_Radar_1R1V_rpc_LocBypassingRunnable_LocBypassingRunnable_m_pad_ensRLocationsPort_par_out_local.TChangeableMemPool._._._m_arrayPool._0_._elem._m_LocationList._Item._90_._dvCov._m_value "" VALUE 0xB0010B64 __Float16_Value 0 NO_COMPU_METHOD -65504 65504 ECU_ADDRESS_EXTENSION 0x2 BYTE_ORDER MSB_LAST /end CHARACTERISTIC
/begin CHARACTERISTIC _g_PL_AD_fw_Radar_1R1V_rpc_LocBypassingRunnable_LocBypassingRunnable_m_pad_ensRLocationsPort_par_out_local.TChangeableMemPool._._._m_arrayPool._0_._elem._m_LocationList._Item._90_._dvQly "" VALUE 0xB0010B74 __UByte_Value 0 NO_COMPU_METHOD 0 255 ECU_ADDRESS_EXTENSION 0x2 BYTE_ORDER MSB_LAST /end CHARACTERISTIC
/begin CHARACTERISTIC _g_PL_AD_fw_Radar_1R1V_rpc_LocBypassingRunnable_LocBypassingRunnable_m_pad_ensRLocationsPort_par_out_local.TChangeableMemPool._._._m_arrayPool._0_._elem._m_LocationList._Item._90_._idxAzimuthAmbiguityPeer "" VALUE 0xB0010B76 __UWord_Value 0 NO_COMPU_METHOD 0 65535 ECU_ADDRESS_EXTENSION 0x2 BYTE_ORDER MSB_LAST /end CHARACTERISTIC
/begin CHARACTERISTIC _g_PL_AD_fw_Radar_1R1V_rpc_LocBypassingRunnable_LocBypassingRunnable_m_pad_ensRLocationsPort_par_out_local.TChangeableMemPool._._._m_arrayPool._0_._elem._m_LocationList._Item._90_._measStatus "" VALUE 0xB0010B75 __UByte_Value 0 NO_COMPU_METHOD 0 255 ECU_ADDRESS_EXTENSION 0x2 BYTE_ORDER MSB_LAST /end CHARACTERISTIC
/begin CHARACTERISTIC _g_PL_AD_fw_Radar_1R1V_rpc_LocBypassingRunnable_LocBypassingRunnable_m_pad_ensRLocationsPort_par_out_local.TChangeableMemPool._._._m_arrayPool._0_._elem._m_LocationList._Item._90_._phi._m_value "" VALUE 0xB0010B68 __Float16_Value 0 NO_COMPU_METHOD -65504 65504 ECU_ADDRESS_EXTENSION 0x2 BYTE_ORDER MSB_LAST /end CHARACTERISTIC
/begin CHARACTERISTIC _g_PL_AD_fw_Radar_1R1V_rpc_LocBypassingRunnable_LocBypassingRunnable_m_pad_ensRLocationsPort_par_out_local.TChangeableMemPool._._._m_arrayPool._0_._elem._m_LocationList._Item._90_._phiQly "" VALUE 0xB0010B6B __UByte_Value 0 NO_COMPU_METHOD 0 255 ECU_ADDRESS_EXTENSION 0x2 BYTE_ORDER MSB_LAST /end CHARACTERISTIC
/begin CHARACTERISTIC _g_PL_AD_fw_Radar_1R1V_rpc_LocBypassingRunnable_LocBypassingRunnable_m_pad_ensRLocationsPort_par_out_local.TChangeableMemPool._._._m_arrayPool._0_._elem._m_LocationList._Item._90_._phiVar._m_value "" VALUE 0xB0010B6E __Float16_Value 0 NO_COMPU_METHOD -65504 65504 ECU_ADDRESS_EXTENSION 0x2 BYTE_ORDER MSB_LAST /end CHARACTERISTIC
/begin CHARACTERISTIC _g_PL_AD_fw_Radar_1R1V_rpc_LocBypassingRunnable_LocBypassingRunnable_m_pad_ensRLocationsPort_par_out_local.TChangeableMemPool._._._m_arrayPool._0_._elem._m_LocationList._Item._90_._theta._m_value "" VALUE 0xB0010B66 __Float16_Value 0 NO_COMPU_METHOD -65504 65504 ECU_ADDRESS_EXTENSION 0x2 BYTE_ORDER MSB_LAST /end CHARACTERISTIC
/begin CHARACTERISTIC _g_PL_AD_fw_Radar_1R1V_rpc_LocBypassingRunnable_LocBypassingRunnable_m_pad_ensRLocationsPort_par_out_local.TChangeableMemPool._._._m_arrayPool._0_._elem._m_LocationList._Item._90_._thetaQly "" VALUE 0xB0010B6A __UByte_Value 0 NO_COMPU_METHOD 0 255 ECU_ADDRESS_EXTENSION 0x2 BYTE_ORDER MSB_LAST /end CHARACTERISTIC
/begin CHARACTERISTIC _g_PL_AD_fw_Radar_1R1V_rpc_LocBypassingRunnable_LocBypassingRunnable_m_pad_ensRLocationsPort_par_out_local.TChangeableMemPool._._._m_arrayPool._0_._elem._m_LocationList._Item._90_._thetaVar._m_value "" VALUE 0xB0010B6C __Float16_Value 0 NO_COMPU_METHOD -65504 65504 ECU_ADDRESS_EXTENSION 0x2 BYTE_ORDER MSB_LAST /end CHARACTERISTIC
/begin CHARACTERISTIC _g_PL_AD_fw_Radar_1R1V_rpc_LocBypassingRunnable_LocBypassingRunnable_m_pad_ensRLocationsPort_par_out_local.TChangeableMemPool._._._m_arrayPool._0_._elem._m_LocationList._Item._90_._v "" VALUE 0xB0010B5C __Float32_Value 0 NO_COMPU_METHOD -3.4028234663852886E+38 3.4028234663852886E+38 ECU_ADDRESS_EXTENSION 0x2 BYTE_ORDER MSB_LAST /end CHARACTERISTIC
/begin CHARACTERISTIC _g_PL_AD_fw_Radar_1R1V_rpc_LocBypassingRunnable_LocBypassingRunnable_m_pad_ensRLocationsPort_par_out_local.TChangeableMemPool._._._m_arrayPool._0_._elem._m_LocationList._Item._90_._vVar._m_value "" VALUE 0xB0010B62 __Float16_Value 0 NO_COMPU_METHOD -65504 65504 ECU_ADDRESS_EXTENSION 0x2 BYTE_ORDER MSB_LAST /end CHARACTERISTIC
/begin CHARACTERISTIC _g_PL_AD_fw_Radar_1R1V_rpc_LocBypassingRunnable_LocBypassingRunnable_m_pad_ensRLocationsPort_par_out_local.TChangeableMemPool._._._m_arrayPool._0_._elem._m_LocationList._Item._91_._Rcs._m_value "" VALUE 0xB0010B90 __Float16_Value 0 NO_COMPU_METHOD -65504 65504 ECU_ADDRESS_EXTENSION 0x2 BYTE_ORDER MSB_LAST /end CHARACTERISTIC
/begin CHARACTERISTIC _g_PL_AD_fw_Radar_1R1V_rpc_LocBypassingRunnable_LocBypassingRunnable_m_pad_ensRLocationsPort_par_out_local.TChangeableMemPool._._._m_arrayPool._0_._elem._m_LocationList._Item._91_._Rssi._m_value "" VALUE 0xB0010B92 __Float16_Value 0 NO_COMPU_METHOD -65504 65504 ECU_ADDRESS_EXTENSION 0x2 BYTE_ORDER MSB_LAST /end CHARACTERISTIC
/begin CHARACTERISTIC _g_PL_AD_fw_Radar_1R1V_rpc_LocBypassingRunnable_LocBypassingRunnable_m_pad_ensRLocationsPort_par_out_local.TChangeableMemPool._._._m_arrayPool._0_._elem._m_LocationList._Item._91_._d "" VALUE 0xB0010B78 __Float32_Value 0 NO_COMPU_METHOD -3.4028234663852886E+38 3.4028234663852886E+38 ECU_ADDRESS_EXTENSION 0x2 BYTE_ORDER MSB_LAST /end CHARACTERISTIC
/begin CHARACTERISTIC _g_PL_AD_fw_Radar_1R1V_rpc_LocBypassingRunnable_LocBypassingRunnable_m_pad_ensRLocationsPort_par_out_local.TChangeableMemPool._._._m_arrayPool._0_._elem._m_LocationList._Item._91_._dVar._m_value "" VALUE 0xB0010B80 __Float16_Value 0 NO_COMPU_METHOD -65504 65504 ECU_ADDRESS_EXTENSION 0x2 BYTE_ORDER MSB_LAST /end CHARACTERISTIC
/begin CHARACTERISTIC _g_PL_AD_fw_Radar_1R1V_rpc_LocBypassingRunnable_LocBypassingRunnable_m_pad_ensRLocationsPort_par_out_local.TChangeableMemPool._._._m_arrayPool._0_._elem._m_LocationList._Item._91_._dvCov._m_value "" VALUE 0xB0010B84 __Float16_Value 0 NO_COMPU_METHOD -65504 65504 ECU_ADDRESS_EXTENSION 0x2 BYTE_ORDER MSB_LAST /end CHARACTERISTIC
/begin CHARACTERISTIC _g_PL_AD_fw_Radar_1R1V_rpc_LocBypassingRunnable_LocBypassingRunnable_m_pad_ensRLocationsPort_par_out_local.TChangeableMemPool._._._m_arrayPool._0_._elem._m_LocationList._Item._91_._dvQly "" VALUE 0xB0010B94 __UByte_Value 0 NO_COMPU_METHOD 0 255 ECU_ADDRESS_EXTENSION 0x2 BYTE_ORDER MSB_LAST /end CHARACTERISTIC
/begin CHARACTERISTIC _g_PL_AD_fw_Radar_1R1V_rpc_LocBypassingRunnable_LocBypassingRunnable_m_pad_ensRLocationsPort_par_out_local.TChangeableMemPool._._._m_arrayPool._0_._elem._m_LocationList._Item._91_._idxAzimuthAmbiguityPeer "" VALUE 0xB0010B96 __UWord_Value 0 NO_COMPU_METHOD 0 65535 ECU_ADDRESS_EXTENSION 0x2 BYTE_ORDER MSB_LAST /end CHARACTERISTIC
/begin CHARACTERISTIC _g_PL_AD_fw_Radar_1R1V_rpc_LocBypassingRunnable_LocBypassingRunnable_m_pad_ensRLocationsPort_par_out_local.TChangeableMemPool._._._m_arrayPool._0_._elem._m_LocationList._Item._91_._measStatus "" VALUE 0xB0010B95 __UByte_Value 0 NO_COMPU_METHOD 0 255 ECU_ADDRESS_EXTENSION 0x2 BYTE_ORDER MSB_LAST /end CHARACTERISTIC
/begin CHARACTERISTIC _g_PL_AD_fw_Radar_1R1V_rpc_LocBypassingRunnable_LocBypassingRunnable_m_pad_ensRLocationsPort_par_out_local.TChangeableMemPool._._._m_arrayPool._0_._elem._m_LocationList._Item._91_._phi._m_value "" VALUE 0xB0010B88 __Float16_Value 0 NO_COMPU_METHOD -65504 65504 ECU_ADDRESS_EXTENSION 0x2 BYTE_ORDER MSB_LAST /end CHARACTERISTIC
/begin CHARACTERISTIC _g_PL_AD_fw_Radar_1R1V_rpc_LocBypassingRunnable_LocBypassingRunnable_m_pad_ensRLocationsPort_par_out_local.TChangeableMemPool._._._m_arrayPool._0_._elem._m_LocationList._Item._91_._phiQly "" VALUE 0xB0010B8B __UByte_Value 0 NO_COMPU_METHOD 0 255 ECU_ADDRESS_EXTENSION 0x2 BYTE_ORDER MSB_LAST /end CHARACTERISTIC
/begin CHARACTERISTIC _g_PL_AD_fw_Radar_1R1V_rpc_LocBypassingRunnable_LocBypassingRunnable_m_pad_ensRLocationsPort_par_out_local.TChangeableMemPool._._._m_arrayPool._0_._elem._m_LocationList._Item._91_._phiVar._m_value "" VALUE 0xB0010B8E __Float16_Value 0 NO_COMPU_METHOD -65504 65504 ECU_ADDRESS_EXTENSION 0x2 BYTE_ORDER MSB_LAST /end CHARACTERISTIC
/begin CHARACTERISTIC _g_PL_AD_fw_Radar_1R1V_rpc_LocBypassingRunnable_LocBypassingRunnable_m_pad_ensRLocationsPort_par_out_local.TChangeableMemPool._._._m_arrayPool._0_._elem._m_LocationList._Item._91_._theta._m_value "" VALUE 0xB0010B86 __Float16_Value 0 NO_COMPU_METHOD -65504 65504 ECU_ADDRESS_EXTENSION 0x2 BYTE_ORDER MSB_LAST /end CHARACTERISTIC
/begin CHARACTERISTIC _g_PL_AD_fw_Radar_1R1V_rpc_LocBypassingRunnable_LocBypassingRunnable_m_pad_ensRLocationsPort_par_out_local.TChangeableMemPool._._._m_arrayPool._0_._elem._m_LocationList._Item._91_._thetaQly "" VALUE 0xB0010B8A __UByte_Value 0 NO_COMPU_METHOD 0 255 ECU_ADDRESS_EXTENSION 0x2 BYTE_ORDER MSB_LAST /end CHARACTERISTIC
/begin CHARACTERISTIC _g_PL_AD_fw_Radar_1R1V_rpc_LocBypassingRunnable_LocBypassingRunnable_m_pad_ensRLocationsPort_par_out_local.TChangeableMemPool._._._m_arrayPool._0_._elem._m_LocationList._Item._91_._thetaVar._m_value "" VALUE 0xB0010B8C __Float16_Value 0 NO_COMPU_METHOD -65504 65504 ECU_ADDRESS_EXTENSION 0x2 BYTE_ORDER MSB_LAST /end CHARACTERISTIC
/begin CHARACTERISTIC _g_PL_AD_fw_Radar_1R1V_rpc_LocBypassingRunnable_LocBypassingRunnable_m_pad_ensRLocationsPort_par_out_local.TChangeableMemPool._._._m_arrayPool._0_._elem._m_LocationList._Item._91_._v "" VALUE 0xB0010B7C __Float32_Value 0 NO_COMPU_METHOD -3.4028234663852886E+38 3.4028234663852886E+38 ECU_ADDRESS_EXTENSION 0x2 BYTE_ORDER MSB_LAST /end CHARACTERISTIC
/begin CHARACTERISTIC _g_PL_AD_fw_Radar_1R1V_rpc_LocBypassingRunnable_LocBypassingRunnable_m_pad_ensRLocationsPort_par_out_local.TChangeableMemPool._._._m_arrayPool._0_._elem._m_LocationList._Item._91_._vVar._m_value "" VALUE 0xB0010B82 __Float16_Value 0 NO_COMPU_METHOD -65504 65504 ECU_ADDRESS_EXTENSION 0x2 BYTE_ORDER MSB_LAST /end CHARACTERISTIC
/begin CHARACTERISTIC _g_PL_AD_fw_Radar_1R1V_rpc_LocBypassingRunnable_LocBypassingRunnable_m_pad_ensRLocationsPort_par_out_local.TChangeableMemPool._._._m_arrayPool._0_._elem._m_LocationList._Item._92_._Rcs._m_value "" VALUE 0xB0010BB0 __Float16_Value 0 NO_COMPU_METHOD -65504 65504 ECU_ADDRESS_EXTENSION 0x2 BYTE_ORDER MSB_LAST /end CHARACTERISTIC
/begin CHARACTERISTIC _g_PL_AD_fw_Radar_1R1V_rpc_LocBypassingRunnable_LocBypassingRunnable_m_pad_ensRLocationsPort_par_out_local.TChangeableMemPool._._._m_arrayPool._0_._elem._m_LocationList._Item._92_._Rssi._m_value "" VALUE 0xB0010BB2 __Float16_Value 0 NO_COMPU_METHOD -65504 65504 ECU_ADDRESS_EXTENSION 0x2 BYTE_ORDER MSB_LAST /end CHARACTERISTIC
/begin CHARACTERISTIC _g_PL_AD_fw_Radar_1R1V_rpc_LocBypassingRunnable_LocBypassingRunnable_m_pad_ensRLocationsPort_par_out_local.TChangeableMemPool._._._m_arrayPool._0_._elem._m_LocationList._Item._92_._d "" VALUE 0xB0010B98 __Float32_Value 0 NO_COMPU_METHOD -3.4028234663852886E+38 3.4028234663852886E+38 ECU_ADDRESS_EXTENSION 0x2 BYTE_ORDER MSB_LAST /end CHARACTERISTIC
/begin CHARACTERISTIC _g_PL_AD_fw_Radar_1R1V_rpc_LocBypassingRunnable_LocBypassingRunnable_m_pad_ensRLocationsPort_par_out_local.TChangeableMemPool._._._m_arrayPool._0_._elem._m_LocationList._Item._92_._dVar._m_value "" VALUE 0xB0010BA0 __Float16_Value 0 NO_COMPU_METHOD -65504 65504 ECU_ADDRESS_EXTENSION 0x2 BYTE_ORDER MSB_LAST /end CHARACTERISTIC
/begin CHARACTERISTIC _g_PL_AD_fw_Radar_1R1V_rpc_LocBypassingRunnable_LocBypassingRunnable_m_pad_ensRLocationsPort_par_out_local.TChangeableMemPool._._._m_arrayPool._0_._elem._m_LocationList._Item._92_._dvCov._m_value "" VALUE 0xB0010BA4 __Float16_Value 0 NO_COMPU_METHOD -65504 65504 ECU_ADDRESS_EXTENSION 0x2 BYTE_ORDER MSB_LAST /end CHARACTERISTIC
/begin CHARACTERISTIC _g_PL_AD_fw_Radar_1R1V_rpc_LocBypassingRunnable_LocBypassingRunnable_m_pad_ensRLocationsPort_par_out_local.TChangeableMemPool._._._m_arrayPool._0_._elem._m_LocationList._Item._92_._dvQly "" VALUE 0xB0010BB4 __UByte_Value 0 NO_COMPU_METHOD 0 255 ECU_ADDRESS_EXTENSION 0x2 BYTE_ORDER MSB_LAST /end CHARACTERISTIC
/begin CHARACTERISTIC _g_PL_AD_fw_Radar_1R1V_rpc_LocBypassingRunnable_LocBypassingRunnable_m_pad_ensRLocationsPort_par_out_local.TChangeableMemPool._._._m_arrayPool._0_._elem._m_LocationList._Item._92_._idxAzimuthAmbiguityPeer "" VALUE 0xB0010BB6 __UWord_Value 0 NO_COMPU_METHOD 0 65535 ECU_ADDRESS_EXTENSION 0x2 BYTE_ORDER MSB_LAST /end CHARACTERISTIC
/begin CHARACTERISTIC _g_PL_AD_fw_Radar_1R1V_rpc_LocBypassingRunnable_LocBypassingRunnable_m_pad_ensRLocationsPort_par_out_local.TChangeableMemPool._._._m_arrayPool._0_._elem._m_LocationList._Item._92_._measStatus "" VALUE 0xB0010BB5 __UByte_Value 0 NO_COMPU_METHOD 0 255 ECU_ADDRESS_EXTENSION 0x2 BYTE_ORDER MSB_LAST /end CHARACTERISTIC
/begin CHARACTERISTIC _g_PL_AD_fw_Radar_1R1V_rpc_LocBypassingRunnable_LocBypassingRunnable_m_pad_ensRLocationsPort_par_out_local.TChangeableMemPool._._._m_arrayPool._0_._elem._m_LocationList._Item._92_._phi._m_value "" VALUE 0xB0010BA8 __Float16_Value 0 NO_COMPU_METHOD -65504 65504 ECU_ADDRESS_EXTENSION 0x2 BYTE_ORDER MSB_LAST /end CHARACTERISTIC
/begin CHARACTERISTIC _g_PL_AD_fw_Radar_1R1V_rpc_LocBypassingRunnable_LocBypassingRunnable_m_pad_ensRLocationsPort_par_out_local.TChangeableMemPool._._._m_arrayPool._0_._elem._m_LocationList._Item._92_._phiQly "" VALUE 0xB0010BAB __UByte_Value 0 NO_COMPU_METHOD 0 255 ECU_ADDRESS_EXTENSION 0x2 BYTE_ORDER MSB_LAST /end CHARACTERISTIC
/begin CHARACTERISTIC _g_PL_AD_fw_Radar_1R1V_rpc_LocBypassingRunnable_LocBypassingRunnable_m_pad_ensRLocationsPort_par_out_local.TChangeableMemPool._._._m_arrayPool._0_._elem._m_LocationList._Item._92_._phiVar._m_value "" VALUE 0xB0010BAE __Float16_Value 0 NO_COMPU_METHOD -65504 65504 ECU_ADDRESS_EXTENSION 0x2 BYTE_ORDER MSB_LAST /end CHARACTERISTIC
/begin CHARACTERISTIC _g_PL_AD_fw_Radar_1R1V_rpc_LocBypassingRunnable_LocBypassingRunnable_m_pad_ensRLocationsPort_par_out_local.TChangeableMemPool._._._m_arrayPool._0_._elem._m_LocationList._Item._92_._theta._m_value "" VALUE 0xB0010BA6 __Float16_Value 0 NO_COMPU_METHOD -65504 65504 ECU_ADDRESS_EXTENSION 0x2 BYTE_ORDER MSB_LAST /end CHARACTERISTIC
/begin CHARACTERISTIC _g_PL_AD_fw_Radar_1R1V_rpc_LocBypassingRunnable_LocBypassingRunnable_m_pad_ensRLocationsPort_par_out_local.TChangeableMemPool._._._m_arrayPool._0_._elem._m_LocationList._Item._92_._thetaQly "" VALUE 0xB0010BAA __UByte_Value 0 NO_COMPU_METHOD 0 255 ECU_ADDRESS_EXTENSION 0x2 BYTE_ORDER MSB_LAST /end CHARACTERISTIC
/begin CHARACTERISTIC _g_PL_AD_fw_Radar_1R1V_rpc_LocBypassingRunnable_LocBypassingRunnable_m_pad_ensRLocationsPort_par_out_local.TChangeableMemPool._._._m_arrayPool._0_._elem._m_LocationList._Item._92_._thetaVar._m_value "" VALUE 0xB0010BAC __Float16_Value 0 NO_COMPU_METHOD -65504 65504 ECU_ADDRESS_EXTENSION 0x2 BYTE_ORDER MSB_LAST /end CHARACTERISTIC
/begin CHARACTERISTIC _g_PL_AD_fw_Radar_1R1V_rpc_LocBypassingRunnable_LocBypassingRunnable_m_pad_ensRLocationsPort_par_out_local.TChangeableMemPool._._._m_arrayPool._0_._elem._m_LocationList._Item._92_._v "" VALUE 0xB0010B9C __Float32_Value 0 NO_COMPU_METHOD -3.4028234663852886E+38 3.4028234663852886E+38 ECU_ADDRESS_EXTENSION 0x2 BYTE_ORDER MSB_LAST /end CHARACTERISTIC
/begin CHARACTERISTIC _g_PL_AD_fw_Radar_1R1V_rpc_LocBypassingRunnable_LocBypassingRunnable_m_pad_ensRLocationsPort_par_out_local.TChangeableMemPool._._._m_arrayPool._0_._elem._m_LocationList._Item._92_._vVar._m_value "" VALUE 0xB0010BA2 __Float16_Value 0 NO_COMPU_METHOD -65504 65504 ECU_ADDRESS_EXTENSION 0x2 BYTE_ORDER MSB_LAST /end CHARACTERISTIC
/begin CHARACTERISTIC _g_PL_AD_fw_Radar_1R1V_rpc_LocBypassingRunnable_LocBypassingRunnable_m_pad_ensRLocationsPort_par_out_local.TChangeableMemPool._._._m_arrayPool._0_._elem._m_LocationList._Item._93_._Rcs._m_value "" VALUE 0xB0010BD0 __Float16_Value 0 NO_COMPU_METHOD -65504 65504 ECU_ADDRESS_EXTENSION 0x2 BYTE_ORDER MSB_LAST /end CHARACTERISTIC
/begin CHARACTERISTIC _g_PL_AD_fw_Radar_1R1V_rpc_LocBypassingRunnable_LocBypassingRunnable_m_pad_ensRLocationsPort_par_out_local.TChangeableMemPool._._._m_arrayPool._0_._elem._m_LocationList._Item._93_._Rssi._m_value "" VALUE 0xB0010BD2 __Float16_Value 0 NO_COMPU_METHOD -65504 65504 ECU_ADDRESS_EXTENSION 0x2 BYTE_ORDER MSB_LAST /end CHARACTERISTIC
/begin CHARACTERISTIC _g_PL_AD_fw_Radar_1R1V_rpc_LocBypassingRunnable_LocBypassingRunnable_m_pad_ensRLocationsPort_par_out_local.TChangeableMemPool._._._m_arrayPool._0_._elem._m_LocationList._Item._93_._d "" VALUE 0xB0010BB8 __Float32_Value 0 NO_COMPU_METHOD -3.4028234663852886E+38 3.4028234663852886E+38 ECU_ADDRESS_EXTENSION 0x2 BYTE_ORDER MSB_LAST /end CHARACTERISTIC
/begin CHARACTERISTIC _g_PL_AD_fw_Radar_1R1V_rpc_LocBypassingRunnable_LocBypassingRunnable_m_pad_ensRLocationsPort_par_out_local.TChangeableMemPool._._._m_arrayPool._0_._elem._m_LocationList._Item._93_._dVar._m_value "" VALUE 0xB0010BC0 __Float16_Value 0 NO_COMPU_METHOD -65504 65504 ECU_ADDRESS_EXTENSION 0x2 BYTE_ORDER MSB_LAST /end CHARACTERISTIC
/begin CHARACTERISTIC _g_PL_AD_fw_Radar_1R1V_rpc_LocBypassingRunnable_LocBypassingRunnable_m_pad_ensRLocationsPort_par_out_local.TChangeableMemPool._._._m_arrayPool._0_._elem._m_LocationList._Item._93_._dvCov._m_value "" VALUE 0xB0010BC4 __Float16_Value 0 NO_COMPU_METHOD -65504 65504 ECU_ADDRESS_EXTENSION 0x2 BYTE_ORDER MSB_LAST /end CHARACTERISTIC
/begin CHARACTERISTIC _g_PL_AD_fw_Radar_1R1V_rpc_LocBypassingRunnable_LocBypassingRunnable_m_pad_ensRLocationsPort_par_out_local.TChangeableMemPool._._._m_arrayPool._0_._elem._m_LocationList._Item._93_._dvQly "" VALUE 0xB0010BD4 __UByte_Value 0 NO_COMPU_METHOD 0 255 ECU_ADDRESS_EXTENSION 0x2 BYTE_ORDER MSB_LAST /end CHARACTERISTIC
/begin CHARACTERISTIC _g_PL_AD_fw_Radar_1R1V_rpc_LocBypassingRunnable_LocBypassingRunnable_m_pad_ensRLocationsPort_par_out_local.TChangeableMemPool._._._m_arrayPool._0_._elem._m_LocationList._Item._93_._idxAzimuthAmbiguityPeer "" VALUE 0xB0010BD6 __UWord_Value 0 NO_COMPU_METHOD 0 65535 ECU_ADDRESS_EXTENSION 0x2 BYTE_ORDER MSB_LAST /end CHARACTERISTIC
/begin CHARACTERISTIC _g_PL_AD_fw_Radar_1R1V_rpc_LocBypassingRunnable_LocBypassingRunnable_m_pad_ensRLocationsPort_par_out_local.TChangeableMemPool._._._m_arrayPool._0_._elem._m_LocationList._Item._93_._measStatus "" VALUE 0xB0010BD5 __UByte_Value 0 NO_COMPU_METHOD 0 255 ECU_ADDRESS_EXTENSION 0x2 BYTE_ORDER MSB_LAST /end CHARACTERISTIC
/begin CHARACTERISTIC _g_PL_AD_fw_Radar_1R1V_rpc_LocBypassingRunnable_LocBypassingRunnable_m_pad_ensRLocationsPort_par_out_local.TChangeableMemPool._._._m_arrayPool._0_._elem._m_LocationList._Item._93_._phi._m_value "" VALUE 0xB0010BC8 __Float16_Value 0 NO_COMPU_METHOD -65504 65504 ECU_ADDRESS_EXTENSION 0x2 BYTE_ORDER MSB_LAST /end CHARACTERISTIC
/begin CHARACTERISTIC _g_PL_AD_fw_Radar_1R1V_rpc_LocBypassingRunnable_LocBypassingRunnable_m_pad_ensRLocationsPort_par_out_local.TChangeableMemPool._._._m_arrayPool._0_._elem._m_LocationList._Item._93_._phiQly "" VALUE 0xB0010BCB __UByte_Value 0 NO_COMPU_METHOD 0 255 ECU_ADDRESS_EXTENSION 0x2 BYTE_ORDER MSB_LAST /end CHARACTERISTIC
/begin CHARACTERISTIC _g_PL_AD_fw_Radar_1R1V_rpc_LocBypassingRunnable_LocBypassingRunnable_m_pad_ensRLocationsPort_par_out_local.TChangeableMemPool._._._m_arrayPool._0_._elem._m_LocationList._Item._93_._phiVar._m_value "" VALUE 0xB0010BCE __Float16_Value 0 NO_COMPU_METHOD -65504 65504 ECU_ADDRESS_EXTENSION 0x2 BYTE_ORDER MSB_LAST /end CHARACTERISTIC
/begin CHARACTERISTIC _g_PL_AD_fw_Radar_1R1V_rpc_LocBypassingRunnable_LocBypassingRunnable_m_pad_ensRLocationsPort_par_out_local.TChangeableMemPool._._._m_arrayPool._0_._elem._m_LocationList._Item._93_._theta._m_value "" VALUE 0xB0010BC6 __Float16_Value 0 NO_COMPU_METHOD -65504 65504 ECU_ADDRESS_EXTENSION 0x2 BYTE_ORDER MSB_LAST /end CHARACTERISTIC
/begin CHARACTERISTIC _g_PL_AD_fw_Radar_1R1V_rpc_LocBypassingRunnable_LocBypassingRunnable_m_pad_ensRLocationsPort_par_out_local.TChangeableMemPool._._._m_arrayPool._0_._elem._m_LocationList._Item._93_._thetaQly "" VALUE 0xB0010BCA __UByte_Value 0 NO_COMPU_METHOD 0 255 ECU_ADDRESS_EXTENSION 0x2 BYTE_ORDER MSB_LAST /end CHARACTERISTIC
/begin CHARACTERISTIC _g_PL_AD_fw_Radar_1R1V_rpc_LocBypassingRunnable_LocBypassingRunnable_m_pad_ensRLocationsPort_par_out_local.TChangeableMemPool._._._m_arrayPool._0_._elem._m_LocationList._Item._93_._thetaVar._m_value "" VALUE 0xB0010BCC __Float16_Value 0 NO_COMPU_METHOD -65504 65504 ECU_ADDRESS_EXTENSION 0x2 BYTE_ORDER MSB_LAST /end CHARACTERISTIC
/begin CHARACTERISTIC _g_PL_AD_fw_Radar_1R1V_rpc_LocBypassingRunnable_LocBypassingRunnable_m_pad_ensRLocationsPort_par_out_local.TChangeableMemPool._._._m_arrayPool._0_._elem._m_LocationList._Item._93_._v "" VALUE 0xB0010BBC __Float32_Value 0 NO_COMPU_METHOD -3.4028234663852886E+38 3.4028234663852886E+38 ECU_ADDRESS_EXTENSION 0x2 BYTE_ORDER MSB_LAST /end CHARACTERISTIC
/begin CHARACTERISTIC _g_PL_AD_fw_Radar_1R1V_rpc_LocBypassingRunnable_LocBypassingRunnable_m_pad_ensRLocationsPort_par_out_local.TChangeableMemPool._._._m_arrayPool._0_._elem._m_LocationList._Item._93_._vVar._m_value "" VALUE 0xB0010BC2 __Float16_Value 0 NO_COMPU_METHOD -65504 65504 ECU_ADDRESS_EXTENSION 0x2 BYTE_ORDER MSB_LAST /end CHARACTERISTIC
/begin CHARACTERISTIC _g_PL_AD_fw_Radar_1R1V_rpc_LocBypassingRunnable_LocBypassingRunnable_m_pad_ensRLocationsPort_par_out_local.TChangeableMemPool._._._m_arrayPool._0_._elem._m_LocationList._Item._94_._Rcs._m_value "" VALUE 0xB0010BF0 __Float16_Value 0 NO_COMPU_METHOD -65504 65504 ECU_ADDRESS_EXTENSION 0x2 BYTE_ORDER MSB_LAST /end CHARACTERISTIC
/begin CHARACTERISTIC _g_PL_AD_fw_Radar_1R1V_rpc_LocBypassingRunnable_LocBypassingRunnable_m_pad_ensRLocationsPort_par_out_local.TChangeableMemPool._._._m_arrayPool._0_._elem._m_LocationList._Item._94_._Rssi._m_value "" VALUE 0xB0010BF2 __Float16_Value 0 NO_COMPU_METHOD -65504 65504 ECU_ADDRESS_EXTENSION 0x2 BYTE_ORDER MSB_LAST /end CHARACTERISTIC
/begin CHARACTERISTIC _g_PL_AD_fw_Radar_1R1V_rpc_LocBypassingRunnable_LocBypassingRunnable_m_pad_ensRLocationsPort_par_out_local.TChangeableMemPool._._._m_arrayPool._0_._elem._m_LocationList._Item._94_._d "" VALUE 0xB0010BD8 __Float32_Value 0 NO_COMPU_METHOD -3.4028234663852886E+38 3.4028234663852886E+38 ECU_ADDRESS_EXTENSION 0x2 BYTE_ORDER MSB_LAST /end CHARACTERISTIC
/begin CHARACTERISTIC _g_PL_AD_fw_Radar_1R1V_rpc_LocBypassingRunnable_LocBypassingRunnable_m_pad_ensRLocationsPort_par_out_local.TChangeableMemPool._._._m_arrayPool._0_._elem._m_LocationList._Item._94_._dVar._m_value "" VALUE 0xB0010BE0 __Float16_Value 0 NO_COMPU_METHOD -65504 65504 ECU_ADDRESS_EXTENSION 0x2 BYTE_ORDER MSB_LAST /end CHARACTERISTIC
/begin CHARACTERISTIC _g_PL_AD_fw_Radar_1R1V_rpc_LocBypassingRunnable_LocBypassingRunnable_m_pad_ensRLocationsPort_par_out_local.TChangeableMemPool._._._m_arrayPool._0_._elem._m_LocationList._Item._94_._dvCov._m_value "" VALUE 0xB0010BE4 __Float16_Value 0 NO_COMPU_METHOD -65504 65504 ECU_ADDRESS_EXTENSION 0x2 BYTE_ORDER MSB_LAST /end CHARACTERISTIC
/begin CHARACTERISTIC _g_PL_AD_fw_Radar_1R1V_rpc_LocBypassingRunnable_LocBypassingRunnable_m_pad_ensRLocationsPort_par_out_local.TChangeableMemPool._._._m_arrayPool._0_._elem._m_LocationList._Item._94_._dvQly "" VALUE 0xB0010BF4 __UByte_Value 0 NO_COMPU_METHOD 0 255 ECU_ADDRESS_EXTENSION 0x2 BYTE_ORDER MSB_LAST /end CHARACTERISTIC
/begin CHARACTERISTIC _g_PL_AD_fw_Radar_1R1V_rpc_LocBypassingRunnable_LocBypassingRunnable_m_pad_ensRLocationsPort_par_out_local.TChangeableMemPool._._._m_arrayPool._0_._elem._m_LocationList._Item._94_._idxAzimuthAmbiguityPeer "" VALUE 0xB0010BF6 __UWord_Value 0 NO_COMPU_METHOD 0 65535 ECU_ADDRESS_EXTENSION 0x2 BYTE_ORDER MSB_LAST /end CHARACTERISTIC
/begin CHARACTERISTIC _g_PL_AD_fw_Radar_1R1V_rpc_LocBypassingRunnable_LocBypassingRunnable_m_pad_ensRLocationsPort_par_out_local.TChangeableMemPool._._._m_arrayPool._0_._elem._m_LocationList._Item._94_._measStatus "" VALUE 0xB0010BF5 __UByte_Value 0 NO_COMPU_METHOD 0 255 ECU_ADDRESS_EXTENSION 0x2 BYTE_ORDER MSB_LAST /end CHARACTERISTIC
/begin CHARACTERISTIC _g_PL_AD_fw_Radar_1R1V_rpc_LocBypassingRunnable_LocBypassingRunnable_m_pad_ensRLocationsPort_par_out_local.TChangeableMemPool._._._m_arrayPool._0_._elem._m_LocationList._Item._94_._phi._m_value "" VALUE 0xB0010BE8 __Float16_Value 0 NO_COMPU_METHOD -65504 65504 ECU_ADDRESS_EXTENSION 0x2 BYTE_ORDER MSB_LAST /end CHARACTERISTIC
/begin CHARACTERISTIC _g_PL_AD_fw_Radar_1R1V_rpc_LocBypassingRunnable_LocBypassingRunnable_m_pad_ensRLocationsPort_par_out_local.TChangeableMemPool._._._m_arrayPool._0_._elem._m_LocationList._Item._94_._phiQly "" VALUE 0xB0010BEB __UByte_Value 0 NO_COMPU_METHOD 0 255 ECU_ADDRESS_EXTENSION 0x2 BYTE_ORDER MSB_LAST /end CHARACTERISTIC
/begin CHARACTERISTIC _g_PL_AD_fw_Radar_1R1V_rpc_LocBypassingRunnable_LocBypassingRunnable_m_pad_ensRLocationsPort_par_out_local.TChangeableMemPool._._._m_arrayPool._0_._elem._m_LocationList._Item._94_._phiVar._m_value "" VALUE 0xB0010BEE __Float16_Value 0 NO_COMPU_METHOD -65504 65504 ECU_ADDRESS_EXTENSION 0x2 BYTE_ORDER MSB_LAST /end CHARACTERISTIC
/begin CHARACTERISTIC _g_PL_AD_fw_Radar_1R1V_rpc_LocBypassingRunnable_LocBypassingRunnable_m_pad_ensRLocationsPort_par_out_local.TChangeableMemPool._._._m_arrayPool._0_._elem._m_LocationList._Item._94_._theta._m_value "" VALUE 0xB0010BE6 __Float16_Value 0 NO_COMPU_METHOD -65504 65504 ECU_ADDRESS_EXTENSION 0x2 BYTE_ORDER MSB_LAST /end CHARACTERISTIC
/begin CHARACTERISTIC _g_PL_AD_fw_Radar_1R1V_rpc_LocBypassingRunnable_LocBypassingRunnable_m_pad_ensRLocationsPort_par_out_local.TChangeableMemPool._._._m_arrayPool._0_._elem._m_LocationList._Item._94_._thetaQly "" VALUE 0xB0010BEA __UByte_Value 0 NO_COMPU_METHOD 0 255 ECU_ADDRESS_EXTENSION 0x2 BYTE_ORDER MSB_LAST /end CHARACTERISTIC
/begin CHARACTERISTIC _g_PL_AD_fw_Radar_1R1V_rpc_LocBypassingRunnable_LocBypassingRunnable_m_pad_ensRLocationsPort_par_out_local.TChangeableMemPool._._._m_arrayPool._0_._elem._m_LocationList._Item._94_._thetaVar._m_value "" VALUE 0xB0010BEC __Float16_Value 0 NO_COMPU_METHOD -65504 65504 ECU_ADDRESS_EXTENSION 0x2 BYTE_ORDER MSB_LAST /end CHARACTERISTIC
/begin CHARACTERISTIC _g_PL_AD_fw_Radar_1R1V_rpc_LocBypassingRunnable_LocBypassingRunnable_m_pad_ensRLocationsPort_par_out_local.TChangeableMemPool._._._m_arrayPool._0_._elem._m_LocationList._Item._94_._v "" VALUE 0xB0010BDC __Float32_Value 0 NO_COMPU_METHOD -3.4028234663852886E+38 3.4028234663852886E+38 ECU_ADDRESS_EXTENSION 0x2 BYTE_ORDER MSB_LAST /end CHARACTERISTIC
/begin CHARACTERISTIC _g_PL_AD_fw_Radar_1R1V_rpc_LocBypassingRunnable_LocBypassingRunnable_m_pad_ensRLocationsPort_par_out_local.TChangeableMemPool._._._m_arrayPool._0_._elem._m_LocationList._Item._94_._vVar._m_value "" VALUE 0xB0010BE2 __Float16_Value 0 NO_COMPU_METHOD -65504 65504 ECU_ADDRESS_EXTENSION 0x2 BYTE_ORDER MSB_LAST /end CHARACTERISTIC
/begin CHARACTERISTIC _g_PL_AD_fw_Radar_1R1V_rpc_LocBypassingRunnable_LocBypassingRunnable_m_pad_ensRLocationsPort_par_out_local.TChangeableMemPool._._._m_arrayPool._0_._elem._m_LocationList._Item._95_._Rcs._m_value "" VALUE 0xB0010C10 __Float16_Value 0 NO_COMPU_METHOD -65504 65504 ECU_ADDRESS_EXTENSION 0x2 BYTE_ORDER MSB_LAST /end CHARACTERISTIC
/begin CHARACTERISTIC _g_PL_AD_fw_Radar_1R1V_rpc_LocBypassingRunnable_LocBypassingRunnable_m_pad_ensRLocationsPort_par_out_local.TChangeableMemPool._._._m_arrayPool._0_._elem._m_LocationList._Item._95_._Rssi._m_value "" VALUE 0xB0010C12 __Float16_Value 0 NO_COMPU_METHOD -65504 65504 ECU_ADDRESS_EXTENSION 0x2 BYTE_ORDER MSB_LAST /end CHARACTERISTIC
/begin CHARACTERISTIC _g_PL_AD_fw_Radar_1R1V_rpc_LocBypassingRunnable_LocBypassingRunnable_m_pad_ensRLocationsPort_par_out_local.TChangeableMemPool._._._m_arrayPool._0_._elem._m_LocationList._Item._95_._d "" VALUE 0xB0010BF8 __Float32_Value 0 NO_COMPU_METHOD -3.4028234663852886E+38 3.4028234663852886E+38 ECU_ADDRESS_EXTENSION 0x2 BYTE_ORDER MSB_LAST /end CHARACTERISTIC
/begin CHARACTERISTIC _g_PL_AD_fw_Radar_1R1V_rpc_LocBypassingRunnable_LocBypassingRunnable_m_pad_ensRLocationsPort_par_out_local.TChangeableMemPool._._._m_arrayPool._0_._elem._m_LocationList._Item._95_._dVar._m_value "" VALUE 0xB0010C00 __Float16_Value 0 NO_COMPU_METHOD -65504 65504 ECU_ADDRESS_EXTENSION 0x2 BYTE_ORDER MSB_LAST /end CHARACTERISTIC
/begin CHARACTERISTIC _g_PL_AD_fw_Radar_1R1V_rpc_LocBypassingRunnable_LocBypassingRunnable_m_pad_ensRLocationsPort_par_out_local.TChangeableMemPool._._._m_arrayPool._0_._elem._m_LocationList._Item._95_._dvCov._m_value "" VALUE 0xB0010C04 __Float16_Value 0 NO_COMPU_METHOD -65504 65504 ECU_ADDRESS_EXTENSION 0x2 BYTE_ORDER MSB_LAST /end CHARACTERISTIC
/begin CHARACTERISTIC _g_PL_AD_fw_Radar_1R1V_rpc_LocBypassingRunnable_LocBypassingRunnable_m_pad_ensRLocationsPort_par_out_local.TChangeableMemPool._._._m_arrayPool._0_._elem._m_LocationList._Item._95_._dvQly "" VALUE 0xB0010C14 __UByte_Value 0 NO_COMPU_METHOD 0 255 ECU_ADDRESS_EXTENSION 0x2 BYTE_ORDER MSB_LAST /end CHARACTERISTIC
/begin CHARACTERISTIC _g_PL_AD_fw_Radar_1R1V_rpc_LocBypassingRunnable_LocBypassingRunnable_m_pad_ensRLocationsPort_par_out_local.TChangeableMemPool._._._m_arrayPool._0_._elem._m_LocationList._Item._95_._idxAzimuthAmbiguityPeer "" VALUE 0xB0010C16 __UWord_Value 0 NO_COMPU_METHOD 0 65535 ECU_ADDRESS_EXTENSION 0x2 BYTE_ORDER MSB_LAST /end CHARACTERISTIC
/begin CHARACTERISTIC _g_PL_AD_fw_Radar_1R1V_rpc_LocBypassingRunnable_LocBypassingRunnable_m_pad_ensRLocationsPort_par_out_local.TChangeableMemPool._._._m_arrayPool._0_._elem._m_LocationList._Item._95_._measStatus "" VALUE 0xB0010C15 __UByte_Value 0 NO_COMPU_METHOD 0 255 ECU_ADDRESS_EXTENSION 0x2 BYTE_ORDER MSB_LAST /end CHARACTERISTIC
/begin CHARACTERISTIC _g_PL_AD_fw_Radar_1R1V_rpc_LocBypassingRunnable_LocBypassingRunnable_m_pad_ensRLocationsPort_par_out_local.TChangeableMemPool._._._m_arrayPool._0_._elem._m_LocationList._Item._95_._phi._m_value "" VALUE 0xB0010C08 __Float16_Value 0 NO_COMPU_METHOD -65504 65504 ECU_ADDRESS_EXTENSION 0x2 BYTE_ORDER MSB_LAST /end CHARACTERISTIC
/begin CHARACTERISTIC _g_PL_AD_fw_Radar_1R1V_rpc_LocBypassingRunnable_LocBypassingRunnable_m_pad_ensRLocationsPort_par_out_local.TChangeableMemPool._._._m_arrayPool._0_._elem._m_LocationList._Item._95_._phiQly "" VALUE 0xB0010C0B __UByte_Value 0 NO_COMPU_METHOD 0 255 ECU_ADDRESS_EXTENSION 0x2 BYTE_ORDER MSB_LAST /end CHARACTERISTIC
/begin CHARACTERISTIC _g_PL_AD_fw_Radar_1R1V_rpc_LocBypassingRunnable_LocBypassingRunnable_m_pad_ensRLocationsPort_par_out_local.TChangeableMemPool._._._m_arrayPool._0_._elem._m_LocationList._Item._95_._phiVar._m_value "" VALUE 0xB0010C0E __Float16_Value 0 NO_COMPU_METHOD -65504 65504 ECU_ADDRESS_EXTENSION 0x2 BYTE_ORDER MSB_LAST /end CHARACTERISTIC
/begin CHARACTERISTIC _g_PL_AD_fw_Radar_1R1V_rpc_LocBypassingRunnable_LocBypassingRunnable_m_pad_ensRLocationsPort_par_out_local.TChangeableMemPool._._._m_arrayPool._0_._elem._m_LocationList._Item._95_._theta._m_value "" VALUE 0xB0010C06 __Float16_Value 0 NO_COMPU_METHOD -65504 65504 ECU_ADDRESS_EXTENSION 0x2 BYTE_ORDER MSB_LAST /end CHARACTERISTIC
/begin CHARACTERISTIC _g_PL_AD_fw_Radar_1R1V_rpc_LocBypassingRunnable_LocBypassingRunnable_m_pad_ensRLocationsPort_par_out_local.TChangeableMemPool._._._m_arrayPool._0_._elem._m_LocationList._Item._95_._thetaQly "" VALUE 0xB0010C0A __UByte_Value 0 NO_COMPU_METHOD 0 255 ECU_ADDRESS_EXTENSION 0x2 BYTE_ORDER MSB_LAST /end CHARACTERISTIC
/begin CHARACTERISTIC _g_PL_AD_fw_Radar_1R1V_rpc_LocBypassingRunnable_LocBypassingRunnable_m_pad_ensRLocationsPort_par_out_local.TChangeableMemPool._._._m_arrayPool._0_._elem._m_LocationList._Item._95_._thetaVar._m_value "" VALUE 0xB0010C0C __Float16_Value 0 NO_COMPU_METHOD -65504 65504 ECU_ADDRESS_EXTENSION 0x2 BYTE_ORDER MSB_LAST /end CHARACTERISTIC
/begin CHARACTERISTIC _g_PL_AD_fw_Radar_1R1V_rpc_LocBypassingRunnable_LocBypassingRunnable_m_pad_ensRLocationsPort_par_out_local.TChangeableMemPool._._._m_arrayPool._0_._elem._m_LocationList._Item._95_._v "" VALUE 0xB0010BFC __Float32_Value 0 NO_COMPU_METHOD -3.4028234663852886E+38 3.4028234663852886E+38 ECU_ADDRESS_EXTENSION 0x2 BYTE_ORDER MSB_LAST /end CHARACTERISTIC
/begin CHARACTERISTIC _g_PL_AD_fw_Radar_1R1V_rpc_LocBypassingRunnable_LocBypassingRunnable_m_pad_ensRLocationsPort_par_out_local.TChangeableMemPool._._._m_arrayPool._0_._elem._m_LocationList._Item._95_._vVar._m_value "" VALUE 0xB0010C02 __Float16_Value 0 NO_COMPU_METHOD -65504 65504 ECU_ADDRESS_EXTENSION 0x2 BYTE_ORDER MSB_LAST /end CHARACTERISTIC
/begin CHARACTERISTIC _g_PL_AD_fw_Radar_1R1V_rpc_LocBypassingRunnable_LocBypassingRunnable_m_pad_ensRLocationsPort_par_out_local.TChangeableMemPool._._._m_arrayPool._0_._elem._m_LocationList._Item._96_._Rcs._m_value "" VALUE 0xB0010C30 __Float16_Value 0 NO_COMPU_METHOD -65504 65504 ECU_ADDRESS_EXTENSION 0x2 BYTE_ORDER MSB_LAST /end CHARACTERISTIC
/begin CHARACTERISTIC _g_PL_AD_fw_Radar_1R1V_rpc_LocBypassingRunnable_LocBypassingRunnable_m_pad_ensRLocationsPort_par_out_local.TChangeableMemPool._._._m_arrayPool._0_._elem._m_LocationList._Item._96_._Rssi._m_value "" VALUE 0xB0010C32 __Float16_Value 0 NO_COMPU_METHOD -65504 65504 ECU_ADDRESS_EXTENSION 0x2 BYTE_ORDER MSB_LAST /end CHARACTERISTIC
/begin CHARACTERISTIC _g_PL_AD_fw_Radar_1R1V_rpc_LocBypassingRunnable_LocBypassingRunnable_m_pad_ensRLocationsPort_par_out_local.TChangeableMemPool._._._m_arrayPool._0_._elem._m_LocationList._Item._96_._d "" VALUE 0xB0010C18 __Float32_Value 0 NO_COMPU_METHOD -3.4028234663852886E+38 3.4028234663852886E+38 ECU_ADDRESS_EXTENSION 0x2 BYTE_ORDER MSB_LAST /end CHARACTERISTIC
/begin CHARACTERISTIC _g_PL_AD_fw_Radar_1R1V_rpc_LocBypassingRunnable_LocBypassingRunnable_m_pad_ensRLocationsPort_par_out_local.TChangeableMemPool._._._m_arrayPool._0_._elem._m_LocationList._Item._96_._dVar._m_value "" VALUE 0xB0010C20 __Float16_Value 0 NO_COMPU_METHOD -65504 65504 ECU_ADDRESS_EXTENSION 0x2 BYTE_ORDER MSB_LAST /end CHARACTERISTIC
/begin CHARACTERISTIC _g_PL_AD_fw_Radar_1R1V_rpc_LocBypassingRunnable_LocBypassingRunnable_m_pad_ensRLocationsPort_par_out_local.TChangeableMemPool._._._m_arrayPool._0_._elem._m_LocationList._Item._96_._dvCov._m_value "" VALUE 0xB0010C24 __Float16_Value 0 NO_COMPU_METHOD -65504 65504 ECU_ADDRESS_EXTENSION 0x2 BYTE_ORDER MSB_LAST /end CHARACTERISTIC
/begin CHARACTERISTIC _g_PL_AD_fw_Radar_1R1V_rpc_LocBypassingRunnable_LocBypassingRunnable_m_pad_ensRLocationsPort_par_out_local.TChangeableMemPool._._._m_arrayPool._0_._elem._m_LocationList._Item._96_._dvQly "" VALUE 0xB0010C34 __UByte_Value 0 NO_COMPU_METHOD 0 255 ECU_ADDRESS_EXTENSION 0x2 BYTE_ORDER MSB_LAST /end CHARACTERISTIC
/begin CHARACTERISTIC _g_PL_AD_fw_Radar_1R1V_rpc_LocBypassingRunnable_LocBypassingRunnable_m_pad_ensRLocationsPort_par_out_local.TChangeableMemPool._._._m_arrayPool._0_._elem._m_LocationList._Item._96_._idxAzimuthAmbiguityPeer "" VALUE 0xB0010C36 __UWord_Value 0 NO_COMPU_METHOD 0 65535 ECU_ADDRESS_EXTENSION 0x2 BYTE_ORDER MSB_LAST /end CHARACTERISTIC
/begin CHARACTERISTIC _g_PL_AD_fw_Radar_1R1V_rpc_LocBypassingRunnable_LocBypassingRunnable_m_pad_ensRLocationsPort_par_out_local.TChangeableMemPool._._._m_arrayPool._0_._elem._m_LocationList._Item._96_._measStatus "" VALUE 0xB0010C35 __UByte_Value 0 NO_COMPU_METHOD 0 255 ECU_ADDRESS_EXTENSION 0x2 BYTE_ORDER MSB_LAST /end CHARACTERISTIC
/begin CHARACTERISTIC _g_PL_AD_fw_Radar_1R1V_rpc_LocBypassingRunnable_LocBypassingRunnable_m_pad_ensRLocationsPort_par_out_local.TChangeableMemPool._._._m_arrayPool._0_._elem._m_LocationList._Item._96_._phi._m_value "" VALUE 0xB0010C28 __Float16_Value 0 NO_COMPU_METHOD -65504 65504 ECU_ADDRESS_EXTENSION 0x2 BYTE_ORDER MSB_LAST /end CHARACTERISTIC
/begin CHARACTERISTIC _g_PL_AD_fw_Radar_1R1V_rpc_LocBypassingRunnable_LocBypassingRunnable_m_pad_ensRLocationsPort_par_out_local.TChangeableMemPool._._._m_arrayPool._0_._elem._m_LocationList._Item._96_._phiQly "" VALUE 0xB0010C2B __UByte_Value 0 NO_COMPU_METHOD 0 255 ECU_ADDRESS_EXTENSION 0x2 BYTE_ORDER MSB_LAST /end CHARACTERISTIC
/begin CHARACTERISTIC _g_PL_AD_fw_Radar_1R1V_rpc_LocBypassingRunnable_LocBypassingRunnable_m_pad_ensRLocationsPort_par_out_local.TChangeableMemPool._._._m_arrayPool._0_._elem._m_LocationList._Item._96_._phiVar._m_value "" VALUE 0xB0010C2E __Float16_Value 0 NO_COMPU_METHOD -65504 65504 ECU_ADDRESS_EXTENSION 0x2 BYTE_ORDER MSB_LAST /end CHARACTERISTIC
/begin CHARACTERISTIC _g_PL_AD_fw_Radar_1R1V_rpc_LocBypassingRunnable_LocBypassingRunnable_m_pad_ensRLocationsPort_par_out_local.TChangeableMemPool._._._m_arrayPool._0_._elem._m_LocationList._Item._96_._theta._m_value "" VALUE 0xB0010C26 __Float16_Value 0 NO_COMPU_METHOD -65504 65504 ECU_ADDRESS_EXTENSION 0x2 BYTE_ORDER MSB_LAST /end CHARACTERISTIC
/begin CHARACTERISTIC _g_PL_AD_fw_Radar_1R1V_rpc_LocBypassingRunnable_LocBypassingRunnable_m_pad_ensRLocationsPort_par_out_local.TChangeableMemPool._._._m_arrayPool._0_._elem._m_LocationList._Item._96_._thetaQly "" VALUE 0xB0010C2A __UByte_Value 0 NO_COMPU_METHOD 0 255 ECU_ADDRESS_EXTENSION 0x2 BYTE_ORDER MSB_LAST /end CHARACTERISTIC
/begin CHARACTERISTIC _g_PL_AD_fw_Radar_1R1V_rpc_LocBypassingRunnable_LocBypassingRunnable_m_pad_ensRLocationsPort_par_out_local.TChangeableMemPool._._._m_arrayPool._0_._elem._m_LocationList._Item._96_._thetaVar._m_value "" VALUE 0xB0010C2C __Float16_Value 0 NO_COMPU_METHOD -65504 65504 ECU_ADDRESS_EXTENSION 0x2 BYTE_ORDER MSB_LAST /end CHARACTERISTIC
/begin CHARACTERISTIC _g_PL_AD_fw_Radar_1R1V_rpc_LocBypassingRunnable_LocBypassingRunnable_m_pad_ensRLocationsPort_par_out_local.TChangeableMemPool._._._m_arrayPool._0_._elem._m_LocationList._Item._96_._v "" VALUE 0xB0010C1C __Float32_Value 0 NO_COMPU_METHOD -3.4028234663852886E+38 3.4028234663852886E+38 ECU_ADDRESS_EXTENSION 0x2 BYTE_ORDER MSB_LAST /end CHARACTERISTIC
/begin CHARACTERISTIC _g_PL_AD_fw_Radar_1R1V_rpc_LocBypassingRunnable_LocBypassingRunnable_m_pad_ensRLocationsPort_par_out_local.TChangeableMemPool._._._m_arrayPool._0_._elem._m_LocationList._Item._96_._vVar._m_value "" VALUE 0xB0010C22 __Float16_Value 0 NO_COMPU_METHOD -65504 65504 ECU_ADDRESS_EXTENSION 0x2 BYTE_ORDER MSB_LAST /end CHARACTERISTIC
/begin CHARACTERISTIC _g_PL_AD_fw_Radar_1R1V_rpc_LocBypassingRunnable_LocBypassingRunnable_m_pad_ensRLocationsPort_par_out_local.TChangeableMemPool._._._m_arrayPool._0_._elem._m_LocationList._Item._97_._Rcs._m_value "" VALUE 0xB0010C50 __Float16_Value 0 NO_COMPU_METHOD -65504 65504 ECU_ADDRESS_EXTENSION 0x2 BYTE_ORDER MSB_LAST /end CHARACTERISTIC
/begin CHARACTERISTIC _g_PL_AD_fw_Radar_1R1V_rpc_LocBypassingRunnable_LocBypassingRunnable_m_pad_ensRLocationsPort_par_out_local.TChangeableMemPool._._._m_arrayPool._0_._elem._m_LocationList._Item._97_._Rssi._m_value "" VALUE 0xB0010C52 __Float16_Value 0 NO_COMPU_METHOD -65504 65504 ECU_ADDRESS_EXTENSION 0x2 BYTE_ORDER MSB_LAST /end CHARACTERISTIC
/begin CHARACTERISTIC _g_PL_AD_fw_Radar_1R1V_rpc_LocBypassingRunnable_LocBypassingRunnable_m_pad_ensRLocationsPort_par_out_local.TChangeableMemPool._._._m_arrayPool._0_._elem._m_LocationList._Item._97_._d "" VALUE 0xB0010C38 __Float32_Value 0 NO_COMPU_METHOD -3.4028234663852886E+38 3.4028234663852886E+38 ECU_ADDRESS_EXTENSION 0x2 BYTE_ORDER MSB_LAST /end CHARACTERISTIC
/begin CHARACTERISTIC _g_PL_AD_fw_Radar_1R1V_rpc_LocBypassingRunnable_LocBypassingRunnable_m_pad_ensRLocationsPort_par_out_local.TChangeableMemPool._._._m_arrayPool._0_._elem._m_LocationList._Item._97_._dVar._m_value "" VALUE 0xB0010C40 __Float16_Value 0 NO_COMPU_METHOD -65504 65504 ECU_ADDRESS_EXTENSION 0x2 BYTE_ORDER MSB_LAST /end CHARACTERISTIC
/begin CHARACTERISTIC _g_PL_AD_fw_Radar_1R1V_rpc_LocBypassingRunnable_LocBypassingRunnable_m_pad_ensRLocationsPort_par_out_local.TChangeableMemPool._._._m_arrayPool._0_._elem._m_LocationList._Item._97_._dvCov._m_value "" VALUE 0xB0010C44 __Float16_Value 0 NO_COMPU_METHOD -65504 65504 ECU_ADDRESS_EXTENSION 0x2 BYTE_ORDER MSB_LAST /end CHARACTERISTIC
/begin CHARACTERISTIC _g_PL_AD_fw_Radar_1R1V_rpc_LocBypassingRunnable_LocBypassingRunnable_m_pad_ensRLocationsPort_par_out_local.TChangeableMemPool._._._m_arrayPool._0_._elem._m_LocationList._Item._97_._dvQly "" VALUE 0xB0010C54 __UByte_Value 0 NO_COMPU_METHOD 0 255 ECU_ADDRESS_EXTENSION 0x2 BYTE_ORDER MSB_LAST /end CHARACTERISTIC
/begin CHARACTERISTIC _g_PL_AD_fw_Radar_1R1V_rpc_LocBypassingRunnable_LocBypassingRunnable_m_pad_ensRLocationsPort_par_out_local.TChangeableMemPool._._._m_arrayPool._0_._elem._m_LocationList._Item._97_._idxAzimuthAmbiguityPeer "" VALUE 0xB0010C56 __UWord_Value 0 NO_COMPU_METHOD 0 65535 ECU_ADDRESS_EXTENSION 0x2 BYTE_ORDER MSB_LAST /end CHARACTERISTIC
/begin CHARACTERISTIC _g_PL_AD_fw_Radar_1R1V_rpc_LocBypassingRunnable_LocBypassingRunnable_m_pad_ensRLocationsPort_par_out_local.TChangeableMemPool._._._m_arrayPool._0_._elem._m_LocationList._Item._97_._measStatus "" VALUE 0xB0010C55 __UByte_Value 0 NO_COMPU_METHOD 0 255 ECU_ADDRESS_EXTENSION 0x2 BYTE_ORDER MSB_LAST /end CHARACTERISTIC
/begin CHARACTERISTIC _g_PL_AD_fw_Radar_1R1V_rpc_LocBypassingRunnable_LocBypassingRunnable_m_pad_ensRLocationsPort_par_out_local.TChangeableMemPool._._._m_arrayPool._0_._elem._m_LocationList._Item._97_._phi._m_value "" VALUE 0xB0010C48 __Float16_Value 0 NO_COMPU_METHOD -65504 65504 ECU_ADDRESS_EXTENSION 0x2 BYTE_ORDER MSB_LAST /end CHARACTERISTIC
/begin CHARACTERISTIC _g_PL_AD_fw_Radar_1R1V_rpc_LocBypassingRunnable_LocBypassingRunnable_m_pad_ensRLocationsPort_par_out_local.TChangeableMemPool._._._m_arrayPool._0_._elem._m_LocationList._Item._97_._phiQly "" VALUE 0xB0010C4B __UByte_Value 0 NO_COMPU_METHOD 0 255 ECU_ADDRESS_EXTENSION 0x2 BYTE_ORDER MSB_LAST /end CHARACTERISTIC
/begin CHARACTERISTIC _g_PL_AD_fw_Radar_1R1V_rpc_LocBypassingRunnable_LocBypassingRunnable_m_pad_ensRLocationsPort_par_out_local.TChangeableMemPool._._._m_arrayPool._0_._elem._m_LocationList._Item._97_._phiVar._m_value "" VALUE 0xB0010C4E __Float16_Value 0 NO_COMPU_METHOD -65504 65504 ECU_ADDRESS_EXTENSION 0x2 BYTE_ORDER MSB_LAST /end CHARACTERISTIC
/begin CHARACTERISTIC _g_PL_AD_fw_Radar_1R1V_rpc_LocBypassingRunnable_LocBypassingRunnable_m_pad_ensRLocationsPort_par_out_local.TChangeableMemPool._._._m_arrayPool._0_._elem._m_LocationList._Item._97_._theta._m_value "" VALUE 0xB0010C46 __Float16_Value 0 NO_COMPU_METHOD -65504 65504 ECU_ADDRESS_EXTENSION 0x2 BYTE_ORDER MSB_LAST /end CHARACTERISTIC
/begin CHARACTERISTIC _g_PL_AD_fw_Radar_1R1V_rpc_LocBypassingRunnable_LocBypassingRunnable_m_pad_ensRLocationsPort_par_out_local.TChangeableMemPool._._._m_arrayPool._0_._elem._m_LocationList._Item._97_._thetaQly "" VALUE 0xB0010C4A __UByte_Value 0 NO_COMPU_METHOD 0 255 ECU_ADDRESS_EXTENSION 0x2 BYTE_ORDER MSB_LAST /end CHARACTERISTIC
/begin CHARACTERISTIC _g_PL_AD_fw_Radar_1R1V_rpc_LocBypassingRunnable_LocBypassingRunnable_m_pad_ensRLocationsPort_par_out_local.TChangeableMemPool._._._m_arrayPool._0_._elem._m_LocationList._Item._97_._thetaVar._m_value "" VALUE 0xB0010C4C __Float16_Value 0 NO_COMPU_METHOD -65504 65504 ECU_ADDRESS_EXTENSION 0x2 BYTE_ORDER MSB_LAST /end CHARACTERISTIC
/begin CHARACTERISTIC _g_PL_AD_fw_Radar_1R1V_rpc_LocBypassingRunnable_LocBypassingRunnable_m_pad_ensRLocationsPort_par_out_local.TChangeableMemPool._._._m_arrayPool._0_._elem._m_LocationList._Item._97_._v "" VALUE 0xB0010C3C __Float32_Value 0 NO_COMPU_METHOD -3.4028234663852886E+38 3.4028234663852886E+38 ECU_ADDRESS_EXTENSION 0x2 BYTE_ORDER MSB_LAST /end CHARACTERISTIC
/begin CHARACTERISTIC _g_PL_AD_fw_Radar_1R1V_rpc_LocBypassingRunnable_LocBypassingRunnable_m_pad_ensRLocationsPort_par_out_local.TChangeableMemPool._._._m_arrayPool._0_._elem._m_LocationList._Item._97_._vVar._m_value "" VALUE 0xB0010C42 __Float16_Value 0 NO_COMPU_METHOD -65504 65504 ECU_ADDRESS_EXTENSION 0x2 BYTE_ORDER MSB_LAST /end CHARACTERISTIC
/begin CHARACTERISTIC _g_PL_AD_fw_Radar_1R1V_rpc_LocBypassingRunnable_LocBypassingRunnable_m_pad_ensRLocationsPort_par_out_local.TChangeableMemPool._._._m_arrayPool._0_._elem._m_LocationList._Item._98_._Rcs._m_value "" VALUE 0xB0010C70 __Float16_Value 0 NO_COMPU_METHOD -65504 65504 ECU_ADDRESS_EXTENSION 0x2 BYTE_ORDER MSB_LAST /end CHARACTERISTIC
/begin CHARACTERISTIC _g_PL_AD_fw_Radar_1R1V_rpc_LocBypassingRunnable_LocBypassingRunnable_m_pad_ensRLocationsPort_par_out_local.TChangeableMemPool._._._m_arrayPool._0_._elem._m_LocationList._Item._98_._Rssi._m_value "" VALUE 0xB0010C72 __Float16_Value 0 NO_COMPU_METHOD -65504 65504 ECU_ADDRESS_EXTENSION 0x2 BYTE_ORDER MSB_LAST /end CHARACTERISTIC
/begin CHARACTERISTIC _g_PL_AD_fw_Radar_1R1V_rpc_LocBypassingRunnable_LocBypassingRunnable_m_pad_ensRLocationsPort_par_out_local.TChangeableMemPool._._._m_arrayPool._0_._elem._m_LocationList._Item._98_._d "" VALUE 0xB0010C58 __Float32_Value 0 NO_COMPU_METHOD -3.4028234663852886E+38 3.4028234663852886E+38 ECU_ADDRESS_EXTENSION 0x2 BYTE_ORDER MSB_LAST /end CHARACTERISTIC
/begin CHARACTERISTIC _g_PL_AD_fw_Radar_1R1V_rpc_LocBypassingRunnable_LocBypassingRunnable_m_pad_ensRLocationsPort_par_out_local.TChangeableMemPool._._._m_arrayPool._0_._elem._m_LocationList._Item._98_._dVar._m_value "" VALUE 0xB0010C60 __Float16_Value 0 NO_COMPU_METHOD -65504 65504 ECU_ADDRESS_EXTENSION 0x2 BYTE_ORDER MSB_LAST /end CHARACTERISTIC
/begin CHARACTERISTIC _g_PL_AD_fw_Radar_1R1V_rpc_LocBypassingRunnable_LocBypassingRunnable_m_pad_ensRLocationsPort_par_out_local.TChangeableMemPool._._._m_arrayPool._0_._elem._m_LocationList._Item._98_._dvCov._m_value "" VALUE 0xB0010C64 __Float16_Value 0 NO_COMPU_METHOD -65504 65504 ECU_ADDRESS_EXTENSION 0x2 BYTE_ORDER MSB_LAST /end CHARACTERISTIC
/begin CHARACTERISTIC _g_PL_AD_fw_Radar_1R1V_rpc_LocBypassingRunnable_LocBypassingRunnable_m_pad_ensRLocationsPort_par_out_local.TChangeableMemPool._._._m_arrayPool._0_._elem._m_LocationList._Item._98_._dvQly "" VALUE 0xB0010C74 __UByte_Value 0 NO_COMPU_METHOD 0 255 ECU_ADDRESS_EXTENSION 0x2 BYTE_ORDER MSB_LAST /end CHARACTERISTIC
/begin CHARACTERISTIC _g_PL_AD_fw_Radar_1R1V_rpc_LocBypassingRunnable_LocBypassingRunnable_m_pad_ensRLocationsPort_par_out_local.TChangeableMemPool._._._m_arrayPool._0_._elem._m_LocationList._Item._98_._idxAzimuthAmbiguityPeer "" VALUE 0xB0010C76 __UWord_Value 0 NO_COMPU_METHOD 0 65535 ECU_ADDRESS_EXTENSION 0x2 BYTE_ORDER MSB_LAST /end CHARACTERISTIC
/begin CHARACTERISTIC _g_PL_AD_fw_Radar_1R1V_rpc_LocBypassingRunnable_LocBypassingRunnable_m_pad_ensRLocationsPort_par_out_local.TChangeableMemPool._._._m_arrayPool._0_._elem._m_LocationList._Item._98_._measStatus "" VALUE 0xB0010C75 __UByte_Value 0 NO_COMPU_METHOD 0 255 ECU_ADDRESS_EXTENSION 0x2 BYTE_ORDER MSB_LAST /end CHARACTERISTIC
/begin CHARACTERISTIC _g_PL_AD_fw_Radar_1R1V_rpc_LocBypassingRunnable_LocBypassingRunnable_m_pad_ensRLocationsPort_par_out_local.TChangeableMemPool._._._m_arrayPool._0_._elem._m_LocationList._Item._98_._phi._m_value "" VALUE 0xB0010C68 __Float16_Value 0 NO_COMPU_METHOD -65504 65504 ECU_ADDRESS_EXTENSION 0x2 BYTE_ORDER MSB_LAST /end CHARACTERISTIC
/begin CHARACTERISTIC _g_PL_AD_fw_Radar_1R1V_rpc_LocBypassingRunnable_LocBypassingRunnable_m_pad_ensRLocationsPort_par_out_local.TChangeableMemPool._._._m_arrayPool._0_._elem._m_LocationList._Item._98_._phiQly "" VALUE 0xB0010C6B __UByte_Value 0 NO_COMPU_METHOD 0 255 ECU_ADDRESS_EXTENSION 0x2 BYTE_ORDER MSB_LAST /end CHARACTERISTIC
/begin CHARACTERISTIC _g_PL_AD_fw_Radar_1R1V_rpc_LocBypassingRunnable_LocBypassingRunnable_m_pad_ensRLocationsPort_par_out_local.TChangeableMemPool._._._m_arrayPool._0_._elem._m_LocationList._Item._98_._phiVar._m_value "" VALUE 0xB0010C6E __Float16_Value 0 NO_COMPU_METHOD -65504 65504 ECU_ADDRESS_EXTENSION 0x2 BYTE_ORDER MSB_LAST /end CHARACTERISTIC
/begin CHARACTERISTIC _g_PL_AD_fw_Radar_1R1V_rpc_LocBypassingRunnable_LocBypassingRunnable_m_pad_ensRLocationsPort_par_out_local.TChangeableMemPool._._._m_arrayPool._0_._elem._m_LocationList._Item._98_._theta._m_value "" VALUE 0xB0010C66 __Float16_Value 0 NO_COMPU_METHOD -65504 65504 ECU_ADDRESS_EXTENSION 0x2 BYTE_ORDER MSB_LAST /end CHARACTERISTIC
/begin CHARACTERISTIC _g_PL_AD_fw_Radar_1R1V_rpc_LocBypassingRunnable_LocBypassingRunnable_m_pad_ensRLocationsPort_par_out_local.TChangeableMemPool._._._m_arrayPool._0_._elem._m_LocationList._Item._98_._thetaQly "" VALUE 0xB0010C6A __UByte_Value 0 NO_COMPU_METHOD 0 255 ECU_ADDRESS_EXTENSION 0x2 BYTE_ORDER MSB_LAST /end CHARACTERISTIC
/begin CHARACTERISTIC _g_PL_AD_fw_Radar_1R1V_rpc_LocBypassingRunnable_LocBypassingRunnable_m_pad_ensRLocationsPort_par_out_local.TChangeableMemPool._._._m_arrayPool._0_._elem._m_LocationList._Item._98_._thetaVar._m_value "" VALUE 0xB0010C6C __Float16_Value 0 NO_COMPU_METHOD -65504 65504 ECU_ADDRESS_EXTENSION 0x2 BYTE_ORDER MSB_LAST /end CHARACTERISTIC
/begin CHARACTERISTIC _g_PL_AD_fw_Radar_1R1V_rpc_LocBypassingRunnable_LocBypassingRunnable_m_pad_ensRLocationsPort_par_out_local.TChangeableMemPool._._._m_arrayPool._0_._elem._m_LocationList._Item._98_._v "" VALUE 0xB0010C5C __Float32_Value 0 NO_COMPU_METHOD -3.4028234663852886E+38 3.4028234663852886E+38 ECU_ADDRESS_EXTENSION 0x2 BYTE_ORDER MSB_LAST /end CHARACTERISTIC
/begin CHARACTERISTIC _g_PL_AD_fw_Radar_1R1V_rpc_LocBypassingRunnable_LocBypassingRunnable_m_pad_ensRLocationsPort_par_out_local.TChangeableMemPool._._._m_arrayPool._0_._elem._m_LocationList._Item._98_._vVar._m_value "" VALUE 0xB0010C62 __Float16_Value 0 NO_COMPU_METHOD -65504 65504 ECU_ADDRESS_EXTENSION 0x2 BYTE_ORDER MSB_LAST /end CHARACTERISTIC
/begin CHARACTERISTIC _g_PL_AD_fw_Radar_1R1V_rpc_LocBypassingRunnable_LocBypassingRunnable_m_pad_ensRLocationsPort_par_out_local.TChangeableMemPool._._._m_arrayPool._0_._elem._m_LocationList._Item._99_._Rcs._m_value "" VALUE 0xB0010C90 __Float16_Value 0 NO_COMPU_METHOD -65504 65504 ECU_ADDRESS_EXTENSION 0x2 BYTE_ORDER MSB_LAST /end CHARACTERISTIC
/begin CHARACTERISTIC _g_PL_AD_fw_Radar_1R1V_rpc_LocBypassingRunnable_LocBypassingRunnable_m_pad_ensRLocationsPort_par_out_local.TChangeableMemPool._._._m_arrayPool._0_._elem._m_LocationList._Item._99_._Rssi._m_value "" VALUE 0xB0010C92 __Float16_Value 0 NO_COMPU_METHOD -65504 65504 ECU_ADDRESS_EXTENSION 0x2 BYTE_ORDER MSB_LAST /end CHARACTERISTIC
/begin CHARACTERISTIC _g_PL_AD_fw_Radar_1R1V_rpc_LocBypassingRunnable_LocBypassingRunnable_m_pad_ensRLocationsPort_par_out_local.TChangeableMemPool._._._m_arrayPool._0_._elem._m_LocationList._Item._99_._d "" VALUE 0xB0010C78 __Float32_Value 0 NO_COMPU_METHOD -3.4028234663852886E+38 3.4028234663852886E+38 ECU_ADDRESS_EXTENSION 0x2 BYTE_ORDER MSB_LAST /end CHARACTERISTIC
/begin CHARACTERISTIC _g_PL_AD_fw_Radar_1R1V_rpc_LocBypassingRunnable_LocBypassingRunnable_m_pad_ensRLocationsPort_par_out_local.TChangeableMemPool._._._m_arrayPool._0_._elem._m_LocationList._Item._99_._dVar._m_value "" VALUE 0xB0010C80 __Float16_Value 0 NO_COMPU_METHOD -65504 65504 ECU_ADDRESS_EXTENSION 0x2 BYTE_ORDER MSB_LAST /end CHARACTERISTIC
/begin CHARACTERISTIC _g_PL_AD_fw_Radar_1R1V_rpc_LocBypassingRunnable_LocBypassingRunnable_m_pad_ensRLocationsPort_par_out_local.TChangeableMemPool._._._m_arrayPool._0_._elem._m_LocationList._Item._99_._dvCov._m_value "" VALUE 0xB0010C84 __Float16_Value 0 NO_COMPU_METHOD -65504 65504 ECU_ADDRESS_EXTENSION 0x2 BYTE_ORDER MSB_LAST /end CHARACTERISTIC
/begin CHARACTERISTIC _g_PL_AD_fw_Radar_1R1V_rpc_LocBypassingRunnable_LocBypassingRunnable_m_pad_ensRLocationsPort_par_out_local.TChangeableMemPool._._._m_arrayPool._0_._elem._m_LocationList._Item._99_._dvQly "" VALUE 0xB0010C94 __UByte_Value 0 NO_COMPU_METHOD 0 255 ECU_ADDRESS_EXTENSION 0x2 BYTE_ORDER MSB_LAST /end CHARACTERISTIC
/begin CHARACTERISTIC _g_PL_AD_fw_Radar_1R1V_rpc_LocBypassingRunnable_LocBypassingRunnable_m_pad_ensRLocationsPort_par_out_local.TChangeableMemPool._._._m_arrayPool._0_._elem._m_LocationList._Item._99_._idxAzimuthAmbiguityPeer "" VALUE 0xB0010C96 __UWord_Value 0 NO_COMPU_METHOD 0 65535 ECU_ADDRESS_EXTENSION 0x2 BYTE_ORDER MSB_LAST /end CHARACTERISTIC
/begin CHARACTERISTIC _g_PL_AD_fw_Radar_1R1V_rpc_LocBypassingRunnable_LocBypassingRunnable_m_pad_ensRLocationsPort_par_out_local.TChangeableMemPool._._._m_arrayPool._0_._elem._m_LocationList._Item._99_._measStatus "" VALUE 0xB0010C95 __UByte_Value 0 NO_COMPU_METHOD 0 255 ECU_ADDRESS_EXTENSION 0x2 BYTE_ORDER MSB_LAST /end CHARACTERISTIC
/begin CHARACTERISTIC _g_PL_AD_fw_Radar_1R1V_rpc_LocBypassingRunnable_LocBypassingRunnable_m_pad_ensRLocationsPort_par_out_local.TChangeableMemPool._._._m_arrayPool._0_._elem._m_LocationList._Item._99_._phi._m_value "" VALUE 0xB0010C88 __Float16_Value 0 NO_COMPU_METHOD -65504 65504 ECU_ADDRESS_EXTENSION 0x2 BYTE_ORDER MSB_LAST /end CHARACTERISTIC
/begin CHARACTERISTIC _g_PL_AD_fw_Radar_1R1V_rpc_LocBypassingRunnable_LocBypassingRunnable_m_pad_ensRLocationsPort_par_out_local.TChangeableMemPool._._._m_arrayPool._0_._elem._m_LocationList._Item._99_._phiQly "" VALUE 0xB0010C8B __UByte_Value 0 NO_COMPU_METHOD 0 255 ECU_ADDRESS_EXTENSION 0x2 BYTE_ORDER MSB_LAST /end CHARACTERISTIC
/begin CHARACTERISTIC _g_PL_AD_fw_Radar_1R1V_rpc_LocBypassingRunnable_LocBypassingRunnable_m_pad_ensRLocationsPort_par_out_local.TChangeableMemPool._._._m_arrayPool._0_._elem._m_LocationList._Item._99_._phiVar._m_value "" VALUE 0xB0010C8E __Float16_Value 0 NO_COMPU_METHOD -65504 65504 ECU_ADDRESS_EXTENSION 0x2 BYTE_ORDER MSB_LAST /end CHARACTERISTIC
/begin CHARACTERISTIC _g_PL_AD_fw_Radar_1R1V_rpc_LocBypassingRunnable_LocBypassingRunnable_m_pad_ensRLocationsPort_par_out_local.TChangeableMemPool._._._m_arrayPool._0_._elem._m_LocationList._Item._99_._theta._m_value "" VALUE 0xB0010C86 __Float16_Value 0 NO_COMPU_METHOD -65504 65504 ECU_ADDRESS_EXTENSION 0x2 BYTE_ORDER MSB_LAST /end CHARACTERISTIC
/begin CHARACTERISTIC _g_PL_AD_fw_Radar_1R1V_rpc_LocBypassingRunnable_LocBypassingRunnable_m_pad_ensRLocationsPort_par_out_local.TChangeableMemPool._._._m_arrayPool._0_._elem._m_LocationList._Item._99_._thetaQly "" VALUE 0xB0010C8A __UByte_Value 0 NO_COMPU_METHOD 0 255 ECU_ADDRESS_EXTENSION 0x2 BYTE_ORDER MSB_LAST /end CHARACTERISTIC
/begin CHARACTERISTIC _g_PL_AD_fw_Radar_1R1V_rpc_LocBypassingRunnable_LocBypassingRunnable_m_pad_ensRLocationsPort_par_out_local.TChangeableMemPool._._._m_arrayPool._0_._elem._m_LocationList._Item._99_._thetaVar._m_value "" VALUE 0xB0010C8C __Float16_Value 0 NO_COMPU_METHOD -65504 65504 ECU_ADDRESS_EXTENSION 0x2 BYTE_ORDER MSB_LAST /end CHARACTERISTIC
/begin CHARACTERISTIC _g_PL_AD_fw_Radar_1R1V_rpc_LocBypassingRunnable_LocBypassingRunnable_m_pad_ensRLocationsPort_par_out_local.TChangeableMemPool._._._m_arrayPool._0_._elem._m_LocationList._Item._99_._v "" VALUE 0xB0010C7C __Float32_Value 0 NO_COMPU_METHOD -3.4028234663852886E+38 3.4028234663852886E+38 ECU_ADDRESS_EXTENSION 0x2 BYTE_ORDER MSB_LAST /end CHARACTERISTIC
/begin CHARACTERISTIC _g_PL_AD_fw_Radar_1R1V_rpc_LocBypassingRunnable_LocBypassingRunnable_m_pad_ensRLocationsPort_par_out_local.TChangeableMemPool._._._m_arrayPool._0_._elem._m_LocationList._Item._99_._vVar._m_value "" VALUE 0xB0010C82 __Float16_Value 0 NO_COMPU_METHOD -65504 65504 ECU_ADDRESS_EXTENSION 0x2 BYTE_ORDER MSB_LAST /end CHARACTERISTIC
/begin CHARACTERISTIC _g_PL_AD_fw_Radar_1R1V_rpc_LocBypassingRunnable_LocBypassingRunnable_m_pad_ensRLocationsPort_par_out_local.TChangeableMemPool._._._m_arrayPool._0_._elem._m_LocationList._Item._9_._Rcs._m_value "" VALUE 0xB0010150 __Float16_Value 0 NO_COMPU_METHOD -65504 65504 ECU_ADDRESS_EXTENSION 0x2 BYTE_ORDER MSB_LAST /end CHARACTERISTIC
/begin CHARACTERISTIC _g_PL_AD_fw_Radar_1R1V_rpc_LocBypassingRunnable_LocBypassingRunnable_m_pad_ensRLocationsPort_par_out_local.TChangeableMemPool._._._m_arrayPool._0_._elem._m_LocationList._Item._9_._Rssi._m_value "" VALUE 0xB0010152 __Float16_Value 0 NO_COMPU_METHOD -65504 65504 ECU_ADDRESS_EXTENSION 0x2 BYTE_ORDER MSB_LAST /end CHARACTERISTIC
/begin CHARACTERISTIC _g_PL_AD_fw_Radar_1R1V_rpc_LocBypassingRunnable_LocBypassingRunnable_m_pad_ensRLocationsPort_par_out_local.TChangeableMemPool._._._m_arrayPool._0_._elem._m_LocationList._Item._9_._d "" VALUE 0xB0010138 __Float32_Value 0 NO_COMPU_METHOD -3.4028234663852886E+38 3.4028234663852886E+38 ECU_ADDRESS_EXTENSION 0x2 BYTE_ORDER MSB_LAST /end CHARACTERISTIC
/begin CHARACTERISTIC _g_PL_AD_fw_Radar_1R1V_rpc_LocBypassingRunnable_LocBypassingRunnable_m_pad_ensRLocationsPort_par_out_local.TChangeableMemPool._._._m_arrayPool._0_._elem._m_LocationList._Item._9_._dVar._m_value "" VALUE 0xB0010140 __Float16_Value 0 NO_COMPU_METHOD -65504 65504 ECU_ADDRESS_EXTENSION 0x2 BYTE_ORDER MSB_LAST /end CHARACTERISTIC
/begin CHARACTERISTIC _g_PL_AD_fw_Radar_1R1V_rpc_LocBypassingRunnable_LocBypassingRunnable_m_pad_ensRLocationsPort_par_out_local.TChangeableMemPool._._._m_arrayPool._0_._elem._m_LocationList._Item._9_._dvCov._m_value "" VALUE 0xB0010144 __Float16_Value 0 NO_COMPU_METHOD -65504 65504 ECU_ADDRESS_EXTENSION 0x2 BYTE_ORDER MSB_LAST /end CHARACTERISTIC
/begin CHARACTERISTIC _g_PL_AD_fw_Radar_1R1V_rpc_LocBypassingRunnable_LocBypassingRunnable_m_pad_ensRLocationsPort_par_out_local.TChangeableMemPool._._._m_arrayPool._0_._elem._m_LocationList._Item._9_._dvQly "" VALUE 0xB0010154 __UByte_Value 0 NO_COMPU_METHOD 0 255 ECU_ADDRESS_EXTENSION 0x2 BYTE_ORDER MSB_LAST /end CHARACTERISTIC
/begin CHARACTERISTIC _g_PL_AD_fw_Radar_1R1V_rpc_LocBypassingRunnable_LocBypassingRunnable_m_pad_ensRLocationsPort_par_out_local.TChangeableMemPool._._._m_arrayPool._0_._elem._m_LocationList._Item._9_._idxAzimuthAmbiguityPeer "" VALUE 0xB0010156 __UWord_Value 0 NO_COMPU_METHOD 0 65535 ECU_ADDRESS_EXTENSION 0x2 BYTE_ORDER MSB_LAST /end CHARACTERISTIC
/begin CHARACTERISTIC _g_PL_AD_fw_Radar_1R1V_rpc_LocBypassingRunnable_LocBypassingRunnable_m_pad_ensRLocationsPort_par_out_local.TChangeableMemPool._._._m_arrayPool._0_._elem._m_LocationList._Item._9_._measStatus "" VALUE 0xB0010155 __UByte_Value 0 NO_COMPU_METHOD 0 255 ECU_ADDRESS_EXTENSION 0x2 BYTE_ORDER MSB_LAST /end CHARACTERISTIC
/begin CHARACTERISTIC _g_PL_AD_fw_Radar_1R1V_rpc_LocBypassingRunnable_LocBypassingRunnable_m_pad_ensRLocationsPort_par_out_local.TChangeableMemPool._._._m_arrayPool._0_._elem._m_LocationList._Item._9_._phi._m_value "" VALUE 0xB0010148 __Float16_Value 0 NO_COMPU_METHOD -65504 65504 ECU_ADDRESS_EXTENSION 0x2 BYTE_ORDER MSB_LAST /end CHARACTERISTIC
/begin CHARACTERISTIC _g_PL_AD_fw_Radar_1R1V_rpc_LocBypassingRunnable_LocBypassingRunnable_m_pad_ensRLocationsPort_par_out_local.TChangeableMemPool._._._m_arrayPool._0_._elem._m_LocationList._Item._9_._phiQly "" VALUE 0xB001014B __UByte_Value 0 NO_COMPU_METHOD 0 255 ECU_ADDRESS_EXTENSION 0x2 BYTE_ORDER MSB_LAST /end CHARACTERISTIC
/begin CHARACTERISTIC _g_PL_AD_fw_Radar_1R1V_rpc_LocBypassingRunnable_LocBypassingRunnable_m_pad_ensRLocationsPort_par_out_local.TChangeableMemPool._._._m_arrayPool._0_._elem._m_LocationList._Item._9_._phiVar._m_value "" VALUE 0xB001014E __Float16_Value 0 NO_COMPU_METHOD -65504 65504 ECU_ADDRESS_EXTENSION 0x2 BYTE_ORDER MSB_LAST /end CHARACTERISTIC
/begin CHARACTERISTIC _g_PL_AD_fw_Radar_1R1V_rpc_LocBypassingRunnable_LocBypassingRunnable_m_pad_ensRLocationsPort_par_out_local.TChangeableMemPool._._._m_arrayPool._0_._elem._m_LocationList._Item._9_._theta._m_value "" VALUE 0xB0010146 __Float16_Value 0 NO_COMPU_METHOD -65504 65504 ECU_ADDRESS_EXTENSION 0x2 BYTE_ORDER MSB_LAST /end CHARACTERISTIC
/begin CHARACTERISTIC _g_PL_AD_fw_Radar_1R1V_rpc_LocBypassingRunnable_LocBypassingRunnable_m_pad_ensRLocationsPort_par_out_local.TChangeableMemPool._._._m_arrayPool._0_._elem._m_LocationList._Item._9_._thetaQly "" VALUE 0xB001014A __UByte_Value 0 NO_COMPU_METHOD 0 255 ECU_ADDRESS_EXTENSION 0x2 BYTE_ORDER MSB_LAST /end CHARACTERISTIC
/begin CHARACTERISTIC _g_PL_AD_fw_Radar_1R1V_rpc_LocBypassingRunnable_LocBypassingRunnable_m_pad_ensRLocationsPort_par_out_local.TChangeableMemPool._._._m_arrayPool._0_._elem._m_LocationList._Item._9_._thetaVar._m_value "" VALUE 0xB001014C __Float16_Value 0 NO_COMPU_METHOD -65504 65504 ECU_ADDRESS_EXTENSION 0x2 BYTE_ORDER MSB_LAST /end CHARACTERISTIC
/begin CHARACTERISTIC _g_PL_AD_fw_Radar_1R1V_rpc_LocBypassingRunnable_LocBypassingRunnable_m_pad_ensRLocationsPort_par_out_local.TChangeableMemPool._._._m_arrayPool._0_._elem._m_LocationList._Item._9_._v "" VALUE 0xB001013C __Float32_Value 0 NO_COMPU_METHOD -3.4028234663852886E+38 3.4028234663852886E+38 ECU_ADDRESS_EXTENSION 0x2 BYTE_ORDER MSB_LAST /end CHARACTERISTIC
/begin CHARACTERISTIC _g_PL_AD_fw_Radar_1R1V_rpc_LocBypassingRunnable_LocBypassingRunnable_m_pad_ensRLocationsPort_par_out_local.TChangeableMemPool._._._m_arrayPool._0_._elem._m_LocationList._Item._9_._vVar._m_value "" VALUE 0xB0010142 __Float16_Value 0 NO_COMPU_METHOD -65504 65504 ECU_ADDRESS_EXTENSION 0x2 BYTE_ORDER MSB_LAST /end CHARACTERISTIC
/begin CHARACTERISTIC _g_PL_AD_fw_Radar_1R1V_rpc_LocBypassingRunnable_LocBypassingRunnable_m_pad_ensRLocationsPort_par_out_local.TChangeableMemPool._._._m_arrayPool._0_._elem._m_LocationList._NumLocs "" VALUE 0xB0012AD8 __UWord_Value 0 NO_COMPU_METHOD 0 65535 ECU_ADDRESS_EXTENSION 0x2 BYTE_ORDER MSB_LAST /end CHARACTERISTIC
/begin CHARACTERISTIC _g_PL_AD_fw_Radar_1R1V_rpc_LocBypassingRunnable_LocBypassingRunnable_m_pad_ensRLocationsPort_par_out_local.TChangeableMemPool._._._m_arrayPool._0_._elem._m_LocationList._tAbsMeasTimeStamp "" VALUE 0xB0012ADC __ULong_Value 0 NO_COMPU_METHOD 0 4294967295 ECU_ADDRESS_EXTENSION 0x2 BYTE_ORDER MSB_LAST /end CHARACTERISTIC
/begin CHARACTERISTIC _g_PL_AD_fw_Radar_1R1V_rpc_LocBypassingRunnable_LocBypassingRunnable_m_pad_ensRLocationsPort_par_out_local.TChangeableMemPool._._._m_arrayPool._0_._elem._m_SensState._DataMeasured "" VALUE 0xB0012AE1 __UByte_Value 0 NO_COMPU_METHOD 0 255 ECU_ADDRESS_EXTENSION 0x2 BYTE_ORDER MSB_LAST /end CHARACTERISTIC
/begin COMPU_METHOD _rba_FeeFs2_Prv_SectorErase_st._state_en.CONVERSION "enumeration table" TAB_VERB "%.0" "" COMPU_TAB_REF _rba_FeeFs2_Prv_SectorErase_st._state_en.CONVERSION /end COMPU_METHOD
/begin COMPU_METHOD _rba_FeeFs2_Prv_SectorErase_st._state_en.CONVERSION0 "@@@@RuleName created by CANape" TAB_VERB "%.0" "" COMPU_TAB_REF _rba_FeeFs2_Prv_SectorErase_st._state_en.CONVERSION0 /end COMPU_METHOD
/begin COMPU_METHOD _rba_FeeFs2_Prv_SectorSetState_st._newSectorState_en.CONVERSION "@@@@RuleName created by CANape" TAB_VERB "%.0" "" COMPU_TAB_REF _rba_FeeFs2_Prv_SectorSetState_st._newSectorState_en.CONVERSION /end COMPU_METHOD
/begin COMPU_METHOD _rba_FeeFs2_Prv_SectorSetState_st._state_en.CONVERSION "enumeration table" TAB_VERB "%.0" "" COMPU_TAB_REF _rba_FeeFs2_Prv_SectorSetState_st._state_en.CONVERSION /end COMPU_METHOD
/begin COMPU_METHOD _rba_FeeFs2_Prv_SectorSetState_st._state_en.CONVERSION0 "@@@@RuleName created by CANape" TAB_VERB "%.0" "" COMPU_TAB_REF _rba_FeeFs2_Prv_SectorSetState_st._state_en.CONVERSION0 /end COMPU_METHOD
/begin COMPU_METHOD _rba_FeeFs2_Prv_SectorSetWlDfc_st._state_en.CONVERSION "enumeration table" TAB_VERB "%.0" "" COMPU_TAB_REF _rba_FeeFs2_Prv_SectorSetWlDfc_st._state_en.CONVERSION /end COMPU_METHOD
/begin COMPU_METHOD _rba_FeeFs2_Prv_SectorSetWlDfc_st._state_en.CONVERSION0 "@@@@RuleName created by CANape" TAB_VERB "%.0" "" COMPU_TAB_REF _rba_FeeFs2_Prv_SectorSetWlDfc_st._state_en.CONVERSION0 /end COMPU_METHOD
/begin COMPU_METHOD _rba_FeeFs2_Prv_SectorWriteMarker_st._state_en.CONVERSION "enumeration table" TAB_VERB "%.0" "" COMPU_TAB_REF _rba_FeeFs2_Prv_SectorWriteMarker_st._state_en.CONVERSION /end COMPU_METHOD
/begin COMPU_METHOD _rba_FeeFs2_Prv_SectorWriteMarker_st._state_en.CONVERSION0 "@@@@RuleName created by CANape" TAB_VERB "%.0" "" COMPU_TAB_REF _rba_FeeFs2_Prv_SectorWriteMarker_st._state_en.CONVERSION0 /end COMPU_METHOD
/begin COMPU_METHOD _rba_FeeFs2_Prv_Write_st._state_en.CONVERSION "@@@@RuleName created by CANape" TAB_VERB "%.0" "" COMPU_TAB_REF _rba_FeeFs2_Prv_Write_st._state_en.CONVERSION /end COMPU_METHOD
/begin COMPU_METHOD _rba_QueuedSpi_HwUnitCfg_0._0_._DmaConfigRx._TfrReqTyp_en.CONVERSION "enumeration table" TAB_VERB "%.0" "" COMPU_TAB_REF _rba_QueuedSpi_HwUnitCfg_0._0_._DmaConfigRx._TfrReqTyp_en.CONVERSION /end COMPU_METHOD
/begin COMPU_METHOD _rba_QueuedSpi_HwUnit_cast._0_._DmaConfigTx1_st._LinkedListTyp_en.CONVERSION "enumeration table" TAB_VERB "%.0" "" COMPU_TAB_REF _rba_QueuedSpi_HwUnit_cast._0_._DmaConfigTx1_st._LinkedListTyp_en.CONVERSION /end COMPU_METHOD
/begin COMPU_METHOD _rba_QueuedSpi_HwUnit_cast._0_._stAsyncMode_en.CONVERSION "enumeration table" TAB_VERB "%.0" "" COMPU_TAB_REF _rba_QueuedSpi_HwUnit_cast._0_._stAsyncMode_en.CONVERSION /end COMPU_METHOD
/begin COMPU_METHOD _rba_QueuedSpi_HwUnit_cast._0_._stHwUnit_en.CONVERSION "enumeration table" TAB_VERB "%.0" "" COMPU_TAB_REF _rba_QueuedSpi_HwUnit_cast._0_._stHwUnit_en.CONVERSION /end COMPU_METHOD
/begin COMPU_METHOD _rba_QueuedSpi_HwUnit_cast._5_._DmaConfigTx2_st._ChDataWidth_en.CONVERSION "@@@@RuleName created by CANape" TAB_VERB "%.0" "" COMPU_TAB_REF _rba_QueuedSpi_HwUnit_cast._5_._DmaConfigTx2_st._ChDataWidth_en.CONVERSION /end COMPU_METHOD
/begin COMPU_METHOD _rba_QueuedSpi_HwUnit_cast._5_._DmaConfigTx2_st._IntTrigTyp_en.CONVERSION "@@@@RuleName created by CANape" TAB_VERB "%.0" "" COMPU_TAB_REF _rba_QueuedSpi_HwUnit_cast._5_._DmaConfigTx2_st._IntTrigTyp_en.CONVERSION /end COMPU_METHOD
/begin COMPU_METHOD _rba_QueuedSpi_HwUnit_cast._5_._DmaConfigTx2_st._MovesPerTfr_en.CONVERSION "@@@@RuleName created by CANape" TAB_VERB "%.0" "" COMPU_TAB_REF _rba_QueuedSpi_HwUnit_cast._5_._DmaConfigTx2_st._MovesPerTfr_en.CONVERSION /end COMPU_METHOD
/begin COMPU_METHOD _rba_QueuedSpi_HwUnit_cast._5_._DmaConfigTx2_st._SrcAddrModifier_en.CONVERSION "@@@@RuleName created by CANape" TAB_VERB "%.0" "" COMPU_TAB_REF _rba_QueuedSpi_HwUnit_cast._5_._DmaConfigTx2_st._SrcAddrModifier_en.CONVERSION /end COMPU_METHOD
/begin COMPU_METHOD _rba_QueuedSpi_HwUnit_cast._5_._DmaConfigTx2_st._TfrReqTyp_en.CONVERSION "@@@@RuleName created by CANape" TAB_VERB "%.0" "" COMPU_TAB_REF _rba_QueuedSpi_HwUnit_cast._5_._DmaConfigTx2_st._TfrReqTyp_en.CONVERSION /end COMPU_METHOD
/begin COMPU_METHOD _rba_QueuedSpi_HwUnit_cast._5_._stAsyncMode_en.CONVERSION "@@@@RuleName created by CANape" TAB_VERB "%.0" "" COMPU_TAB_REF _rba_QueuedSpi_HwUnit_cast._5_._stAsyncMode_en.CONVERSION /end COMPU_METHOD
/begin COMPU_METHOD _rba_QueuedSpi_HwUnit_cast._5_._stHwUnit_en.CONVERSION "@@@@RuleName created by CANape" TAB_VERB "%.0" "" COMPU_TAB_REF _rba_QueuedSpi_HwUnit_cast._5_._stHwUnit_en.CONVERSION /end COMPU_METHOD
/begin COMPU_METHOD _rbsftmon_CoreClockInitializationState_en.CONVERSION "enumeration table" TAB_VERB "%.0" "" COMPU_TAB_REF _rbsftmon_CoreClockInitializationState_en.CONVERSION /end COMPU_METHOD
/begin COMPU_METHOD _stLLDRet_st._stRet_en.CONVERSION "@@@@RuleName created by CANape" TAB_VERB "%.0" "" COMPU_TAB_REF _stLLDRet_st._stRet_en.CONVERSION /end COMPU_METHOD
/begin COMPU_METHOD _syslog_dataLog._FreezeTrigger.CONVERSION "enumeration table" TAB_VERB "%.0" "" COMPU_TAB_REF _syslog_dataLog._FreezeTrigger.CONVERSION /end COMPU_METHOD
/begin COMPU_METHOD _syslog_dataLog._LastResetReason.CONVERSION "@@@@RuleName created by CANape" TAB_VERB "%.0" "" COMPU_TAB_REF _syslog_dataLog._LastResetReason.CONVERSION /end COMPU_METHOD
/begin COMPU_METHOD _warningArray._m_value._3_.CONVERSION "@@@@RuleName created by CANape" TAB_VERB "%.0" "" COMPU_TAB_REF _warningArray._m_value._3_.CONVERSION /end COMPU_METHOD
/begin COMPU_METHOD calibRotState "enumeration table" TAB_VERB "%.0" "" COMPU_TAB_REF calibRotState /end COMPU_METHOD
/begin COMPU_METHOD d_builtin_type_print "enumeration table" TAB_VERB "%.0" "" COMPU_TAB_REF d_builtin_type_print /end COMPU_METHOD
/begin COMPU_METHOD dxToleranz_Scaling "" LINEAR "%11.9" "" COEFFS_LINEAR 0.001953125 0 /end COMPU_METHOD
/begin COMPU_METHOD eErrorId "enumeration table" TAB_VERB "%.0" "" COMPU_TAB_REF eErrorId /end COMPU_METHOD
/begin COMPU_METHOD eErrorId.OLD_Copy1 "enumeration table" TAB_VERB "%.0" "" COMPU_TAB_REF eErrorId.OLD_1 /end COMPU_METHOD
/begin COMPU_METHOD ecy_hsm_Csai_KeyIdTag "enumeration table" TAB_VERB "%.0" "" COMPU_TAB_REF ecy_hsm_Csai_KeyIdTag /end COMPU_METHOD
/begin COMPU_METHOD messagePriority "enumeration table" TAB_VERB "%.0" "" COMPU_TAB_REF messagePriority /end COMPU_METHOD
/begin COMPU_METHOD messageType "enumeration table" TAB_VERB "%.0" "" COMPU_TAB_REF messageType /end COMPU_METHOD
/begin COMPU_METHOD rbMonReact_EventState "enumeration table" TAB_VERB "%.0" "" COMPU_TAB_REF rbMonReact_EventState /end COMPU_METHOD
/begin COMPU_METHOD rbNetCom_State_e "enumeration table" TAB_VERB "%.0" "" COMPU_TAB_REF rbNetCom_State_e /end COMPU_METHOD
/begin COMPU_METHOD rbNet_State_e "enumeration table" TAB_VERB "%.0" "" COMPU_TAB_REF rbNet_State_e /end COMPU_METHOD
/begin COMPU_METHOD rbPdm_EDevelopmentError "enumeration table" TAB_VERB "%.0" "" COMPU_TAB_REF rbPdm_EDevelopmentError /end COMPU_METHOD
/begin COMPU_METHOD rbPdm_EJobStatus "enumeration table" TAB_VERB "%.0" "" COMPU_TAB_REF rbPdm_EJobStatus /end COMPU_METHOD
/begin COMPU_METHOD rbPdm_ERequestType "enumeration table" TAB_VERB "%.0" "" COMPU_TAB_REF rbPdm_ERequestType /end COMPU_METHOD
/begin COMPU_METHOD rbSysEvM_EventState "enumeration table" TAB_VERB "%.0" "" COMPU_TAB_REF rbSysEvM_EventState /end COMPU_METHOD
/begin COMPU_METHOD rcy_hsm_Csai_JobPriorityTag "enumeration table" TAB_VERB "%.0" "" COMPU_TAB_REF rcy_hsm_Csai_JobPriorityTag /end COMPU_METHOD
/begin COMPU_METHOD rcy_hsm_Csai_SecAcc_NonceCtrl "enumeration table" TAB_VERB "%.0" "" COMPU_TAB_REF rcy_hsm_Csai_SecAcc_NonceCtrl /end COMPU_METHOD
/begin COMPU_VTAB_RANGE _rba_FeeFs2_Prv_SectorErase_st._state_en.CONVERSION "" 6 0 0 "RBA_FEEFS2_PRV_SECTOR_ERASE_IDLE_E" 1 1 "RBA_FEEFS2_PRV_SECTOR_ERASE_INIT_E" 2 2 "RBA_FEEFS2_PRV_SECTOR_ERASE_OVERPROGRAMHEADER_E" 3 3 "RBA_FEEFS2_PRV_SECTOR_ERASE_ERASING_E" 4 4 "RBA_FEEFS2_PRV_SECTOR_ERASE_SETSTATE_E" 5 5 "RBA_FEEFS2_PRV_SECTOR_ERASE_FINAL_E" DEFAULT_VALUE "" /end COMPU_VTAB_RANGE
/begin COMPU_VTAB_RANGE _rba_FeeFs2_Prv_SectorErase_st._state_en.CONVERSION0 "@@@@RuleName created by CANape" 6 0 0 "RBA_FEEFS2_PRV_SECTOR_ERASE_IDLE_E" 1 1 "RBA_FEEFS2_PRV_SECTOR_ERASE_INIT_E" 2 2 "RBA_FEEFS2_PRV_SECTOR_ERASE_OVERPROGRAMHEADER_E" 3 3 "RBA_FEEFS2_PRV_SECTOR_ERASE_ERASING_E" 4 4 "RBA_FEEFS2_PRV_SECTOR_ERASE_SETSTATE_E" 5 5 "RBA_FEEFS2_PRV_SECTOR_ERASE_FINAL_E" DEFAULT_VALUE "" /end COMPU_VTAB_RANGE
/begin COMPU_VTAB_RANGE _rba_FeeFs2_Prv_SectorSetState_st._newSectorState_en.CONVERSION "@@@@RuleName created by CANape" 7 0 0 "RBA_FEEFS2_PRV_SECTOR_STATE_UNDEF_E" 1 1 "RBA_FEEFS2_PRV_SECTOR_STATE_ERASED_E" 2 2 "RBA_FEEFS2_PRV_SECTOR_STATE_FATPREPARE_E" 3 3 "RBA_FEEFS2_PRV_SECTOR_STATE_FATACTIVE_E" 4 4 "RBA_FEEFS2_PRV_SECTOR_STATE_DAT_E" 5 5 "RBA_FEEFS2_PRV_SECTOR_STATE_RDY4ERASE_E" 6 6 "RBA_FEEFS2_PRV_SECTOR_STATE_END_E" DEFAULT_VALUE "" /end COMPU_VTAB_RANGE
/begin COMPU_VTAB_RANGE _rba_FeeFs2_Prv_SectorSetState_st._state_en.CONVERSION "" 3 0 0 "RBA_FEEFS2_PRV_SECTOR_SETSTATE_IDLE_E" 1 1 "RBA_FEEFS2_PRV_SECTOR_SETSTATE_INIT_E" 2 2 "RBA_FEEFS2_PRV_SECTOR_SETSTATE_WRITING_E" DEFAULT_VALUE "" /end COMPU_VTAB_RANGE
/begin COMPU_VTAB_RANGE _rba_FeeFs2_Prv_SectorSetState_st._state_en.CONVERSION0 "@@@@RuleName created by CANape" 3 0 0 "RBA_FEEFS2_PRV_SECTOR_SETSTATE_IDLE_E" 1 1 "RBA_FEEFS2_PRV_SECTOR_SETSTATE_INIT_E" 2 2 "RBA_FEEFS2_PRV_SECTOR_SETSTATE_WRITING_E" DEFAULT_VALUE "" /end COMPU_VTAB_RANGE
/begin COMPU_VTAB_RANGE _rba_FeeFs2_Prv_SectorSetWlDfc_st._state_en.CONVERSION "" 3 0 0 "RBA_FEEFS2_PRV_SECTOR_SETWLDFC_IDLE_E" 1 1 "RBA_FEEFS2_PRV_SECTOR_SETWLDFC_INIT_E" 2 2 "RBA_FEEFS2_PRV_SECTOR_SETWLDFC_WRITING_E" DEFAULT_VALUE "" /end COMPU_VTAB_RANGE
/begin COMPU_VTAB_RANGE _rba_FeeFs2_Prv_SectorSetWlDfc_st._state_en.CONVERSION0 "@@@@RuleName created by CANape" 3 0 0 "RBA_FEEFS2_PRV_SECTOR_SETWLDFC_IDLE_E" 1 1 "RBA_FEEFS2_PRV_SECTOR_SETWLDFC_INIT_E" 2 2 "RBA_FEEFS2_PRV_SECTOR_SETWLDFC_WRITING_E" DEFAULT_VALUE "" /end COMPU_VTAB_RANGE
/begin COMPU_VTAB_RANGE _rba_FeeFs2_Prv_SectorWriteMarker_st._state_en.CONVERSION "" 3 0 0 "RBA_FEEFS2_PRV_SECTOR_WRITEMARKER_IDLE_E" 1 1 "RBA_FEEFS2_PRV_SECTOR_WRITEMARKER_INIT_E" 2 2 "RBA_FEEFS2_PRV_SECTOR_WRITEMARKER_WRITING_E" DEFAULT_VALUE "" /end COMPU_VTAB_RANGE
/begin COMPU_VTAB_RANGE _rba_FeeFs2_Prv_SectorWriteMarker_st._state_en.CONVERSION0 "@@@@RuleName created by CANape" 3 0 0 "RBA_FEEFS2_PRV_SECTOR_WRITEMARKER_IDLE_E" 1 1 "RBA_FEEFS2_PRV_SECTOR_WRITEMARKER_INIT_E" 2 2 "RBA_FEEFS2_PRV_SECTOR_WRITEMARKER_WRITING_E" DEFAULT_VALUE "" /end COMPU_VTAB_RANGE
/begin COMPU_VTAB_RANGE _rba_FeeFs2_Prv_Write_st._state_en.CONVERSION "@@@@RuleName created by CANape" 11 0 0 "RBA_FEEFS2_PRV_WRITE_IDLE_E" 1 1 "RBA_FEEFS2_PRV_WRITE_INIT_E" 2 2 "RBA_FEEFS2_PRV_WRITE_CALCCRCINRAM_E" 3 3 "RBA_FEEFS2_PRV_WRITE_GETLATEST_E" 4 4 "RBA_FEEFS2_PRV_WRITE_COMPARE_E" 5 5 "RBA_FEEFS2_PRV_WRITE_MALLOCDAT_E" 6 6 "RBA_FEEFS2_PRV_WRITE_MALLOCFAT_E" 7 7 "RBA_FEEFS2_PRV_WRITE_DATWRITE_E" 8 8 "RBA_FEEFS2_PRV_WRITE_VERIFY_E" 9 9 "RBA_FEEFS2_PRV_WRITE_FATWRITE_E" 10 10 "RBA_FEEFS2_PRV_WRITE_FINAL_E" DEFAULT_VALUE "" /end COMPU_VTAB_RANGE
/begin COMPU_VTAB_RANGE _rba_QueuedSpi_HwUnitCfg_0._0_._DmaConfigRx._TfrReqTyp_en.CONVERSION "" 6 0 0 "RBA_DMA_SW_TRIG_COMPLETE_TRANSACTION" 1 1 "RBA_DMA_SW_TRIG_SINGLE_TRANSFER" 2 2 "RBA_DMA_HW_TRIG_COMPLETE_TRANSACTION" 3 3 "RBA_DMA_HW_TRIG_SINGLE_TRANSFER" 4 4 "RBA_DMA_HW_TRIG_CONTINUOUS_SINGLE_TRANSFER" 5 5 "RBA_DMA_HW_TRIG_CONTINUOUS_COMPLETE_TRANSACTION" DEFAULT_VALUE "" /end COMPU_VTAB_RANGE
/begin COMPU_VTAB _rba_QueuedSpi_HwUnit_cast._0_._DmaConfigTx1_st._LinkedListTyp_en.CONVERSION "enumeration table" TAB_VERB 5 0 "RBA_DMA_NO_LINKEDLIST" 12 "RBA_DMA_LINKEDLIST" 13 "RBA_DMA_ACCUMULATED_LINKEDLIST" 14 "RBA_DMA_SAFE_LINKEDLIST" 15 "RBA_DMA_CONDITIONAL_LINKEDLIST" /end COMPU_VTAB
/begin COMPU_VTAB_RANGE _rba_QueuedSpi_HwUnit_cast._0_._stAsyncMode_en.CONVERSION "" 2 0 0 "SPI_RB_LO_POLLING_MODE" 1 1 "SPI_RB_LO_INTERRUPT_MODE" DEFAULT_VALUE "" /end COMPU_VTAB_RANGE
/begin COMPU_VTAB_RANGE _rba_QueuedSpi_HwUnit_cast._0_._stHwUnit_en.CONVERSION "" 3 0 0 "SPI_RB_LO_UNINIT" 1 1 "SPI_RB_LO_IDLE" 2 2 "SPI_RB_LO_BUSY" DEFAULT_VALUE "" /end COMPU_VTAB_RANGE
/begin COMPU_VTAB_RANGE _rba_QueuedSpi_HwUnit_cast._5_._DmaConfigTx2_st._ChDataWidth_en.CONVERSION "@@@@RuleName created by CANape" 6 0 0 "RBA_DMA_MOVE_HAS_8_BIT_DATA" 1 1 "RBA_DMA_MOVE_HAS_16_BIT_DATA" 2 2 "RBA_DMA_MOVE_HAS_32_BIT_DATA" 3 3 "RBA_DMA_MOVE_HAS_64_BIT_DATA" 4 4 "RBA_DMA_MOVE_HAS_128_BIT_DATA" 5 5 "RBA_DMA_MOVE_HAS_256_BIT_DATA" DEFAULT_VALUE "" /end COMPU_VTAB_RANGE
/begin COMPU_VTAB_RANGE _rba_QueuedSpi_HwUnit_cast._5_._DmaConfigTx2_st._IntTrigTyp_en.CONVERSION "@@@@RuleName created by CANape" 4 0 0 "RBA_DMA_NO_INT_BUT_FLAG_FOR_COMPLETE_TRANSACTION" 1 1 "RBA_DMA_NO_INT_BUT_FLAG_FOR_EACH_TRANSFER" 2 2 "RBA_DMA_INT_TRIG_AND_FLAG_FOR_COMPLETE_TRANSACTION" 3 3 "RBA_DMA_INT_TRIG_AND_FLAG_FOR_EACH_TRANSFER" DEFAULT_VALUE "" /end COMPU_VTAB_RANGE
/begin COMPU_VTAB_RANGE _rba_QueuedSpi_HwUnit_cast._5_._DmaConfigTx2_st._MovesPerTfr_en.CONVERSION "@@@@RuleName created by CANape" 8 0 0 "RBA_DMA_TFR_HAS_1_DMA_MOVE" 1 1 "RBA_DMA_TFR_HAS_2_DMA_MOVES" 2 2 "RBA_DMA_TFR_HAS_4_DMA_MOVES" 3 3 "RBA_DMA_TFR_HAS_8_DMA_MOVES" 4 4 "RBA_DMA_TFR_HAS_16_DMA_MOVES" 5 5 "RBA_DMA_TFR_HAS_3_DMA_MOVES" 6 6 "RBA_DMA_TFR_HAS_5_DMA_MOVES" 7 7 "RBA_DMA_TFR_HAS_9_DMA_MOVES" DEFAULT_VALUE "" /end COMPU_VTAB_RANGE
/begin COMPU_VTAB_RANGE _rba_QueuedSpi_HwUnit_cast._5_._DmaConfigTx2_st._SrcAddrModifier_en.CONVERSION "@@@@RuleName created by CANape" 17 0 0 "RBA_DMA_DECREMENT_ADDR_BY_1_X_DATAWIDTH" 1 1 "RBA_DMA_DECREMENT_ADDR_BY_2_X_DATAWIDTH" 2 2 "RBA_DMA_DECREMENT_ADDR_BY_4_X_DATAWIDTH" 3 3 "RBA_DMA_DECREMENT_ADDR_BY_8_X_DATAWIDTH" 4 4 "RBA_DMA_DECREMENT_ADDR_BY_16_X_DATAWIDTH" 5 5 "RBA_DMA_DECREMENT_ADDR_BY_32_X_DATAWIDTH" 6 6 "RBA_DMA_DECREMENT_ADDR_BY_64_X_DATAWIDTH" 7 7 "RBA_DMA_DECREMENT_ADDR_BY_128_X_DATAWIDTH" 8 8 "RBA_DMA_INCREMENT_ADDR_BY_1_X_DATAWIDTH" 9 9 "RBA_DMA_INCREMENT_ADDR_BY_2_X_DATAWIDTH" 10 10 "RBA_DMA_INCREMENT_ADDR_BY_4_X_DATAWIDTH" 11 11 "RBA_DMA_INCREMENT_ADDR_BY_8_X_DATAWIDTH" 12 12 "RBA_DMA_INCREMENT_ADDR_BY_16_X_DATAWIDTH" 13 13 "RBA_DMA_INCREMENT_ADDR_BY_32_X_DATAWIDTH" 14 14 "RBA_DMA_INCREMENT_ADDR_BY_64_X_DATAWIDTH" 15 15 "RBA_DMA_INCREMENT_ADDR_BY_128_X_DATAWIDTH" 16 16 "RBA_DMA_NO_MODIFICATION_OF_ADDRESS" DEFAULT_VALUE "" /end COMPU_VTAB_RANGE
/begin COMPU_VTAB_RANGE _rba_QueuedSpi_HwUnit_cast._5_._DmaConfigTx2_st._TfrReqTyp_en.CONVERSION "@@@@RuleName created by CANape" 6 0 0 "RBA_DMA_SW_TRIG_COMPLETE_TRANSACTION" 1 1 "RBA_DMA_SW_TRIG_SINGLE_TRANSFER" 2 2 "RBA_DMA_HW_TRIG_COMPLETE_TRANSACTION" 3 3 "RBA_DMA_HW_TRIG_SINGLE_TRANSFER" 4 4 "RBA_DMA_HW_TRIG_CONTINUOUS_SINGLE_TRANSFER" 5 5 "RBA_DMA_HW_TRIG_CONTINUOUS_COMPLETE_TRANSACTION" DEFAULT_VALUE "" /end COMPU_VTAB_RANGE
/begin COMPU_VTAB_RANGE _rba_QueuedSpi_HwUnit_cast._5_._stAsyncMode_en.CONVERSION "@@@@RuleName created by CANape" 2 0 0 "SPI_RB_LO_POLLING_MODE" 1 1 "SPI_RB_LO_INTERRUPT_MODE" DEFAULT_VALUE "" /end COMPU_VTAB_RANGE
/begin COMPU_VTAB_RANGE _rba_QueuedSpi_HwUnit_cast._5_._stHwUnit_en.CONVERSION "@@@@RuleName created by CANape" 3 0 0 "SPI_RB_LO_UNINIT" 1 1 "SPI_RB_LO_IDLE" 2 2 "SPI_RB_LO_BUSY" DEFAULT_VALUE "" /end COMPU_VTAB_RANGE
/begin COMPU_VTAB _rbsftmon_CoreClockInitializationState_en.CONVERSION "enumeration table" TAB_VERB 4 0 "RBSFTMON_CORECLK_INITSUBSTATE_ENABLESMUALARM_E" 1 "RBSFTMON_CORECLK_INITSUBSTATE_ENABLEMAINCLOCK_E" 2 "RBSFTMON_CORECLK_INITSUBSTATE_ENABLEBACKUPCLOCK_E" 3 "RBSFTMON_CORECLK_INITSUBSTATE_IDLEMODE_E" /end COMPU_VTAB
/begin COMPU_VTAB_RANGE _stLLDRet_st._stRet_en.CONVERSION "@@@@RuleName created by CANape" 9 0 0 "FLS_RB_ST_OK_E" 1 1 "FLS_RB_ST_ERROR_E" 2 2 "FLS_RB_ST_ERASING_E" 3 3 "FLS_RB_ST_PROGRAMMING_E" 4 4 "FLS_RB_ST_READING_E" 5 5 "FLS_RB_ST_COMPARING_E" 6 6 "FLS_RB_ST_COMPARE_FAILED_E" 254 254 "FLS_RB_ST_ADDR_ERR_E" 255 255 "FLS_RB_ST_LENGTH_ERR_E" DEFAULT_VALUE "" /end COMPU_VTAB_RANGE
/begin COMPU_VTAB_RANGE _syslog_dataLog._FreezeTrigger.CONVERSION "" 3 0 0 "SYSLOG_FREEZE_TRAHA" 1 1 "SYSLOG_FREEZE_RTAOS" 2 2 "SYSLOG_FREEZE_NOFREEZE" DEFAULT_VALUE "" /end COMPU_VTAB_RANGE
/begin COMPU_VTAB_RANGE _syslog_dataLog._LastResetReason.CONVERSION "@@@@RuleName created by CANape" 17 0 0 "MCU_ESR0_RESET" 1 1 "MCU_ESR1_RESET" 2 2 "MCU_SMU_RESET" 3 3 "MCU_SW_RESET" 4 4 "MCU_STM0_RESET" 5 5 "MCU_STM1_RESET" 6 6 "MCU_STM2_RESET" 7 7 "MCU_STM3_RESET" 8 8 "MCU_STM4_RESET" 9 9 "MCU_STM5_RESET" 10 10 "MCU_CB0_RESET" 11 11 "MCU_CB1_RESET" 12 12 "MCU_CB3_RESET" 13 13 "MCU_STBYR_RESET" 14 14 "MCU_WARM_POWER_ON_RESET" 15 15 "MCU_POWER_ON_RESET" 16 16 "MCU_RESET_UNDEFINED" DEFAULT_VALUE "" /end COMPU_VTAB_RANGE
/begin COMPU_VTAB_RANGE _warningArray._m_value._3_.CONVERSION "@@@@RuleName created by CANape" 5 0 0 "typeAcoustical" 1 1 "typeBrakeJerk" 2 2 "typePartialBrake" 3 3 "typeNoWarning" 4 4 "numTotalValues" DEFAULT_VALUE "" /end COMPU_VTAB_RANGE
/begin COMPU_VTAB calibRotState "enumeration table" TAB_VERB 3 0 "NOT_FINISHED" 1 "FINISHED_SUCCESSFULLY" 2 "FINISHED_UNSUCCESSFULLY" /end COMPU_VTAB
/begin COMPU_VTAB_RANGE d_builtin_type_print "" 10 0 0 "D_PRINT_DEFAULT" 1 1 "D_PRINT_INT" 2 2 "D_PRINT_UNSIGNED" 3 3 "D_PRINT_LONG" 4 4 "D_PRINT_UNSIGNED_LONG" 5 5 "D_PRINT_LONG_LONG" 6 6 "D_PRINT_UNSIGNED_LONG_LONG" 7 7 "D_PRINT_BOOL" 8 8 "D_PRINT_FLOAT" 9 9 "D_PRINT_VOID" DEFAULT_VALUE "" /end COMPU_VTAB_RANGE
/begin COMPU_VTAB_RANGE eErrorId "" 35 0 0 "RIF_CONF_ENABLE_TIMEOUT" 1 1 "RIF_CONF_DISABLE_TIMEOUT" 2 2 "RIF_CONF_RESET_TIMEOUT" 3 3 "RIF_DATA_CRC" 4 4 "RIF_DATA_COUNTER" 5 5 "RIF_DFU_LKSTP" 6 6 "RIF_REG_CRC" 7 7 "RIF_SFTY_CTRL" 8 8 "RIF_CAL_DESKEW" 9 9 "RIF_CAL_TIMEOUT" 10 10 "SPU_INT_TIMEOUT" 11 11 "SPU_MON_STAT_REG" 12 12 "SPU_HW_INIT" 13 13 "SPU_SBST" 14 14 "MMIC_CONFIG_FAILED" 15 15 "MMIC_MODRUN_FAILED" 16 16 "MMIC_EVALMON_FAILED" 17 17 "MMIC_TXLOWPOW_ERR" 18 18 "MMIC_TXAMPDRFT_ERR" 19 19 "MMIC_TXPHADRFT_ERR" 20 20 "MMIC_RXAMPDRFT_ERR" 21 21 "MMIC_RXPHADRFT_ERR" 22 22 "MMIC_RXGAIN_ERR" 23 23 "MMIC_RXCORFRQ_ERR" 24 24 "MMIC_UNDERVOLT_ERR" 25 25 "MMIC_BALLBREAK_ERR" 26 26 "MMIC_MBC_ERR" 27 27 "MMIC_OVERVOLT_ERR" 28 28 "MMIC_PLLDLDUNLOCK_ERR" 29 29 "MMIC_SPISEGV_ERR" 30 30 "MMIC_LVDS_ERR" 31 31 "MMIC_RMP_ERR" 32 32 "MMIC_RFSP_ERR" 33 33 "ERROR_DSP_INTERNAL" 34 34 "LENGTH_ERROR_LIST" DEFAULT_VALUE "" /end COMPU_VTAB_RANGE
/begin COMPU_VTAB_RANGE eErrorId.OLD_1 "" 31 0 0 "RIF_CONF_ENABLE_TIMEOUT" 1 1 "RIF_CONF_DISABLE_TIMEOUT" 2 2 "RIF_CONF_RESET_TIMEOUT" 3 3 "RIF_DATA_CRC" 4 4 "RIF_DATA_COUNTER" 5 5 "RIF_CAL_DESKEW" 6 6 "RIF_CAL_TIMEOUT" 7 7 "SPU_INT_TIMEOUT" 8 8 "SPU_MON_STAT_REG" 9 9 "SPU_HW_INIT" 10 10 "SPU_SBST" 11 11 "MMIC_CONFIG_FAILED" 12 12 "MMIC_MODRUN_FAILED" 13 13 "MMIC_EVALMON_FAILED" 14 14 "MMIC_TXLOWPOW_ERR" 15 15 "MMIC_TXAMPDRFT_ERR" 16 16 "MMIC_TXPHADRFT_ERR" 17 17 "MMIC_RXAMPDRFT_ERR" 18 18 "MMIC_RXPHADRFT_ERR" 19 19 "MMIC_RXGAIN_ERR" 20 20 "MMIC_RXCORFRQ_ERR" 21 21 "MMIC_UNDERVOLT_ERR" 22 22 "MMIC_BALLBREAK_ERR" 23 23 "MMIC_MBC_ERR" 24 24 "MMIC_OVERVOLT_ERR" 25 25 "MMIC_PLLDLDUNLOCK_ERR" 26 26 "MMIC_SPISEGV_ERR" 27 27 "MMIC_LVDS_ERR" 28 28 "MMIC_RMP_ERR" 29 29 "ERROR_DSP_INTERNAL" 30 30 "LENGTH_ERROR_LIST" DEFAULT_VALUE "" /end COMPU_VTAB_RANGE
/begin COMPU_VTAB ecy_hsm_Csai_KeyIdTag "enumeration table" TAB_VERB 35 0 "ecy_hsm_CSAI_KEYID_AES_KEY_start" 0 "ecy_hsm_CSAI_KEYID_AES_KEY_DYNAMIC_CFG_CRYPTO_AES128_KEY_DYNAMIC_0_BASE_0" 1 "ecy_hsm_CSAI_KEYID_AES_KEY_DYNAMIC_CFG_CRYPTO_AES128_KEY_DYNAMIC_0_INST_1" 2 "ecy_hsm_CSAI_KEYID_AES_KEY_end" 256 "ecy_hsm_CSAI_KEYID_RSA_KEY_start" 256 "ecy_hsm_CSAI_KEYID_RSA_KEY_STATIC_CFG_RSA2048_KEY_PUB_STATIC_0" 257 "ecy_hsm_CSAI_KEYID_RSA_KEY_end" 512 "ecy_hsm_CSAI_KEYID_ECC_KEY_start" 513 "ecy_hsm_CSAI_KEYID_ECC_KEY_end" 768 "ecy_hsm_CSAI_KEYID_CERT_start" 768 "ecy_hsm_CSAI_KEYID_CERT_STATIC_CFG_CERT_0_CVC_RSA2048__RBPKI_PRJ" 769 "ecy_hsm_CSAI_KEYID_CERT_STATIC_CFG_CERT_1_CVC_RSA2048__RBPKI_RESERVED" 770 "ecy_hsm_CSAI_KEYID_CERT_end" 1024 "ecy_hsm_CSAI_KEYID_OID_start" 1024 "ecy_hsm_CSAI_KEYID_OID_STATIC_CFG_OID_0_CVC_RSA2048__RBPKI_PRJ" 1025 "ecy_hsm_CSAI_KEYID_OID_STATIC_CFG_OID_1_CVC_RSA2048__RBPKI_RESERVED" 1026 "ecy_hsm_CSAI_KEYID_OID_end" 1280 "ecy_hsm_CSAI_KEYID_SECRET_DATA_start" 1280 "ecy_hsm_CSAI_KEYID_SECRET_DATA_DYNAMIC_CFG_SECRET_DATA_0_2B__RBPLATFORM_LCPONCTR" 1281 "ecy_hsm_CSAI_KEYID_SECRET_DATA_DYNAMIC_CFG_SECRET_DATA_1_2B__RESERVED" 1282 "ecy_hsm_CSAI_KEYID_SECRET_DATA_end" 1536 "ecy_hsm_CSAI_KEYID_INT_DATA_start" 1536 "ecy_hsm_CSAI_KEYID_INT_DATA_STATIC_CFG_INT_DATA_0" 1537 "ecy_hsm_CSAI_KEYID_INT_DATA_DYNAMIC_CFG_INT_DATA_TRUSTED_BOOT_REF" 1538 "ecy_hsm_CSAI_KEYID_INT_DATA_DYNAMIC_CFG_LIFE_CYCLE_STATE" 1539 "ecy_hsm_CSAI_KEYID_INT_DATA_DYNAMIC_CFG_PASSWORDS" 1540 "ecy_hsm_CSAI_KEYID_INT_DATA_DYNAMIC_CFG_SERIALNUMBER" 1541 "ecy_hsm_CSAI_KEYID_INT_DATA_DYNAMIC_CFG_HSM_UPDATE_PASSWORD" 1542 "ecy_hsm_CSAI_KEYID_INT_DATA_STATIC_CFG_HSM_SUSPEND_TIME" 1543 "ecy_hsm_CSAI_KEYID_INT_DATA_DYNAMIC_CFG_SECACC_NONCE" 1544 "ecy_hsm_CSAI_KEYID_INT_DATA_STATIC_CFG_SECURE_DEBUG_NONCE_CNTRL" 1545 "ecy_hsm_CSAI_KEYID_INT_DATA_STATIC_CFG_SECURE_DEBUG_USE_CASE" 1546 "ecy_hsm_CSAI_KEYID_INT_DATA_STATIC_CFG_SECURE_DEBUG_CHALLENGE_LEN" 1547 "ecy_hsm_CSAI_KEYID_INT_DATA_end" 2147483647 "ecy_hsm_CSAI_SHE_KEYID_RESERVED" /end COMPU_VTAB
/begin COMPU_VTAB_RANGE messagePriority "" 4 0 0 "high" 1 1 "medium" 2 2 "low" 3 3 "unpriorized" DEFAULT_VALUE "" /end COMPU_VTAB_RANGE
/begin COMPU_VTAB_RANGE messageType "" 4 0 0 "warning" 1 1 "textMessage" 2 2 "otherInformation" 3 3 "none" DEFAULT_VALUE "" /end COMPU_VTAB_RANGE
/begin COMPU_VTAB rbMonReact_EventState "enumeration table" TAB_VERB 3 0 "rbMonReact_EventStateFailed_e" 1 "rbMonReact_EventStatePassed_e" 2 "rbMonReact_Prv_EventStateInit_e" /end COMPU_VTAB
/begin COMPU_VTAB rbNetCom_State_e "enumeration table" TAB_VERB 6 0 "rbNetCom_ErrorInvalid_e" 1 "rbNetCom_Valid_e" 2 "rbNetCom_OutOfRange_e" 3 "rbNetCom_NoSpecialValue_e" 4 "rbNetCom_Received_e" 5 "rbNetCom_InRange_e" /end COMPU_VTAB
/begin COMPU_VTAB_RANGE rbNet_State_e "" 2 0 0 "rbNet_Valid_e" 1 1 "rbNet_ErrorInvalid_e" DEFAULT_VALUE "" /end COMPU_VTAB_RANGE
/begin COMPU_VTAB rbPdm_EDevelopmentError "enumeration table" TAB_VERB 6 0 "NoError_e" 1 "WriteError_e" 2 "ReadError_e" 3 "StatusError_e" 4 "RamBlockMissingError_e" 5 "InvalidBlockIdArgumentError_e" /end COMPU_VTAB
/begin COMPU_VTAB rbPdm_EJobStatus "enumeration table" TAB_VERB 16 0 "JobStatusInit_e" 1 "JobWriteAccepted_e" 2 "JobWriteRejected_e" 3 "JobWriteRetriggerOnGoing_e" 4 "JobWriteCompleted_e" 5 "JobWriteFailed_e" 6 "JobReadCompleted_e" 7 "JobReadFailed_e" 8 "JobRestoreAccepted_e" 9 "JobRestoreRejected_e" 10 "JobRestoreCompleted_e" 11 "JobRestoreFailed_e" 12 "JobInvalidateAccepted_e" 13 "JobInvalidateRejected_e" 14 "JobInvalidateCompleted_e" 15 "JobInvalidateFailed_e" /end COMPU_VTAB
/begin COMPU_VTAB rbPdm_ERequestType "enumeration table" TAB_VERB 6 0 "RequestNone_e" 1 "RequestWrite_e" 2 "RequestWriteImmediate_e" 3 "RequestRead_e" 4 "RequestInvalidate_e" 5 "RequestRestore_e" /end COMPU_VTAB
/begin COMPU_VTAB_RANGE rbSysEvM_EventState "" 5 0 0 "PASSED" 1 1 "FAILED" 2 2 "PREPASSED" 3 3 "PREFAILED" 5 5 "NO_UPDATE" DEFAULT_VALUE "" /end COMPU_VTAB_RANGE
/begin COMPU_VTAB rcy_hsm_Csai_JobPriorityTag "enumeration table" TAB_VERB 7 0 "ecy_hsm_CSAI_PRIO_BACKGROUND" 1 "ecy_hsm_CSAI_PRIO_LOW" 2 "ecy_hsm_CSAI_PRIO_MEDIUM" 3 "ecy_hsm_CSAI_PRIO_HIGH" 3 "ecy_hsm_CSAI_PRIO_SAFETY" 5 "ecy_hsm_CSAI_PRIO_UNCHANGED" 2147483647 "ecy_hsm_CSAI_JOBPRIORITY_RESERVED" /end COMPU_VTAB
/begin COMPU_VTAB rcy_hsm_Csai_SecAcc_NonceCtrl "enumeration table" TAB_VERB 8 1 "ecy_hsm_CSAI_NONCE_ZERO" 2 "ecy_hsm_CSAI_NONCE_RND" 3 "ecy_hsm_CSAI_NONCE_RND_STORE_DFLASH" 4 "ecy_hsm_CSAI_NONCE_FROM_DFLASH" 5 "ecy_hsm_CSAI_NONCE_DEVICE_ID" 6 "ecy_hsm_CSAI_NONCE_HASHED_DEVICE_ID" 7 "ecy_hsm_CSAI_NONCE_NUMTYPES" 2147483647 "ecy_hsm_CSAI_NONCE_RESERVED" /end COMPU_VTAB
/begin RECORD_LAYOUT NewString.RecordLayout FNC_VALUES 1 UBYTE COLUMN_DIR DIRECT ALIGNMENT_FLOAT64_IEEE 8 ALIGNMENT_INT64 8 /end RECORD_LAYOUT
/begin RECORD_LAYOUT SSV__A_INT64_S AXIS_PTS_X 1 A_INT64 INDEX_INCR DIRECT ALIGNMENT_FLOAT64_IEEE 8 ALIGNMENT_INT64 8 /end RECORD_LAYOUT
/begin RECORD_LAYOUT SSV__A_UINT64_S AXIS_PTS_X 1 A_UINT64 INDEX_INCR DIRECT ALIGNMENT_FLOAT64_IEEE 8 ALIGNMENT_INT64 8 /end RECORD_LAYOUT
/begin RECORD_LAYOUT SSV__FLOAT32_IEEE_S AXIS_PTS_X 1 FLOAT32_IEEE INDEX_INCR DIRECT ALIGNMENT_FLOAT64_IEEE 8 ALIGNMENT_INT64 8 /end RECORD_LAYOUT
/begin RECORD_LAYOUT SSV__FLOAT64_IEEE_S AXIS_PTS_X 1 FLOAT64_IEEE INDEX_INCR DIRECT ALIGNMENT_FLOAT64_IEEE 8 ALIGNMENT_INT64 8 /end RECORD_LAYOUT
/begin RECORD_LAYOUT SSV__SBYTE_S AXIS_PTS_X 1 SBYTE INDEX_INCR DIRECT ALIGNMENT_FLOAT64_IEEE 8 ALIGNMENT_INT64 8 /end RECORD_LAYOUT
/begin RECORD_LAYOUT SSV__SLONG_S AXIS_PTS_X 1 SLONG INDEX_INCR DIRECT ALIGNMENT_FLOAT64_IEEE 8 ALIGNMENT_INT64 8 /end RECORD_LAYOUT
/begin RECORD_LAYOUT SSV__SWORD_S AXIS_PTS_X 1 SWORD INDEX_INCR DIRECT ALIGNMENT_FLOAT64_IEEE 8 ALIGNMENT_INT64 8 /end RECORD_LAYOUT
/begin RECORD_LAYOUT SSV__UBYTE_S AXIS_PTS_X 1 UBYTE INDEX_INCR DIRECT ALIGNMENT_FLOAT64_IEEE 8 ALIGNMENT_INT64 8 /end RECORD_LAYOUT
/begin RECORD_LAYOUT SSV__ULONG_S AXIS_PTS_X 1 ULONG INDEX_INCR DIRECT ALIGNMENT_FLOAT64_IEEE 8 ALIGNMENT_INT64 8 /end RECORD_LAYOUT
/begin RECORD_LAYOUT SSV__UWORD_S AXIS_PTS_X 1 UWORD INDEX_INCR DIRECT ALIGNMENT_FLOAT64_IEEE 8 ALIGNMENT_INT64 8 /end RECORD_LAYOUT
/begin RECORD_LAYOUT SWORD_COL_DIRECT FNC_VALUES 1 SWORD COLUMN_DIR DIRECT ALIGNMENT_FLOAT64_IEEE 8 ALIGNMENT_INT64 8 /end RECORD_LAYOUT
/begin RECORD_LAYOUT __A_INT64_S FNC_VALUES 1 A_INT64 COLUMN_DIR DIRECT ALIGNMENT_FLOAT64_IEEE 8 ALIGNMENT_INT64 8 /end RECORD_LAYOUT
/begin RECORD_LAYOUT __A_INT64_Z FNC_VALUES 1 A_INT64 ROW_DIR DIRECT ALIGNMENT_FLOAT64_IEEE 8 ALIGNMENT_INT64 8 /end RECORD_LAYOUT
/begin RECORD_LAYOUT __A_UINT64_S FNC_VALUES 1 A_UINT64 COLUMN_DIR DIRECT ALIGNMENT_FLOAT64_IEEE 8 ALIGNMENT_INT64 8 /end RECORD_LAYOUT
/begin RECORD_LAYOUT __A_UINT64_Z FNC_VALUES 1 A_UINT64 ROW_DIR DIRECT ALIGNMENT_FLOAT64_IEEE 8 ALIGNMENT_INT64 8 /end RECORD_LAYOUT
/begin RECORD_LAYOUT __FLOAT32_IEEE_S FNC_VALUES 1 FLOAT32_IEEE COLUMN_DIR DIRECT ALIGNMENT_FLOAT64_IEEE 8 ALIGNMENT_INT64 8 /end RECORD_LAYOUT
/begin RECORD_LAYOUT __FLOAT32_IEEE_Z FNC_VALUES 1 FLOAT32_IEEE ROW_DIR DIRECT ALIGNMENT_FLOAT64_IEEE 8 ALIGNMENT_INT64 8 /end RECORD_LAYOUT
/begin RECORD_LAYOUT __FLOAT64_IEEE_S FNC_VALUES 1 FLOAT64_IEEE COLUMN_DIR DIRECT ALIGNMENT_FLOAT64_IEEE 8 ALIGNMENT_INT64 8 /end RECORD_LAYOUT
/begin RECORD_LAYOUT __FLOAT64_IEEE_Z FNC_VALUES 1 FLOAT64_IEEE ROW_DIR DIRECT ALIGNMENT_FLOAT64_IEEE 8 ALIGNMENT_INT64 8 /end RECORD_LAYOUT
/begin RECORD_LAYOUT __Float16_Value FNC_VALUES 1 FLOAT16_IEEE ROW_DIR DIRECT /end RECORD_LAYOUT
/begin RECORD_LAYOUT __Float32_Value FNC_VALUES 1 FLOAT32_IEEE ROW_DIR DIRECT /end RECORD_LAYOUT
/begin RECORD_LAYOUT __SBYTE_S FNC_VALUES 1 SBYTE COLUMN_DIR DIRECT ALIGNMENT_FLOAT64_IEEE 8 ALIGNMENT_INT64 8 /end RECORD_LAYOUT
/begin RECORD_LAYOUT __SBYTE_Z FNC_VALUES 1 SBYTE ROW_DIR DIRECT ALIGNMENT_FLOAT64_IEEE 8 ALIGNMENT_INT64 8 /end RECORD_LAYOUT
/begin RECORD_LAYOUT __SByte_Value FNC_VALUES 1 SBYTE ROW_DIR DIRECT /end RECORD_LAYOUT
/begin RECORD_LAYOUT __SLONG_S FNC_VALUES 1 SLONG COLUMN_DIR DIRECT ALIGNMENT_FLOAT64_IEEE 8 ALIGNMENT_INT64 8 /end RECORD_LAYOUT
/begin RECORD_LAYOUT __SLONG_Z FNC_VALUES 1 SLONG ROW_DIR DIRECT ALIGNMENT_FLOAT64_IEEE 8 ALIGNMENT_INT64 8 /end RECORD_LAYOUT
/begin RECORD_LAYOUT __SWORD_S FNC_VALUES 1 SWORD COLUMN_DIR DIRECT ALIGNMENT_FLOAT64_IEEE 8 ALIGNMENT_INT64 8 /end RECORD_LAYOUT
/begin RECORD_LAYOUT __SWORD_Z FNC_VALUES 1 SWORD ROW_DIR DIRECT ALIGNMENT_FLOAT64_IEEE 8 ALIGNMENT_INT64 8 /end RECORD_LAYOUT
/begin RECORD_LAYOUT __UBYTE_S FNC_VALUES 1 UBYTE COLUMN_DIR DIRECT ALIGNMENT_FLOAT64_IEEE 8 ALIGNMENT_INT64 8 /end RECORD_LAYOUT
/begin RECORD_LAYOUT __UBYTE_S_M_M_M_S1_S1_M FNC_VALUES 1 UBYTE COLUMN_DIR DIRECT ALIGNMENT_FLOAT64_IEEE 8 ALIGNMENT_INT64 8 /end RECORD_LAYOUT
/begin RECORD_LAYOUT __UBYTE_Z FNC_VALUES 1 UBYTE ROW_DIR DIRECT ALIGNMENT_FLOAT64_IEEE 8 ALIGNMENT_INT64 8 /end RECORD_LAYOUT
/begin RECORD_LAYOUT __UByte_Value FNC_VALUES 1 UBYTE ROW_DIR DIRECT /end RECORD_LAYOUT
/begin RECORD_LAYOUT __ULONG_S FNC_VALUES 1 ULONG COLUMN_DIR DIRECT ALIGNMENT_FLOAT64_IEEE 8 ALIGNMENT_INT64 8 /end RECORD_LAYOUT
/begin RECORD_LAYOUT __ULONG_Z FNC_VALUES 1 ULONG ROW_DIR DIRECT ALIGNMENT_FLOAT64_IEEE 8 ALIGNMENT_INT64 8 /end RECORD_LAYOUT
/begin RECORD_LAYOUT __ULong_Value FNC_VALUES 1 ULONG ROW_DIR DIRECT /end RECORD_LAYOUT
/begin RECORD_LAYOUT __UWORD_S FNC_VALUES 1 UWORD COLUMN_DIR DIRECT ALIGNMENT_FLOAT64_IEEE 8 ALIGNMENT_INT64 8 /end RECORD_LAYOUT
/begin RECORD_LAYOUT __UWORD_Z FNC_VALUES 1 UWORD ROW_DIR DIRECT ALIGNMENT_FLOAT64_IEEE 8 ALIGNMENT_INT64 8 /end RECORD_LAYOUT
/begin RECORD_LAYOUT __UWord_Value FNC_VALUES 1 UWORD ROW_DIR DIRECT /end RECORD_LAYOUT
/end MODULE
/end PROJECT
