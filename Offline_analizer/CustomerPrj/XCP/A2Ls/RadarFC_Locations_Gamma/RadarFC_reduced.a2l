/* generated by ASAP2 Modifier - ASAP2 Tool-Set Version 18.0.10 */
ASAP2_VERSION 1 71
/begin PROJECT RADAR_GEN5 ""
/begin HEADER "" VERSION "TO_BE_FILLED" /end HEADER
/begin MODULE RADAR_GEN5 ""
/begin MOD_PAR "" ADDR_EPK 0x800B04BC EPK "$ SW built by GHC2KOR on LR-C-0048Q at 08/07/2024 07:21:46 $" /end MOD_PAR
/begin MOD_COMMON "" ALIGNMENT_BYTE 1 ALIGNMENT_WORD 2 ALIGNMENT_LONG 4 ALIGNMENT_FLOAT16_IEEE 2 ALIGNMENT_FLOAT32_IEEE 4 ALIGNMENT_FLOAT64_IEEE 4 ALIGNMENT_INT64 4 /end MOD_COMMON
/begin IF_DATA XCP
 /begin PROTOCOL_LAYER 0x0100 0x09C4 0xC8 0x00 0x00 0x00 0x00 0x00 0xFA 0x0200 BYTE_ORDER_MSB_LAST ADDRESS_GRANULARITY_BYTE OPTIONAL_CMD PROGRAM_PREPARE OPTIONAL_CMD PROGRAM_RESET OPTIONAL_CMD PROGRAM OPTIONAL_CMD PROGRAM_CLEAR OPTIONAL_CMD PROGRAM_START OPTIONAL_CMD ALLOC_ODT_ENTRY OPTIONAL_CMD ALLOC_ODT OPTIONAL_CMD ALLOC_DAQ OPTIONAL_CMD FREE_DAQ OPTIONAL_CMD GET_DAQ_EVENT_INFO OPTIONAL_CMD GET_DAQ_RESOLUTION_INFO OPTIONAL_CMD GET_DAQ_PROCESSOR_INFO OPTIONAL_CMD GET_DAQ_CLOCK OPTIONAL_CMD START_STOP_SYNCH OPTIONAL_CMD START_STOP_DAQ_LIST OPTIONAL_CMD GET_DAQ_LIST_MODE OPTIONAL_CMD SET_DAQ_LIST_MODE OPTIONAL_CMD WRITE_DAQ OPTIONAL_CMD SET_DAQ_PTR OPTIONAL_CMD CLEAR_DAQ_LIST OPTIONAL_CMD SHORT_DOWNLOAD OPTIONAL_CMD DOWNLOAD_MAX OPTIONAL_CMD DOWNLOAD OPTIONAL_CMD SHORT_UPLOAD OPTIONAL_CMD UPLOAD OPTIONAL_CMD SET_MTA OPTIONAL_CMD GET_COMM_MODE_INFO /end PROTOCOL_LAYER
 /begin DAQ DYNAMIC 0x00 0x1B 0x00 OPTIMISATION_TYPE_DEFAULT ADDRESS_EXTENSION_FREE IDENTIFICATION_FIELD_TYPE_RELATIVE_BYTE GRANULARITY_ODT_ENTRY_SIZE_DAQ_BYTE 0xF8 OVERLOAD_INDICATION_PID /begin STIM GRANULARITY_ODT_ENTRY_SIZE_STIM_BYTE 0xF8 /end STIM /begin TIMESTAMP_SUPPORTED 0x01 SIZE_DWORD UNIT_1US /end TIMESTAMP_SUPPORTED /begin EVENT "core0_t10" "core0_t10" 0x01 DAQ 0xFF 0x0A 0x06 0x00 /end EVENT /begin EVENT "core0_t20" "core0_t20" 0x02 DAQ 0xFF 0x14 0x06 0x00 /end EVENT /begin EVENT "core0_t50" "core0_t50" 0x19 DAQ 0xFF 0x32 0x06 0x00 /end EVENT /begin EVENT "core0_bg" "core0_bg" 0x04 DAQ 0xFF 0x32 0x06 0x00 /end EVENT /begin EVENT "core0_t100" "core0_t10" 0x03 DAQ 0xFF 0x64 0x06 0x00 /end EVENT /begin EVENT "core1_t10" "core1_t10" 0x05 DAQ 0xFF 0x0A 0x06 0x00 /end EVENT /begin EVENT "core1_t20" "core1_t20" 0x06 DAQ 0xFF 0x14 0x06 0x00 /end EVENT /begin EVENT "core1_bg" "core1_bg" 0x08 DAQ 0xFF 0x32 0x06 0x00 /end EVENT /begin EVENT "core1_t100" "core1_t10" 0x07 DAQ 0xFF 0x64 0x06 0x00 /end EVENT /begin EVENT "core2_t10" "core2_t10" 0x09 DAQ 0xFF 0x0A 0x06 0x00 /end EVENT /begin EVENT "core2_t20" "core2_t20" 0x0A DAQ 0xFF 0x14 0x06 0x00 /end EVENT /begin EVENT "core2_bg" "core2_bg" 0x0C DAQ 0xFF 0x32 0x06 0x00 /end EVENT /begin EVENT "core2_t100" "core2_t10" 0x0B DAQ 0xFF 0x64 0x06 0x00 /end EVENT /begin EVENT "core3_t10" "core3_t10" 0x0D DAQ 0xFF 0x0A 0x06 0x00 /end EVENT /begin EVENT "core3_t20" "core3_t20" 0x0E DAQ 0xFF 0x14 0x06 0x00 /end EVENT /begin EVENT "core3_bg" "core3_bg" 0x10 DAQ 0xFF 0x32 0x06 0x00 /end EVENT /begin EVENT "core3_t100" "core3_t10" 0x0F DAQ 0xFF 0x64 0x06 0x00 /end EVENT /begin EVENT "core4_t10" "core4_t10" 0x11 DAQ 0xFF 0x0A 0x06 0x00 /end EVENT /begin EVENT "core4_t20" "core4_t20" 0x12 DAQ 0xFF 0x14 0x06 0x00 /end EVENT /begin EVENT "core4_t100" "core4_t10" 0x13 DAQ 0xFF 0x64 0x06 0x00 /end EVENT /begin EVENT "core4_bg" "core4_bg" 0x14 DAQ 0xFF 0x32 0x06 0x00 /end EVENT /begin EVENT "core5_t10" "core5_t10" 0x15 DAQ 0xFF 0x0A 0x06 0x00 /end EVENT /begin EVENT "core5_t20" "core5_t20" 0x16 DAQ 0xFF 0x14 0x06 0x00 /end EVENT /begin EVENT "core5_t100" "core5_t10" 0x17 DAQ 0xFF 0x64 0x06 0x00 /end EVENT /begin EVENT "core5_bg" "core5_bg" 0x18 DAQ 0xFF 0x32 0x06 0x00 /end EVENT /begin EVENT "VX113x" "VX113x" 0x8000 DAQ 0xFF 0x0A 0x06 0x00 /end EVENT /begin EVENT "VX14xx" "VX14xx" 0x8001 DAQ 0xFF 0x0A 0x06 0x00 /end EVENT
  /begin EVENT "MEAS_OBJ_HIL_BYPASS_EV" "MEAS_OBJ_" 0x1B DAQ 0xFF 0x32 0x06 0xFE /end EVENT
  /begin EVENT "STIM_OBJ_HIL_BYPASS_EV" "STIM_OBJ_" 0x1C STIM 0xFF 0x32 0x06 0xFF /end EVENT
  /begin EVENT "m70BEDAAD" "m70BEDAAD" 0x60 DAQ 0xFF 0x01 0x07 0x00 /end EVENT
  /begin EVENT "m028AD5B1" "m028AD5B1" 0x61 DAQ 0xFF 0x01 0x07 0x00 /end EVENT
  /begin EVENT "m388DCE1F" "m388DCE1F" 0x62 DAQ 0xFF 0x01 0x07 0x00 /end EVENT
  /begin EVENT "m277C35A2" "m277C35A2" 0x63 DAQ 0xFF 0x01 0x07 0x00 /end EVENT
  /begin EVENT "m226110CE" "m226110CE" 0x64 DAQ 0xFF 0x01 0x07 0x00 /end EVENT
  /begin EVENT "mB9C2DE7A" "mB9C2DE7A" 0x65 DAQ 0xFF 0x01 0x07 0x00 /end EVENT
  /begin EVENT "m6D96C5B7" "m6D96C5B7" 0x66 DAQ 0xFF 0x01 0x07 0x00 /end EVENT
  /begin EVENT "m4B5389F7" "m4B5389F7" 0x67 DAQ 0xFF 0x01 0x07 0x00 /end EVENT
  /begin EVENT "m05E4EEDA" "m05E4EEDA" 0x68 DAQ 0xFF 0x01 0x07 0x00 /end EVENT
  /begin EVENT "mAEE755BF" "mAEE755BF" 0x69 DAQ 0xFF 0x01 0x07 0x00 /end EVENT
  /begin EVENT "m8D34A18B" "m8D34A18B" 0x6A DAQ 0xFF 0x01 0x07 0x00 /end EVENT
  /begin EVENT "mBDF372E6" "mBDF372E6" 0x6B DAQ 0xFF 0x01 0x07 0x00 /end EVENT
  /begin EVENT "m673397A9" "m673397A9" 0x6C DAQ 0xFF 0x01 0x07 0x00 /end EVENT
  /begin EVENT "m09AF22B6" "m09AF22B6" 0x6D DAQ 0xFF 0x01 0x07 0x00 /end EVENT
  /begin EVENT "mED88301C" "mED88301C" 0x6E DAQ 0xFF 0x01 0x07 0x00 /end EVENT
  /begin EVENT "m5B30E0EC" "m5B30E0EC" 0x6F DAQ 0xFF 0x01 0x07 0x00 /end EVENT
  /begin EVENT "mD4FEA742" "mD4FEA742" 0x70 DAQ 0xFF 0x01 0x07 0x00 /end EVENT
  /begin EVENT "m6971EE33" "m6971EE33" 0x71 DAQ 0xFF 0x01 0x07 0x00 /end EVENT
  /begin EVENT "mF4236A7C" "mF4236A7C" 0x72 DAQ 0xFF 0x01 0x07 0x00 /end EVENT
  /begin EVENT "m169D989B" "m169D989B" 0x73 DAQ 0xFF 0x01 0x07 0x00 /end EVENT
  /begin EVENT "mE2D4D7CC" "mE2D4D7CC" 0x74 DAQ 0xFF 0x01 0x07 0x00 /end EVENT
  /begin EVENT "m74793D25" "m74793D25" 0x75 DAQ 0xFF 0x01 0x07 0x00 /end EVENT
  /begin EVENT "m54AAE2D2" "m54AAE2D2" 0x76 DAQ 0xFF 0x01 0x07 0x00 /end EVENT
  /begin EVENT "m44150998" "m44150998" 0x77 DAQ 0xFF 0x01 0x07 0x00 /end EVENT
  /begin EVENT "mC37BEA6B" "mC37BEA6B" 0x78 DAQ 0xFF 0x01 0x07 0x00 /end EVENT
  /begin EVENT "m7FC38E8C" "m7FC38E8C" 0x79 DAQ 0xFF 0x01 0x07 0x00 /end EVENT
  /begin EVENT "mE6EAC0BB" "mE6EAC0BB" 0x7A DAQ 0xFF 0x01 0x07 0x00 /end EVENT
  /begin EVENT "mF1BBE94A" "mF1BBE94A" 0x7B DAQ 0xFF 0x01 0x07 0x00 /end EVENT
  /begin EVENT "mC4AD6325" "mC4AD6325" 0x7C DAQ 0xFF 0x01 0x07 0x00 /end EVENT
  /begin EVENT "m5CC13641" "m5CC13641" 0x7D DAQ 0xFF 0x01 0x07 0x00 /end EVENT
  /begin EVENT "mF632389D" "mF632389D" 0x7E DAQ 0xFF 0x01 0x07 0x00 /end EVENT
  /begin EVENT "m7896344C" "m7896344C" 0x7F DAQ 0xFF 0x01 0x07 0x00 /end EVENT
  /begin EVENT "mEE42867E" "mEE42867E" 0x80 DAQ 0xFF 0x01 0x07 0x00 /end EVENT
  /begin EVENT "m8BE7C754" "m8BE7C754" 0x81 DAQ 0xFF 0x01 0x07 0x00 /end EVENT
  /begin EVENT "mC4CC89CB" "mC4CC89CB" 0x82 DAQ 0xFF 0x01 0x07 0x00 /end EVENT
  /begin EVENT "mF07DD84D" "mF07DD84D" 0x83 DAQ 0xFF 0x01 0x07 0x00 /end EVENT
  /begin EVENT "mD95C1093" "mD95C1093" 0x84 DAQ 0xFF 0x01 0x07 0x00 /end EVENT
  /begin EVENT "m8188E012" "m8188E012" 0x85 DAQ 0xFF 0x01 0x07 0x00 /end EVENT
  /begin EVENT "mC7DA7622" "mC7DA7622" 0x86 DAQ 0xFF 0x01 0x07 0x00 /end EVENT
  /begin EVENT "mE8669EED" "mE8669EED" 0x87 DAQ 0xFF 0x01 0x07 0x00 /end EVENT
  /begin EVENT "m09329641" "m09329641" 0x88 DAQ 0xFF 0x01 0x07 0x00 /end EVENT
  /begin EVENT "m06F98A9B" "m06F98A9B" 0x89 DAQ 0xFF 0x01 0x07 0x00 /end EVENT
  /begin EVENT "m7E05614E" "m7E05614E" 0x8A DAQ 0xFF 0x01 0x07 0x00 /end EVENT
  /begin EVENT "mB8101AB9" "mB8101AB9" 0x8B DAQ 0xFF 0x01 0x07 0x00 /end EVENT
  /begin EVENT "m12332BF5" "m12332BF5" 0x8C DAQ 0xFF 0x01 0x07 0x00 /end EVENT
  /begin EVENT "m392C484C" "m392C484C" 0x8D DAQ 0xFF 0x01 0x07 0x00 /end EVENT
  /begin EVENT "m848A8F95" "m848A8F95" 0x8E DAQ 0xFF 0x01 0x07 0x00 /end EVENT
  /begin EVENT "m9ED6D216" "m9ED6D216" 0x8F DAQ 0xFF 0x01 0x07 0x00 /end EVENT
  /begin EVENT "m08CC2D2D" "m08CC2D2D" 0x90 DAQ 0xFF 0x01 0x07 0x00 /end EVENT
  /begin EVENT "mEEA804F6" "mEEA804F6" 0x91 DAQ 0xFF 0x01 0x07 0x00 /end EVENT
  /begin EVENT "mC565C863" "mC565C863" 0x92 DAQ 0xFF 0x01 0x07 0x00 /end EVENT
  /begin EVENT "m7179D09A" "m7179D09A" 0x93 DAQ 0xFF 0x01 0x07 0x00 /end EVENT
  /begin EVENT "m6A649DB9" "m6A649DB9" 0x94 DAQ 0xFF 0x01 0x07 0x00 /end EVENT
  /begin EVENT "mC34685E8" "mC34685E8" 0x95 DAQ 0xFF 0x01 0x07 0x00 /end EVENT
  /begin EVENT "mB2608B19" "mB2608B19" 0x96 DAQ 0xFF 0x01 0x07 0x00 /end EVENT
  /begin EVENT "mFB95FD67" "mFB95FD67" 0x97 DAQ 0xFF 0x01 0x07 0x00 /end EVENT
  /begin EVENT "mE026C5A6" "mE026C5A6" 0x98 DAQ 0xFF 0x01 0x07 0x00 /end EVENT
  /begin EVENT "m53C4AEB8" "m53C4AEB8" 0x99 DAQ 0xFF 0x01 0x07 0x00 /end EVENT
  /begin EVENT "m37134B79" "m37134B79" 0x9A DAQ 0xFF 0x01 0x07 0x00 /end EVENT
  /begin EVENT "m6EAA1401" "m6EAA1401" 0x9B DAQ 0xFF 0x01 0x07 0x00 /end EVENT
  /begin EVENT "mC00DE2A2" "mC00DE2A2" 0x9C DAQ 0xFF 0x01 0x07 0x00 /end EVENT
  /begin EVENT "mF668CE45" "mF668CE45" 0x9D DAQ 0xFF 0x01 0x07 0x00 /end EVENT
  /begin EVENT "mA0227CE0" "mA0227CE0" 0x9E DAQ 0xFF 0x01 0x07 0x00 /end EVENT
  /begin EVENT "m87AD3F00" "m87AD3F00" 0x9F DAQ 0xFF 0x01 0x07 0x00 /end EVENT
  /begin EVENT "mD177BD67" "mD177BD67" 0xA0 DAQ 0xFF 0x01 0x07 0x00 /end EVENT
  /begin EVENT "m944AFDC6" "m944AFDC6" 0xA1 DAQ 0xFF 0x01 0x07 0x00 /end EVENT
  /begin EVENT "m496328A6" "m496328A6" 0xA2 DAQ 0xFF 0x01 0x07 0x00 /end EVENT
  /begin EVENT "mE6295B24" "mE6295B24" 0xA3 DAQ 0xFF 0x01 0x07 0x00 /end EVENT
  /begin EVENT "mC963B22B" "mC963B22B" 0xA4 DAQ 0xFF 0x01 0x07 0x00 /end EVENT
  /begin EVENT "mF56939BC" "mF56939BC" 0xA5 DAQ 0xFF 0x01 0x07 0x00 /end EVENT
  /begin EVENT "m85F0B096" "m85F0B096" 0xA6 DAQ 0xFF 0x01 0x07 0x00 /end EVENT
  /begin EVENT "m2D0FE7FF" "m2D0FE7FF" 0xA7 DAQ 0xFF 0x01 0x07 0x00 /end EVENT
  /begin EVENT "mB3E1B4DE" "mB3E1B4DE" 0xA8 DAQ 0xFF 0x01 0x07 0x00 /end EVENT
  /begin EVENT "m866622E4" "m866622E4" 0xA9 DAQ 0xFF 0x01 0x07 0x00 /end EVENT
  /begin EVENT "m7C47122F" "m7C47122F" 0xAA DAQ 0xFF 0x01 0x07 0x00 /end EVENT
  /begin EVENT "mE7A29D6C" "mE7A29D6C" 0xAB DAQ 0xFF 0x01 0x07 0x00 /end EVENT
  /begin EVENT "mC1BDC313" "mC1BDC313" 0xAC DAQ 0xFF 0x01 0x07 0x00 /end EVENT
  /begin EVENT "m03770C27" "m03770C27" 0xAD DAQ 0xFF 0x01 0x07 0x00 /end EVENT
  /begin EVENT "m97B53199" "m97B53199" 0xAE DAQ 0xFF 0x01 0x07 0x00 /end EVENT
  /begin EVENT "mFD97D8CD" "mFD97D8CD" 0xAF DAQ 0xFF 0x01 0x07 0x00 /end EVENT
  /begin EVENT "m7CD848A3" "m7CD848A3" 0xB0 DAQ 0xFF 0x01 0x07 0x00 /end EVENT
  /begin EVENT "mDF0CC1F5" "mDF0CC1F5" 0xB1 DAQ 0xFF 0x01 0x07 0x00 /end EVENT
  /begin EVENT "m48C6BF9A" "m48C6BF9A" 0xB2 DAQ 0xFF 0x01 0x07 0x00 /end EVENT
  /begin EVENT "mD1D823E0" "mD1D823E0" 0xB3 DAQ 0xFF 0x01 0x07 0x00 /end EVENT
  /begin EVENT "m2B47D09B" "m2B47D09B" 0xB4 DAQ 0xFF 0x01 0x07 0x00 /end EVENT
  /begin EVENT "m852F4A9C" "m852F4A9C" 0xB5 DAQ 0xFF 0x01 0x07 0x00 /end EVENT
  /begin EVENT "mA9A88C89" "mA9A88C89" 0xB6 DAQ 0xFF 0x01 0x07 0x00 /end EVENT
  /begin EVENT "m1AF1D69E" "m1AF1D69E" 0xB7 DAQ 0xFF 0x01 0x07 0x00 /end EVENT
  /begin EVENT "m6D9096E0" "m6D9096E0" 0xB8 DAQ 0xFF 0x01 0x07 0x00 /end EVENT
  /begin EVENT "mD9B4DB81" "mD9B4DB81" 0xB9 DAQ 0xFF 0x01 0x07 0x00 /end EVENT
  /begin EVENT "mFF65A322" "mFF65A322" 0xBA DAQ 0xFF 0x01 0x07 0x00 /end EVENT
  /begin EVENT "m7655505E" "m7655505E" 0xBB DAQ 0xFF 0x01 0x07 0x00 /end EVENT
  /begin EVENT "mD9DC863D" "mD9DC863D" 0xBC DAQ 0xFF 0x01 0x07 0x00 /end EVENT
  /begin EVENT "mC9B3E3B9" "mC9B3E3B9" 0xBD DAQ 0xFF 0x01 0x07 0x00 /end EVENT
  /begin EVENT "mF439877D" "mF439877D" 0xBE DAQ 0xFF 0x01 0x07 0x00 /end EVENT
  /begin EVENT "m8C109747" "m8C109747" 0xBF DAQ 0xFF 0x01 0x07 0x00 /end EVENT
  /begin EVENT "m7B525483" "m7B525483" 0xC0 DAQ 0xFF 0x01 0x07 0x00 /end EVENT
  /begin EVENT "mB48E3FF6" "mB48E3FF6" 0xC1 DAQ 0xFF 0x01 0x07 0x00 /end EVENT
 /end DAQ
/end IF_DATA
/begin MEASUREMENT _g_PL_AD_fw_OneDrivingSW_perHv_HV_PerPmeRunnable_PerPmeRunnable.m_controller.m_HistBuffer.m_hostVehHist.tAbsTimeStamp_ul "" ULONG NO_COMPU_METHOD 0 0 0 4294967295 BYTE_ORDER MSB_LAST ECU_ADDRESS 0xB00626C0 ECU_ADDRESS_EXTENSION 0x1 /end MEASUREMENT
/begin MEASUREMENT _g_PL_AD_fw_Radar_1R1V_rpc_LocBypassingRunnable_LocBypassingRunnable.m_bypassFailedCounter "" ULONG NO_COMPU_METHOD 0 0 0 4294967295 BYTE_ORDER MSB_LAST ECU_ADDRESS 0xB0044B38 ECU_ADDRESS_EXTENSION 0x1 /end MEASUREMENT
/begin MEASUREMENT _g_PL_AD_fw_Radar_1R1V_rpc_LocBypassingRunnable_LocBypassingRunnable.m_bypassInactiveCounter "" ULONG NO_COMPU_METHOD 0 0 0 4294967295 BYTE_ORDER MSB_LAST ECU_ADDRESS 0xB0044B30 ECU_ADDRESS_EXTENSION 0x1 /end MEASUREMENT
/begin MEASUREMENT _g_PL_AD_fw_Radar_1R1V_rpc_LocBypassingRunnable_LocBypassingRunnable.m_bypassSuccessfulCounter "" ULONG NO_COMPU_METHOD 0 0 0 4294967295 BYTE_ORDER MSB_LAST ECU_ADDRESS 0xB0044B34 ECU_ADDRESS_EXTENSION 0x1 /end MEASUREMENT
/begin CHARACTERISTIC _g_PL_AD_fw_Radar_1R1V_rpc_LocBypassingRunnable_LocBypassingRunnable._m_pad_hilLocActive_par "" VALUE 0xB0044B2C __UByte_Value 0 NO_COMPU_METHOD 0 255 ECU_ADDRESS_EXTENSION 0x1 BYTE_ORDER MSB_LAST /end CHARACTERISTIC
/begin MEASUREMENT _g_PL_AD_fw_Radar_1R1V_rpc_LocBypassingRunnable_LocBypassingRunnable.m_status "" UBYTE EStatus 0 0 0 255 BYTE_ORDER MSB_LAST ECU_ADDRESS 0xB0044B2D ECU_ADDRESS_EXTENSION 0x1 /end MEASUREMENT
/begin MEASUREMENT _g_PL_AD_fw_Radar_1R1V_rpc_LocBypassingRunnable_LocBypassingRunnable.m_status "" UBYTE EStatus 0 0 0 255 BYTE_ORDER MSB_LAST ECU_ADDRESS 0xB0044B2D ECU_ADDRESS_EXTENSION 0x1 /end MEASUREMENT
/begin MEASUREMENT _g_PL_AD_fw_Radar_1R1V_rpc_LocBypassingRunnable_LocBypassingRunnable.m_unknownErrorCounter "" ULONG NO_COMPU_METHOD 0 0 0 4294967295 BYTE_ORDER MSB_LAST ECU_ADDRESS 0xB0044B40 ECU_ADDRESS_EXTENSION 0x1 /end MEASUREMENT
/begin MEASUREMENT _g_PL_AD_fw_Radar_1R1V_rpc_LocBypassingRunnable_LocBypassingRunnable.m_vxFailureCounter "" ULONG NO_COMPU_METHOD 0 0 0 4294967295 BYTE_ORDER MSB_LAST ECU_ADDRESS 0xB0044B3C ECU_ADDRESS_EXTENSION 0x1 /end MEASUREMENT
/begin CHARACTERISTIC _g_PL_AD_fw_Radar_1R1V_rpc_LocBypassingRunnable_LocBypassingRunnable_m_pad_ensRLocationsPort_par_out_local.TChangeableMemPool._._._m_arrayPool._0_._elem._m_LocationList._Item._0_._Rcs._m_value "" VALUE 0xB0010030 __Float16_Value 0 NO_COMPU_METHOD -65504 65504 ECU_ADDRESS_EXTENSION 0x2 BYTE_ORDER MSB_LAST /end CHARACTERISTIC
/begin CHARACTERISTIC _g_PL_AD_fw_Radar_1R1V_rpc_LocBypassingRunnable_LocBypassingRunnable_m_pad_ensRLocationsPort_par_out_local.TChangeableMemPool._._._m_arrayPool._0_._elem._m_LocationList._Item._0_._Rssi._m_value "" VALUE 0xB0010032 __Float16_Value 0 NO_COMPU_METHOD -65504 65504 ECU_ADDRESS_EXTENSION 0x2 BYTE_ORDER MSB_LAST /end CHARACTERISTIC
/begin CHARACTERISTIC _g_PL_AD_fw_Radar_1R1V_rpc_LocBypassingRunnable_LocBypassingRunnable_m_pad_ensRLocationsPort_par_out_local.TChangeableMemPool._._._m_arrayPool._0_._elem._m_LocationList._Item._0_._d "" VALUE 0xB0010018 __Float32_Value 0 NO_COMPU_METHOD -3.4028234663852886E+38 3.4028234663852886E+38 ECU_ADDRESS_EXTENSION 0x2 BYTE_ORDER MSB_LAST /end CHARACTERISTIC
/begin CHARACTERISTIC _g_PL_AD_fw_Radar_1R1V_rpc_LocBypassingRunnable_LocBypassingRunnable_m_pad_ensRLocationsPort_par_out_local.TChangeableMemPool._._._m_arrayPool._0_._elem._m_LocationList._Item._0_._dVar._m_value "" VALUE 0xB0010020 __Float16_Value 0 NO_COMPU_METHOD -65504 65504 ECU_ADDRESS_EXTENSION 0x2 BYTE_ORDER MSB_LAST /end CHARACTERISTIC
/begin CHARACTERISTIC _g_PL_AD_fw_Radar_1R1V_rpc_LocBypassingRunnable_LocBypassingRunnable_m_pad_ensRLocationsPort_par_out_local.TChangeableMemPool._._._m_arrayPool._0_._elem._m_LocationList._Item._0_._dvCov._m_value "" VALUE 0xB0010024 __Float16_Value 0 NO_COMPU_METHOD -65504 65504 ECU_ADDRESS_EXTENSION 0x2 BYTE_ORDER MSB_LAST /end CHARACTERISTIC
/begin CHARACTERISTIC _g_PL_AD_fw_Radar_1R1V_rpc_LocBypassingRunnable_LocBypassingRunnable_m_pad_ensRLocationsPort_par_out_local.TChangeableMemPool._._._m_arrayPool._0_._elem._m_LocationList._Item._0_._dvQly "" VALUE 0xB0010034 __UByte_Value 0 NO_COMPU_METHOD 0 255 ECU_ADDRESS_EXTENSION 0x2 BYTE_ORDER MSB_LAST /end CHARACTERISTIC
/begin CHARACTERISTIC _g_PL_AD_fw_Radar_1R1V_rpc_LocBypassingRunnable_LocBypassingRunnable_m_pad_ensRLocationsPort_par_out_local.TChangeableMemPool._._._m_arrayPool._0_._elem._m_LocationList._Item._0_._idxAzimuthAmbiguityPeer "" VALUE 0xB0010036 __UWord_Value 0 NO_COMPU_METHOD 0 65535 ECU_ADDRESS_EXTENSION 0x2 BYTE_ORDER MSB_LAST /end CHARACTERISTIC
/begin CHARACTERISTIC _g_PL_AD_fw_Radar_1R1V_rpc_LocBypassingRunnable_LocBypassingRunnable_m_pad_ensRLocationsPort_par_out_local.TChangeableMemPool._._._m_arrayPool._0_._elem._m_LocationList._Item._0_._measStatus "" VALUE 0xB0010035 __UByte_Value 0 NO_COMPU_METHOD 0 255 ECU_ADDRESS_EXTENSION 0x2 BYTE_ORDER MSB_LAST /end CHARACTERISTIC
/begin CHARACTERISTIC _g_PL_AD_fw_Radar_1R1V_rpc_LocBypassingRunnable_LocBypassingRunnable_m_pad_ensRLocationsPort_par_out_local.TChangeableMemPool._._._m_arrayPool._0_._elem._m_LocationList._Item._0_._phi._m_value "" VALUE 0xB0010028 __Float16_Value 0 NO_COMPU_METHOD -65504 65504 ECU_ADDRESS_EXTENSION 0x2 BYTE_ORDER MSB_LAST /end CHARACTERISTIC
/begin CHARACTERISTIC _g_PL_AD_fw_Radar_1R1V_rpc_LocBypassingRunnable_LocBypassingRunnable_m_pad_ensRLocationsPort_par_out_local.TChangeableMemPool._._._m_arrayPool._0_._elem._m_LocationList._Item._0_._phiQly "" VALUE 0xB001002B __UByte_Value 0 NO_COMPU_METHOD 0 255 ECU_ADDRESS_EXTENSION 0x2 BYTE_ORDER MSB_LAST /end CHARACTERISTIC
/begin CHARACTERISTIC _g_PL_AD_fw_Radar_1R1V_rpc_LocBypassingRunnable_LocBypassingRunnable_m_pad_ensRLocationsPort_par_out_local.TChangeableMemPool._._._m_arrayPool._0_._elem._m_LocationList._Item._0_._phiVar._m_value "" VALUE 0xB001002E __Float16_Value 0 NO_COMPU_METHOD -65504 65504 ECU_ADDRESS_EXTENSION 0x2 BYTE_ORDER MSB_LAST /end CHARACTERISTIC
/begin CHARACTERISTIC _g_PL_AD_fw_Radar_1R1V_rpc_LocBypassingRunnable_LocBypassingRunnable_m_pad_ensRLocationsPort_par_out_local.TChangeableMemPool._._._m_arrayPool._0_._elem._m_LocationList._Item._0_._theta._m_value "" VALUE 0xB0010026 __Float16_Value 0 NO_COMPU_METHOD -65504 65504 ECU_ADDRESS_EXTENSION 0x2 BYTE_ORDER MSB_LAST /end CHARACTERISTIC
/begin CHARACTERISTIC _g_PL_AD_fw_Radar_1R1V_rpc_LocBypassingRunnable_LocBypassingRunnable_m_pad_ensRLocationsPort_par_out_local.TChangeableMemPool._._._m_arrayPool._0_._elem._m_LocationList._Item._0_._thetaQly "" VALUE 0xB001002A __UByte_Value 0 NO_COMPU_METHOD 0 255 ECU_ADDRESS_EXTENSION 0x2 BYTE_ORDER MSB_LAST /end CHARACTERISTIC
/begin CHARACTERISTIC _g_PL_AD_fw_Radar_1R1V_rpc_LocBypassingRunnable_LocBypassingRunnable_m_pad_ensRLocationsPort_par_out_local.TChangeableMemPool._._._m_arrayPool._0_._elem._m_LocationList._Item._0_._thetaVar._m_value "" VALUE 0xB001002C __Float16_Value 0 NO_COMPU_METHOD -65504 65504 ECU_ADDRESS_EXTENSION 0x2 BYTE_ORDER MSB_LAST /end CHARACTERISTIC
/begin CHARACTERISTIC _g_PL_AD_fw_Radar_1R1V_rpc_LocBypassingRunnable_LocBypassingRunnable_m_pad_ensRLocationsPort_par_out_local.TChangeableMemPool._._._m_arrayPool._0_._elem._m_LocationList._Item._0_._v "" VALUE 0xB001001C __Float32_Value 0 NO_COMPU_METHOD -3.4028234663852886E+38 3.4028234663852886E+38 ECU_ADDRESS_EXTENSION 0x2 BYTE_ORDER MSB_LAST /end CHARACTERISTIC
/begin CHARACTERISTIC _g_PL_AD_fw_Radar_1R1V_rpc_LocBypassingRunnable_LocBypassingRunnable_m_pad_ensRLocationsPort_par_out_local.TChangeableMemPool._._._m_arrayPool._0_._elem._m_LocationList._Item._0_._vVar._m_value "" VALUE 0xB0010022 __Float16_Value 0 NO_COMPU_METHOD -65504 65504 ECU_ADDRESS_EXTENSION 0x2 BYTE_ORDER MSB_LAST /end CHARACTERISTIC
/begin CHARACTERISTIC _g_PL_AD_fw_Radar_1R1V_rpc_LocBypassingRunnable_LocBypassingRunnable_m_pad_ensRLocationsPort_par_out_local.TChangeableMemPool._._._m_arrayPool._0_._elem._m_LocationList._Item._100_._Rcs._m_value "" VALUE 0xB0010CB0 __Float16_Value 0 NO_COMPU_METHOD -65504 65504 ECU_ADDRESS_EXTENSION 0x2 BYTE_ORDER MSB_LAST /end CHARACTERISTIC
/begin CHARACTERISTIC _g_PL_AD_fw_Radar_1R1V_rpc_LocBypassingRunnable_LocBypassingRunnable_m_pad_ensRLocationsPort_par_out_local.TChangeableMemPool._._._m_arrayPool._0_._elem._m_LocationList._Item._100_._Rssi._m_value "" VALUE 0xB0010CB2 __Float16_Value 0 NO_COMPU_METHOD -65504 65504 ECU_ADDRESS_EXTENSION 0x2 BYTE_ORDER MSB_LAST /end CHARACTERISTIC
/begin CHARACTERISTIC _g_PL_AD_fw_Radar_1R1V_rpc_LocBypassingRunnable_LocBypassingRunnable_m_pad_ensRLocationsPort_par_out_local.TChangeableMemPool._._._m_arrayPool._0_._elem._m_LocationList._Item._100_._d "" VALUE 0xB0010C98 __Float32_Value 0 NO_COMPU_METHOD -3.4028234663852886E+38 3.4028234663852886E+38 ECU_ADDRESS_EXTENSION 0x2 BYTE_ORDER MSB_LAST /end CHARACTERISTIC
/begin CHARACTERISTIC _g_PL_AD_fw_Radar_1R1V_rpc_LocBypassingRunnable_LocBypassingRunnable_m_pad_ensRLocationsPort_par_out_local.TChangeableMemPool._._._m_arrayPool._0_._elem._m_LocationList._Item._100_._dVar._m_value "" VALUE 0xB0010CA0 __Float16_Value 0 NO_COMPU_METHOD -65504 65504 ECU_ADDRESS_EXTENSION 0x2 BYTE_ORDER MSB_LAST /end CHARACTERISTIC
/begin CHARACTERISTIC _g_PL_AD_fw_Radar_1R1V_rpc_LocBypassingRunnable_LocBypassingRunnable_m_pad_ensRLocationsPort_par_out_local.TChangeableMemPool._._._m_arrayPool._0_._elem._m_LocationList._Item._100_._dvCov._m_value "" VALUE 0xB0010CA4 __Float16_Value 0 NO_COMPU_METHOD -65504 65504 ECU_ADDRESS_EXTENSION 0x2 BYTE_ORDER MSB_LAST /end CHARACTERISTIC
/begin CHARACTERISTIC _g_PL_AD_fw_Radar_1R1V_rpc_LocBypassingRunnable_LocBypassingRunnable_m_pad_ensRLocationsPort_par_out_local.TChangeableMemPool._._._m_arrayPool._0_._elem._m_LocationList._Item._100_._dvQly "" VALUE 0xB0010CB4 __UByte_Value 0 NO_COMPU_METHOD 0 255 ECU_ADDRESS_EXTENSION 0x2 BYTE_ORDER MSB_LAST /end CHARACTERISTIC
/begin CHARACTERISTIC _g_PL_AD_fw_Radar_1R1V_rpc_LocBypassingRunnable_LocBypassingRunnable_m_pad_ensRLocationsPort_par_out_local.TChangeableMemPool._._._m_arrayPool._0_._elem._m_LocationList._Item._100_._idxAzimuthAmbiguityPeer "" VALUE 0xB0010CB6 __UWord_Value 0 NO_COMPU_METHOD 0 65535 ECU_ADDRESS_EXTENSION 0x2 BYTE_ORDER MSB_LAST /end CHARACTERISTIC
/begin CHARACTERISTIC _g_PL_AD_fw_Radar_1R1V_rpc_LocBypassingRunnable_LocBypassingRunnable_m_pad_ensRLocationsPort_par_out_local.TChangeableMemPool._._._m_arrayPool._0_._elem._m_LocationList._Item._100_._measStatus "" VALUE 0xB0010CB5 __UByte_Value 0 NO_COMPU_METHOD 0 255 ECU_ADDRESS_EXTENSION 0x2 BYTE_ORDER MSB_LAST /end CHARACTERISTIC
/begin CHARACTERISTIC _g_PL_AD_fw_Radar_1R1V_rpc_LocBypassingRunnable_LocBypassingRunnable_m_pad_ensRLocationsPort_par_out_local.TChangeableMemPool._._._m_arrayPool._0_._elem._m_LocationList._Item._100_._phi._m_value "" VALUE 0xB0010CA8 __Float16_Value 0 NO_COMPU_METHOD -65504 65504 ECU_ADDRESS_EXTENSION 0x2 BYTE_ORDER MSB_LAST /end CHARACTERISTIC
/begin CHARACTERISTIC _g_PL_AD_fw_Radar_1R1V_rpc_LocBypassingRunnable_LocBypassingRunnable_m_pad_ensRLocationsPort_par_out_local.TChangeableMemPool._._._m_arrayPool._0_._elem._m_LocationList._Item._100_._phiQly "" VALUE 0xB0010CAB __UByte_Value 0 NO_COMPU_METHOD 0 255 ECU_ADDRESS_EXTENSION 0x2 BYTE_ORDER MSB_LAST /end CHARACTERISTIC
/begin CHARACTERISTIC _g_PL_AD_fw_Radar_1R1V_rpc_LocBypassingRunnable_LocBypassingRunnable_m_pad_ensRLocationsPort_par_out_local.TChangeableMemPool._._._m_arrayPool._0_._elem._m_LocationList._Item._100_._phiVar._m_value "" VALUE 0xB0010CAE __Float16_Value 0 NO_COMPU_METHOD -65504 65504 ECU_ADDRESS_EXTENSION 0x2 BYTE_ORDER MSB_LAST /end CHARACTERISTIC
/begin CHARACTERISTIC _g_PL_AD_fw_Radar_1R1V_rpc_LocBypassingRunnable_LocBypassingRunnable_m_pad_ensRLocationsPort_par_out_local.TChangeableMemPool._._._m_arrayPool._0_._elem._m_LocationList._Item._100_._theta._m_value "" VALUE 0xB0010CA6 __Float16_Value 0 NO_COMPU_METHOD -65504 65504 ECU_ADDRESS_EXTENSION 0x2 BYTE_ORDER MSB_LAST /end CHARACTERISTIC
/begin CHARACTERISTIC _g_PL_AD_fw_Radar_1R1V_rpc_LocBypassingRunnable_LocBypassingRunnable_m_pad_ensRLocationsPort_par_out_local.TChangeableMemPool._._._m_arrayPool._0_._elem._m_LocationList._Item._100_._thetaQly "" VALUE 0xB0010CAA __UByte_Value 0 NO_COMPU_METHOD 0 255 ECU_ADDRESS_EXTENSION 0x2 BYTE_ORDER MSB_LAST /end CHARACTERISTIC
/begin CHARACTERISTIC _g_PL_AD_fw_Radar_1R1V_rpc_LocBypassingRunnable_LocBypassingRunnable_m_pad_ensRLocationsPort_par_out_local.TChangeableMemPool._._._m_arrayPool._0_._elem._m_LocationList._Item._100_._thetaVar._m_value "" VALUE 0xB0010CAC __Float16_Value 0 NO_COMPU_METHOD -65504 65504 ECU_ADDRESS_EXTENSION 0x2 BYTE_ORDER MSB_LAST /end CHARACTERISTIC
/begin CHARACTERISTIC _g_PL_AD_fw_Radar_1R1V_rpc_LocBypassingRunnable_LocBypassingRunnable_m_pad_ensRLocationsPort_par_out_local.TChangeableMemPool._._._m_arrayPool._0_._elem._m_LocationList._Item._100_._v "" VALUE 0xB0010C9C __Float32_Value 0 NO_COMPU_METHOD -3.4028234663852886E+38 3.4028234663852886E+38 ECU_ADDRESS_EXTENSION 0x2 BYTE_ORDER MSB_LAST /end CHARACTERISTIC
/begin CHARACTERISTIC _g_PL_AD_fw_Radar_1R1V_rpc_LocBypassingRunnable_LocBypassingRunnable_m_pad_ensRLocationsPort_par_out_local.TChangeableMemPool._._._m_arrayPool._0_._elem._m_LocationList._Item._100_._vVar._m_value "" VALUE 0xB0010CA2 __Float16_Value 0 NO_COMPU_METHOD -65504 65504 ECU_ADDRESS_EXTENSION 0x2 BYTE_ORDER MSB_LAST /end CHARACTERISTIC
/begin CHARACTERISTIC _g_PL_AD_fw_Radar_1R1V_rpc_LocBypassingRunnable_LocBypassingRunnable_m_pad_ensRLocationsPort_par_out_local.TChangeableMemPool._._._m_arrayPool._0_._elem._m_LocationList._Item._101_._Rcs._m_value "" VALUE 0xB0010CD0 __Float16_Value 0 NO_COMPU_METHOD -65504 65504 ECU_ADDRESS_EXTENSION 0x2 BYTE_ORDER MSB_LAST /end CHARACTERISTIC
/begin CHARACTERISTIC _g_PL_AD_fw_Radar_1R1V_rpc_LocBypassingRunnable_LocBypassingRunnable_m_pad_ensRLocationsPort_par_out_local.TChangeableMemPool._._._m_arrayPool._0_._elem._m_LocationList._Item._101_._Rssi._m_value "" VALUE 0xB0010CD2 __Float16_Value 0 NO_COMPU_METHOD -65504 65504 ECU_ADDRESS_EXTENSION 0x2 BYTE_ORDER MSB_LAST /end CHARACTERISTIC
/begin CHARACTERISTIC _g_PL_AD_fw_Radar_1R1V_rpc_LocBypassingRunnable_LocBypassingRunnable_m_pad_ensRLocationsPort_par_out_local.TChangeableMemPool._._._m_arrayPool._0_._elem._m_LocationList._Item._101_._d "" VALUE 0xB0010CB8 __Float32_Value 0 NO_COMPU_METHOD -3.4028234663852886E+38 3.4028234663852886E+38 ECU_ADDRESS_EXTENSION 0x2 BYTE_ORDER MSB_LAST /end CHARACTERISTIC
/begin CHARACTERISTIC _g_PL_AD_fw_Radar_1R1V_rpc_LocBypassingRunnable_LocBypassingRunnable_m_pad_ensRLocationsPort_par_out_local.TChangeableMemPool._._._m_arrayPool._0_._elem._m_LocationList._Item._101_._dVar._m_value "" VALUE 0xB0010CC0 __Float16_Value 0 NO_COMPU_METHOD -65504 65504 ECU_ADDRESS_EXTENSION 0x2 BYTE_ORDER MSB_LAST /end CHARACTERISTIC
/begin CHARACTERISTIC _g_PL_AD_fw_Radar_1R1V_rpc_LocBypassingRunnable_LocBypassingRunnable_m_pad_ensRLocationsPort_par_out_local.TChangeableMemPool._._._m_arrayPool._0_._elem._m_LocationList._Item._101_._dvCov._m_value "" VALUE 0xB0010CC4 __Float16_Value 0 NO_COMPU_METHOD -65504 65504 ECU_ADDRESS_EXTENSION 0x2 BYTE_ORDER MSB_LAST /end CHARACTERISTIC
/begin CHARACTERISTIC _g_PL_AD_fw_Radar_1R1V_rpc_LocBypassingRunnable_LocBypassingRunnable_m_pad_ensRLocationsPort_par_out_local.TChangeableMemPool._._._m_arrayPool._0_._elem._m_LocationList._Item._101_._dvQly "" VALUE 0xB0010CD4 __UByte_Value 0 NO_COMPU_METHOD 0 255 ECU_ADDRESS_EXTENSION 0x2 BYTE_ORDER MSB_LAST /end CHARACTERISTIC
/begin CHARACTERISTIC _g_PL_AD_fw_Radar_1R1V_rpc_LocBypassingRunnable_LocBypassingRunnable_m_pad_ensRLocationsPort_par_out_local.TChangeableMemPool._._._m_arrayPool._0_._elem._m_LocationList._Item._101_._idxAzimuthAmbiguityPeer "" VALUE 0xB0010CD6 __UWord_Value 0 NO_COMPU_METHOD 0 65535 ECU_ADDRESS_EXTENSION 0x2 BYTE_ORDER MSB_LAST /end CHARACTERISTIC
/begin CHARACTERISTIC _g_PL_AD_fw_Radar_1R1V_rpc_LocBypassingRunnable_LocBypassingRunnable_m_pad_ensRLocationsPort_par_out_local.TChangeableMemPool._._._m_arrayPool._0_._elem._m_LocationList._Item._101_._measStatus "" VALUE 0xB0010CD5 __UByte_Value 0 NO_COMPU_METHOD 0 255 ECU_ADDRESS_EXTENSION 0x2 BYTE_ORDER MSB_LAST /end CHARACTERISTIC
/begin CHARACTERISTIC _g_PL_AD_fw_Radar_1R1V_rpc_LocBypassingRunnable_LocBypassingRunnable_m_pad_ensRLocationsPort_par_out_local.TChangeableMemPool._._._m_arrayPool._0_._elem._m_LocationList._Item._101_._phi._m_value "" VALUE 0xB0010CC8 __Float16_Value 0 NO_COMPU_METHOD -65504 65504 ECU_ADDRESS_EXTENSION 0x2 BYTE_ORDER MSB_LAST /end CHARACTERISTIC
/begin CHARACTERISTIC _g_PL_AD_fw_Radar_1R1V_rpc_LocBypassingRunnable_LocBypassingRunnable_m_pad_ensRLocationsPort_par_out_local.TChangeableMemPool._._._m_arrayPool._0_._elem._m_LocationList._Item._101_._phiQly "" VALUE 0xB0010CCB __UByte_Value 0 NO_COMPU_METHOD 0 255 ECU_ADDRESS_EXTENSION 0x2 BYTE_ORDER MSB_LAST /end CHARACTERISTIC
/begin CHARACTERISTIC _g_PL_AD_fw_Radar_1R1V_rpc_LocBypassingRunnable_LocBypassingRunnable_m_pad_ensRLocationsPort_par_out_local.TChangeableMemPool._._._m_arrayPool._0_._elem._m_LocationList._Item._101_._phiVar._m_value "" VALUE 0xB0010CCE __Float16_Value 0 NO_COMPU_METHOD -65504 65504 ECU_ADDRESS_EXTENSION 0x2 BYTE_ORDER MSB_LAST /end CHARACTERISTIC
/begin CHARACTERISTIC _g_PL_AD_fw_Radar_1R1V_rpc_LocBypassingRunnable_LocBypassingRunnable_m_pad_ensRLocationsPort_par_out_local.TChangeableMemPool._._._m_arrayPool._0_._elem._m_LocationList._Item._101_._theta._m_value "" VALUE 0xB0010CC6 __Float16_Value 0 NO_COMPU_METHOD -65504 65504 ECU_ADDRESS_EXTENSION 0x2 BYTE_ORDER MSB_LAST /end CHARACTERISTIC
/begin CHARACTERISTIC _g_PL_AD_fw_Radar_1R1V_rpc_LocBypassingRunnable_LocBypassingRunnable_m_pad_ensRLocationsPort_par_out_local.TChangeableMemPool._._._m_arrayPool._0_._elem._m_LocationList._Item._101_._thetaQly "" VALUE 0xB0010CCA __UByte_Value 0 NO_COMPU_METHOD 0 255 ECU_ADDRESS_EXTENSION 0x2 BYTE_ORDER MSB_LAST /end CHARACTERISTIC
/begin CHARACTERISTIC _g_PL_AD_fw_Radar_1R1V_rpc_LocBypassingRunnable_LocBypassingRunnable_m_pad_ensRLocationsPort_par_out_local.TChangeableMemPool._._._m_arrayPool._0_._elem._m_LocationList._Item._101_._thetaVar._m_value "" VALUE 0xB0010CCC __Float16_Value 0 NO_COMPU_METHOD -65504 65504 ECU_ADDRESS_EXTENSION 0x2 BYTE_ORDER MSB_LAST /end CHARACTERISTIC
/begin CHARACTERISTIC _g_PL_AD_fw_Radar_1R1V_rpc_LocBypassingRunnable_LocBypassingRunnable_m_pad_ensRLocationsPort_par_out_local.TChangeableMemPool._._._m_arrayPool._0_._elem._m_LocationList._Item._101_._v "" VALUE 0xB0010CBC __Float32_Value 0 NO_COMPU_METHOD -3.4028234663852886E+38 3.4028234663852886E+38 ECU_ADDRESS_EXTENSION 0x2 BYTE_ORDER MSB_LAST /end CHARACTERISTIC
/begin CHARACTERISTIC _g_PL_AD_fw_Radar_1R1V_rpc_LocBypassingRunnable_LocBypassingRunnable_m_pad_ensRLocationsPort_par_out_local.TChangeableMemPool._._._m_arrayPool._0_._elem._m_LocationList._Item._101_._vVar._m_value "" VALUE 0xB0010CC2 __Float16_Value 0 NO_COMPU_METHOD -65504 65504 ECU_ADDRESS_EXTENSION 0x2 BYTE_ORDER MSB_LAST /end CHARACTERISTIC
/begin CHARACTERISTIC _g_PL_AD_fw_Radar_1R1V_rpc_LocBypassingRunnable_LocBypassingRunnable_m_pad_ensRLocationsPort_par_out_local.TChangeableMemPool._._._m_arrayPool._0_._elem._m_LocationList._Item._102_._Rcs._m_value "" VALUE 0xB0010CF0 __Float16_Value 0 NO_COMPU_METHOD -65504 65504 ECU_ADDRESS_EXTENSION 0x2 BYTE_ORDER MSB_LAST /end CHARACTERISTIC
/begin CHARACTERISTIC _g_PL_AD_fw_Radar_1R1V_rpc_LocBypassingRunnable_LocBypassingRunnable_m_pad_ensRLocationsPort_par_out_local.TChangeableMemPool._._._m_arrayPool._0_._elem._m_LocationList._Item._102_._Rssi._m_value "" VALUE 0xB0010CF2 __Float16_Value 0 NO_COMPU_METHOD -65504 65504 ECU_ADDRESS_EXTENSION 0x2 BYTE_ORDER MSB_LAST /end CHARACTERISTIC
/begin CHARACTERISTIC _g_PL_AD_fw_Radar_1R1V_rpc_LocBypassingRunnable_LocBypassingRunnable_m_pad_ensRLocationsPort_par_out_local.TChangeableMemPool._._._m_arrayPool._0_._elem._m_LocationList._Item._102_._d "" VALUE 0xB0010CD8 __Float32_Value 0 NO_COMPU_METHOD -3.4028234663852886E+38 3.4028234663852886E+38 ECU_ADDRESS_EXTENSION 0x2 BYTE_ORDER MSB_LAST /end CHARACTERISTIC
/begin CHARACTERISTIC _g_PL_AD_fw_Radar_1R1V_rpc_LocBypassingRunnable_LocBypassingRunnable_m_pad_ensRLocationsPort_par_out_local.TChangeableMemPool._._._m_arrayPool._0_._elem._m_LocationList._Item._102_._dVar._m_value "" VALUE 0xB0010CE0 __Float16_Value 0 NO_COMPU_METHOD -65504 65504 ECU_ADDRESS_EXTENSION 0x2 BYTE_ORDER MSB_LAST /end CHARACTERISTIC
/begin CHARACTERISTIC _g_PL_AD_fw_Radar_1R1V_rpc_LocBypassingRunnable_LocBypassingRunnable_m_pad_ensRLocationsPort_par_out_local.TChangeableMemPool._._._m_arrayPool._0_._elem._m_LocationList._Item._102_._dvCov._m_value "" VALUE 0xB0010CE4 __Float16_Value 0 NO_COMPU_METHOD -65504 65504 ECU_ADDRESS_EXTENSION 0x2 BYTE_ORDER MSB_LAST /end CHARACTERISTIC
/begin CHARACTERISTIC _g_PL_AD_fw_Radar_1R1V_rpc_LocBypassingRunnable_LocBypassingRunnable_m_pad_ensRLocationsPort_par_out_local.TChangeableMemPool._._._m_arrayPool._0_._elem._m_LocationList._Item._102_._dvQly "" VALUE 0xB0010CF4 __UByte_Value 0 NO_COMPU_METHOD 0 255 ECU_ADDRESS_EXTENSION 0x2 BYTE_ORDER MSB_LAST /end CHARACTERISTIC
/begin CHARACTERISTIC _g_PL_AD_fw_Radar_1R1V_rpc_LocBypassingRunnable_LocBypassingRunnable_m_pad_ensRLocationsPort_par_out_local.TChangeableMemPool._._._m_arrayPool._0_._elem._m_LocationList._Item._102_._idxAzimuthAmbiguityPeer "" VALUE 0xB0010CF6 __UWord_Value 0 NO_COMPU_METHOD 0 65535 ECU_ADDRESS_EXTENSION 0x2 BYTE_ORDER MSB_LAST /end CHARACTERISTIC
/begin CHARACTERISTIC _g_PL_AD_fw_Radar_1R1V_rpc_LocBypassingRunnable_LocBypassingRunnable_m_pad_ensRLocationsPort_par_out_local.TChangeableMemPool._._._m_arrayPool._0_._elem._m_LocationList._Item._102_._measStatus "" VALUE 0xB0010CF5 __UByte_Value 0 NO_COMPU_METHOD 0 255 ECU_ADDRESS_EXTENSION 0x2 BYTE_ORDER MSB_LAST /end CHARACTERISTIC
/begin CHARACTERISTIC _g_PL_AD_fw_Radar_1R1V_rpc_LocBypassingRunnable_LocBypassingRunnable_m_pad_ensRLocationsPort_par_out_local.TChangeableMemPool._._._m_arrayPool._0_._elem._m_LocationList._Item._102_._phi._m_value "" VALUE 0xB0010CE8 __Float16_Value 0 NO_COMPU_METHOD -65504 65504 ECU_ADDRESS_EXTENSION 0x2 BYTE_ORDER MSB_LAST /end CHARACTERISTIC
/begin CHARACTERISTIC _g_PL_AD_fw_Radar_1R1V_rpc_LocBypassingRunnable_LocBypassingRunnable_m_pad_ensRLocationsPort_par_out_local.TChangeableMemPool._._._m_arrayPool._0_._elem._m_LocationList._Item._102_._phiQly "" VALUE 0xB0010CEB __UByte_Value 0 NO_COMPU_METHOD 0 255 ECU_ADDRESS_EXTENSION 0x2 BYTE_ORDER MSB_LAST /end CHARACTERISTIC
/begin CHARACTERISTIC _g_PL_AD_fw_Radar_1R1V_rpc_LocBypassingRunnable_LocBypassingRunnable_m_pad_ensRLocationsPort_par_out_local.TChangeableMemPool._._._m_arrayPool._0_._elem._m_LocationList._Item._102_._phiVar._m_value "" VALUE 0xB0010CEE __Float16_Value 0 NO_COMPU_METHOD -65504 65504 ECU_ADDRESS_EXTENSION 0x2 BYTE_ORDER MSB_LAST /end CHARACTERISTIC
/begin CHARACTERISTIC _g_PL_AD_fw_Radar_1R1V_rpc_LocBypassingRunnable_LocBypassingRunnable_m_pad_ensRLocationsPort_par_out_local.TChangeableMemPool._._._m_arrayPool._0_._elem._m_LocationList._Item._102_._theta._m_value "" VALUE 0xB0010CE6 __Float16_Value 0 NO_COMPU_METHOD -65504 65504 ECU_ADDRESS_EXTENSION 0x2 BYTE_ORDER MSB_LAST /end CHARACTERISTIC
/begin CHARACTERISTIC _g_PL_AD_fw_Radar_1R1V_rpc_LocBypassingRunnable_LocBypassingRunnable_m_pad_ensRLocationsPort_par_out_local.TChangeableMemPool._._._m_arrayPool._0_._elem._m_LocationList._Item._102_._thetaQly "" VALUE 0xB0010CEA __UByte_Value 0 NO_COMPU_METHOD 0 255 ECU_ADDRESS_EXTENSION 0x2 BYTE_ORDER MSB_LAST /end CHARACTERISTIC
/begin CHARACTERISTIC _g_PL_AD_fw_Radar_1R1V_rpc_LocBypassingRunnable_LocBypassingRunnable_m_pad_ensRLocationsPort_par_out_local.TChangeableMemPool._._._m_arrayPool._0_._elem._m_LocationList._Item._102_._thetaVar._m_value "" VALUE 0xB0010CEC __Float16_Value 0 NO_COMPU_METHOD -65504 65504 ECU_ADDRESS_EXTENSION 0x2 BYTE_ORDER MSB_LAST /end CHARACTERISTIC
/begin CHARACTERISTIC _g_PL_AD_fw_Radar_1R1V_rpc_LocBypassingRunnable_LocBypassingRunnable_m_pad_ensRLocationsPort_par_out_local.TChangeableMemPool._._._m_arrayPool._0_._elem._m_LocationList._Item._102_._v "" VALUE 0xB0010CDC __Float32_Value 0 NO_COMPU_METHOD -3.4028234663852886E+38 3.4028234663852886E+38 ECU_ADDRESS_EXTENSION 0x2 BYTE_ORDER MSB_LAST /end CHARACTERISTIC
/begin CHARACTERISTIC _g_PL_AD_fw_Radar_1R1V_rpc_LocBypassingRunnable_LocBypassingRunnable_m_pad_ensRLocationsPort_par_out_local.TChangeableMemPool._._._m_arrayPool._0_._elem._m_LocationList._Item._102_._vVar._m_value "" VALUE 0xB0010CE2 __Float16_Value 0 NO_COMPU_METHOD -65504 65504 ECU_ADDRESS_EXTENSION 0x2 BYTE_ORDER MSB_LAST /end CHARACTERISTIC
/begin CHARACTERISTIC _g_PL_AD_fw_Radar_1R1V_rpc_LocBypassingRunnable_LocBypassingRunnable_m_pad_ensRLocationsPort_par_out_local.TChangeableMemPool._._._m_arrayPool._0_._elem._m_LocationList._Item._103_._Rcs._m_value "" VALUE 0xB0010D10 __Float16_Value 0 NO_COMPU_METHOD -65504 65504 ECU_ADDRESS_EXTENSION 0x2 BYTE_ORDER MSB_LAST /end CHARACTERISTIC
/begin CHARACTERISTIC _g_PL_AD_fw_Radar_1R1V_rpc_LocBypassingRunnable_LocBypassingRunnable_m_pad_ensRLocationsPort_par_out_local.TChangeableMemPool._._._m_arrayPool._0_._elem._m_LocationList._Item._103_._Rssi._m_value "" VALUE 0xB0010D12 __Float16_Value 0 NO_COMPU_METHOD -65504 65504 ECU_ADDRESS_EXTENSION 0x2 BYTE_ORDER MSB_LAST /end CHARACTERISTIC
/begin CHARACTERISTIC _g_PL_AD_fw_Radar_1R1V_rpc_LocBypassingRunnable_LocBypassingRunnable_m_pad_ensRLocationsPort_par_out_local.TChangeableMemPool._._._m_arrayPool._0_._elem._m_LocationList._Item._103_._d "" VALUE 0xB0010CF8 __Float32_Value 0 NO_COMPU_METHOD -3.4028234663852886E+38 3.4028234663852886E+38 ECU_ADDRESS_EXTENSION 0x2 BYTE_ORDER MSB_LAST /end CHARACTERISTIC
/begin CHARACTERISTIC _g_PL_AD_fw_Radar_1R1V_rpc_LocBypassingRunnable_LocBypassingRunnable_m_pad_ensRLocationsPort_par_out_local.TChangeableMemPool._._._m_arrayPool._0_._elem._m_LocationList._Item._103_._dVar._m_value "" VALUE 0xB0010D00 __Float16_Value 0 NO_COMPU_METHOD -65504 65504 ECU_ADDRESS_EXTENSION 0x2 BYTE_ORDER MSB_LAST /end CHARACTERISTIC
/begin CHARACTERISTIC _g_PL_AD_fw_Radar_1R1V_rpc_LocBypassingRunnable_LocBypassingRunnable_m_pad_ensRLocationsPort_par_out_local.TChangeableMemPool._._._m_arrayPool._0_._elem._m_LocationList._Item._103_._dvCov._m_value "" VALUE 0xB0010D04 __Float16_Value 0 NO_COMPU_METHOD -65504 65504 ECU_ADDRESS_EXTENSION 0x2 BYTE_ORDER MSB_LAST /end CHARACTERISTIC
/begin CHARACTERISTIC _g_PL_AD_fw_Radar_1R1V_rpc_LocBypassingRunnable_LocBypassingRunnable_m_pad_ensRLocationsPort_par_out_local.TChangeableMemPool._._._m_arrayPool._0_._elem._m_LocationList._Item._103_._dvQly "" VALUE 0xB0010D14 __UByte_Value 0 NO_COMPU_METHOD 0 255 ECU_ADDRESS_EXTENSION 0x2 BYTE_ORDER MSB_LAST /end CHARACTERISTIC
/begin CHARACTERISTIC _g_PL_AD_fw_Radar_1R1V_rpc_LocBypassingRunnable_LocBypassingRunnable_m_pad_ensRLocationsPort_par_out_local.TChangeableMemPool._._._m_arrayPool._0_._elem._m_LocationList._Item._103_._idxAzimuthAmbiguityPeer "" VALUE 0xB0010D16 __UWord_Value 0 NO_COMPU_METHOD 0 65535 ECU_ADDRESS_EXTENSION 0x2 BYTE_ORDER MSB_LAST /end CHARACTERISTIC
/begin CHARACTERISTIC _g_PL_AD_fw_Radar_1R1V_rpc_LocBypassingRunnable_LocBypassingRunnable_m_pad_ensRLocationsPort_par_out_local.TChangeableMemPool._._._m_arrayPool._0_._elem._m_LocationList._Item._103_._measStatus "" VALUE 0xB0010D15 __UByte_Value 0 NO_COMPU_METHOD 0 255 ECU_ADDRESS_EXTENSION 0x2 BYTE_ORDER MSB_LAST /end CHARACTERISTIC
/begin CHARACTERISTIC _g_PL_AD_fw_Radar_1R1V_rpc_LocBypassingRunnable_LocBypassingRunnable_m_pad_ensRLocationsPort_par_out_local.TChangeableMemPool._._._m_arrayPool._0_._elem._m_LocationList._Item._103_._phi._m_value "" VALUE 0xB0010D08 __Float16_Value 0 NO_COMPU_METHOD -65504 65504 ECU_ADDRESS_EXTENSION 0x2 BYTE_ORDER MSB_LAST /end CHARACTERISTIC
/begin CHARACTERISTIC _g_PL_AD_fw_Radar_1R1V_rpc_LocBypassingRunnable_LocBypassingRunnable_m_pad_ensRLocationsPort_par_out_local.TChangeableMemPool._._._m_arrayPool._0_._elem._m_LocationList._Item._103_._phiQly "" VALUE 0xB0010D0B __UByte_Value 0 NO_COMPU_METHOD 0 255 ECU_ADDRESS_EXTENSION 0x2 BYTE_ORDER MSB_LAST /end CHARACTERISTIC
/begin CHARACTERISTIC _g_PL_AD_fw_Radar_1R1V_rpc_LocBypassingRunnable_LocBypassingRunnable_m_pad_ensRLocationsPort_par_out_local.TChangeableMemPool._._._m_arrayPool._0_._elem._m_LocationList._Item._103_._phiVar._m_value "" VALUE 0xB0010D0E __Float16_Value 0 NO_COMPU_METHOD -65504 65504 ECU_ADDRESS_EXTENSION 0x2 BYTE_ORDER MSB_LAST /end CHARACTERISTIC
/begin CHARACTERISTIC _g_PL_AD_fw_Radar_1R1V_rpc_LocBypassingRunnable_LocBypassingRunnable_m_pad_ensRLocationsPort_par_out_local.TChangeableMemPool._._._m_arrayPool._0_._elem._m_LocationList._Item._103_._theta._m_value "" VALUE 0xB0010D06 __Float16_Value 0 NO_COMPU_METHOD -65504 65504 ECU_ADDRESS_EXTENSION 0x2 BYTE_ORDER MSB_LAST /end CHARACTERISTIC
/begin CHARACTERISTIC _g_PL_AD_fw_Radar_1R1V_rpc_LocBypassingRunnable_LocBypassingRunnable_m_pad_ensRLocationsPort_par_out_local.TChangeableMemPool._._._m_arrayPool._0_._elem._m_LocationList._Item._103_._thetaQly "" VALUE 0xB0010D0A __UByte_Value 0 NO_COMPU_METHOD 0 255 ECU_ADDRESS_EXTENSION 0x2 BYTE_ORDER MSB_LAST /end CHARACTERISTIC
/begin CHARACTERISTIC _g_PL_AD_fw_Radar_1R1V_rpc_LocBypassingRunnable_LocBypassingRunnable_m_pad_ensRLocationsPort_par_out_local.TChangeableMemPool._._._m_arrayPool._0_._elem._m_LocationList._Item._103_._thetaVar._m_value "" VALUE 0xB0010D0C __Float16_Value 0 NO_COMPU_METHOD -65504 65504 ECU_ADDRESS_EXTENSION 0x2 BYTE_ORDER MSB_LAST /end CHARACTERISTIC
/begin CHARACTERISTIC _g_PL_AD_fw_Radar_1R1V_rpc_LocBypassingRunnable_LocBypassingRunnable_m_pad_ensRLocationsPort_par_out_local.TChangeableMemPool._._._m_arrayPool._0_._elem._m_LocationList._Item._103_._v "" VALUE 0xB0010CFC __Float32_Value 0 NO_COMPU_METHOD -3.4028234663852886E+38 3.4028234663852886E+38 ECU_ADDRESS_EXTENSION 0x2 BYTE_ORDER MSB_LAST /end CHARACTERISTIC
/begin CHARACTERISTIC _g_PL_AD_fw_Radar_1R1V_rpc_LocBypassingRunnable_LocBypassingRunnable_m_pad_ensRLocationsPort_par_out_local.TChangeableMemPool._._._m_arrayPool._0_._elem._m_LocationList._Item._103_._vVar._m_value "" VALUE 0xB0010D02 __Float16_Value 0 NO_COMPU_METHOD -65504 65504 ECU_ADDRESS_EXTENSION 0x2 BYTE_ORDER MSB_LAST /end CHARACTERISTIC
/begin CHARACTERISTIC _g_PL_AD_fw_Radar_1R1V_rpc_LocBypassingRunnable_LocBypassingRunnable_m_pad_ensRLocationsPort_par_out_local.TChangeableMemPool._._._m_arrayPool._0_._elem._m_LocationList._Item._104_._Rcs._m_value "" VALUE 0xB0010D30 __Float16_Value 0 NO_COMPU_METHOD -65504 65504 ECU_ADDRESS_EXTENSION 0x2 BYTE_ORDER MSB_LAST /end CHARACTERISTIC
/begin CHARACTERISTIC _g_PL_AD_fw_Radar_1R1V_rpc_LocBypassingRunnable_LocBypassingRunnable_m_pad_ensRLocationsPort_par_out_local.TChangeableMemPool._._._m_arrayPool._0_._elem._m_LocationList._Item._104_._Rssi._m_value "" VALUE 0xB0010D32 __Float16_Value 0 NO_COMPU_METHOD -65504 65504 ECU_ADDRESS_EXTENSION 0x2 BYTE_ORDER MSB_LAST /end CHARACTERISTIC
/begin CHARACTERISTIC _g_PL_AD_fw_Radar_1R1V_rpc_LocBypassingRunnable_LocBypassingRunnable_m_pad_ensRLocationsPort_par_out_local.TChangeableMemPool._._._m_arrayPool._0_._elem._m_LocationList._Item._104_._d "" VALUE 0xB0010D18 __Float32_Value 0 NO_COMPU_METHOD -3.4028234663852886E+38 3.4028234663852886E+38 ECU_ADDRESS_EXTENSION 0x2 BYTE_ORDER MSB_LAST /end CHARACTERISTIC
/begin CHARACTERISTIC _g_PL_AD_fw_Radar_1R1V_rpc_LocBypassingRunnable_LocBypassingRunnable_m_pad_ensRLocationsPort_par_out_local.TChangeableMemPool._._._m_arrayPool._0_._elem._m_LocationList._Item._104_._dVar._m_value "" VALUE 0xB0010D20 __Float16_Value 0 NO_COMPU_METHOD -65504 65504 ECU_ADDRESS_EXTENSION 0x2 BYTE_ORDER MSB_LAST /end CHARACTERISTIC
/begin CHARACTERISTIC _g_PL_AD_fw_Radar_1R1V_rpc_LocBypassingRunnable_LocBypassingRunnable_m_pad_ensRLocationsPort_par_out_local.TChangeableMemPool._._._m_arrayPool._0_._elem._m_LocationList._Item._104_._dvCov._m_value "" VALUE 0xB0010D24 __Float16_Value 0 NO_COMPU_METHOD -65504 65504 ECU_ADDRESS_EXTENSION 0x2 BYTE_ORDER MSB_LAST /end CHARACTERISTIC
/begin CHARACTERISTIC _g_PL_AD_fw_Radar_1R1V_rpc_LocBypassingRunnable_LocBypassingRunnable_m_pad_ensRLocationsPort_par_out_local.TChangeableMemPool._._._m_arrayPool._0_._elem._m_LocationList._Item._104_._dvQly "" VALUE 0xB0010D34 __UByte_Value 0 NO_COMPU_METHOD 0 255 ECU_ADDRESS_EXTENSION 0x2 BYTE_ORDER MSB_LAST /end CHARACTERISTIC
/begin CHARACTERISTIC _g_PL_AD_fw_Radar_1R1V_rpc_LocBypassingRunnable_LocBypassingRunnable_m_pad_ensRLocationsPort_par_out_local.TChangeableMemPool._._._m_arrayPool._0_._elem._m_LocationList._Item._104_._idxAzimuthAmbiguityPeer "" VALUE 0xB0010D36 __UWord_Value 0 NO_COMPU_METHOD 0 65535 ECU_ADDRESS_EXTENSION 0x2 BYTE_ORDER MSB_LAST /end CHARACTERISTIC
/begin CHARACTERISTIC _g_PL_AD_fw_Radar_1R1V_rpc_LocBypassingRunnable_LocBypassingRunnable_m_pad_ensRLocationsPort_par_out_local.TChangeableMemPool._._._m_arrayPool._0_._elem._m_LocationList._Item._104_._measStatus "" VALUE 0xB0010D35 __UByte_Value 0 NO_COMPU_METHOD 0 255 ECU_ADDRESS_EXTENSION 0x2 BYTE_ORDER MSB_LAST /end CHARACTERISTIC
/begin CHARACTERISTIC _g_PL_AD_fw_Radar_1R1V_rpc_LocBypassingRunnable_LocBypassingRunnable_m_pad_ensRLocationsPort_par_out_local.TChangeableMemPool._._._m_arrayPool._0_._elem._m_LocationList._Item._104_._phi._m_value "" VALUE 0xB0010D28 __Float16_Value 0 NO_COMPU_METHOD -65504 65504 ECU_ADDRESS_EXTENSION 0x2 BYTE_ORDER MSB_LAST /end CHARACTERISTIC
/begin CHARACTERISTIC _g_PL_AD_fw_Radar_1R1V_rpc_LocBypassingRunnable_LocBypassingRunnable_m_pad_ensRLocationsPort_par_out_local.TChangeableMemPool._._._m_arrayPool._0_._elem._m_LocationList._Item._104_._phiQly "" VALUE 0xB0010D2B __UByte_Value 0 NO_COMPU_METHOD 0 255 ECU_ADDRESS_EXTENSION 0x2 BYTE_ORDER MSB_LAST /end CHARACTERISTIC
/begin CHARACTERISTIC _g_PL_AD_fw_Radar_1R1V_rpc_LocBypassingRunnable_LocBypassingRunnable_m_pad_ensRLocationsPort_par_out_local.TChangeableMemPool._._._m_arrayPool._0_._elem._m_LocationList._Item._104_._phiVar._m_value "" VALUE 0xB0010D2E __Float16_Value 0 NO_COMPU_METHOD -65504 65504 ECU_ADDRESS_EXTENSION 0x2 BYTE_ORDER MSB_LAST /end CHARACTERISTIC
/begin CHARACTERISTIC _g_PL_AD_fw_Radar_1R1V_rpc_LocBypassingRunnable_LocBypassingRunnable_m_pad_ensRLocationsPort_par_out_local.TChangeableMemPool._._._m_arrayPool._0_._elem._m_LocationList._Item._104_._theta._m_value "" VALUE 0xB0010D26 __Float16_Value 0 NO_COMPU_METHOD -65504 65504 ECU_ADDRESS_EXTENSION 0x2 BYTE_ORDER MSB_LAST /end CHARACTERISTIC
/begin CHARACTERISTIC _g_PL_AD_fw_Radar_1R1V_rpc_LocBypassingRunnable_LocBypassingRunnable_m_pad_ensRLocationsPort_par_out_local.TChangeableMemPool._._._m_arrayPool._0_._elem._m_LocationList._Item._104_._thetaQly "" VALUE 0xB0010D2A __UByte_Value 0 NO_COMPU_METHOD 0 255 ECU_ADDRESS_EXTENSION 0x2 BYTE_ORDER MSB_LAST /end CHARACTERISTIC
/begin CHARACTERISTIC _g_PL_AD_fw_Radar_1R1V_rpc_LocBypassingRunnable_LocBypassingRunnable_m_pad_ensRLocationsPort_par_out_local.TChangeableMemPool._._._m_arrayPool._0_._elem._m_LocationList._Item._104_._thetaVar._m_value "" VALUE 0xB0010D2C __Float16_Value 0 NO_COMPU_METHOD -65504 65504 ECU_ADDRESS_EXTENSION 0x2 BYTE_ORDER MSB_LAST /end CHARACTERISTIC
/begin CHARACTERISTIC _g_PL_AD_fw_Radar_1R1V_rpc_LocBypassingRunnable_LocBypassingRunnable_m_pad_ensRLocationsPort_par_out_local.TChangeableMemPool._._._m_arrayPool._0_._elem._m_LocationList._Item._104_._v "" VALUE 0xB0010D1C __Float32_Value 0 NO_COMPU_METHOD -3.4028234663852886E+38 3.4028234663852886E+38 ECU_ADDRESS_EXTENSION 0x2 BYTE_ORDER MSB_LAST /end CHARACTERISTIC
/begin CHARACTERISTIC _g_PL_AD_fw_Radar_1R1V_rpc_LocBypassingRunnable_LocBypassingRunnable_m_pad_ensRLocationsPort_par_out_local.TChangeableMemPool._._._m_arrayPool._0_._elem._m_LocationList._Item._104_._vVar._m_value "" VALUE 0xB0010D22 __Float16_Value 0 NO_COMPU_METHOD -65504 65504 ECU_ADDRESS_EXTENSION 0x2 BYTE_ORDER MSB_LAST /end CHARACTERISTIC
/begin CHARACTERISTIC _g_PL_AD_fw_Radar_1R1V_rpc_LocBypassingRunnable_LocBypassingRunnable_m_pad_ensRLocationsPort_par_out_local.TChangeableMemPool._._._m_arrayPool._0_._elem._m_LocationList._Item._105_._Rcs._m_value "" VALUE 0xB0010D50 __Float16_Value 0 NO_COMPU_METHOD -65504 65504 ECU_ADDRESS_EXTENSION 0x2 BYTE_ORDER MSB_LAST /end CHARACTERISTIC
/begin CHARACTERISTIC _g_PL_AD_fw_Radar_1R1V_rpc_LocBypassingRunnable_LocBypassingRunnable_m_pad_ensRLocationsPort_par_out_local.TChangeableMemPool._._._m_arrayPool._0_._elem._m_LocationList._Item._105_._Rssi._m_value "" VALUE 0xB0010D52 __Float16_Value 0 NO_COMPU_METHOD -65504 65504 ECU_ADDRESS_EXTENSION 0x2 BYTE_ORDER MSB_LAST /end CHARACTERISTIC
/begin CHARACTERISTIC _g_PL_AD_fw_Radar_1R1V_rpc_LocBypassingRunnable_LocBypassingRunnable_m_pad_ensRLocationsPort_par_out_local.TChangeableMemPool._._._m_arrayPool._0_._elem._m_LocationList._Item._105_._d "" VALUE 0xB0010D38 __Float32_Value 0 NO_COMPU_METHOD -3.4028234663852886E+38 3.4028234663852886E+38 ECU_ADDRESS_EXTENSION 0x2 BYTE_ORDER MSB_LAST /end CHARACTERISTIC
/begin CHARACTERISTIC _g_PL_AD_fw_Radar_1R1V_rpc_LocBypassingRunnable_LocBypassingRunnable_m_pad_ensRLocationsPort_par_out_local.TChangeableMemPool._._._m_arrayPool._0_._elem._m_LocationList._Item._105_._dVar._m_value "" VALUE 0xB0010D40 __Float16_Value 0 NO_COMPU_METHOD -65504 65504 ECU_ADDRESS_EXTENSION 0x2 BYTE_ORDER MSB_LAST /end CHARACTERISTIC
/begin CHARACTERISTIC _g_PL_AD_fw_Radar_1R1V_rpc_LocBypassingRunnable_LocBypassingRunnable_m_pad_ensRLocationsPort_par_out_local.TChangeableMemPool._._._m_arrayPool._0_._elem._m_LocationList._Item._105_._dvCov._m_value "" VALUE 0xB0010D44 __Float16_Value 0 NO_COMPU_METHOD -65504 65504 ECU_ADDRESS_EXTENSION 0x2 BYTE_ORDER MSB_LAST /end CHARACTERISTIC
/begin CHARACTERISTIC _g_PL_AD_fw_Radar_1R1V_rpc_LocBypassingRunnable_LocBypassingRunnable_m_pad_ensRLocationsPort_par_out_local.TChangeableMemPool._._._m_arrayPool._0_._elem._m_LocationList._Item._105_._dvQly "" VALUE 0xB0010D54 __UByte_Value 0 NO_COMPU_METHOD 0 255 ECU_ADDRESS_EXTENSION 0x2 BYTE_ORDER MSB_LAST /end CHARACTERISTIC
/begin CHARACTERISTIC _g_PL_AD_fw_Radar_1R1V_rpc_LocBypassingRunnable_LocBypassingRunnable_m_pad_ensRLocationsPort_par_out_local.TChangeableMemPool._._._m_arrayPool._0_._elem._m_LocationList._Item._105_._idxAzimuthAmbiguityPeer "" VALUE 0xB0010D56 __UWord_Value 0 NO_COMPU_METHOD 0 65535 ECU_ADDRESS_EXTENSION 0x2 BYTE_ORDER MSB_LAST /end CHARACTERISTIC
/begin CHARACTERISTIC _g_PL_AD_fw_Radar_1R1V_rpc_LocBypassingRunnable_LocBypassingRunnable_m_pad_ensRLocationsPort_par_out_local.TChangeableMemPool._._._m_arrayPool._0_._elem._m_LocationList._Item._105_._measStatus "" VALUE 0xB0010D55 __UByte_Value 0 NO_COMPU_METHOD 0 255 ECU_ADDRESS_EXTENSION 0x2 BYTE_ORDER MSB_LAST /end CHARACTERISTIC
/begin CHARACTERISTIC _g_PL_AD_fw_Radar_1R1V_rpc_LocBypassingRunnable_LocBypassingRunnable_m_pad_ensRLocationsPort_par_out_local.TChangeableMemPool._._._m_arrayPool._0_._elem._m_LocationList._Item._105_._phi._m_value "" VALUE 0xB0010D48 __Float16_Value 0 NO_COMPU_METHOD -65504 65504 ECU_ADDRESS_EXTENSION 0x2 BYTE_ORDER MSB_LAST /end CHARACTERISTIC
/begin CHARACTERISTIC _g_PL_AD_fw_Radar_1R1V_rpc_LocBypassingRunnable_LocBypassingRunnable_m_pad_ensRLocationsPort_par_out_local.TChangeableMemPool._._._m_arrayPool._0_._elem._m_LocationList._Item._105_._phiQly "" VALUE 0xB0010D4B __UByte_Value 0 NO_COMPU_METHOD 0 255 ECU_ADDRESS_EXTENSION 0x2 BYTE_ORDER MSB_LAST /end CHARACTERISTIC
/begin CHARACTERISTIC _g_PL_AD_fw_Radar_1R1V_rpc_LocBypassingRunnable_LocBypassingRunnable_m_pad_ensRLocationsPort_par_out_local.TChangeableMemPool._._._m_arrayPool._0_._elem._m_LocationList._Item._105_._phiVar._m_value "" VALUE 0xB0010D4E __Float16_Value 0 NO_COMPU_METHOD -65504 65504 ECU_ADDRESS_EXTENSION 0x2 BYTE_ORDER MSB_LAST /end CHARACTERISTIC
/begin CHARACTERISTIC _g_PL_AD_fw_Radar_1R1V_rpc_LocBypassingRunnable_LocBypassingRunnable_m_pad_ensRLocationsPort_par_out_local.TChangeableMemPool._._._m_arrayPool._0_._elem._m_LocationList._Item._105_._theta._m_value "" VALUE 0xB0010D46 __Float16_Value 0 NO_COMPU_METHOD -65504 65504 ECU_ADDRESS_EXTENSION 0x2 BYTE_ORDER MSB_LAST /end CHARACTERISTIC
/begin CHARACTERISTIC _g_PL_AD_fw_Radar_1R1V_rpc_LocBypassingRunnable_LocBypassingRunnable_m_pad_ensRLocationsPort_par_out_local.TChangeableMemPool._._._m_arrayPool._0_._elem._m_LocationList._Item._105_._thetaQly "" VALUE 0xB0010D4A __UByte_Value 0 NO_COMPU_METHOD 0 255 ECU_ADDRESS_EXTENSION 0x2 BYTE_ORDER MSB_LAST /end CHARACTERISTIC
/begin CHARACTERISTIC _g_PL_AD_fw_Radar_1R1V_rpc_LocBypassingRunnable_LocBypassingRunnable_m_pad_ensRLocationsPort_par_out_local.TChangeableMemPool._._._m_arrayPool._0_._elem._m_LocationList._Item._105_._thetaVar._m_value "" VALUE 0xB0010D4C __Float16_Value 0 NO_COMPU_METHOD -65504 65504 ECU_ADDRESS_EXTENSION 0x2 BYTE_ORDER MSB_LAST /end CHARACTERISTIC
/begin CHARACTERISTIC _g_PL_AD_fw_Radar_1R1V_rpc_LocBypassingRunnable_LocBypassingRunnable_m_pad_ensRLocationsPort_par_out_local.TChangeableMemPool._._._m_arrayPool._0_._elem._m_LocationList._Item._105_._v "" VALUE 0xB0010D3C __Float32_Value 0 NO_COMPU_METHOD -3.4028234663852886E+38 3.4028234663852886E+38 ECU_ADDRESS_EXTENSION 0x2 BYTE_ORDER MSB_LAST /end CHARACTERISTIC
/begin CHARACTERISTIC _g_PL_AD_fw_Radar_1R1V_rpc_LocBypassingRunnable_LocBypassingRunnable_m_pad_ensRLocationsPort_par_out_local.TChangeableMemPool._._._m_arrayPool._0_._elem._m_LocationList._Item._105_._vVar._m_value "" VALUE 0xB0010D42 __Float16_Value 0 NO_COMPU_METHOD -65504 65504 ECU_ADDRESS_EXTENSION 0x2 BYTE_ORDER MSB_LAST /end CHARACTERISTIC
/begin CHARACTERISTIC _g_PL_AD_fw_Radar_1R1V_rpc_LocBypassingRunnable_LocBypassingRunnable_m_pad_ensRLocationsPort_par_out_local.TChangeableMemPool._._._m_arrayPool._0_._elem._m_LocationList._Item._106_._Rcs._m_value "" VALUE 0xB0010D70 __Float16_Value 0 NO_COMPU_METHOD -65504 65504 ECU_ADDRESS_EXTENSION 0x2 BYTE_ORDER MSB_LAST /end CHARACTERISTIC
/begin CHARACTERISTIC _g_PL_AD_fw_Radar_1R1V_rpc_LocBypassingRunnable_LocBypassingRunnable_m_pad_ensRLocationsPort_par_out_local.TChangeableMemPool._._._m_arrayPool._0_._elem._m_LocationList._Item._106_._Rssi._m_value "" VALUE 0xB0010D72 __Float16_Value 0 NO_COMPU_METHOD -65504 65504 ECU_ADDRESS_EXTENSION 0x2 BYTE_ORDER MSB_LAST /end CHARACTERISTIC
/begin CHARACTERISTIC _g_PL_AD_fw_Radar_1R1V_rpc_LocBypassingRunnable_LocBypassingRunnable_m_pad_ensRLocationsPort_par_out_local.TChangeableMemPool._._._m_arrayPool._0_._elem._m_LocationList._Item._106_._d "" VALUE 0xB0010D58 __Float32_Value 0 NO_COMPU_METHOD -3.4028234663852886E+38 3.4028234663852886E+38 ECU_ADDRESS_EXTENSION 0x2 BYTE_ORDER MSB_LAST /end CHARACTERISTIC
/begin CHARACTERISTIC _g_PL_AD_fw_Radar_1R1V_rpc_LocBypassingRunnable_LocBypassingRunnable_m_pad_ensRLocationsPort_par_out_local.TChangeableMemPool._._._m_arrayPool._0_._elem._m_LocationList._Item._106_._dVar._m_value "" VALUE 0xB0010D60 __Float16_Value 0 NO_COMPU_METHOD -65504 65504 ECU_ADDRESS_EXTENSION 0x2 BYTE_ORDER MSB_LAST /end CHARACTERISTIC
/begin CHARACTERISTIC _g_PL_AD_fw_Radar_1R1V_rpc_LocBypassingRunnable_LocBypassingRunnable_m_pad_ensRLocationsPort_par_out_local.TChangeableMemPool._._._m_arrayPool._0_._elem._m_LocationList._Item._106_._dvCov._m_value "" VALUE 0xB0010D64 __Float16_Value 0 NO_COMPU_METHOD -65504 65504 ECU_ADDRESS_EXTENSION 0x2 BYTE_ORDER MSB_LAST /end CHARACTERISTIC
/begin CHARACTERISTIC _g_PL_AD_fw_Radar_1R1V_rpc_LocBypassingRunnable_LocBypassingRunnable_m_pad_ensRLocationsPort_par_out_local.TChangeableMemPool._._._m_arrayPool._0_._elem._m_LocationList._Item._106_._dvQly "" VALUE 0xB0010D74 __UByte_Value 0 NO_COMPU_METHOD 0 255 ECU_ADDRESS_EXTENSION 0x2 BYTE_ORDER MSB_LAST /end CHARACTERISTIC
/begin CHARACTERISTIC _g_PL_AD_fw_Radar_1R1V_rpc_LocBypassingRunnable_LocBypassingRunnable_m_pad_ensRLocationsPort_par_out_local.TChangeableMemPool._._._m_arrayPool._0_._elem._m_LocationList._Item._106_._idxAzimuthAmbiguityPeer "" VALUE 0xB0010D76 __UWord_Value 0 NO_COMPU_METHOD 0 65535 ECU_ADDRESS_EXTENSION 0x2 BYTE_ORDER MSB_LAST /end CHARACTERISTIC
/begin CHARACTERISTIC _g_PL_AD_fw_Radar_1R1V_rpc_LocBypassingRunnable_LocBypassingRunnable_m_pad_ensRLocationsPort_par_out_local.TChangeableMemPool._._._m_arrayPool._0_._elem._m_LocationList._Item._106_._measStatus "" VALUE 0xB0010D75 __UByte_Value 0 NO_COMPU_METHOD 0 255 ECU_ADDRESS_EXTENSION 0x2 BYTE_ORDER MSB_LAST /end CHARACTERISTIC
/begin CHARACTERISTIC _g_PL_AD_fw_Radar_1R1V_rpc_LocBypassingRunnable_LocBypassingRunnable_m_pad_ensRLocationsPort_par_out_local.TChangeableMemPool._._._m_arrayPool._0_._elem._m_LocationList._Item._106_._phi._m_value "" VALUE 0xB0010D68 __Float16_Value 0 NO_COMPU_METHOD -65504 65504 ECU_ADDRESS_EXTENSION 0x2 BYTE_ORDER MSB_LAST /end CHARACTERISTIC
/begin CHARACTERISTIC _g_PL_AD_fw_Radar_1R1V_rpc_LocBypassingRunnable_LocBypassingRunnable_m_pad_ensRLocationsPort_par_out_local.TChangeableMemPool._._._m_arrayPool._0_._elem._m_LocationList._Item._106_._phiQly "" VALUE 0xB0010D6B __UByte_Value 0 NO_COMPU_METHOD 0 255 ECU_ADDRESS_EXTENSION 0x2 BYTE_ORDER MSB_LAST /end CHARACTERISTIC
/begin CHARACTERISTIC _g_PL_AD_fw_Radar_1R1V_rpc_LocBypassingRunnable_LocBypassingRunnable_m_pad_ensRLocationsPort_par_out_local.TChangeableMemPool._._._m_arrayPool._0_._elem._m_LocationList._Item._106_._phiVar._m_value "" VALUE 0xB0010D6E __Float16_Value 0 NO_COMPU_METHOD -65504 65504 ECU_ADDRESS_EXTENSION 0x2 BYTE_ORDER MSB_LAST /end CHARACTERISTIC
/begin CHARACTERISTIC _g_PL_AD_fw_Radar_1R1V_rpc_LocBypassingRunnable_LocBypassingRunnable_m_pad_ensRLocationsPort_par_out_local.TChangeableMemPool._._._m_arrayPool._0_._elem._m_LocationList._Item._106_._theta._m_value "" VALUE 0xB0010D66 __Float16_Value 0 NO_COMPU_METHOD -65504 65504 ECU_ADDRESS_EXTENSION 0x2 BYTE_ORDER MSB_LAST /end CHARACTERISTIC
/begin CHARACTERISTIC _g_PL_AD_fw_Radar_1R1V_rpc_LocBypassingRunnable_LocBypassingRunnable_m_pad_ensRLocationsPort_par_out_local.TChangeableMemPool._._._m_arrayPool._0_._elem._m_LocationList._Item._106_._thetaQly "" VALUE 0xB0010D6A __UByte_Value 0 NO_COMPU_METHOD 0 255 ECU_ADDRESS_EXTENSION 0x2 BYTE_ORDER MSB_LAST /end CHARACTERISTIC
/begin CHARACTERISTIC _g_PL_AD_fw_Radar_1R1V_rpc_LocBypassingRunnable_LocBypassingRunnable_m_pad_ensRLocationsPort_par_out_local.TChangeableMemPool._._._m_arrayPool._0_._elem._m_LocationList._Item._106_._thetaVar._m_value "" VALUE 0xB0010D6C __Float16_Value 0 NO_COMPU_METHOD -65504 65504 ECU_ADDRESS_EXTENSION 0x2 BYTE_ORDER MSB_LAST /end CHARACTERISTIC
/begin CHARACTERISTIC _g_PL_AD_fw_Radar_1R1V_rpc_LocBypassingRunnable_LocBypassingRunnable_m_pad_ensRLocationsPort_par_out_local.TChangeableMemPool._._._m_arrayPool._0_._elem._m_LocationList._Item._106_._v "" VALUE 0xB0010D5C __Float32_Value 0 NO_COMPU_METHOD -3.4028234663852886E+38 3.4028234663852886E+38 ECU_ADDRESS_EXTENSION 0x2 BYTE_ORDER MSB_LAST /end CHARACTERISTIC
/begin CHARACTERISTIC _g_PL_AD_fw_Radar_1R1V_rpc_LocBypassingRunnable_LocBypassingRunnable_m_pad_ensRLocationsPort_par_out_local.TChangeableMemPool._._._m_arrayPool._0_._elem._m_LocationList._Item._106_._vVar._m_value "" VALUE 0xB0010D62 __Float16_Value 0 NO_COMPU_METHOD -65504 65504 ECU_ADDRESS_EXTENSION 0x2 BYTE_ORDER MSB_LAST /end CHARACTERISTIC
/begin CHARACTERISTIC _g_PL_AD_fw_Radar_1R1V_rpc_LocBypassingRunnable_LocBypassingRunnable_m_pad_ensRLocationsPort_par_out_local.TChangeableMemPool._._._m_arrayPool._0_._elem._m_LocationList._Item._107_._Rcs._m_value "" VALUE 0xB0010D90 __Float16_Value 0 NO_COMPU_METHOD -65504 65504 ECU_ADDRESS_EXTENSION 0x2 BYTE_ORDER MSB_LAST /end CHARACTERISTIC
/begin CHARACTERISTIC _g_PL_AD_fw_Radar_1R1V_rpc_LocBypassingRunnable_LocBypassingRunnable_m_pad_ensRLocationsPort_par_out_local.TChangeableMemPool._._._m_arrayPool._0_._elem._m_LocationList._Item._107_._Rssi._m_value "" VALUE 0xB0010D92 __Float16_Value 0 NO_COMPU_METHOD -65504 65504 ECU_ADDRESS_EXTENSION 0x2 BYTE_ORDER MSB_LAST /end CHARACTERISTIC
/begin CHARACTERISTIC _g_PL_AD_fw_Radar_1R1V_rpc_LocBypassingRunnable_LocBypassingRunnable_m_pad_ensRLocationsPort_par_out_local.TChangeableMemPool._._._m_arrayPool._0_._elem._m_LocationList._Item._107_._d "" VALUE 0xB0010D78 __Float32_Value 0 NO_COMPU_METHOD -3.4028234663852886E+38 3.4028234663852886E+38 ECU_ADDRESS_EXTENSION 0x2 BYTE_ORDER MSB_LAST /end CHARACTERISTIC
/begin CHARACTERISTIC _g_PL_AD_fw_Radar_1R1V_rpc_LocBypassingRunnable_LocBypassingRunnable_m_pad_ensRLocationsPort_par_out_local.TChangeableMemPool._._._m_arrayPool._0_._elem._m_LocationList._Item._107_._dVar._m_value "" VALUE 0xB0010D80 __Float16_Value 0 NO_COMPU_METHOD -65504 65504 ECU_ADDRESS_EXTENSION 0x2 BYTE_ORDER MSB_LAST /end CHARACTERISTIC
/begin CHARACTERISTIC _g_PL_AD_fw_Radar_1R1V_rpc_LocBypassingRunnable_LocBypassingRunnable_m_pad_ensRLocationsPort_par_out_local.TChangeableMemPool._._._m_arrayPool._0_._elem._m_LocationList._Item._107_._dvCov._m_value "" VALUE 0xB0010D84 __Float16_Value 0 NO_COMPU_METHOD -65504 65504 ECU_ADDRESS_EXTENSION 0x2 BYTE_ORDER MSB_LAST /end CHARACTERISTIC
/begin CHARACTERISTIC _g_PL_AD_fw_Radar_1R1V_rpc_LocBypassingRunnable_LocBypassingRunnable_m_pad_ensRLocationsPort_par_out_local.TChangeableMemPool._._._m_arrayPool._0_._elem._m_LocationList._Item._107_._dvQly "" VALUE 0xB0010D94 __UByte_Value 0 NO_COMPU_METHOD 0 255 ECU_ADDRESS_EXTENSION 0x2 BYTE_ORDER MSB_LAST /end CHARACTERISTIC
/begin CHARACTERISTIC _g_PL_AD_fw_Radar_1R1V_rpc_LocBypassingRunnable_LocBypassingRunnable_m_pad_ensRLocationsPort_par_out_local.TChangeableMemPool._._._m_arrayPool._0_._elem._m_LocationList._Item._107_._idxAzimuthAmbiguityPeer "" VALUE 0xB0010D96 __UWord_Value 0 NO_COMPU_METHOD 0 65535 ECU_ADDRESS_EXTENSION 0x2 BYTE_ORDER MSB_LAST /end CHARACTERISTIC
/begin CHARACTERISTIC _g_PL_AD_fw_Radar_1R1V_rpc_LocBypassingRunnable_LocBypassingRunnable_m_pad_ensRLocationsPort_par_out_local.TChangeableMemPool._._._m_arrayPool._0_._elem._m_LocationList._Item._107_._measStatus "" VALUE 0xB0010D95 __UByte_Value 0 NO_COMPU_METHOD 0 255 ECU_ADDRESS_EXTENSION 0x2 BYTE_ORDER MSB_LAST /end CHARACTERISTIC
/begin CHARACTERISTIC _g_PL_AD_fw_Radar_1R1V_rpc_LocBypassingRunnable_LocBypassingRunnable_m_pad_ensRLocationsPort_par_out_local.TChangeableMemPool._._._m_arrayPool._0_._elem._m_LocationList._Item._107_._phi._m_value "" VALUE 0xB0010D88 __Float16_Value 0 NO_COMPU_METHOD -65504 65504 ECU_ADDRESS_EXTENSION 0x2 BYTE_ORDER MSB_LAST /end CHARACTERISTIC
/begin CHARACTERISTIC _g_PL_AD_fw_Radar_1R1V_rpc_LocBypassingRunnable_LocBypassingRunnable_m_pad_ensRLocationsPort_par_out_local.TChangeableMemPool._._._m_arrayPool._0_._elem._m_LocationList._Item._107_._phiQly "" VALUE 0xB0010D8B __UByte_Value 0 NO_COMPU_METHOD 0 255 ECU_ADDRESS_EXTENSION 0x2 BYTE_ORDER MSB_LAST /end CHARACTERISTIC
/begin CHARACTERISTIC _g_PL_AD_fw_Radar_1R1V_rpc_LocBypassingRunnable_LocBypassingRunnable_m_pad_ensRLocationsPort_par_out_local.TChangeableMemPool._._._m_arrayPool._0_._elem._m_LocationList._Item._107_._phiVar._m_value "" VALUE 0xB0010D8E __Float16_Value 0 NO_COMPU_METHOD -65504 65504 ECU_ADDRESS_EXTENSION 0x2 BYTE_ORDER MSB_LAST /end CHARACTERISTIC
/begin CHARACTERISTIC _g_PL_AD_fw_Radar_1R1V_rpc_LocBypassingRunnable_LocBypassingRunnable_m_pad_ensRLocationsPort_par_out_local.TChangeableMemPool._._._m_arrayPool._0_._elem._m_LocationList._Item._107_._theta._m_value "" VALUE 0xB0010D86 __Float16_Value 0 NO_COMPU_METHOD -65504 65504 ECU_ADDRESS_EXTENSION 0x2 BYTE_ORDER MSB_LAST /end CHARACTERISTIC
/begin CHARACTERISTIC _g_PL_AD_fw_Radar_1R1V_rpc_LocBypassingRunnable_LocBypassingRunnable_m_pad_ensRLocationsPort_par_out_local.TChangeableMemPool._._._m_arrayPool._0_._elem._m_LocationList._Item._107_._thetaQly "" VALUE 0xB0010D8A __UByte_Value 0 NO_COMPU_METHOD 0 255 ECU_ADDRESS_EXTENSION 0x2 BYTE_ORDER MSB_LAST /end CHARACTERISTIC
/begin CHARACTERISTIC _g_PL_AD_fw_Radar_1R1V_rpc_LocBypassingRunnable_LocBypassingRunnable_m_pad_ensRLocationsPort_par_out_local.TChangeableMemPool._._._m_arrayPool._0_._elem._m_LocationList._Item._107_._thetaVar._m_value "" VALUE 0xB0010D8C __Float16_Value 0 NO_COMPU_METHOD -65504 65504 ECU_ADDRESS_EXTENSION 0x2 BYTE_ORDER MSB_LAST /end CHARACTERISTIC
/begin CHARACTERISTIC _g_PL_AD_fw_Radar_1R1V_rpc_LocBypassingRunnable_LocBypassingRunnable_m_pad_ensRLocationsPort_par_out_local.TChangeableMemPool._._._m_arrayPool._0_._elem._m_LocationList._Item._107_._v "" VALUE 0xB0010D7C __Float32_Value 0 NO_COMPU_METHOD -3.4028234663852886E+38 3.4028234663852886E+38 ECU_ADDRESS_EXTENSION 0x2 BYTE_ORDER MSB_LAST /end CHARACTERISTIC
/begin CHARACTERISTIC _g_PL_AD_fw_Radar_1R1V_rpc_LocBypassingRunnable_LocBypassingRunnable_m_pad_ensRLocationsPort_par_out_local.TChangeableMemPool._._._m_arrayPool._0_._elem._m_LocationList._Item._107_._vVar._m_value "" VALUE 0xB0010D82 __Float16_Value 0 NO_COMPU_METHOD -65504 65504 ECU_ADDRESS_EXTENSION 0x2 BYTE_ORDER MSB_LAST /end CHARACTERISTIC
/begin CHARACTERISTIC _g_PL_AD_fw_Radar_1R1V_rpc_LocBypassingRunnable_LocBypassingRunnable_m_pad_ensRLocationsPort_par_out_local.TChangeableMemPool._._._m_arrayPool._0_._elem._m_LocationList._Item._108_._Rcs._m_value "" VALUE 0xB0010DB0 __Float16_Value 0 NO_COMPU_METHOD -65504 65504 ECU_ADDRESS_EXTENSION 0x2 BYTE_ORDER MSB_LAST /end CHARACTERISTIC
/begin CHARACTERISTIC _g_PL_AD_fw_Radar_1R1V_rpc_LocBypassingRunnable_LocBypassingRunnable_m_pad_ensRLocationsPort_par_out_local.TChangeableMemPool._._._m_arrayPool._0_._elem._m_LocationList._Item._108_._Rssi._m_value "" VALUE 0xB0010DB2 __Float16_Value 0 NO_COMPU_METHOD -65504 65504 ECU_ADDRESS_EXTENSION 0x2 BYTE_ORDER MSB_LAST /end CHARACTERISTIC
/begin CHARACTERISTIC _g_PL_AD_fw_Radar_1R1V_rpc_LocBypassingRunnable_LocBypassingRunnable_m_pad_ensRLocationsPort_par_out_local.TChangeableMemPool._._._m_arrayPool._0_._elem._m_LocationList._Item._108_._d "" VALUE 0xB0010D98 __Float32_Value 0 NO_COMPU_METHOD -3.4028234663852886E+38 3.4028234663852886E+38 ECU_ADDRESS_EXTENSION 0x2 BYTE_ORDER MSB_LAST /end CHARACTERISTIC
/begin CHARACTERISTIC _g_PL_AD_fw_Radar_1R1V_rpc_LocBypassingRunnable_LocBypassingRunnable_m_pad_ensRLocationsPort_par_out_local.TChangeableMemPool._._._m_arrayPool._0_._elem._m_LocationList._Item._108_._dVar._m_value "" VALUE 0xB0010DA0 __Float16_Value 0 NO_COMPU_METHOD -65504 65504 ECU_ADDRESS_EXTENSION 0x2 BYTE_ORDER MSB_LAST /end CHARACTERISTIC
/begin CHARACTERISTIC _g_PL_AD_fw_Radar_1R1V_rpc_LocBypassingRunnable_LocBypassingRunnable_m_pad_ensRLocationsPort_par_out_local.TChangeableMemPool._._._m_arrayPool._0_._elem._m_LocationList._Item._108_._dvCov._m_value "" VALUE 0xB0010DA4 __Float16_Value 0 NO_COMPU_METHOD -65504 65504 ECU_ADDRESS_EXTENSION 0x2 BYTE_ORDER MSB_LAST /end CHARACTERISTIC
/begin CHARACTERISTIC _g_PL_AD_fw_Radar_1R1V_rpc_LocBypassingRunnable_LocBypassingRunnable_m_pad_ensRLocationsPort_par_out_local.TChangeableMemPool._._._m_arrayPool._0_._elem._m_LocationList._Item._108_._dvQly "" VALUE 0xB0010DB4 __UByte_Value 0 NO_COMPU_METHOD 0 255 ECU_ADDRESS_EXTENSION 0x2 BYTE_ORDER MSB_LAST /end CHARACTERISTIC
/begin CHARACTERISTIC _g_PL_AD_fw_Radar_1R1V_rpc_LocBypassingRunnable_LocBypassingRunnable_m_pad_ensRLocationsPort_par_out_local.TChangeableMemPool._._._m_arrayPool._0_._elem._m_LocationList._Item._108_._idxAzimuthAmbiguityPeer "" VALUE 0xB0010DB6 __UWord_Value 0 NO_COMPU_METHOD 0 65535 ECU_ADDRESS_EXTENSION 0x2 BYTE_ORDER MSB_LAST /end CHARACTERISTIC
/begin CHARACTERISTIC _g_PL_AD_fw_Radar_1R1V_rpc_LocBypassingRunnable_LocBypassingRunnable_m_pad_ensRLocationsPort_par_out_local.TChangeableMemPool._._._m_arrayPool._0_._elem._m_LocationList._Item._108_._measStatus "" VALUE 0xB0010DB5 __UByte_Value 0 NO_COMPU_METHOD 0 255 ECU_ADDRESS_EXTENSION 0x2 BYTE_ORDER MSB_LAST /end CHARACTERISTIC
/begin CHARACTERISTIC _g_PL_AD_fw_Radar_1R1V_rpc_LocBypassingRunnable_LocBypassingRunnable_m_pad_ensRLocationsPort_par_out_local.TChangeableMemPool._._._m_arrayPool._0_._elem._m_LocationList._Item._108_._phi._m_value "" VALUE 0xB0010DA8 __Float16_Value 0 NO_COMPU_METHOD -65504 65504 ECU_ADDRESS_EXTENSION 0x2 BYTE_ORDER MSB_LAST /end CHARACTERISTIC
/begin CHARACTERISTIC _g_PL_AD_fw_Radar_1R1V_rpc_LocBypassingRunnable_LocBypassingRunnable_m_pad_ensRLocationsPort_par_out_local.TChangeableMemPool._._._m_arrayPool._0_._elem._m_LocationList._Item._108_._phiQly "" VALUE 0xB0010DAB __UByte_Value 0 NO_COMPU_METHOD 0 255 ECU_ADDRESS_EXTENSION 0x2 BYTE_ORDER MSB_LAST /end CHARACTERISTIC
/begin CHARACTERISTIC _g_PL_AD_fw_Radar_1R1V_rpc_LocBypassingRunnable_LocBypassingRunnable_m_pad_ensRLocationsPort_par_out_local.TChangeableMemPool._._._m_arrayPool._0_._elem._m_LocationList._Item._108_._phiVar._m_value "" VALUE 0xB0010DAE __Float16_Value 0 NO_COMPU_METHOD -65504 65504 ECU_ADDRESS_EXTENSION 0x2 BYTE_ORDER MSB_LAST /end CHARACTERISTIC
/begin CHARACTERISTIC _g_PL_AD_fw_Radar_1R1V_rpc_LocBypassingRunnable_LocBypassingRunnable_m_pad_ensRLocationsPort_par_out_local.TChangeableMemPool._._._m_arrayPool._0_._elem._m_LocationList._Item._108_._theta._m_value "" VALUE 0xB0010DA6 __Float16_Value 0 NO_COMPU_METHOD -65504 65504 ECU_ADDRESS_EXTENSION 0x2 BYTE_ORDER MSB_LAST /end CHARACTERISTIC
/begin CHARACTERISTIC _g_PL_AD_fw_Radar_1R1V_rpc_LocBypassingRunnable_LocBypassingRunnable_m_pad_ensRLocationsPort_par_out_local.TChangeableMemPool._._._m_arrayPool._0_._elem._m_LocationList._Item._108_._thetaQly "" VALUE 0xB0010DAA __UByte_Value 0 NO_COMPU_METHOD 0 255 ECU_ADDRESS_EXTENSION 0x2 BYTE_ORDER MSB_LAST /end CHARACTERISTIC
/begin CHARACTERISTIC _g_PL_AD_fw_Radar_1R1V_rpc_LocBypassingRunnable_LocBypassingRunnable_m_pad_ensRLocationsPort_par_out_local.TChangeableMemPool._._._m_arrayPool._0_._elem._m_LocationList._Item._108_._thetaVar._m_value "" VALUE 0xB0010DAC __Float16_Value 0 NO_COMPU_METHOD -65504 65504 ECU_ADDRESS_EXTENSION 0x2 BYTE_ORDER MSB_LAST /end CHARACTERISTIC
/begin CHARACTERISTIC _g_PL_AD_fw_Radar_1R1V_rpc_LocBypassingRunnable_LocBypassingRunnable_m_pad_ensRLocationsPort_par_out_local.TChangeableMemPool._._._m_arrayPool._0_._elem._m_LocationList._Item._108_._v "" VALUE 0xB0010D9C __Float32_Value 0 NO_COMPU_METHOD -3.4028234663852886E+38 3.4028234663852886E+38 ECU_ADDRESS_EXTENSION 0x2 BYTE_ORDER MSB_LAST /end CHARACTERISTIC
/begin CHARACTERISTIC _g_PL_AD_fw_Radar_1R1V_rpc_LocBypassingRunnable_LocBypassingRunnable_m_pad_ensRLocationsPort_par_out_local.TChangeableMemPool._._._m_arrayPool._0_._elem._m_LocationList._Item._108_._vVar._m_value "" VALUE 0xB0010DA2 __Float16_Value 0 NO_COMPU_METHOD -65504 65504 ECU_ADDRESS_EXTENSION 0x2 BYTE_ORDER MSB_LAST /end CHARACTERISTIC
/begin CHARACTERISTIC _g_PL_AD_fw_Radar_1R1V_rpc_LocBypassingRunnable_LocBypassingRunnable_m_pad_ensRLocationsPort_par_out_local.TChangeableMemPool._._._m_arrayPool._0_._elem._m_LocationList._Item._109_._Rcs._m_value "" VALUE 0xB0010DD0 __Float16_Value 0 NO_COMPU_METHOD -65504 65504 ECU_ADDRESS_EXTENSION 0x2 BYTE_ORDER MSB_LAST /end CHARACTERISTIC
/begin CHARACTERISTIC _g_PL_AD_fw_Radar_1R1V_rpc_LocBypassingRunnable_LocBypassingRunnable_m_pad_ensRLocationsPort_par_out_local.TChangeableMemPool._._._m_arrayPool._0_._elem._m_LocationList._Item._109_._Rssi._m_value "" VALUE 0xB0010DD2 __Float16_Value 0 NO_COMPU_METHOD -65504 65504 ECU_ADDRESS_EXTENSION 0x2 BYTE_ORDER MSB_LAST /end CHARACTERISTIC
/begin CHARACTERISTIC _g_PL_AD_fw_Radar_1R1V_rpc_LocBypassingRunnable_LocBypassingRunnable_m_pad_ensRLocationsPort_par_out_local.TChangeableMemPool._._._m_arrayPool._0_._elem._m_LocationList._Item._109_._d "" VALUE 0xB0010DB8 __Float32_Value 0 NO_COMPU_METHOD -3.4028234663852886E+38 3.4028234663852886E+38 ECU_ADDRESS_EXTENSION 0x2 BYTE_ORDER MSB_LAST /end CHARACTERISTIC
/begin CHARACTERISTIC _g_PL_AD_fw_Radar_1R1V_rpc_LocBypassingRunnable_LocBypassingRunnable_m_pad_ensRLocationsPort_par_out_local.TChangeableMemPool._._._m_arrayPool._0_._elem._m_LocationList._Item._109_._dVar._m_value "" VALUE 0xB0010DC0 __Float16_Value 0 NO_COMPU_METHOD -65504 65504 ECU_ADDRESS_EXTENSION 0x2 BYTE_ORDER MSB_LAST /end CHARACTERISTIC
/begin CHARACTERISTIC _g_PL_AD_fw_Radar_1R1V_rpc_LocBypassingRunnable_LocBypassingRunnable_m_pad_ensRLocationsPort_par_out_local.TChangeableMemPool._._._m_arrayPool._0_._elem._m_LocationList._Item._109_._dvCov._m_value "" VALUE 0xB0010DC4 __Float16_Value 0 NO_COMPU_METHOD -65504 65504 ECU_ADDRESS_EXTENSION 0x2 BYTE_ORDER MSB_LAST /end CHARACTERISTIC
/begin CHARACTERISTIC _g_PL_AD_fw_Radar_1R1V_rpc_LocBypassingRunnable_LocBypassingRunnable_m_pad_ensRLocationsPort_par_out_local.TChangeableMemPool._._._m_arrayPool._0_._elem._m_LocationList._Item._109_._dvQly "" VALUE 0xB0010DD4 __UByte_Value 0 NO_COMPU_METHOD 0 255 ECU_ADDRESS_EXTENSION 0x2 BYTE_ORDER MSB_LAST /end CHARACTERISTIC
/begin CHARACTERISTIC _g_PL_AD_fw_Radar_1R1V_rpc_LocBypassingRunnable_LocBypassingRunnable_m_pad_ensRLocationsPort_par_out_local.TChangeableMemPool._._._m_arrayPool._0_._elem._m_LocationList._Item._109_._idxAzimuthAmbiguityPeer "" VALUE 0xB0010DD6 __UWord_Value 0 NO_COMPU_METHOD 0 65535 ECU_ADDRESS_EXTENSION 0x2 BYTE_ORDER MSB_LAST /end CHARACTERISTIC
/begin CHARACTERISTIC _g_PL_AD_fw_Radar_1R1V_rpc_LocBypassingRunnable_LocBypassingRunnable_m_pad_ensRLocationsPort_par_out_local.TChangeableMemPool._._._m_arrayPool._0_._elem._m_LocationList._Item._109_._measStatus "" VALUE 0xB0010DD5 __UByte_Value 0 NO_COMPU_METHOD 0 255 ECU_ADDRESS_EXTENSION 0x2 BYTE_ORDER MSB_LAST /end CHARACTERISTIC
/begin CHARACTERISTIC _g_PL_AD_fw_Radar_1R1V_rpc_LocBypassingRunnable_LocBypassingRunnable_m_pad_ensRLocationsPort_par_out_local.TChangeableMemPool._._._m_arrayPool._0_._elem._m_LocationList._Item._109_._phi._m_value "" VALUE 0xB0010DC8 __Float16_Value 0 NO_COMPU_METHOD -65504 65504 ECU_ADDRESS_EXTENSION 0x2 BYTE_ORDER MSB_LAST /end CHARACTERISTIC
/begin CHARACTERISTIC _g_PL_AD_fw_Radar_1R1V_rpc_LocBypassingRunnable_LocBypassingRunnable_m_pad_ensRLocationsPort_par_out_local.TChangeableMemPool._._._m_arrayPool._0_._elem._m_LocationList._Item._109_._phiQly "" VALUE 0xB0010DCB __UByte_Value 0 NO_COMPU_METHOD 0 255 ECU_ADDRESS_EXTENSION 0x2 BYTE_ORDER MSB_LAST /end CHARACTERISTIC
/begin CHARACTERISTIC _g_PL_AD_fw_Radar_1R1V_rpc_LocBypassingRunnable_LocBypassingRunnable_m_pad_ensRLocationsPort_par_out_local.TChangeableMemPool._._._m_arrayPool._0_._elem._m_LocationList._Item._109_._phiVar._m_value "" VALUE 0xB0010DCE __Float16_Value 0 NO_COMPU_METHOD -65504 65504 ECU_ADDRESS_EXTENSION 0x2 BYTE_ORDER MSB_LAST /end CHARACTERISTIC
/begin CHARACTERISTIC _g_PL_AD_fw_Radar_1R1V_rpc_LocBypassingRunnable_LocBypassingRunnable_m_pad_ensRLocationsPort_par_out_local.TChangeableMemPool._._._m_arrayPool._0_._elem._m_LocationList._Item._109_._theta._m_value "" VALUE 0xB0010DC6 __Float16_Value 0 NO_COMPU_METHOD -65504 65504 ECU_ADDRESS_EXTENSION 0x2 BYTE_ORDER MSB_LAST /end CHARACTERISTIC
/begin CHARACTERISTIC _g_PL_AD_fw_Radar_1R1V_rpc_LocBypassingRunnable_LocBypassingRunnable_m_pad_ensRLocationsPort_par_out_local.TChangeableMemPool._._._m_arrayPool._0_._elem._m_LocationList._Item._109_._thetaQly "" VALUE 0xB0010DCA __UByte_Value 0 NO_COMPU_METHOD 0 255 ECU_ADDRESS_EXTENSION 0x2 BYTE_ORDER MSB_LAST /end CHARACTERISTIC
/begin CHARACTERISTIC _g_PL_AD_fw_Radar_1R1V_rpc_LocBypassingRunnable_LocBypassingRunnable_m_pad_ensRLocationsPort_par_out_local.TChangeableMemPool._._._m_arrayPool._0_._elem._m_LocationList._Item._109_._thetaVar._m_value "" VALUE 0xB0010DCC __Float16_Value 0 NO_COMPU_METHOD -65504 65504 ECU_ADDRESS_EXTENSION 0x2 BYTE_ORDER MSB_LAST /end CHARACTERISTIC
/begin CHARACTERISTIC _g_PL_AD_fw_Radar_1R1V_rpc_LocBypassingRunnable_LocBypassingRunnable_m_pad_ensRLocationsPort_par_out_local.TChangeableMemPool._._._m_arrayPool._0_._elem._m_LocationList._Item._109_._v "" VALUE 0xB0010DBC __Float32_Value 0 NO_COMPU_METHOD -3.4028234663852886E+38 3.4028234663852886E+38 ECU_ADDRESS_EXTENSION 0x2 BYTE_ORDER MSB_LAST /end CHARACTERISTIC
/begin CHARACTERISTIC _g_PL_AD_fw_Radar_1R1V_rpc_LocBypassingRunnable_LocBypassingRunnable_m_pad_ensRLocationsPort_par_out_local.TChangeableMemPool._._._m_arrayPool._0_._elem._m_LocationList._Item._109_._vVar._m_value "" VALUE 0xB0010DC2 __Float16_Value 0 NO_COMPU_METHOD -65504 65504 ECU_ADDRESS_EXTENSION 0x2 BYTE_ORDER MSB_LAST /end CHARACTERISTIC
/begin CHARACTERISTIC _g_PL_AD_fw_Radar_1R1V_rpc_LocBypassingRunnable_LocBypassingRunnable_m_pad_ensRLocationsPort_par_out_local.TChangeableMemPool._._._m_arrayPool._0_._elem._m_LocationList._Item._10_._Rcs._m_value "" VALUE 0xB0010170 __Float16_Value 0 NO_COMPU_METHOD -65504 65504 ECU_ADDRESS_EXTENSION 0x2 BYTE_ORDER MSB_LAST /end CHARACTERISTIC
/begin CHARACTERISTIC _g_PL_AD_fw_Radar_1R1V_rpc_LocBypassingRunnable_LocBypassingRunnable_m_pad_ensRLocationsPort_par_out_local.TChangeableMemPool._._._m_arrayPool._0_._elem._m_LocationList._Item._10_._Rssi._m_value "" VALUE 0xB0010172 __Float16_Value 0 NO_COMPU_METHOD -65504 65504 ECU_ADDRESS_EXTENSION 0x2 BYTE_ORDER MSB_LAST /end CHARACTERISTIC
/begin CHARACTERISTIC _g_PL_AD_fw_Radar_1R1V_rpc_LocBypassingRunnable_LocBypassingRunnable_m_pad_ensRLocationsPort_par_out_local.TChangeableMemPool._._._m_arrayPool._0_._elem._m_LocationList._Item._10_._d "" VALUE 0xB0010158 __Float32_Value 0 NO_COMPU_METHOD -3.4028234663852886E+38 3.4028234663852886E+38 ECU_ADDRESS_EXTENSION 0x2 BYTE_ORDER MSB_LAST /end CHARACTERISTIC
/begin CHARACTERISTIC _g_PL_AD_fw_Radar_1R1V_rpc_LocBypassingRunnable_LocBypassingRunnable_m_pad_ensRLocationsPort_par_out_local.TChangeableMemPool._._._m_arrayPool._0_._elem._m_LocationList._Item._10_._dVar._m_value "" VALUE 0xB0010160 __Float16_Value 0 NO_COMPU_METHOD -65504 65504 ECU_ADDRESS_EXTENSION 0x2 BYTE_ORDER MSB_LAST /end CHARACTERISTIC
/begin CHARACTERISTIC _g_PL_AD_fw_Radar_1R1V_rpc_LocBypassingRunnable_LocBypassingRunnable_m_pad_ensRLocationsPort_par_out_local.TChangeableMemPool._._._m_arrayPool._0_._elem._m_LocationList._Item._10_._dvCov._m_value "" VALUE 0xB0010164 __Float16_Value 0 NO_COMPU_METHOD -65504 65504 ECU_ADDRESS_EXTENSION 0x2 BYTE_ORDER MSB_LAST /end CHARACTERISTIC
/begin CHARACTERISTIC _g_PL_AD_fw_Radar_1R1V_rpc_LocBypassingRunnable_LocBypassingRunnable_m_pad_ensRLocationsPort_par_out_local.TChangeableMemPool._._._m_arrayPool._0_._elem._m_LocationList._Item._10_._dvQly "" VALUE 0xB0010174 __UByte_Value 0 NO_COMPU_METHOD 0 255 ECU_ADDRESS_EXTENSION 0x2 BYTE_ORDER MSB_LAST /end CHARACTERISTIC
/begin CHARACTERISTIC _g_PL_AD_fw_Radar_1R1V_rpc_LocBypassingRunnable_LocBypassingRunnable_m_pad_ensRLocationsPort_par_out_local.TChangeableMemPool._._._m_arrayPool._0_._elem._m_LocationList._Item._10_._idxAzimuthAmbiguityPeer "" VALUE 0xB0010176 __UWord_Value 0 NO_COMPU_METHOD 0 65535 ECU_ADDRESS_EXTENSION 0x2 BYTE_ORDER MSB_LAST /end CHARACTERISTIC
/begin CHARACTERISTIC _g_PL_AD_fw_Radar_1R1V_rpc_LocBypassingRunnable_LocBypassingRunnable_m_pad_ensRLocationsPort_par_out_local.TChangeableMemPool._._._m_arrayPool._0_._elem._m_LocationList._Item._10_._measStatus "" VALUE 0xB0010175 __UByte_Value 0 NO_COMPU_METHOD 0 255 ECU_ADDRESS_EXTENSION 0x2 BYTE_ORDER MSB_LAST /end CHARACTERISTIC
/begin CHARACTERISTIC _g_PL_AD_fw_Radar_1R1V_rpc_LocBypassingRunnable_LocBypassingRunnable_m_pad_ensRLocationsPort_par_out_local.TChangeableMemPool._._._m_arrayPool._0_._elem._m_LocationList._Item._10_._phi._m_value "" VALUE 0xB0010168 __Float16_Value 0 NO_COMPU_METHOD -65504 65504 ECU_ADDRESS_EXTENSION 0x2 BYTE_ORDER MSB_LAST /end CHARACTERISTIC
/begin CHARACTERISTIC _g_PL_AD_fw_Radar_1R1V_rpc_LocBypassingRunnable_LocBypassingRunnable_m_pad_ensRLocationsPort_par_out_local.TChangeableMemPool._._._m_arrayPool._0_._elem._m_LocationList._Item._10_._phiQly "" VALUE 0xB001016B __UByte_Value 0 NO_COMPU_METHOD 0 255 ECU_ADDRESS_EXTENSION 0x2 BYTE_ORDER MSB_LAST /end CHARACTERISTIC
/begin CHARACTERISTIC _g_PL_AD_fw_Radar_1R1V_rpc_LocBypassingRunnable_LocBypassingRunnable_m_pad_ensRLocationsPort_par_out_local.TChangeableMemPool._._._m_arrayPool._0_._elem._m_LocationList._Item._10_._phiVar._m_value "" VALUE 0xB001016E __Float16_Value 0 NO_COMPU_METHOD -65504 65504 ECU_ADDRESS_EXTENSION 0x2 BYTE_ORDER MSB_LAST /end CHARACTERISTIC
/begin CHARACTERISTIC _g_PL_AD_fw_Radar_1R1V_rpc_LocBypassingRunnable_LocBypassingRunnable_m_pad_ensRLocationsPort_par_out_local.TChangeableMemPool._._._m_arrayPool._0_._elem._m_LocationList._Item._10_._theta._m_value "" VALUE 0xB0010166 __Float16_Value 0 NO_COMPU_METHOD -65504 65504 ECU_ADDRESS_EXTENSION 0x2 BYTE_ORDER MSB_LAST /end CHARACTERISTIC
/begin CHARACTERISTIC _g_PL_AD_fw_Radar_1R1V_rpc_LocBypassingRunnable_LocBypassingRunnable_m_pad_ensRLocationsPort_par_out_local.TChangeableMemPool._._._m_arrayPool._0_._elem._m_LocationList._Item._10_._thetaQly "" VALUE 0xB001016A __UByte_Value 0 NO_COMPU_METHOD 0 255 ECU_ADDRESS_EXTENSION 0x2 BYTE_ORDER MSB_LAST /end CHARACTERISTIC
/begin CHARACTERISTIC _g_PL_AD_fw_Radar_1R1V_rpc_LocBypassingRunnable_LocBypassingRunnable_m_pad_ensRLocationsPort_par_out_local.TChangeableMemPool._._._m_arrayPool._0_._elem._m_LocationList._Item._10_._thetaVar._m_value "" VALUE 0xB001016C __Float16_Value 0 NO_COMPU_METHOD -65504 65504 ECU_ADDRESS_EXTENSION 0x2 BYTE_ORDER MSB_LAST /end CHARACTERISTIC
/begin CHARACTERISTIC _g_PL_AD_fw_Radar_1R1V_rpc_LocBypassingRunnable_LocBypassingRunnable_m_pad_ensRLocationsPort_par_out_local.TChangeableMemPool._._._m_arrayPool._0_._elem._m_LocationList._Item._10_._v "" VALUE 0xB001015C __Float32_Value 0 NO_COMPU_METHOD -3.4028234663852886E+38 3.4028234663852886E+38 ECU_ADDRESS_EXTENSION 0x2 BYTE_ORDER MSB_LAST /end CHARACTERISTIC
/begin CHARACTERISTIC _g_PL_AD_fw_Radar_1R1V_rpc_LocBypassingRunnable_LocBypassingRunnable_m_pad_ensRLocationsPort_par_out_local.TChangeableMemPool._._._m_arrayPool._0_._elem._m_LocationList._Item._10_._vVar._m_value "" VALUE 0xB0010162 __Float16_Value 0 NO_COMPU_METHOD -65504 65504 ECU_ADDRESS_EXTENSION 0x2 BYTE_ORDER MSB_LAST /end CHARACTERISTIC
/begin CHARACTERISTIC _g_PL_AD_fw_Radar_1R1V_rpc_LocBypassingRunnable_LocBypassingRunnable_m_pad_ensRLocationsPort_par_out_local.TChangeableMemPool._._._m_arrayPool._0_._elem._m_LocationList._Item._110_._Rcs._m_value "" VALUE 0xB0010DF0 __Float16_Value 0 NO_COMPU_METHOD -65504 65504 ECU_ADDRESS_EXTENSION 0x2 BYTE_ORDER MSB_LAST /end CHARACTERISTIC
/begin CHARACTERISTIC _g_PL_AD_fw_Radar_1R1V_rpc_LocBypassingRunnable_LocBypassingRunnable_m_pad_ensRLocationsPort_par_out_local.TChangeableMemPool._._._m_arrayPool._0_._elem._m_LocationList._Item._110_._Rssi._m_value "" VALUE 0xB0010DF2 __Float16_Value 0 NO_COMPU_METHOD -65504 65504 ECU_ADDRESS_EXTENSION 0x2 BYTE_ORDER MSB_LAST /end CHARACTERISTIC
/begin CHARACTERISTIC _g_PL_AD_fw_Radar_1R1V_rpc_LocBypassingRunnable_LocBypassingRunnable_m_pad_ensRLocationsPort_par_out_local.TChangeableMemPool._._._m_arrayPool._0_._elem._m_LocationList._Item._110_._d "" VALUE 0xB0010DD8 __Float32_Value 0 NO_COMPU_METHOD -3.4028234663852886E+38 3.4028234663852886E+38 ECU_ADDRESS_EXTENSION 0x2 BYTE_ORDER MSB_LAST /end CHARACTERISTIC
/begin CHARACTERISTIC _g_PL_AD_fw_Radar_1R1V_rpc_LocBypassingRunnable_LocBypassingRunnable_m_pad_ensRLocationsPort_par_out_local.TChangeableMemPool._._._m_arrayPool._0_._elem._m_LocationList._Item._110_._dVar._m_value "" VALUE 0xB0010DE0 __Float16_Value 0 NO_COMPU_METHOD -65504 65504 ECU_ADDRESS_EXTENSION 0x2 BYTE_ORDER MSB_LAST /end CHARACTERISTIC
/begin CHARACTERISTIC _g_PL_AD_fw_Radar_1R1V_rpc_LocBypassingRunnable_LocBypassingRunnable_m_pad_ensRLocationsPort_par_out_local.TChangeableMemPool._._._m_arrayPool._0_._elem._m_LocationList._Item._110_._dvCov._m_value "" VALUE 0xB0010DE4 __Float16_Value 0 NO_COMPU_METHOD -65504 65504 ECU_ADDRESS_EXTENSION 0x2 BYTE_ORDER MSB_LAST /end CHARACTERISTIC
/begin CHARACTERISTIC _g_PL_AD_fw_Radar_1R1V_rpc_LocBypassingRunnable_LocBypassingRunnable_m_pad_ensRLocationsPort_par_out_local.TChangeableMemPool._._._m_arrayPool._0_._elem._m_LocationList._Item._110_._dvQly "" VALUE 0xB0010DF4 __UByte_Value 0 NO_COMPU_METHOD 0 255 ECU_ADDRESS_EXTENSION 0x2 BYTE_ORDER MSB_LAST /end CHARACTERISTIC
/begin CHARACTERISTIC _g_PL_AD_fw_Radar_1R1V_rpc_LocBypassingRunnable_LocBypassingRunnable_m_pad_ensRLocationsPort_par_out_local.TChangeableMemPool._._._m_arrayPool._0_._elem._m_LocationList._Item._110_._idxAzimuthAmbiguityPeer "" VALUE 0xB0010DF6 __UWord_Value 0 NO_COMPU_METHOD 0 65535 ECU_ADDRESS_EXTENSION 0x2 BYTE_ORDER MSB_LAST /end CHARACTERISTIC
/begin CHARACTERISTIC _g_PL_AD_fw_Radar_1R1V_rpc_LocBypassingRunnable_LocBypassingRunnable_m_pad_ensRLocationsPort_par_out_local.TChangeableMemPool._._._m_arrayPool._0_._elem._m_LocationList._Item._110_._measStatus "" VALUE 0xB0010DF5 __UByte_Value 0 NO_COMPU_METHOD 0 255 ECU_ADDRESS_EXTENSION 0x2 BYTE_ORDER MSB_LAST /end CHARACTERISTIC
/begin CHARACTERISTIC _g_PL_AD_fw_Radar_1R1V_rpc_LocBypassingRunnable_LocBypassingRunnable_m_pad_ensRLocationsPort_par_out_local.TChangeableMemPool._._._m_arrayPool._0_._elem._m_LocationList._Item._110_._phi._m_value "" VALUE 0xB0010DE8 __Float16_Value 0 NO_COMPU_METHOD -65504 65504 ECU_ADDRESS_EXTENSION 0x2 BYTE_ORDER MSB_LAST /end CHARACTERISTIC
/begin CHARACTERISTIC _g_PL_AD_fw_Radar_1R1V_rpc_LocBypassingRunnable_LocBypassingRunnable_m_pad_ensRLocationsPort_par_out_local.TChangeableMemPool._._._m_arrayPool._0_._elem._m_LocationList._Item._110_._phiQly "" VALUE 0xB0010DEB __UByte_Value 0 NO_COMPU_METHOD 0 255 ECU_ADDRESS_EXTENSION 0x2 BYTE_ORDER MSB_LAST /end CHARACTERISTIC
/begin CHARACTERISTIC _g_PL_AD_fw_Radar_1R1V_rpc_LocBypassingRunnable_LocBypassingRunnable_m_pad_ensRLocationsPort_par_out_local.TChangeableMemPool._._._m_arrayPool._0_._elem._m_LocationList._Item._110_._phiVar._m_value "" VALUE 0xB0010DEE __Float16_Value 0 NO_COMPU_METHOD -65504 65504 ECU_ADDRESS_EXTENSION 0x2 BYTE_ORDER MSB_LAST /end CHARACTERISTIC
/begin CHARACTERISTIC _g_PL_AD_fw_Radar_1R1V_rpc_LocBypassingRunnable_LocBypassingRunnable_m_pad_ensRLocationsPort_par_out_local.TChangeableMemPool._._._m_arrayPool._0_._elem._m_LocationList._Item._110_._theta._m_value "" VALUE 0xB0010DE6 __Float16_Value 0 NO_COMPU_METHOD -65504 65504 ECU_ADDRESS_EXTENSION 0x2 BYTE_ORDER MSB_LAST /end CHARACTERISTIC
/begin CHARACTERISTIC _g_PL_AD_fw_Radar_1R1V_rpc_LocBypassingRunnable_LocBypassingRunnable_m_pad_ensRLocationsPort_par_out_local.TChangeableMemPool._._._m_arrayPool._0_._elem._m_LocationList._Item._110_._thetaQly "" VALUE 0xB0010DEA __UByte_Value 0 NO_COMPU_METHOD 0 255 ECU_ADDRESS_EXTENSION 0x2 BYTE_ORDER MSB_LAST /end CHARACTERISTIC
/begin CHARACTERISTIC _g_PL_AD_fw_Radar_1R1V_rpc_LocBypassingRunnable_LocBypassingRunnable_m_pad_ensRLocationsPort_par_out_local.TChangeableMemPool._._._m_arrayPool._0_._elem._m_LocationList._Item._110_._thetaVar._m_value "" VALUE 0xB0010DEC __Float16_Value 0 NO_COMPU_METHOD -65504 65504 ECU_ADDRESS_EXTENSION 0x2 BYTE_ORDER MSB_LAST /end CHARACTERISTIC
/begin CHARACTERISTIC _g_PL_AD_fw_Radar_1R1V_rpc_LocBypassingRunnable_LocBypassingRunnable_m_pad_ensRLocationsPort_par_out_local.TChangeableMemPool._._._m_arrayPool._0_._elem._m_LocationList._Item._110_._v "" VALUE 0xB0010DDC __Float32_Value 0 NO_COMPU_METHOD -3.4028234663852886E+38 3.4028234663852886E+38 ECU_ADDRESS_EXTENSION 0x2 BYTE_ORDER MSB_LAST /end CHARACTERISTIC
/begin CHARACTERISTIC _g_PL_AD_fw_Radar_1R1V_rpc_LocBypassingRunnable_LocBypassingRunnable_m_pad_ensRLocationsPort_par_out_local.TChangeableMemPool._._._m_arrayPool._0_._elem._m_LocationList._Item._110_._vVar._m_value "" VALUE 0xB0010DE2 __Float16_Value 0 NO_COMPU_METHOD -65504 65504 ECU_ADDRESS_EXTENSION 0x2 BYTE_ORDER MSB_LAST /end CHARACTERISTIC
/begin CHARACTERISTIC _g_PL_AD_fw_Radar_1R1V_rpc_LocBypassingRunnable_LocBypassingRunnable_m_pad_ensRLocationsPort_par_out_local.TChangeableMemPool._._._m_arrayPool._0_._elem._m_LocationList._Item._111_._Rcs._m_value "" VALUE 0xB0010E10 __Float16_Value 0 NO_COMPU_METHOD -65504 65504 ECU_ADDRESS_EXTENSION 0x2 BYTE_ORDER MSB_LAST /end CHARACTERISTIC
/begin CHARACTERISTIC _g_PL_AD_fw_Radar_1R1V_rpc_LocBypassingRunnable_LocBypassingRunnable_m_pad_ensRLocationsPort_par_out_local.TChangeableMemPool._._._m_arrayPool._0_._elem._m_LocationList._Item._111_._Rssi._m_value "" VALUE 0xB0010E12 __Float16_Value 0 NO_COMPU_METHOD -65504 65504 ECU_ADDRESS_EXTENSION 0x2 BYTE_ORDER MSB_LAST /end CHARACTERISTIC
/begin CHARACTERISTIC _g_PL_AD_fw_Radar_1R1V_rpc_LocBypassingRunnable_LocBypassingRunnable_m_pad_ensRLocationsPort_par_out_local.TChangeableMemPool._._._m_arrayPool._0_._elem._m_LocationList._Item._111_._d "" VALUE 0xB0010DF8 __Float32_Value 0 NO_COMPU_METHOD -3.4028234663852886E+38 3.4028234663852886E+38 ECU_ADDRESS_EXTENSION 0x2 BYTE_ORDER MSB_LAST /end CHARACTERISTIC
/begin CHARACTERISTIC _g_PL_AD_fw_Radar_1R1V_rpc_LocBypassingRunnable_LocBypassingRunnable_m_pad_ensRLocationsPort_par_out_local.TChangeableMemPool._._._m_arrayPool._0_._elem._m_LocationList._Item._111_._dVar._m_value "" VALUE 0xB0010E00 __Float16_Value 0 NO_COMPU_METHOD -65504 65504 ECU_ADDRESS_EXTENSION 0x2 BYTE_ORDER MSB_LAST /end CHARACTERISTIC
/begin CHARACTERISTIC _g_PL_AD_fw_Radar_1R1V_rpc_LocBypassingRunnable_LocBypassingRunnable_m_pad_ensRLocationsPort_par_out_local.TChangeableMemPool._._._m_arrayPool._0_._elem._m_LocationList._Item._111_._dvCov._m_value "" VALUE 0xB0010E04 __Float16_Value 0 NO_COMPU_METHOD -65504 65504 ECU_ADDRESS_EXTENSION 0x2 BYTE_ORDER MSB_LAST /end CHARACTERISTIC
/begin CHARACTERISTIC _g_PL_AD_fw_Radar_1R1V_rpc_LocBypassingRunnable_LocBypassingRunnable_m_pad_ensRLocationsPort_par_out_local.TChangeableMemPool._._._m_arrayPool._0_._elem._m_LocationList._Item._111_._dvQly "" VALUE 0xB0010E14 __UByte_Value 0 NO_COMPU_METHOD 0 255 ECU_ADDRESS_EXTENSION 0x2 BYTE_ORDER MSB_LAST /end CHARACTERISTIC
/begin CHARACTERISTIC _g_PL_AD_fw_Radar_1R1V_rpc_LocBypassingRunnable_LocBypassingRunnable_m_pad_ensRLocationsPort_par_out_local.TChangeableMemPool._._._m_arrayPool._0_._elem._m_LocationList._Item._111_._idxAzimuthAmbiguityPeer "" VALUE 0xB0010E16 __UWord_Value 0 NO_COMPU_METHOD 0 65535 ECU_ADDRESS_EXTENSION 0x2 BYTE_ORDER MSB_LAST /end CHARACTERISTIC
/begin CHARACTERISTIC _g_PL_AD_fw_Radar_1R1V_rpc_LocBypassingRunnable_LocBypassingRunnable_m_pad_ensRLocationsPort_par_out_local.TChangeableMemPool._._._m_arrayPool._0_._elem._m_LocationList._Item._111_._measStatus "" VALUE 0xB0010E15 __UByte_Value 0 NO_COMPU_METHOD 0 255 ECU_ADDRESS_EXTENSION 0x2 BYTE_ORDER MSB_LAST /end CHARACTERISTIC
/begin CHARACTERISTIC _g_PL_AD_fw_Radar_1R1V_rpc_LocBypassingRunnable_LocBypassingRunnable_m_pad_ensRLocationsPort_par_out_local.TChangeableMemPool._._._m_arrayPool._0_._elem._m_LocationList._Item._111_._phi._m_value "" VALUE 0xB0010E08 __Float16_Value 0 NO_COMPU_METHOD -65504 65504 ECU_ADDRESS_EXTENSION 0x2 BYTE_ORDER MSB_LAST /end CHARACTERISTIC
/begin CHARACTERISTIC _g_PL_AD_fw_Radar_1R1V_rpc_LocBypassingRunnable_LocBypassingRunnable_m_pad_ensRLocationsPort_par_out_local.TChangeableMemPool._._._m_arrayPool._0_._elem._m_LocationList._Item._111_._phiQly "" VALUE 0xB0010E0B __UByte_Value 0 NO_COMPU_METHOD 0 255 ECU_ADDRESS_EXTENSION 0x2 BYTE_ORDER MSB_LAST /end CHARACTERISTIC
/begin CHARACTERISTIC _g_PL_AD_fw_Radar_1R1V_rpc_LocBypassingRunnable_LocBypassingRunnable_m_pad_ensRLocationsPort_par_out_local.TChangeableMemPool._._._m_arrayPool._0_._elem._m_LocationList._Item._111_._phiVar._m_value "" VALUE 0xB0010E0E __Float16_Value 0 NO_COMPU_METHOD -65504 65504 ECU_ADDRESS_EXTENSION 0x2 BYTE_ORDER MSB_LAST /end CHARACTERISTIC
/begin CHARACTERISTIC _g_PL_AD_fw_Radar_1R1V_rpc_LocBypassingRunnable_LocBypassingRunnable_m_pad_ensRLocationsPort_par_out_local.TChangeableMemPool._._._m_arrayPool._0_._elem._m_LocationList._Item._111_._theta._m_value "" VALUE 0xB0010E06 __Float16_Value 0 NO_COMPU_METHOD -65504 65504 ECU_ADDRESS_EXTENSION 0x2 BYTE_ORDER MSB_LAST /end CHARACTERISTIC
/begin CHARACTERISTIC _g_PL_AD_fw_Radar_1R1V_rpc_LocBypassingRunnable_LocBypassingRunnable_m_pad_ensRLocationsPort_par_out_local.TChangeableMemPool._._._m_arrayPool._0_._elem._m_LocationList._Item._111_._thetaQly "" VALUE 0xB0010E0A __UByte_Value 0 NO_COMPU_METHOD 0 255 ECU_ADDRESS_EXTENSION 0x2 BYTE_ORDER MSB_LAST /end CHARACTERISTIC
/begin CHARACTERISTIC _g_PL_AD_fw_Radar_1R1V_rpc_LocBypassingRunnable_LocBypassingRunnable_m_pad_ensRLocationsPort_par_out_local.TChangeableMemPool._._._m_arrayPool._0_._elem._m_LocationList._Item._111_._thetaVar._m_value "" VALUE 0xB0010E0C __Float16_Value 0 NO_COMPU_METHOD -65504 65504 ECU_ADDRESS_EXTENSION 0x2 BYTE_ORDER MSB_LAST /end CHARACTERISTIC
/begin CHARACTERISTIC _g_PL_AD_fw_Radar_1R1V_rpc_LocBypassingRunnable_LocBypassingRunnable_m_pad_ensRLocationsPort_par_out_local.TChangeableMemPool._._._m_arrayPool._0_._elem._m_LocationList._Item._111_._v "" VALUE 0xB0010DFC __Float32_Value 0 NO_COMPU_METHOD -3.4028234663852886E+38 3.4028234663852886E+38 ECU_ADDRESS_EXTENSION 0x2 BYTE_ORDER MSB_LAST /end CHARACTERISTIC
/begin CHARACTERISTIC _g_PL_AD_fw_Radar_1R1V_rpc_LocBypassingRunnable_LocBypassingRunnable_m_pad_ensRLocationsPort_par_out_local.TChangeableMemPool._._._m_arrayPool._0_._elem._m_LocationList._Item._111_._vVar._m_value "" VALUE 0xB0010E02 __Float16_Value 0 NO_COMPU_METHOD -65504 65504 ECU_ADDRESS_EXTENSION 0x2 BYTE_ORDER MSB_LAST /end CHARACTERISTIC
/begin CHARACTERISTIC _g_PL_AD_fw_Radar_1R1V_rpc_LocBypassingRunnable_LocBypassingRunnable_m_pad_ensRLocationsPort_par_out_local.TChangeableMemPool._._._m_arrayPool._0_._elem._m_LocationList._Item._112_._Rcs._m_value "" VALUE 0xB0010E30 __Float16_Value 0 NO_COMPU_METHOD -65504 65504 ECU_ADDRESS_EXTENSION 0x2 BYTE_ORDER MSB_LAST /end CHARACTERISTIC
/begin CHARACTERISTIC _g_PL_AD_fw_Radar_1R1V_rpc_LocBypassingRunnable_LocBypassingRunnable_m_pad_ensRLocationsPort_par_out_local.TChangeableMemPool._._._m_arrayPool._0_._elem._m_LocationList._Item._112_._Rssi._m_value "" VALUE 0xB0010E32 __Float16_Value 0 NO_COMPU_METHOD -65504 65504 ECU_ADDRESS_EXTENSION 0x2 BYTE_ORDER MSB_LAST /end CHARACTERISTIC
/begin CHARACTERISTIC _g_PL_AD_fw_Radar_1R1V_rpc_LocBypassingRunnable_LocBypassingRunnable_m_pad_ensRLocationsPort_par_out_local.TChangeableMemPool._._._m_arrayPool._0_._elem._m_LocationList._Item._112_._d "" VALUE 0xB0010E18 __Float32_Value 0 NO_COMPU_METHOD -3.4028234663852886E+38 3.4028234663852886E+38 ECU_ADDRESS_EXTENSION 0x2 BYTE_ORDER MSB_LAST /end CHARACTERISTIC
/begin CHARACTERISTIC _g_PL_AD_fw_Radar_1R1V_rpc_LocBypassingRunnable_LocBypassingRunnable_m_pad_ensRLocationsPort_par_out_local.TChangeableMemPool._._._m_arrayPool._0_._elem._m_LocationList._Item._112_._dVar._m_value "" VALUE 0xB0010E20 __Float16_Value 0 NO_COMPU_METHOD -65504 65504 ECU_ADDRESS_EXTENSION 0x2 BYTE_ORDER MSB_LAST /end CHARACTERISTIC
/begin CHARACTERISTIC _g_PL_AD_fw_Radar_1R1V_rpc_LocBypassingRunnable_LocBypassingRunnable_m_pad_ensRLocationsPort_par_out_local.TChangeableMemPool._._._m_arrayPool._0_._elem._m_LocationList._Item._112_._dvCov._m_value "" VALUE 0xB0010E24 __Float16_Value 0 NO_COMPU_METHOD -65504 65504 ECU_ADDRESS_EXTENSION 0x2 BYTE_ORDER MSB_LAST /end CHARACTERISTIC
/begin CHARACTERISTIC _g_PL_AD_fw_Radar_1R1V_rpc_LocBypassingRunnable_LocBypassingRunnable_m_pad_ensRLocationsPort_par_out_local.TChangeableMemPool._._._m_arrayPool._0_._elem._m_LocationList._Item._112_._dvQly "" VALUE 0xB0010E34 __UByte_Value 0 NO_COMPU_METHOD 0 255 ECU_ADDRESS_EXTENSION 0x2 BYTE_ORDER MSB_LAST /end CHARACTERISTIC
/begin CHARACTERISTIC _g_PL_AD_fw_Radar_1R1V_rpc_LocBypassingRunnable_LocBypassingRunnable_m_pad_ensRLocationsPort_par_out_local.TChangeableMemPool._._._m_arrayPool._0_._elem._m_LocationList._Item._112_._idxAzimuthAmbiguityPeer "" VALUE 0xB0010E36 __UWord_Value 0 NO_COMPU_METHOD 0 65535 ECU_ADDRESS_EXTENSION 0x2 BYTE_ORDER MSB_LAST /end CHARACTERISTIC
/begin CHARACTERISTIC _g_PL_AD_fw_Radar_1R1V_rpc_LocBypassingRunnable_LocBypassingRunnable_m_pad_ensRLocationsPort_par_out_local.TChangeableMemPool._._._m_arrayPool._0_._elem._m_LocationList._Item._112_._measStatus "" VALUE 0xB0010E35 __UByte_Value 0 NO_COMPU_METHOD 0 255 ECU_ADDRESS_EXTENSION 0x2 BYTE_ORDER MSB_LAST /end CHARACTERISTIC
/begin CHARACTERISTIC _g_PL_AD_fw_Radar_1R1V_rpc_LocBypassingRunnable_LocBypassingRunnable_m_pad_ensRLocationsPort_par_out_local.TChangeableMemPool._._._m_arrayPool._0_._elem._m_LocationList._Item._112_._phi._m_value "" VALUE 0xB0010E28 __Float16_Value 0 NO_COMPU_METHOD -65504 65504 ECU_ADDRESS_EXTENSION 0x2 BYTE_ORDER MSB_LAST /end CHARACTERISTIC
/begin CHARACTERISTIC _g_PL_AD_fw_Radar_1R1V_rpc_LocBypassingRunnable_LocBypassingRunnable_m_pad_ensRLocationsPort_par_out_local.TChangeableMemPool._._._m_arrayPool._0_._elem._m_LocationList._Item._112_._phiQly "" VALUE 0xB0010E2B __UByte_Value 0 NO_COMPU_METHOD 0 255 ECU_ADDRESS_EXTENSION 0x2 BYTE_ORDER MSB_LAST /end CHARACTERISTIC
/begin CHARACTERISTIC _g_PL_AD_fw_Radar_1R1V_rpc_LocBypassingRunnable_LocBypassingRunnable_m_pad_ensRLocationsPort_par_out_local.TChangeableMemPool._._._m_arrayPool._0_._elem._m_LocationList._Item._112_._phiVar._m_value "" VALUE 0xB0010E2E __Float16_Value 0 NO_COMPU_METHOD -65504 65504 ECU_ADDRESS_EXTENSION 0x2 BYTE_ORDER MSB_LAST /end CHARACTERISTIC
/begin CHARACTERISTIC _g_PL_AD_fw_Radar_1R1V_rpc_LocBypassingRunnable_LocBypassingRunnable_m_pad_ensRLocationsPort_par_out_local.TChangeableMemPool._._._m_arrayPool._0_._elem._m_LocationList._Item._112_._theta._m_value "" VALUE 0xB0010E26 __Float16_Value 0 NO_COMPU_METHOD -65504 65504 ECU_ADDRESS_EXTENSION 0x2 BYTE_ORDER MSB_LAST /end CHARACTERISTIC
/begin CHARACTERISTIC _g_PL_AD_fw_Radar_1R1V_rpc_LocBypassingRunnable_LocBypassingRunnable_m_pad_ensRLocationsPort_par_out_local.TChangeableMemPool._._._m_arrayPool._0_._elem._m_LocationList._Item._112_._thetaQly "" VALUE 0xB0010E2A __UByte_Value 0 NO_COMPU_METHOD 0 255 ECU_ADDRESS_EXTENSION 0x2 BYTE_ORDER MSB_LAST /end CHARACTERISTIC
/begin CHARACTERISTIC _g_PL_AD_fw_Radar_1R1V_rpc_LocBypassingRunnable_LocBypassingRunnable_m_pad_ensRLocationsPort_par_out_local.TChangeableMemPool._._._m_arrayPool._0_._elem._m_LocationList._Item._112_._thetaVar._m_value "" VALUE 0xB0010E2C __Float16_Value 0 NO_COMPU_METHOD -65504 65504 ECU_ADDRESS_EXTENSION 0x2 BYTE_ORDER MSB_LAST /end CHARACTERISTIC
/begin CHARACTERISTIC _g_PL_AD_fw_Radar_1R1V_rpc_LocBypassingRunnable_LocBypassingRunnable_m_pad_ensRLocationsPort_par_out_local.TChangeableMemPool._._._m_arrayPool._0_._elem._m_LocationList._Item._112_._v "" VALUE 0xB0010E1C __Float32_Value 0 NO_COMPU_METHOD -3.4028234663852886E+38 3.4028234663852886E+38 ECU_ADDRESS_EXTENSION 0x2 BYTE_ORDER MSB_LAST /end CHARACTERISTIC
/begin CHARACTERISTIC _g_PL_AD_fw_Radar_1R1V_rpc_LocBypassingRunnable_LocBypassingRunnable_m_pad_ensRLocationsPort_par_out_local.TChangeableMemPool._._._m_arrayPool._0_._elem._m_LocationList._Item._112_._vVar._m_value "" VALUE 0xB0010E22 __Float16_Value 0 NO_COMPU_METHOD -65504 65504 ECU_ADDRESS_EXTENSION 0x2 BYTE_ORDER MSB_LAST /end CHARACTERISTIC
/begin CHARACTERISTIC _g_PL_AD_fw_Radar_1R1V_rpc_LocBypassingRunnable_LocBypassingRunnable_m_pad_ensRLocationsPort_par_out_local.TChangeableMemPool._._._m_arrayPool._0_._elem._m_LocationList._Item._113_._Rcs._m_value "" VALUE 0xB0010E50 __Float16_Value 0 NO_COMPU_METHOD -65504 65504 ECU_ADDRESS_EXTENSION 0x2 BYTE_ORDER MSB_LAST /end CHARACTERISTIC
/begin CHARACTERISTIC _g_PL_AD_fw_Radar_1R1V_rpc_LocBypassingRunnable_LocBypassingRunnable_m_pad_ensRLocationsPort_par_out_local.TChangeableMemPool._._._m_arrayPool._0_._elem._m_LocationList._Item._113_._Rssi._m_value "" VALUE 0xB0010E52 __Float16_Value 0 NO_COMPU_METHOD -65504 65504 ECU_ADDRESS_EXTENSION 0x2 BYTE_ORDER MSB_LAST /end CHARACTERISTIC
/begin CHARACTERISTIC _g_PL_AD_fw_Radar_1R1V_rpc_LocBypassingRunnable_LocBypassingRunnable_m_pad_ensRLocationsPort_par_out_local.TChangeableMemPool._._._m_arrayPool._0_._elem._m_LocationList._Item._113_._d "" VALUE 0xB0010E38 __Float32_Value 0 NO_COMPU_METHOD -3.4028234663852886E+38 3.4028234663852886E+38 ECU_ADDRESS_EXTENSION 0x2 BYTE_ORDER MSB_LAST /end CHARACTERISTIC
/begin CHARACTERISTIC _g_PL_AD_fw_Radar_1R1V_rpc_LocBypassingRunnable_LocBypassingRunnable_m_pad_ensRLocationsPort_par_out_local.TChangeableMemPool._._._m_arrayPool._0_._elem._m_LocationList._Item._113_._dVar._m_value "" VALUE 0xB0010E40 __Float16_Value 0 NO_COMPU_METHOD -65504 65504 ECU_ADDRESS_EXTENSION 0x2 BYTE_ORDER MSB_LAST /end CHARACTERISTIC
/begin CHARACTERISTIC _g_PL_AD_fw_Radar_1R1V_rpc_LocBypassingRunnable_LocBypassingRunnable_m_pad_ensRLocationsPort_par_out_local.TChangeableMemPool._._._m_arrayPool._0_._elem._m_LocationList._Item._113_._dvCov._m_value "" VALUE 0xB0010E44 __Float16_Value 0 NO_COMPU_METHOD -65504 65504 ECU_ADDRESS_EXTENSION 0x2 BYTE_ORDER MSB_LAST /end CHARACTERISTIC
/begin CHARACTERISTIC _g_PL_AD_fw_Radar_1R1V_rpc_LocBypassingRunnable_LocBypassingRunnable_m_pad_ensRLocationsPort_par_out_local.TChangeableMemPool._._._m_arrayPool._0_._elem._m_LocationList._Item._113_._dvQly "" VALUE 0xB0010E54 __UByte_Value 0 NO_COMPU_METHOD 0 255 ECU_ADDRESS_EXTENSION 0x2 BYTE_ORDER MSB_LAST /end CHARACTERISTIC
/begin CHARACTERISTIC _g_PL_AD_fw_Radar_1R1V_rpc_LocBypassingRunnable_LocBypassingRunnable_m_pad_ensRLocationsPort_par_out_local.TChangeableMemPool._._._m_arrayPool._0_._elem._m_LocationList._Item._113_._idxAzimuthAmbiguityPeer "" VALUE 0xB0010E56 __UWord_Value 0 NO_COMPU_METHOD 0 65535 ECU_ADDRESS_EXTENSION 0x2 BYTE_ORDER MSB_LAST /end CHARACTERISTIC
/begin CHARACTERISTIC _g_PL_AD_fw_Radar_1R1V_rpc_LocBypassingRunnable_LocBypassingRunnable_m_pad_ensRLocationsPort_par_out_local.TChangeableMemPool._._._m_arrayPool._0_._elem._m_LocationList._Item._113_._measStatus "" VALUE 0xB0010E55 __UByte_Value 0 NO_COMPU_METHOD 0 255 ECU_ADDRESS_EXTENSION 0x2 BYTE_ORDER MSB_LAST /end CHARACTERISTIC
/begin CHARACTERISTIC _g_PL_AD_fw_Radar_1R1V_rpc_LocBypassingRunnable_LocBypassingRunnable_m_pad_ensRLocationsPort_par_out_local.TChangeableMemPool._._._m_arrayPool._0_._elem._m_LocationList._Item._113_._phi._m_value "" VALUE 0xB0010E48 __Float16_Value 0 NO_COMPU_METHOD -65504 65504 ECU_ADDRESS_EXTENSION 0x2 BYTE_ORDER MSB_LAST /end CHARACTERISTIC
/begin CHARACTERISTIC _g_PL_AD_fw_Radar_1R1V_rpc_LocBypassingRunnable_LocBypassingRunnable_m_pad_ensRLocationsPort_par_out_local.TChangeableMemPool._._._m_arrayPool._0_._elem._m_LocationList._Item._113_._phiQly "" VALUE 0xB0010E4B __UByte_Value 0 NO_COMPU_METHOD 0 255 ECU_ADDRESS_EXTENSION 0x2 BYTE_ORDER MSB_LAST /end CHARACTERISTIC
/begin CHARACTERISTIC _g_PL_AD_fw_Radar_1R1V_rpc_LocBypassingRunnable_LocBypassingRunnable_m_pad_ensRLocationsPort_par_out_local.TChangeableMemPool._._._m_arrayPool._0_._elem._m_LocationList._Item._113_._phiVar._m_value "" VALUE 0xB0010E4E __Float16_Value 0 NO_COMPU_METHOD -65504 65504 ECU_ADDRESS_EXTENSION 0x2 BYTE_ORDER MSB_LAST /end CHARACTERISTIC
/begin CHARACTERISTIC _g_PL_AD_fw_Radar_1R1V_rpc_LocBypassingRunnable_LocBypassingRunnable_m_pad_ensRLocationsPort_par_out_local.TChangeableMemPool._._._m_arrayPool._0_._elem._m_LocationList._Item._113_._theta._m_value "" VALUE 0xB0010E46 __Float16_Value 0 NO_COMPU_METHOD -65504 65504 ECU_ADDRESS_EXTENSION 0x2 BYTE_ORDER MSB_LAST /end CHARACTERISTIC
/begin CHARACTERISTIC _g_PL_AD_fw_Radar_1R1V_rpc_LocBypassingRunnable_LocBypassingRunnable_m_pad_ensRLocationsPort_par_out_local.TChangeableMemPool._._._m_arrayPool._0_._elem._m_LocationList._Item._113_._thetaQly "" VALUE 0xB0010E4A __UByte_Value 0 NO_COMPU_METHOD 0 255 ECU_ADDRESS_EXTENSION 0x2 BYTE_ORDER MSB_LAST /end CHARACTERISTIC
/begin CHARACTERISTIC _g_PL_AD_fw_Radar_1R1V_rpc_LocBypassingRunnable_LocBypassingRunnable_m_pad_ensRLocationsPort_par_out_local.TChangeableMemPool._._._m_arrayPool._0_._elem._m_LocationList._Item._113_._thetaVar._m_value "" VALUE 0xB0010E4C __Float16_Value 0 NO_COMPU_METHOD -65504 65504 ECU_ADDRESS_EXTENSION 0x2 BYTE_ORDER MSB_LAST /end CHARACTERISTIC
/begin CHARACTERISTIC _g_PL_AD_fw_Radar_1R1V_rpc_LocBypassingRunnable_LocBypassingRunnable_m_pad_ensRLocationsPort_par_out_local.TChangeableMemPool._._._m_arrayPool._0_._elem._m_LocationList._Item._113_._v "" VALUE 0xB0010E3C __Float32_Value 0 NO_COMPU_METHOD -3.4028234663852886E+38 3.4028234663852886E+38 ECU_ADDRESS_EXTENSION 0x2 BYTE_ORDER MSB_LAST /end CHARACTERISTIC
/begin CHARACTERISTIC _g_PL_AD_fw_Radar_1R1V_rpc_LocBypassingRunnable_LocBypassingRunnable_m_pad_ensRLocationsPort_par_out_local.TChangeableMemPool._._._m_arrayPool._0_._elem._m_LocationList._Item._113_._vVar._m_value "" VALUE 0xB0010E42 __Float16_Value 0 NO_COMPU_METHOD -65504 65504 ECU_ADDRESS_EXTENSION 0x2 BYTE_ORDER MSB_LAST /end CHARACTERISTIC
/begin CHARACTERISTIC _g_PL_AD_fw_Radar_1R1V_rpc_LocBypassingRunnable_LocBypassingRunnable_m_pad_ensRLocationsPort_par_out_local.TChangeableMemPool._._._m_arrayPool._0_._elem._m_LocationList._Item._114_._Rcs._m_value "" VALUE 0xB0010E70 __Float16_Value 0 NO_COMPU_METHOD -65504 65504 ECU_ADDRESS_EXTENSION 0x2 BYTE_ORDER MSB_LAST /end CHARACTERISTIC
/begin CHARACTERISTIC _g_PL_AD_fw_Radar_1R1V_rpc_LocBypassingRunnable_LocBypassingRunnable_m_pad_ensRLocationsPort_par_out_local.TChangeableMemPool._._._m_arrayPool._0_._elem._m_LocationList._Item._114_._Rssi._m_value "" VALUE 0xB0010E72 __Float16_Value 0 NO_COMPU_METHOD -65504 65504 ECU_ADDRESS_EXTENSION 0x2 BYTE_ORDER MSB_LAST /end CHARACTERISTIC
/begin CHARACTERISTIC _g_PL_AD_fw_Radar_1R1V_rpc_LocBypassingRunnable_LocBypassingRunnable_m_pad_ensRLocationsPort_par_out_local.TChangeableMemPool._._._m_arrayPool._0_._elem._m_LocationList._Item._114_._d "" VALUE 0xB0010E58 __Float32_Value 0 NO_COMPU_METHOD -3.4028234663852886E+38 3.4028234663852886E+38 ECU_ADDRESS_EXTENSION 0x2 BYTE_ORDER MSB_LAST /end CHARACTERISTIC
/begin CHARACTERISTIC _g_PL_AD_fw_Radar_1R1V_rpc_LocBypassingRunnable_LocBypassingRunnable_m_pad_ensRLocationsPort_par_out_local.TChangeableMemPool._._._m_arrayPool._0_._elem._m_LocationList._Item._114_._dVar._m_value "" VALUE 0xB0010E60 __Float16_Value 0 NO_COMPU_METHOD -65504 65504 ECU_ADDRESS_EXTENSION 0x2 BYTE_ORDER MSB_LAST /end CHARACTERISTIC
/begin CHARACTERISTIC _g_PL_AD_fw_Radar_1R1V_rpc_LocBypassingRunnable_LocBypassingRunnable_m_pad_ensRLocationsPort_par_out_local.TChangeableMemPool._._._m_arrayPool._0_._elem._m_LocationList._Item._114_._dvCov._m_value "" VALUE 0xB0010E64 __Float16_Value 0 NO_COMPU_METHOD -65504 65504 ECU_ADDRESS_EXTENSION 0x2 BYTE_ORDER MSB_LAST /end CHARACTERISTIC
/begin CHARACTERISTIC _g_PL_AD_fw_Radar_1R1V_rpc_LocBypassingRunnable_LocBypassingRunnable_m_pad_ensRLocationsPort_par_out_local.TChangeableMemPool._._._m_arrayPool._0_._elem._m_LocationList._Item._114_._dvQly "" VALUE 0xB0010E74 __UByte_Value 0 NO_COMPU_METHOD 0 255 ECU_ADDRESS_EXTENSION 0x2 BYTE_ORDER MSB_LAST /end CHARACTERISTIC
/begin CHARACTERISTIC _g_PL_AD_fw_Radar_1R1V_rpc_LocBypassingRunnable_LocBypassingRunnable_m_pad_ensRLocationsPort_par_out_local.TChangeableMemPool._._._m_arrayPool._0_._elem._m_LocationList._Item._114_._idxAzimuthAmbiguityPeer "" VALUE 0xB0010E76 __UWord_Value 0 NO_COMPU_METHOD 0 65535 ECU_ADDRESS_EXTENSION 0x2 BYTE_ORDER MSB_LAST /end CHARACTERISTIC
/begin CHARACTERISTIC _g_PL_AD_fw_Radar_1R1V_rpc_LocBypassingRunnable_LocBypassingRunnable_m_pad_ensRLocationsPort_par_out_local.TChangeableMemPool._._._m_arrayPool._0_._elem._m_LocationList._Item._114_._measStatus "" VALUE 0xB0010E75 __UByte_Value 0 NO_COMPU_METHOD 0 255 ECU_ADDRESS_EXTENSION 0x2 BYTE_ORDER MSB_LAST /end CHARACTERISTIC
/begin CHARACTERISTIC _g_PL_AD_fw_Radar_1R1V_rpc_LocBypassingRunnable_LocBypassingRunnable_m_pad_ensRLocationsPort_par_out_local.TChangeableMemPool._._._m_arrayPool._0_._elem._m_LocationList._Item._114_._phi._m_value "" VALUE 0xB0010E68 __Float16_Value 0 NO_COMPU_METHOD -65504 65504 ECU_ADDRESS_EXTENSION 0x2 BYTE_ORDER MSB_LAST /end CHARACTERISTIC
/begin CHARACTERISTIC _g_PL_AD_fw_Radar_1R1V_rpc_LocBypassingRunnable_LocBypassingRunnable_m_pad_ensRLocationsPort_par_out_local.TChangeableMemPool._._._m_arrayPool._0_._elem._m_LocationList._Item._114_._phiQly "" VALUE 0xB0010E6B __UByte_Value 0 NO_COMPU_METHOD 0 255 ECU_ADDRESS_EXTENSION 0x2 BYTE_ORDER MSB_LAST /end CHARACTERISTIC
/begin CHARACTERISTIC _g_PL_AD_fw_Radar_1R1V_rpc_LocBypassingRunnable_LocBypassingRunnable_m_pad_ensRLocationsPort_par_out_local.TChangeableMemPool._._._m_arrayPool._0_._elem._m_LocationList._Item._114_._phiVar._m_value "" VALUE 0xB0010E6E __Float16_Value 0 NO_COMPU_METHOD -65504 65504 ECU_ADDRESS_EXTENSION 0x2 BYTE_ORDER MSB_LAST /end CHARACTERISTIC
/begin CHARACTERISTIC _g_PL_AD_fw_Radar_1R1V_rpc_LocBypassingRunnable_LocBypassingRunnable_m_pad_ensRLocationsPort_par_out_local.TChangeableMemPool._._._m_arrayPool._0_._elem._m_LocationList._Item._114_._theta._m_value "" VALUE 0xB0010E66 __Float16_Value 0 NO_COMPU_METHOD -65504 65504 ECU_ADDRESS_EXTENSION 0x2 BYTE_ORDER MSB_LAST /end CHARACTERISTIC
/begin CHARACTERISTIC _g_PL_AD_fw_Radar_1R1V_rpc_LocBypassingRunnable_LocBypassingRunnable_m_pad_ensRLocationsPort_par_out_local.TChangeableMemPool._._._m_arrayPool._0_._elem._m_LocationList._Item._114_._thetaQly "" VALUE 0xB0010E6A __UByte_Value 0 NO_COMPU_METHOD 0 255 ECU_ADDRESS_EXTENSION 0x2 BYTE_ORDER MSB_LAST /end CHARACTERISTIC
/begin CHARACTERISTIC _g_PL_AD_fw_Radar_1R1V_rpc_LocBypassingRunnable_LocBypassingRunnable_m_pad_ensRLocationsPort_par_out_local.TChangeableMemPool._._._m_arrayPool._0_._elem._m_LocationList._Item._114_._thetaVar._m_value "" VALUE 0xB0010E6C __Float16_Value 0 NO_COMPU_METHOD -65504 65504 ECU_ADDRESS_EXTENSION 0x2 BYTE_ORDER MSB_LAST /end CHARACTERISTIC
/begin CHARACTERISTIC _g_PL_AD_fw_Radar_1R1V_rpc_LocBypassingRunnable_LocBypassingRunnable_m_pad_ensRLocationsPort_par_out_local.TChangeableMemPool._._._m_arrayPool._0_._elem._m_LocationList._Item._114_._v "" VALUE 0xB0010E5C __Float32_Value 0 NO_COMPU_METHOD -3.4028234663852886E+38 3.4028234663852886E+38 ECU_ADDRESS_EXTENSION 0x2 BYTE_ORDER MSB_LAST /end CHARACTERISTIC
/begin CHARACTERISTIC _g_PL_AD_fw_Radar_1R1V_rpc_LocBypassingRunnable_LocBypassingRunnable_m_pad_ensRLocationsPort_par_out_local.TChangeableMemPool._._._m_arrayPool._0_._elem._m_LocationList._Item._114_._vVar._m_value "" VALUE 0xB0010E62 __Float16_Value 0 NO_COMPU_METHOD -65504 65504 ECU_ADDRESS_EXTENSION 0x2 BYTE_ORDER MSB_LAST /end CHARACTERISTIC
/begin CHARACTERISTIC _g_PL_AD_fw_Radar_1R1V_rpc_LocBypassingRunnable_LocBypassingRunnable_m_pad_ensRLocationsPort_par_out_local.TChangeableMemPool._._._m_arrayPool._0_._elem._m_LocationList._Item._115_._Rcs._m_value "" VALUE 0xB0010E90 __Float16_Value 0 NO_COMPU_METHOD -65504 65504 ECU_ADDRESS_EXTENSION 0x2 BYTE_ORDER MSB_LAST /end CHARACTERISTIC
/begin CHARACTERISTIC _g_PL_AD_fw_Radar_1R1V_rpc_LocBypassingRunnable_LocBypassingRunnable_m_pad_ensRLocationsPort_par_out_local.TChangeableMemPool._._._m_arrayPool._0_._elem._m_LocationList._Item._115_._Rssi._m_value "" VALUE 0xB0010E92 __Float16_Value 0 NO_COMPU_METHOD -65504 65504 ECU_ADDRESS_EXTENSION 0x2 BYTE_ORDER MSB_LAST /end CHARACTERISTIC
/begin CHARACTERISTIC _g_PL_AD_fw_Radar_1R1V_rpc_LocBypassingRunnable_LocBypassingRunnable_m_pad_ensRLocationsPort_par_out_local.TChangeableMemPool._._._m_arrayPool._0_._elem._m_LocationList._Item._115_._d "" VALUE 0xB0010E78 __Float32_Value 0 NO_COMPU_METHOD -3.4028234663852886E+38 3.4028234663852886E+38 ECU_ADDRESS_EXTENSION 0x2 BYTE_ORDER MSB_LAST /end CHARACTERISTIC
/begin CHARACTERISTIC _g_PL_AD_fw_Radar_1R1V_rpc_LocBypassingRunnable_LocBypassingRunnable_m_pad_ensRLocationsPort_par_out_local.TChangeableMemPool._._._m_arrayPool._0_._elem._m_LocationList._Item._115_._dVar._m_value "" VALUE 0xB0010E80 __Float16_Value 0 NO_COMPU_METHOD -65504 65504 ECU_ADDRESS_EXTENSION 0x2 BYTE_ORDER MSB_LAST /end CHARACTERISTIC
/begin CHARACTERISTIC _g_PL_AD_fw_Radar_1R1V_rpc_LocBypassingRunnable_LocBypassingRunnable_m_pad_ensRLocationsPort_par_out_local.TChangeableMemPool._._._m_arrayPool._0_._elem._m_LocationList._Item._115_._dvCov._m_value "" VALUE 0xB0010E84 __Float16_Value 0 NO_COMPU_METHOD -65504 65504 ECU_ADDRESS_EXTENSION 0x2 BYTE_ORDER MSB_LAST /end CHARACTERISTIC
/begin CHARACTERISTIC _g_PL_AD_fw_Radar_1R1V_rpc_LocBypassingRunnable_LocBypassingRunnable_m_pad_ensRLocationsPort_par_out_local.TChangeableMemPool._._._m_arrayPool._0_._elem._m_LocationList._Item._115_._dvQly "" VALUE 0xB0010E94 __UByte_Value 0 NO_COMPU_METHOD 0 255 ECU_ADDRESS_EXTENSION 0x2 BYTE_ORDER MSB_LAST /end CHARACTERISTIC
/begin CHARACTERISTIC _g_PL_AD_fw_Radar_1R1V_rpc_LocBypassingRunnable_LocBypassingRunnable_m_pad_ensRLocationsPort_par_out_local.TChangeableMemPool._._._m_arrayPool._0_._elem._m_LocationList._Item._115_._idxAzimuthAmbiguityPeer "" VALUE 0xB0010E96 __UWord_Value 0 NO_COMPU_METHOD 0 65535 ECU_ADDRESS_EXTENSION 0x2 BYTE_ORDER MSB_LAST /end CHARACTERISTIC
/begin CHARACTERISTIC _g_PL_AD_fw_Radar_1R1V_rpc_LocBypassingRunnable_LocBypassingRunnable_m_pad_ensRLocationsPort_par_out_local.TChangeableMemPool._._._m_arrayPool._0_._elem._m_LocationList._Item._115_._measStatus "" VALUE 0xB0010E95 __UByte_Value 0 NO_COMPU_METHOD 0 255 ECU_ADDRESS_EXTENSION 0x2 BYTE_ORDER MSB_LAST /end CHARACTERISTIC
/begin CHARACTERISTIC _g_PL_AD_fw_Radar_1R1V_rpc_LocBypassingRunnable_LocBypassingRunnable_m_pad_ensRLocationsPort_par_out_local.TChangeableMemPool._._._m_arrayPool._0_._elem._m_LocationList._Item._115_._phi._m_value "" VALUE 0xB0010E88 __Float16_Value 0 NO_COMPU_METHOD -65504 65504 ECU_ADDRESS_EXTENSION 0x2 BYTE_ORDER MSB_LAST /end CHARACTERISTIC
/begin CHARACTERISTIC _g_PL_AD_fw_Radar_1R1V_rpc_LocBypassingRunnable_LocBypassingRunnable_m_pad_ensRLocationsPort_par_out_local.TChangeableMemPool._._._m_arrayPool._0_._elem._m_LocationList._Item._115_._phiQly "" VALUE 0xB0010E8B __UByte_Value 0 NO_COMPU_METHOD 0 255 ECU_ADDRESS_EXTENSION 0x2 BYTE_ORDER MSB_LAST /end CHARACTERISTIC
/begin CHARACTERISTIC _g_PL_AD_fw_Radar_1R1V_rpc_LocBypassingRunnable_LocBypassingRunnable_m_pad_ensRLocationsPort_par_out_local.TChangeableMemPool._._._m_arrayPool._0_._elem._m_LocationList._Item._115_._phiVar._m_value "" VALUE 0xB0010E8E __Float16_Value 0 NO_COMPU_METHOD -65504 65504 ECU_ADDRESS_EXTENSION 0x2 BYTE_ORDER MSB_LAST /end CHARACTERISTIC
/begin CHARACTERISTIC _g_PL_AD_fw_Radar_1R1V_rpc_LocBypassingRunnable_LocBypassingRunnable_m_pad_ensRLocationsPort_par_out_local.TChangeableMemPool._._._m_arrayPool._0_._elem._m_LocationList._Item._115_._theta._m_value "" VALUE 0xB0010E86 __Float16_Value 0 NO_COMPU_METHOD -65504 65504 ECU_ADDRESS_EXTENSION 0x2 BYTE_ORDER MSB_LAST /end CHARACTERISTIC
/begin CHARACTERISTIC _g_PL_AD_fw_Radar_1R1V_rpc_LocBypassingRunnable_LocBypassingRunnable_m_pad_ensRLocationsPort_par_out_local.TChangeableMemPool._._._m_arrayPool._0_._elem._m_LocationList._Item._115_._thetaQly "" VALUE 0xB0010E8A __UByte_Value 0 NO_COMPU_METHOD 0 255 ECU_ADDRESS_EXTENSION 0x2 BYTE_ORDER MSB_LAST /end CHARACTERISTIC
/begin CHARACTERISTIC _g_PL_AD_fw_Radar_1R1V_rpc_LocBypassingRunnable_LocBypassingRunnable_m_pad_ensRLocationsPort_par_out_local.TChangeableMemPool._._._m_arrayPool._0_._elem._m_LocationList._Item._115_._thetaVar._m_value "" VALUE 0xB0010E8C __Float16_Value 0 NO_COMPU_METHOD -65504 65504 ECU_ADDRESS_EXTENSION 0x2 BYTE_ORDER MSB_LAST /end CHARACTERISTIC
/begin CHARACTERISTIC _g_PL_AD_fw_Radar_1R1V_rpc_LocBypassingRunnable_LocBypassingRunnable_m_pad_ensRLocationsPort_par_out_local.TChangeableMemPool._._._m_arrayPool._0_._elem._m_LocationList._Item._115_._v "" VALUE 0xB0010E7C __Float32_Value 0 NO_COMPU_METHOD -3.4028234663852886E+38 3.4028234663852886E+38 ECU_ADDRESS_EXTENSION 0x2 BYTE_ORDER MSB_LAST /end CHARACTERISTIC
/begin CHARACTERISTIC _g_PL_AD_fw_Radar_1R1V_rpc_LocBypassingRunnable_LocBypassingRunnable_m_pad_ensRLocationsPort_par_out_local.TChangeableMemPool._._._m_arrayPool._0_._elem._m_LocationList._Item._115_._vVar._m_value "" VALUE 0xB0010E82 __Float16_Value 0 NO_COMPU_METHOD -65504 65504 ECU_ADDRESS_EXTENSION 0x2 BYTE_ORDER MSB_LAST /end CHARACTERISTIC
/begin CHARACTERISTIC _g_PL_AD_fw_Radar_1R1V_rpc_LocBypassingRunnable_LocBypassingRunnable_m_pad_ensRLocationsPort_par_out_local.TChangeableMemPool._._._m_arrayPool._0_._elem._m_LocationList._Item._116_._Rcs._m_value "" VALUE 0xB0010EB0 __Float16_Value 0 NO_COMPU_METHOD -65504 65504 ECU_ADDRESS_EXTENSION 0x2 BYTE_ORDER MSB_LAST /end CHARACTERISTIC
/begin CHARACTERISTIC _g_PL_AD_fw_Radar_1R1V_rpc_LocBypassingRunnable_LocBypassingRunnable_m_pad_ensRLocationsPort_par_out_local.TChangeableMemPool._._._m_arrayPool._0_._elem._m_LocationList._Item._116_._Rssi._m_value "" VALUE 0xB0010EB2 __Float16_Value 0 NO_COMPU_METHOD -65504 65504 ECU_ADDRESS_EXTENSION 0x2 BYTE_ORDER MSB_LAST /end CHARACTERISTIC
/begin CHARACTERISTIC _g_PL_AD_fw_Radar_1R1V_rpc_LocBypassingRunnable_LocBypassingRunnable_m_pad_ensRLocationsPort_par_out_local.TChangeableMemPool._._._m_arrayPool._0_._elem._m_LocationList._Item._116_._d "" VALUE 0xB0010E98 __Float32_Value 0 NO_COMPU_METHOD -3.4028234663852886E+38 3.4028234663852886E+38 ECU_ADDRESS_EXTENSION 0x2 BYTE_ORDER MSB_LAST /end CHARACTERISTIC
/begin CHARACTERISTIC _g_PL_AD_fw_Radar_1R1V_rpc_LocBypassingRunnable_LocBypassingRunnable_m_pad_ensRLocationsPort_par_out_local.TChangeableMemPool._._._m_arrayPool._0_._elem._m_LocationList._Item._116_._dVar._m_value "" VALUE 0xB0010EA0 __Float16_Value 0 NO_COMPU_METHOD -65504 65504 ECU_ADDRESS_EXTENSION 0x2 BYTE_ORDER MSB_LAST /end CHARACTERISTIC
/begin CHARACTERISTIC _g_PL_AD_fw_Radar_1R1V_rpc_LocBypassingRunnable_LocBypassingRunnable_m_pad_ensRLocationsPort_par_out_local.TChangeableMemPool._._._m_arrayPool._0_._elem._m_LocationList._Item._116_._dvCov._m_value "" VALUE 0xB0010EA4 __Float16_Value 0 NO_COMPU_METHOD -65504 65504 ECU_ADDRESS_EXTENSION 0x2 BYTE_ORDER MSB_LAST /end CHARACTERISTIC
/begin CHARACTERISTIC _g_PL_AD_fw_Radar_1R1V_rpc_LocBypassingRunnable_LocBypassingRunnable_m_pad_ensRLocationsPort_par_out_local.TChangeableMemPool._._._m_arrayPool._0_._elem._m_LocationList._Item._116_._dvQly "" VALUE 0xB0010EB4 __UByte_Value 0 NO_COMPU_METHOD 0 255 ECU_ADDRESS_EXTENSION 0x2 BYTE_ORDER MSB_LAST /end CHARACTERISTIC
/begin CHARACTERISTIC _g_PL_AD_fw_Radar_1R1V_rpc_LocBypassingRunnable_LocBypassingRunnable_m_pad_ensRLocationsPort_par_out_local.TChangeableMemPool._._._m_arrayPool._0_._elem._m_LocationList._Item._116_._idxAzimuthAmbiguityPeer "" VALUE 0xB0010EB6 __UWord_Value 0 NO_COMPU_METHOD 0 65535 ECU_ADDRESS_EXTENSION 0x2 BYTE_ORDER MSB_LAST /end CHARACTERISTIC
/begin CHARACTERISTIC _g_PL_AD_fw_Radar_1R1V_rpc_LocBypassingRunnable_LocBypassingRunnable_m_pad_ensRLocationsPort_par_out_local.TChangeableMemPool._._._m_arrayPool._0_._elem._m_LocationList._Item._116_._measStatus "" VALUE 0xB0010EB5 __UByte_Value 0 NO_COMPU_METHOD 0 255 ECU_ADDRESS_EXTENSION 0x2 BYTE_ORDER MSB_LAST /end CHARACTERISTIC
/begin CHARACTERISTIC _g_PL_AD_fw_Radar_1R1V_rpc_LocBypassingRunnable_LocBypassingRunnable_m_pad_ensRLocationsPort_par_out_local.TChangeableMemPool._._._m_arrayPool._0_._elem._m_LocationList._Item._116_._phi._m_value "" VALUE 0xB0010EA8 __Float16_Value 0 NO_COMPU_METHOD -65504 65504 ECU_ADDRESS_EXTENSION 0x2 BYTE_ORDER MSB_LAST /end CHARACTERISTIC
/begin CHARACTERISTIC _g_PL_AD_fw_Radar_1R1V_rpc_LocBypassingRunnable_LocBypassingRunnable_m_pad_ensRLocationsPort_par_out_local.TChangeableMemPool._._._m_arrayPool._0_._elem._m_LocationList._Item._116_._phiQly "" VALUE 0xB0010EAB __UByte_Value 0 NO_COMPU_METHOD 0 255 ECU_ADDRESS_EXTENSION 0x2 BYTE_ORDER MSB_LAST /end CHARACTERISTIC
/begin CHARACTERISTIC _g_PL_AD_fw_Radar_1R1V_rpc_LocBypassingRunnable_LocBypassingRunnable_m_pad_ensRLocationsPort_par_out_local.TChangeableMemPool._._._m_arrayPool._0_._elem._m_LocationList._Item._116_._phiVar._m_value "" VALUE 0xB0010EAE __Float16_Value 0 NO_COMPU_METHOD -65504 65504 ECU_ADDRESS_EXTENSION 0x2 BYTE_ORDER MSB_LAST /end CHARACTERISTIC
/begin CHARACTERISTIC _g_PL_AD_fw_Radar_1R1V_rpc_LocBypassingRunnable_LocBypassingRunnable_m_pad_ensRLocationsPort_par_out_local.TChangeableMemPool._._._m_arrayPool._0_._elem._m_LocationList._Item._116_._theta._m_value "" VALUE 0xB0010EA6 __Float16_Value 0 NO_COMPU_METHOD -65504 65504 ECU_ADDRESS_EXTENSION 0x2 BYTE_ORDER MSB_LAST /end CHARACTERISTIC
/begin CHARACTERISTIC _g_PL_AD_fw_Radar_1R1V_rpc_LocBypassingRunnable_LocBypassingRunnable_m_pad_ensRLocationsPort_par_out_local.TChangeableMemPool._._._m_arrayPool._0_._elem._m_LocationList._Item._116_._thetaQly "" VALUE 0xB0010EAA __UByte_Value 0 NO_COMPU_METHOD 0 255 ECU_ADDRESS_EXTENSION 0x2 BYTE_ORDER MSB_LAST /end CHARACTERISTIC
/begin CHARACTERISTIC _g_PL_AD_fw_Radar_1R1V_rpc_LocBypassingRunnable_LocBypassingRunnable_m_pad_ensRLocationsPort_par_out_local.TChangeableMemPool._._._m_arrayPool._0_._elem._m_LocationList._Item._116_._thetaVar._m_value "" VALUE 0xB0010EAC __Float16_Value 0 NO_COMPU_METHOD -65504 65504 ECU_ADDRESS_EXTENSION 0x2 BYTE_ORDER MSB_LAST /end CHARACTERISTIC
/begin CHARACTERISTIC _g_PL_AD_fw_Radar_1R1V_rpc_LocBypassingRunnable_LocBypassingRunnable_m_pad_ensRLocationsPort_par_out_local.TChangeableMemPool._._._m_arrayPool._0_._elem._m_LocationList._Item._116_._v "" VALUE 0xB0010E9C __Float32_Value 0 NO_COMPU_METHOD -3.4028234663852886E+38 3.4028234663852886E+38 ECU_ADDRESS_EXTENSION 0x2 BYTE_ORDER MSB_LAST /end CHARACTERISTIC
/begin CHARACTERISTIC _g_PL_AD_fw_Radar_1R1V_rpc_LocBypassingRunnable_LocBypassingRunnable_m_pad_ensRLocationsPort_par_out_local.TChangeableMemPool._._._m_arrayPool._0_._elem._m_LocationList._Item._116_._vVar._m_value "" VALUE 0xB0010EA2 __Float16_Value 0 NO_COMPU_METHOD -65504 65504 ECU_ADDRESS_EXTENSION 0x2 BYTE_ORDER MSB_LAST /end CHARACTERISTIC
/begin CHARACTERISTIC _g_PL_AD_fw_Radar_1R1V_rpc_LocBypassingRunnable_LocBypassingRunnable_m_pad_ensRLocationsPort_par_out_local.TChangeableMemPool._._._m_arrayPool._0_._elem._m_LocationList._Item._117_._Rcs._m_value "" VALUE 0xB0010ED0 __Float16_Value 0 NO_COMPU_METHOD -65504 65504 ECU_ADDRESS_EXTENSION 0x2 BYTE_ORDER MSB_LAST /end CHARACTERISTIC
/begin CHARACTERISTIC _g_PL_AD_fw_Radar_1R1V_rpc_LocBypassingRunnable_LocBypassingRunnable_m_pad_ensRLocationsPort_par_out_local.TChangeableMemPool._._._m_arrayPool._0_._elem._m_LocationList._Item._117_._Rssi._m_value "" VALUE 0xB0010ED2 __Float16_Value 0 NO_COMPU_METHOD -65504 65504 ECU_ADDRESS_EXTENSION 0x2 BYTE_ORDER MSB_LAST /end CHARACTERISTIC
/begin CHARACTERISTIC _g_PL_AD_fw_Radar_1R1V_rpc_LocBypassingRunnable_LocBypassingRunnable_m_pad_ensRLocationsPort_par_out_local.TChangeableMemPool._._._m_arrayPool._0_._elem._m_LocationList._Item._117_._d "" VALUE 0xB0010EB8 __Float32_Value 0 NO_COMPU_METHOD -3.4028234663852886E+38 3.4028234663852886E+38 ECU_ADDRESS_EXTENSION 0x2 BYTE_ORDER MSB_LAST /end CHARACTERISTIC
/begin CHARACTERISTIC _g_PL_AD_fw_Radar_1R1V_rpc_LocBypassingRunnable_LocBypassingRunnable_m_pad_ensRLocationsPort_par_out_local.TChangeableMemPool._._._m_arrayPool._0_._elem._m_LocationList._Item._117_._dVar._m_value "" VALUE 0xB0010EC0 __Float16_Value 0 NO_COMPU_METHOD -65504 65504 ECU_ADDRESS_EXTENSION 0x2 BYTE_ORDER MSB_LAST /end CHARACTERISTIC
/begin CHARACTERISTIC _g_PL_AD_fw_Radar_1R1V_rpc_LocBypassingRunnable_LocBypassingRunnable_m_pad_ensRLocationsPort_par_out_local.TChangeableMemPool._._._m_arrayPool._0_._elem._m_LocationList._Item._117_._dvCov._m_value "" VALUE 0xB0010EC4 __Float16_Value 0 NO_COMPU_METHOD -65504 65504 ECU_ADDRESS_EXTENSION 0x2 BYTE_ORDER MSB_LAST /end CHARACTERISTIC
/begin CHARACTERISTIC _g_PL_AD_fw_Radar_1R1V_rpc_LocBypassingRunnable_LocBypassingRunnable_m_pad_ensRLocationsPort_par_out_local.TChangeableMemPool._._._m_arrayPool._0_._elem._m_LocationList._Item._117_._dvQly "" VALUE 0xB0010ED4 __UByte_Value 0 NO_COMPU_METHOD 0 255 ECU_ADDRESS_EXTENSION 0x2 BYTE_ORDER MSB_LAST /end CHARACTERISTIC
/begin CHARACTERISTIC _g_PL_AD_fw_Radar_1R1V_rpc_LocBypassingRunnable_LocBypassingRunnable_m_pad_ensRLocationsPort_par_out_local.TChangeableMemPool._._._m_arrayPool._0_._elem._m_LocationList._Item._117_._idxAzimuthAmbiguityPeer "" VALUE 0xB0010ED6 __UWord_Value 0 NO_COMPU_METHOD 0 65535 ECU_ADDRESS_EXTENSION 0x2 BYTE_ORDER MSB_LAST /end CHARACTERISTIC
/begin CHARACTERISTIC _g_PL_AD_fw_Radar_1R1V_rpc_LocBypassingRunnable_LocBypassingRunnable_m_pad_ensRLocationsPort_par_out_local.TChangeableMemPool._._._m_arrayPool._0_._elem._m_LocationList._Item._117_._measStatus "" VALUE 0xB0010ED5 __UByte_Value 0 NO_COMPU_METHOD 0 255 ECU_ADDRESS_EXTENSION 0x2 BYTE_ORDER MSB_LAST /end CHARACTERISTIC
/begin CHARACTERISTIC _g_PL_AD_fw_Radar_1R1V_rpc_LocBypassingRunnable_LocBypassingRunnable_m_pad_ensRLocationsPort_par_out_local.TChangeableMemPool._._._m_arrayPool._0_._elem._m_LocationList._Item._117_._phi._m_value "" VALUE 0xB0010EC8 __Float16_Value 0 NO_COMPU_METHOD -65504 65504 ECU_ADDRESS_EXTENSION 0x2 BYTE_ORDER MSB_LAST /end CHARACTERISTIC
/begin CHARACTERISTIC _g_PL_AD_fw_Radar_1R1V_rpc_LocBypassingRunnable_LocBypassingRunnable_m_pad_ensRLocationsPort_par_out_local.TChangeableMemPool._._._m_arrayPool._0_._elem._m_LocationList._Item._117_._phiQly "" VALUE 0xB0010ECB __UByte_Value 0 NO_COMPU_METHOD 0 255 ECU_ADDRESS_EXTENSION 0x2 BYTE_ORDER MSB_LAST /end CHARACTERISTIC
/begin CHARACTERISTIC _g_PL_AD_fw_Radar_1R1V_rpc_LocBypassingRunnable_LocBypassingRunnable_m_pad_ensRLocationsPort_par_out_local.TChangeableMemPool._._._m_arrayPool._0_._elem._m_LocationList._Item._117_._phiVar._m_value "" VALUE 0xB0010ECE __Float16_Value 0 NO_COMPU_METHOD -65504 65504 ECU_ADDRESS_EXTENSION 0x2 BYTE_ORDER MSB_LAST /end CHARACTERISTIC
/begin CHARACTERISTIC _g_PL_AD_fw_Radar_1R1V_rpc_LocBypassingRunnable_LocBypassingRunnable_m_pad_ensRLocationsPort_par_out_local.TChangeableMemPool._._._m_arrayPool._0_._elem._m_LocationList._Item._117_._theta._m_value "" VALUE 0xB0010EC6 __Float16_Value 0 NO_COMPU_METHOD -65504 65504 ECU_ADDRESS_EXTENSION 0x2 BYTE_ORDER MSB_LAST /end CHARACTERISTIC
/begin CHARACTERISTIC _g_PL_AD_fw_Radar_1R1V_rpc_LocBypassingRunnable_LocBypassingRunnable_m_pad_ensRLocationsPort_par_out_local.TChangeableMemPool._._._m_arrayPool._0_._elem._m_LocationList._Item._117_._thetaQly "" VALUE 0xB0010ECA __UByte_Value 0 NO_COMPU_METHOD 0 255 ECU_ADDRESS_EXTENSION 0x2 BYTE_ORDER MSB_LAST /end CHARACTERISTIC
/begin CHARACTERISTIC _g_PL_AD_fw_Radar_1R1V_rpc_LocBypassingRunnable_LocBypassingRunnable_m_pad_ensRLocationsPort_par_out_local.TChangeableMemPool._._._m_arrayPool._0_._elem._m_LocationList._Item._117_._thetaVar._m_value "" VALUE 0xB0010ECC __Float16_Value 0 NO_COMPU_METHOD -65504 65504 ECU_ADDRESS_EXTENSION 0x2 BYTE_ORDER MSB_LAST /end CHARACTERISTIC
/begin CHARACTERISTIC _g_PL_AD_fw_Radar_1R1V_rpc_LocBypassingRunnable_LocBypassingRunnable_m_pad_ensRLocationsPort_par_out_local.TChangeableMemPool._._._m_arrayPool._0_._elem._m_LocationList._Item._117_._v "" VALUE 0xB0010EBC __Float32_Value 0 NO_COMPU_METHOD -3.4028234663852886E+38 3.4028234663852886E+38 ECU_ADDRESS_EXTENSION 0x2 BYTE_ORDER MSB_LAST /end CHARACTERISTIC
/begin CHARACTERISTIC _g_PL_AD_fw_Radar_1R1V_rpc_LocBypassingRunnable_LocBypassingRunnable_m_pad_ensRLocationsPort_par_out_local.TChangeableMemPool._._._m_arrayPool._0_._elem._m_LocationList._Item._117_._vVar._m_value "" VALUE 0xB0010EC2 __Float16_Value 0 NO_COMPU_METHOD -65504 65504 ECU_ADDRESS_EXTENSION 0x2 BYTE_ORDER MSB_LAST /end CHARACTERISTIC
/begin CHARACTERISTIC _g_PL_AD_fw_Radar_1R1V_rpc_LocBypassingRunnable_LocBypassingRunnable_m_pad_ensRLocationsPort_par_out_local.TChangeableMemPool._._._m_arrayPool._0_._elem._m_LocationList._Item._118_._Rcs._m_value "" VALUE 0xB0010EF0 __Float16_Value 0 NO_COMPU_METHOD -65504 65504 ECU_ADDRESS_EXTENSION 0x2 BYTE_ORDER MSB_LAST /end CHARACTERISTIC
/begin CHARACTERISTIC _g_PL_AD_fw_Radar_1R1V_rpc_LocBypassingRunnable_LocBypassingRunnable_m_pad_ensRLocationsPort_par_out_local.TChangeableMemPool._._._m_arrayPool._0_._elem._m_LocationList._Item._118_._Rssi._m_value "" VALUE 0xB0010EF2 __Float16_Value 0 NO_COMPU_METHOD -65504 65504 ECU_ADDRESS_EXTENSION 0x2 BYTE_ORDER MSB_LAST /end CHARACTERISTIC
/begin CHARACTERISTIC _g_PL_AD_fw_Radar_1R1V_rpc_LocBypassingRunnable_LocBypassingRunnable_m_pad_ensRLocationsPort_par_out_local.TChangeableMemPool._._._m_arrayPool._0_._elem._m_LocationList._Item._118_._d "" VALUE 0xB0010ED8 __Float32_Value 0 NO_COMPU_METHOD -3.4028234663852886E+38 3.4028234663852886E+38 ECU_ADDRESS_EXTENSION 0x2 BYTE_ORDER MSB_LAST /end CHARACTERISTIC
/begin CHARACTERISTIC _g_PL_AD_fw_Radar_1R1V_rpc_LocBypassingRunnable_LocBypassingRunnable_m_pad_ensRLocationsPort_par_out_local.TChangeableMemPool._._._m_arrayPool._0_._elem._m_LocationList._Item._118_._dVar._m_value "" VALUE 0xB0010EE0 __Float16_Value 0 NO_COMPU_METHOD -65504 65504 ECU_ADDRESS_EXTENSION 0x2 BYTE_ORDER MSB_LAST /end CHARACTERISTIC
/begin CHARACTERISTIC _g_PL_AD_fw_Radar_1R1V_rpc_LocBypassingRunnable_LocBypassingRunnable_m_pad_ensRLocationsPort_par_out_local.TChangeableMemPool._._._m_arrayPool._0_._elem._m_LocationList._Item._118_._dvCov._m_value "" VALUE 0xB0010EE4 __Float16_Value 0 NO_COMPU_METHOD -65504 65504 ECU_ADDRESS_EXTENSION 0x2 BYTE_ORDER MSB_LAST /end CHARACTERISTIC
/begin CHARACTERISTIC _g_PL_AD_fw_Radar_1R1V_rpc_LocBypassingRunnable_LocBypassingRunnable_m_pad_ensRLocationsPort_par_out_local.TChangeableMemPool._._._m_arrayPool._0_._elem._m_LocationList._Item._118_._dvQly "" VALUE 0xB0010EF4 __UByte_Value 0 NO_COMPU_METHOD 0 255 ECU_ADDRESS_EXTENSION 0x2 BYTE_ORDER MSB_LAST /end CHARACTERISTIC
/begin CHARACTERISTIC _g_PL_AD_fw_Radar_1R1V_rpc_LocBypassingRunnable_LocBypassingRunnable_m_pad_ensRLocationsPort_par_out_local.TChangeableMemPool._._._m_arrayPool._0_._elem._m_LocationList._Item._118_._idxAzimuthAmbiguityPeer "" VALUE 0xB0010EF6 __UWord_Value 0 NO_COMPU_METHOD 0 65535 ECU_ADDRESS_EXTENSION 0x2 BYTE_ORDER MSB_LAST /end CHARACTERISTIC
/begin CHARACTERISTIC _g_PL_AD_fw_Radar_1R1V_rpc_LocBypassingRunnable_LocBypassingRunnable_m_pad_ensRLocationsPort_par_out_local.TChangeableMemPool._._._m_arrayPool._0_._elem._m_LocationList._Item._118_._measStatus "" VALUE 0xB0010EF5 __UByte_Value 0 NO_COMPU_METHOD 0 255 ECU_ADDRESS_EXTENSION 0x2 BYTE_ORDER MSB_LAST /end CHARACTERISTIC
/begin CHARACTERISTIC _g_PL_AD_fw_Radar_1R1V_rpc_LocBypassingRunnable_LocBypassingRunnable_m_pad_ensRLocationsPort_par_out_local.TChangeableMemPool._._._m_arrayPool._0_._elem._m_LocationList._Item._118_._phi._m_value "" VALUE 0xB0010EE8 __Float16_Value 0 NO_COMPU_METHOD -65504 65504 ECU_ADDRESS_EXTENSION 0x2 BYTE_ORDER MSB_LAST /end CHARACTERISTIC
/begin CHARACTERISTIC _g_PL_AD_fw_Radar_1R1V_rpc_LocBypassingRunnable_LocBypassingRunnable_m_pad_ensRLocationsPort_par_out_local.TChangeableMemPool._._._m_arrayPool._0_._elem._m_LocationList._Item._118_._phiQly "" VALUE 0xB0010EEB __UByte_Value 0 NO_COMPU_METHOD 0 255 ECU_ADDRESS_EXTENSION 0x2 BYTE_ORDER MSB_LAST /end CHARACTERISTIC
/begin CHARACTERISTIC _g_PL_AD_fw_Radar_1R1V_rpc_LocBypassingRunnable_LocBypassingRunnable_m_pad_ensRLocationsPort_par_out_local.TChangeableMemPool._._._m_arrayPool._0_._elem._m_LocationList._Item._118_._phiVar._m_value "" VALUE 0xB0010EEE __Float16_Value 0 NO_COMPU_METHOD -65504 65504 ECU_ADDRESS_EXTENSION 0x2 BYTE_ORDER MSB_LAST /end CHARACTERISTIC
/begin CHARACTERISTIC _g_PL_AD_fw_Radar_1R1V_rpc_LocBypassingRunnable_LocBypassingRunnable_m_pad_ensRLocationsPort_par_out_local.TChangeableMemPool._._._m_arrayPool._0_._elem._m_LocationList._Item._118_._theta._m_value "" VALUE 0xB0010EE6 __Float16_Value 0 NO_COMPU_METHOD -65504 65504 ECU_ADDRESS_EXTENSION 0x2 BYTE_ORDER MSB_LAST /end CHARACTERISTIC
/begin CHARACTERISTIC _g_PL_AD_fw_Radar_1R1V_rpc_LocBypassingRunnable_LocBypassingRunnable_m_pad_ensRLocationsPort_par_out_local.TChangeableMemPool._._._m_arrayPool._0_._elem._m_LocationList._Item._118_._thetaQly "" VALUE 0xB0010EEA __UByte_Value 0 NO_COMPU_METHOD 0 255 ECU_ADDRESS_EXTENSION 0x2 BYTE_ORDER MSB_LAST /end CHARACTERISTIC
/begin CHARACTERISTIC _g_PL_AD_fw_Radar_1R1V_rpc_LocBypassingRunnable_LocBypassingRunnable_m_pad_ensRLocationsPort_par_out_local.TChangeableMemPool._._._m_arrayPool._0_._elem._m_LocationList._Item._118_._thetaVar._m_value "" VALUE 0xB0010EEC __Float16_Value 0 NO_COMPU_METHOD -65504 65504 ECU_ADDRESS_EXTENSION 0x2 BYTE_ORDER MSB_LAST /end CHARACTERISTIC
/begin CHARACTERISTIC _g_PL_AD_fw_Radar_1R1V_rpc_LocBypassingRunnable_LocBypassingRunnable_m_pad_ensRLocationsPort_par_out_local.TChangeableMemPool._._._m_arrayPool._0_._elem._m_LocationList._Item._118_._v "" VALUE 0xB0010EDC __Float32_Value 0 NO_COMPU_METHOD -3.4028234663852886E+38 3.4028234663852886E+38 ECU_ADDRESS_EXTENSION 0x2 BYTE_ORDER MSB_LAST /end CHARACTERISTIC
/begin CHARACTERISTIC _g_PL_AD_fw_Radar_1R1V_rpc_LocBypassingRunnable_LocBypassingRunnable_m_pad_ensRLocationsPort_par_out_local.TChangeableMemPool._._._m_arrayPool._0_._elem._m_LocationList._Item._118_._vVar._m_value "" VALUE 0xB0010EE2 __Float16_Value 0 NO_COMPU_METHOD -65504 65504 ECU_ADDRESS_EXTENSION 0x2 BYTE_ORDER MSB_LAST /end CHARACTERISTIC
/begin CHARACTERISTIC _g_PL_AD_fw_Radar_1R1V_rpc_LocBypassingRunnable_LocBypassingRunnable_m_pad_ensRLocationsPort_par_out_local.TChangeableMemPool._._._m_arrayPool._0_._elem._m_LocationList._Item._119_._Rcs._m_value "" VALUE 0xB0010F10 __Float16_Value 0 NO_COMPU_METHOD -65504 65504 ECU_ADDRESS_EXTENSION 0x2 BYTE_ORDER MSB_LAST /end CHARACTERISTIC
/begin CHARACTERISTIC _g_PL_AD_fw_Radar_1R1V_rpc_LocBypassingRunnable_LocBypassingRunnable_m_pad_ensRLocationsPort_par_out_local.TChangeableMemPool._._._m_arrayPool._0_._elem._m_LocationList._Item._119_._Rssi._m_value "" VALUE 0xB0010F12 __Float16_Value 0 NO_COMPU_METHOD -65504 65504 ECU_ADDRESS_EXTENSION 0x2 BYTE_ORDER MSB_LAST /end CHARACTERISTIC
/begin CHARACTERISTIC _g_PL_AD_fw_Radar_1R1V_rpc_LocBypassingRunnable_LocBypassingRunnable_m_pad_ensRLocationsPort_par_out_local.TChangeableMemPool._._._m_arrayPool._0_._elem._m_LocationList._Item._119_._d "" VALUE 0xB0010EF8 __Float32_Value 0 NO_COMPU_METHOD -3.4028234663852886E+38 3.4028234663852886E+38 ECU_ADDRESS_EXTENSION 0x2 BYTE_ORDER MSB_LAST /end CHARACTERISTIC
/begin CHARACTERISTIC _g_PL_AD_fw_Radar_1R1V_rpc_LocBypassingRunnable_LocBypassingRunnable_m_pad_ensRLocationsPort_par_out_local.TChangeableMemPool._._._m_arrayPool._0_._elem._m_LocationList._Item._119_._dVar._m_value "" VALUE 0xB0010F00 __Float16_Value 0 NO_COMPU_METHOD -65504 65504 ECU_ADDRESS_EXTENSION 0x2 BYTE_ORDER MSB_LAST /end CHARACTERISTIC
/begin CHARACTERISTIC _g_PL_AD_fw_Radar_1R1V_rpc_LocBypassingRunnable_LocBypassingRunnable_m_pad_ensRLocationsPort_par_out_local.TChangeableMemPool._._._m_arrayPool._0_._elem._m_LocationList._Item._119_._dvCov._m_value "" VALUE 0xB0010F04 __Float16_Value 0 NO_COMPU_METHOD -65504 65504 ECU_ADDRESS_EXTENSION 0x2 BYTE_ORDER MSB_LAST /end CHARACTERISTIC
/begin CHARACTERISTIC _g_PL_AD_fw_Radar_1R1V_rpc_LocBypassingRunnable_LocBypassingRunnable_m_pad_ensRLocationsPort_par_out_local.TChangeableMemPool._._._m_arrayPool._0_._elem._m_LocationList._Item._119_._dvQly "" VALUE 0xB0010F14 __UByte_Value 0 NO_COMPU_METHOD 0 255 ECU_ADDRESS_EXTENSION 0x2 BYTE_ORDER MSB_LAST /end CHARACTERISTIC
/begin CHARACTERISTIC _g_PL_AD_fw_Radar_1R1V_rpc_LocBypassingRunnable_LocBypassingRunnable_m_pad_ensRLocationsPort_par_out_local.TChangeableMemPool._._._m_arrayPool._0_._elem._m_LocationList._Item._119_._idxAzimuthAmbiguityPeer "" VALUE 0xB0010F16 __UWord_Value 0 NO_COMPU_METHOD 0 65535 ECU_ADDRESS_EXTENSION 0x2 BYTE_ORDER MSB_LAST /end CHARACTERISTIC
/begin CHARACTERISTIC _g_PL_AD_fw_Radar_1R1V_rpc_LocBypassingRunnable_LocBypassingRunnable_m_pad_ensRLocationsPort_par_out_local.TChangeableMemPool._._._m_arrayPool._0_._elem._m_LocationList._Item._119_._measStatus "" VALUE 0xB0010F15 __UByte_Value 0 NO_COMPU_METHOD 0 255 ECU_ADDRESS_EXTENSION 0x2 BYTE_ORDER MSB_LAST /end CHARACTERISTIC
/begin CHARACTERISTIC _g_PL_AD_fw_Radar_1R1V_rpc_LocBypassingRunnable_LocBypassingRunnable_m_pad_ensRLocationsPort_par_out_local.TChangeableMemPool._._._m_arrayPool._0_._elem._m_LocationList._Item._119_._phi._m_value "" VALUE 0xB0010F08 __Float16_Value 0 NO_COMPU_METHOD -65504 65504 ECU_ADDRESS_EXTENSION 0x2 BYTE_ORDER MSB_LAST /end CHARACTERISTIC
/begin CHARACTERISTIC _g_PL_AD_fw_Radar_1R1V_rpc_LocBypassingRunnable_LocBypassingRunnable_m_pad_ensRLocationsPort_par_out_local.TChangeableMemPool._._._m_arrayPool._0_._elem._m_LocationList._Item._119_._phiQly "" VALUE 0xB0010F0B __UByte_Value 0 NO_COMPU_METHOD 0 255 ECU_ADDRESS_EXTENSION 0x2 BYTE_ORDER MSB_LAST /end CHARACTERISTIC
/begin CHARACTERISTIC _g_PL_AD_fw_Radar_1R1V_rpc_LocBypassingRunnable_LocBypassingRunnable_m_pad_ensRLocationsPort_par_out_local.TChangeableMemPool._._._m_arrayPool._0_._elem._m_LocationList._Item._119_._phiVar._m_value "" VALUE 0xB0010F0E __Float16_Value 0 NO_COMPU_METHOD -65504 65504 ECU_ADDRESS_EXTENSION 0x2 BYTE_ORDER MSB_LAST /end CHARACTERISTIC
/begin CHARACTERISTIC _g_PL_AD_fw_Radar_1R1V_rpc_LocBypassingRunnable_LocBypassingRunnable_m_pad_ensRLocationsPort_par_out_local.TChangeableMemPool._._._m_arrayPool._0_._elem._m_LocationList._Item._119_._theta._m_value "" VALUE 0xB0010F06 __Float16_Value 0 NO_COMPU_METHOD -65504 65504 ECU_ADDRESS_EXTENSION 0x2 BYTE_ORDER MSB_LAST /end CHARACTERISTIC
/begin COMPU_METHOD AAL_MSG "enumeration table" TAB_VERB "%.0" "" COMPU_TAB_REF AAL_MSG /end COMPU_METHOD
/begin COMPU_METHOD AAL_MSG.OLD_Copy1 "enumeration table" TAB_VERB "%.0" "" COMPU_TAB_REF AAL_MSG.OLD_1 /end COMPU_METHOD
/begin COMPU_METHOD AAL_MSG.OLD_Copy2 "enumeration table" TAB_VERB "%.0" "" COMPU_TAB_REF AAL_MSG.OLD_2 /end COMPU_METHOD
/begin COMPU_METHOD AAL_MSG.OLD_Copy3 "enumeration table" TAB_VERB "%.0" "" COMPU_TAB_REF AAL_MSG.OLD_3 /end COMPU_METHOD
/begin COMPU_METHOD AAL_MSG.OLD_Copy4 "enumeration table" TAB_VERB "%.0" "" COMPU_TAB_REF AAL_MSG.OLD_4 /end COMPU_METHOD
/begin COMPU_METHOD AAL_MSG.OLD_Copy5 "enumeration table" TAB_VERB "%.0" "" COMPU_TAB_REF AAL_MSG.OLD_5 /end COMPU_METHOD
/begin COMPU_METHOD AAL_MSG.OLD_Copy6 "enumeration table" TAB_VERB "%.0" "" COMPU_TAB_REF AAL_MSG.OLD_6 /end COMPU_METHOD
/begin COMPU_METHOD AAL_MSG.OLD_Copy7 "enumeration table" TAB_VERB "%.0" "" COMPU_TAB_REF AAL_MSG.OLD_7 /end COMPU_METHOD
/begin COMPU_METHOD AAL_MSG.OLD_Copy8 "enumeration table" TAB_VERB "%.0" "" COMPU_TAB_REF AAL_MSG.OLD_8 /end COMPU_METHOD
/begin COMPU_METHOD AAL_MSG_Copy1 "enumeration table" TAB_VERB "%.0" "" COMPU_TAB_REF AAL_MSG_Copy1 /end COMPU_METHOD
/begin COMPU_METHOD AAL_MSG_Copy3 "enumeration table" TAB_VERB "%.0" "" COMPU_TAB_REF AAL_MSG_Copy3 /end COMPU_METHOD
/begin COMPU_METHOD AccState "enumeration table" TAB_VERB "%.0" "" COMPU_TAB_REF AccState /end COMPU_METHOD
/begin COMPU_METHOD AcceleratorPedalStrategyPrivate "enumeration table" TAB_VERB "%.0" "" COMPU_TAB_REF AcceleratorPedalStrategyPrivate /end COMPU_METHOD
/begin COMPU_METHOD ActorState "enumeration table" TAB_VERB "%.0" "" COMPU_TAB_REF ActorState /end COMPU_METHOD
/begin COMPU_METHOD ActuationState "enumeration table" TAB_VERB "%.0" "" COMPU_TAB_REF ActuationState /end COMPU_METHOD
/begin COMPU_METHOD Availability "enumeration table" TAB_VERB "%.0" "" COMPU_TAB_REF Availability /end COMPU_METHOD
/begin COMPU_METHOD AvailableConfigurations "enumeration table" TAB_VERB "%.0" "" COMPU_TAB_REF AvailableConfigurations /end COMPU_METHOD
/begin COMPU_METHOD BehaviorExecutionRecommendation "enumeration table" TAB_VERB "%.0" "" COMPU_TAB_REF BehaviorExecutionRecommendation /end COMPU_METHOD
/begin COMPU_METHOD BehaviorStrategy "enumeration table" TAB_VERB "%.0" "" COMPU_TAB_REF BehaviorStrategy /end COMPU_METHOD
/begin COMPU_METHOD BehaviorStrategy.OLD_Copy1 "enumeration table" TAB_VERB "%.0" "" COMPU_TAB_REF BehaviorStrategy.OLD_1 /end COMPU_METHOD
/begin COMPU_METHOD BehaviorStrategyType "enumeration table" TAB_VERB "%.0" "" COMPU_TAB_REF BehaviorStrategyType /end COMPU_METHOD
/begin COMPU_METHOD BehaviorType "enumeration table" TAB_VERB "%.0" "" COMPU_TAB_REF BehaviorType /end COMPU_METHOD
/begin COMPU_METHOD BehaviorType.OLD_Copy1 "enumeration table" TAB_VERB "%.0" "" COMPU_TAB_REF BehaviorType.OLD_1 /end COMPU_METHOD
/begin COMPU_METHOD BehaviorType_Copy1 "enumeration table" TAB_VERB "%.0" "" COMPU_TAB_REF BehaviorType_Copy1 /end COMPU_METHOD
/begin COMPU_METHOD BlindnessIndicatorUniqueId "enumeration table" TAB_VERB "%.0" "" COMPU_TAB_REF BlindnessIndicatorUniqueId /end COMPU_METHOD
/begin COMPU_METHOD BlindnessValidityState "enumeration table" TAB_VERB "%.0" "" COMPU_TAB_REF BlindnessValidityState /end COMPU_METHOD
/begin COMPU_METHOD BoundaryType "enumeration table" TAB_VERB "%.0" "" COMPU_TAB_REF BoundaryType /end COMPU_METHOD
/begin COMPU_METHOD C_PLM "enumeration table" TAB_VERB "%.0" "" COMPU_TAB_REF C_PLM /end COMPU_METHOD
/begin COMPU_METHOD CanSM_BusOffRecoveryStateType_Enum "enumeration table" TAB_VERB "%.0" "" COMPU_TAB_REF CanSM_BusOffRecoveryStateType_Enum /end COMPU_METHOD
/begin COMPU_METHOD CanSM_NetworkModeStateType_Enum "enumeration table" TAB_VERB "%.0" "" COMPU_TAB_REF CanSM_NetworkModeStateType_Enum /end COMPU_METHOD
/begin COMPU_METHOD CanSM_TimerStateType_Enum "enumeration table" TAB_VERB "%.0" "" COMPU_TAB_REF CanSM_TimerStateType_Enum /end COMPU_METHOD
/begin COMPU_METHOD CancelationType "enumeration table" TAB_VERB "%.0" "" COMPU_TAB_REF CancelationType /end COMPU_METHOD
/begin COMPU_METHOD ComfortLaneDrivingState "enumeration table" TAB_VERB "%.0" "" COMPU_TAB_REF ComfortLaneDrivingState /end COMPU_METHOD
/begin COMPU_METHOD ConnectionType "enumeration table" TAB_VERB "%.0" "" COMPU_TAB_REF ConnectionType /end COMPU_METHOD
/begin COMPU_METHOD CounterLimit "enumeration table" TAB_VERB "%.0" "" COMPU_TAB_REF CounterLimit /end COMPU_METHOD
/begin COMPU_METHOD CrcRegType "enumeration table" TAB_VERB "%.0" "" COMPU_TAB_REF CrcRegType /end COMPU_METHOD
/begin COMPU_METHOD DSP_ALIGNMENT_MODES "enumeration table" TAB_VERB "%.0" "" COMPU_TAB_REF DSP_ALIGNMENT_MODES /end COMPU_METHOD
/begin COMPU_METHOD DYNCALDYNSTATE "enumeration table" TAB_VERB "%.0" "" COMPU_TAB_REF DYNCALDYNSTATE /end COMPU_METHOD
/begin COMPU_METHOD DaCoreStates "enumeration table" TAB_VERB "%.0" "" COMPU_TAB_REF DaCoreStates /end COMPU_METHOD
/begin COMPU_METHOD DefinedTargetMotionGoal "enumeration table" TAB_VERB "%.0" "" COMPU_TAB_REF DefinedTargetMotionGoal /end COMPU_METHOD
/begin COMPU_METHOD DegreeOfAssistance "enumeration table" TAB_VERB "%.0" "" COMPU_TAB_REF DegreeOfAssistance /end COMPU_METHOD
/begin COMPU_METHOD Drivability "enumeration table" TAB_VERB "%.0" "" COMPU_TAB_REF Drivability /end COMPU_METHOD
/begin COMPU_METHOD DriverSteeringActivity "enumeration table" TAB_VERB "%.0" "" COMPU_TAB_REF DriverSteeringActivity /end COMPU_METHOD
/begin COMPU_METHOD DrivingDirection "enumeration table" TAB_VERB "%.0" "" COMPU_TAB_REF DrivingDirection /end COMPU_METHOD
/begin COMPU_METHOD DrivingProfile "enumeration table" TAB_VERB "%.0" "" COMPU_TAB_REF DrivingProfile /end COMPU_METHOD
/begin COMPU_METHOD DrivingState "enumeration table" TAB_VERB "%.0" "" COMPU_TAB_REF DrivingState /end COMPU_METHOD
/begin COMPU_METHOD DrivingTask "enumeration table" TAB_VERB "%.0" "" COMPU_TAB_REF DrivingTask /end COMPU_METHOD
/begin COMPU_METHOD DrivingTask.OLD_Copy1 "enumeration table" TAB_VERB "%.0" "" COMPU_TAB_REF DrivingTask.OLD_1 /end COMPU_METHOD
/begin COMPU_METHOD DynCalibState "enumeration table" TAB_VERB "%.0" "" COMPU_TAB_REF DynCalibState /end COMPU_METHOD
/begin COMPU_METHOD DynCalibStatus "enumeration table" TAB_VERB "%.0" "" COMPU_TAB_REF DynCalibStatus /end COMPU_METHOD
/begin COMPU_METHOD Dynamic1DMotionGoal "enumeration table" TAB_VERB "%.0" "" COMPU_TAB_REF Dynamic1DMotionGoal /end COMPU_METHOD
/begin COMPU_METHOD Dynamic1DMotionGoal_v0 "enumeration table" TAB_VERB "%.0" "" COMPU_TAB_REF Dynamic1DMotionGoal_v0 /end COMPU_METHOD
/begin COMPU_METHOD Dynamic2DMotionGoal "enumeration table" TAB_VERB "%.0" "" COMPU_TAB_REF Dynamic2DMotionGoal /end COMPU_METHOD
/begin COMPU_METHOD EAalAntenna "enumeration table" TAB_VERB "%.0" "" COMPU_TAB_REF EAalAntenna /end COMPU_METHOD
/begin COMPU_METHOD EAalMsg "enumeration table" TAB_VERB "%.0" "" COMPU_TAB_REF EAalMsg /end COMPU_METHOD
/begin COMPU_METHOD EAccMode "enumeration table" TAB_VERB "%.0" "" COMPU_TAB_REF EAccMode /end COMPU_METHOD
/begin COMPU_METHOD EBLDEVAL_X_SensorType "enumeration table" TAB_VERB "%.0" "" COMPU_TAB_REF EBLDEVAL_X_SensorType /end COMPU_METHOD
/begin COMPU_METHOD EBLDIndicatorState "enumeration table" TAB_VERB "%.0" "" COMPU_TAB_REF EBLDIndicatorState /end COMPU_METHOD
/begin COMPU_METHOD EBepProcstep "enumeration table" TAB_VERB "%.0" "" COMPU_TAB_REF EBepProcstep /end COMPU_METHOD
/begin COMPU_METHOD EBepReflectionFilterStatus "enumeration table" TAB_VERB "%.0" "" COMPU_TAB_REF EBepReflectionFilterStatus /end COMPU_METHOD
/begin COMPU_METHOD EBepReflectionPlsDeleteMode "enumeration table" TAB_VERB "%.0" "" COMPU_TAB_REF EBepReflectionPlsDeleteMode /end COMPU_METHOD
/begin COMPU_METHOD ECommandType "enumeration table" TAB_VERB "%.0" "" COMPU_TAB_REF ECommandType /end COMPU_METHOD
/begin COMPU_METHOD EControlState "enumeration table" TAB_VERB "%.0" "" COMPU_TAB_REF EControlState /end COMPU_METHOD
/begin COMPU_METHOD ECopyHandshake "enumeration table" TAB_VERB "%.0" "" COMPU_TAB_REF ECopyHandshake /end COMPU_METHOD
/begin COMPU_METHOD ECutInLevel "enumeration table" TAB_VERB "%.0" "" COMPU_TAB_REF ECutInLevel /end COMPU_METHOD
/begin COMPU_METHOD EDefaultState "enumeration table" TAB_VERB "%.0" "" COMPU_TAB_REF EDefaultState /end COMPU_METHOD
/begin COMPU_METHOD EDetailledErrorCode "enumeration table" TAB_VERB "%.0" "" COMPU_TAB_REF EDetailledErrorCode /end COMPU_METHOD
/begin COMPU_METHOD EDiaInternalStates "enumeration table" TAB_VERB "%.0" "" COMPU_TAB_REF EDiaInternalStates /end COMPU_METHOD
/begin COMPU_METHOD EStatus "enumeration table" TAB_VERB "%.0" "" COMPU_TAB_REF EStatus /end COMPU_METHOD
/begin COMPU_VTAB_RANGE AAL_MSG "" 51 0 0 "AAL_OK" 1 1 "AAL_SPI_FAILED" 2 2 "AAL_SPI_TRANSFER_FAILED" 3 3 "AAL_RIF_CONFIG_FAILED" 4 4 "AAL_WRONG_MMICADDR" 5 5 "AAL_BUFFER_NOTEMPTY" 6 6 "AAL_BUFFER_OVERFLOW" 7 7 "AAL_MODPARA_NOTSET" 8 8 "AAL_FWSTATE_NOTSET" 32 32 "AAL_WRONG_TRAMP" 33 33 "AAL_WRONG_FSTART" 34 34 "AAL_WRONG_NFSTEP" 35 35 "AAL_WRONG_NSEQ" 36 36 "AAL_WRONG_MINFREQ" 37 37 "AAL_WRONG_MAXFREQ" 38 38 "AAL_WRONG_MAXSWING" 39 39 "AAL_WRONG_ANT_CHOICE" 40 40 "AAL_RAMPTIME2SMALL" 48 48 "AAL_WRONG_NSPON" 49 49 "AAL_WRONG_DECFACTOR" 64 64 "AAL_WRONG_FIRMEWARE" 65 65 "AAL_FIRMWARE_TIMEOUT" 66 66 "AAL_FWRESULTS_FAILED" 67 67 "AAL_DEL_OLD_FW_FAILED" 68 68 "AAL_WRONG_RUNFW_NRPARAMS" 69 69 "AAL_WRONG_RUNFW_NRRESULT" 70 70 "AAL_FW_NOT_STARTED" 71 71 "AAL_FW_STATUS_COUNT_EMPTY" 72 72 "AAL_FW_FAILED" 96 96 "AAL_ENABLERXTX_FAILED" 112 112 "AAL_MMICSTATUS_ERROR" 113 113 "AAL_MMICSTATUS_OKPIN_FAILED" 128 128 "AAL_RFSP_CRC_NOTFOUND" 129 129 "AAL_RFSP_RMPCRC_ERROR" 224 224 "AAL_STATUS_CMD_NOT_ALLOWED" 225 225 "AAL_STATUS_INVALID_SIG" 226 226 "AAL_STATUS_INVALID_SETTING" 227 227 "AAL_STATUS_CALIB_ERROR" 228 228 "AAL_STATUS_77GHz_PLL_UNLOCKED" 229 229 "AAL_STATUS_BB_ERROR" 230 230 "AAL_STATUS_PARAM_ERROR" 231 231 "AAL_STATUS_INVALID_CMD" 232 232 "AAL_STATUS_UNDERFLOW" 233 233 "AAL_STATUS_OVERFLOW" 234 234 "AAL_STATUS_CMD_SEQ_REC" 235 235 "AAL_STATUS_RMP_ERROR" 236 236 "AAL_STATUS_MON_LIMIT_ERROR" 237 237 "AAL_STATUS_MON_CRC_ERROR" 238 238 "AAL_STATUS_ERROR" 239 239 "AAL_STATUS_UNKNOWN_CMD" 4096 4096 "AAL_FIRMEWARE_RUNNING" DEFAULT_VALUE "" /end COMPU_VTAB_RANGE
/begin COMPU_VTAB_RANGE AAL_MSG.OLD_1 "" 20 0 0 "AAL_OK" 1 1 "AAL_WRONG_MMICADDR" 2 2 "AAL_BUFFER_NOTEMPTY" 3 3 "AAL_WRONG_TRAMP" 4 4 "AAL_WRONG_FSTART" 5 5 "AAL_WRONG_NFSTEP" 6 6 "AAL_WRONG_NSEQ" 7 7 "AAL_WRONG_FIRMEWARE" 8 8 "AAL_WRONG_OLDFIRMEWARE_RUNNING" 9 9 "AAL_WRONG_RUNFW_NRPARAMS" 10 10 "AAL_WRONG_RUNFW_NRRESULT" 11 11 "AAL_WRONG_RMPTIME_SEQ" 12 12 "AAL_WRONG_NSPON" 13 13 "AAL_WRONG_MINFREQ" 14 14 "AAL_WRONG_MAXFREQ" 15 15 "AAL_WRONG_MAXSWING" 16 16 "AAL_FW_NOT_STARTED" 17 17 "AAL_FW_NOT_FINISHED" 18 18 "AAL_FW_FAILED" 19 19 "AAL_FW_SEQFULL" DEFAULT_VALUE "" /end COMPU_VTAB_RANGE
/begin COMPU_VTAB_RANGE AAL_MSG.OLD_2 "" 19 0 0 "AAL_OK" 1 1 "AAL_WRONG_MMICADDR" 2 2 "AAL_BUFFER_NOTEMPTY" 25 25 "AAL_WRONG_TRAMP" 26 26 "AAL_WRONG_FSTART" 27 27 "AAL_WRONG_NFSTEP" 28 28 "AAL_WRONG_NSEQ" 29 29 "AAL_WRONG_NSPON" 30 30 "AAL_WRONG_MINFREQ" 31 31 "AAL_WRONG_MAXFREQ" 32 32 "AAL_WRONG_MAXSWING" 50 50 "AAL_WRONG_FIRMEWARE" 51 51 "AAL_WRONG_OLDFIRMEWARE_RUNNING" 52 52 "AAL_WRONG_RUNFW_NRPARAMS" 53 53 "AAL_WRONG_RUNFW_NRRESULT" 54 54 "AAL_FW_NOT_STARTED" 55 55 "AAL_FW_NOT_FINISHED" 56 56 "AAL_FW_FAILED" 57 57 "AAL_FW_SEQFULL" DEFAULT_VALUE "" /end COMPU_VTAB_RANGE
/begin COMPU_VTAB_RANGE AAL_MSG.OLD_3 "" 23 0 0 "AAL_OK" 1 1 "AAL_WRONG_MMICADDR" 2 2 "AAL_BUFFER_NOTEMPTY" 25 25 "AAL_WRONG_TRAMP" 26 26 "AAL_WRONG_FSTART" 27 27 "AAL_WRONG_NFSTEP" 28 28 "AAL_WRONG_NSEQ" 29 29 "AAL_WRONG_NSPON" 30 30 "AAL_WRONG_MINFREQ" 31 31 "AAL_WRONG_MAXFREQ" 32 32 "AAL_WRONG_MAXSWING" 50 50 "AAL_WRONG_FIRMEWARE" 51 51 "AAL_FIRMEWARE_RUNNING" 52 52 "AAL_FIRMWARE_TIMEOUT" 53 53 "AAL_FWRESULTS_FAILED" 54 54 "AAL_DEL_OLD_FW_FAILED" 55 55 "AAL_WRONG_RUNFW_NRPARAMS" 56 56 "AAL_WRONG_RUNFW_NRRESULT" 57 57 "AAL_FW_NOT_STARTED" 58 58 "AAL_FW_NOT_FINISHED" 59 59 "AAL_FW_STATUS_COUNT_EMPTY" 60 60 "AAL_FW_FAILED" 61 61 "AAL_FW_SEQFULL" DEFAULT_VALUE "" /end COMPU_VTAB_RANGE
/begin COMPU_VTAB_RANGE AAL_MSG.OLD_4 "" 45 0 0 "AAL_OK" 1 1 "AAL_SPI_FAILED" 2 2 "AAL_RIF_CONFIG_FAILED" 3 3 "AAL_WRONG_DECFACTOR" 4 4 "AAL_WRONG_MMICADDR" 5 5 "AAL_BUFFER_NOTEMPTY" 6 6 "AAL_MODPARA_NOTSET" 7 7 "AAL_MONCONFIG_NOTSET" 25 25 "AAL_WRONG_TRAMP" 26 26 "AAL_WRONG_FSTART" 27 27 "AAL_WRONG_NFSTEP" 28 28 "AAL_WRONG_NSEQ" 29 29 "AAL_WRONG_NSPON" 30 30 "AAL_WRONG_MINFREQ" 31 31 "AAL_WRONG_MAXFREQ" 32 32 "AAL_WRONG_MAXSWING" 33 33 "AAL_WRONG_ANT_CHOICE" 50 50 "AAL_WRONG_FIRMEWARE" 51 51 "AAL_FIRMEWARE_RUNNING" 52 52 "AAL_FIRMWARE_TIMEOUT" 53 53 "AAL_FWRESULTS_FAILED" 54 54 "AAL_DEL_OLD_FW_FAILED" 55 55 "AAL_WRONG_RUNFW_NRPARAMS" 56 56 "AAL_WRONG_RUNFW_NRRESULT" 57 57 "AAL_FW_NOT_STARTED" 58 58 "AAL_FW_NOT_FINISHED" 59 59 "AAL_FW_STATUS_COUNT_EMPTY" 60 60 "AAL_FW_FAILED" 61 61 "AAL_FW_SEQFULL" 224 224 "AAL_STATUS_CMD_NOT_ALLOWED" 225 225 "AAL_STATUS_INVALID_SIG" 226 226 "AAL_STATUS_INVALID_SETTING" 227 227 "AAL_STATUS_CALIB_ERROR" 228 228 "AAL_STATUS_77GHz_PLL_UNLOCKED" 229 229 "AAL_STATUS_BB_ERROR" 230 230 "AAL_STATUS_PARAM_ERROR" 231 231 "AAL_STATUS_INVALID_CMD" 232 232 "AAL_STATUS_UNDERFLOW" 233 233 "AAL_STATUS_OVERFLOW" 234 234 "AAL_STATUS_CMD_SEQ_REC" 235 235 "AAL_STATUS_RMP_ERROR" 236 236 "AAL_STATUS_MON_LIMIT_ERROR" 237 237 "AAL_STATUS_MON_CRC_ERROR" 238 238 "AAL_STATUS_ERROR" 239 239 "AAL_STATUS_UNKNOWN_CMD" DEFAULT_VALUE "" /end COMPU_VTAB_RANGE
/begin COMPU_VTAB_RANGE AAL_MSG.OLD_5 "" 47 0 0 "AAL_OK" 1 1 "AAL_SPI_FAILED" 2 2 "AAL_SPI_TRANSFER_FAILED" 3 3 "AAL_RIF_CONFIG_FAILED" 4 4 "AAL_WRONG_DECFACTOR" 5 5 "AAL_WRONG_MMICADDR" 6 6 "AAL_BUFFER_NOTEMPTY" 7 7 "AAL_MODPARA_NOTSET" 8 8 "AAL_MONCONFIG_NOTSET" 25 25 "AAL_WRONG_TRAMP" 26 26 "AAL_WRONG_FSTART" 27 27 "AAL_WRONG_NFSTEP" 28 28 "AAL_WRONG_NSEQ" 29 29 "AAL_WRONG_NSPON" 30 30 "AAL_WRONG_MINFREQ" 31 31 "AAL_WRONG_MAXFREQ" 32 32 "AAL_WRONG_MAXSWING" 33 33 "AAL_WRONG_ANT_CHOICE" 34 34 "AAL_WAITTIME2SMALL" 50 50 "AAL_WRONG_FIRMEWARE" 51 51 "AAL_FIRMEWARE_RUNNING" 52 52 "AAL_FIRMWARE_TIMEOUT" 53 53 "AAL_FWRESULTS_FAILED" 54 54 "AAL_DEL_OLD_FW_FAILED" 55 55 "AAL_WRONG_RUNFW_NRPARAMS" 56 56 "AAL_WRONG_RUNFW_NRRESULT" 57 57 "AAL_FW_NOT_STARTED" 58 58 "AAL_FW_NOT_FINISHED" 59 59 "AAL_FW_STATUS_COUNT_EMPTY" 60 60 "AAL_FW_FAILED" 61 61 "AAL_FW_SEQFULL" 224 224 "AAL_STATUS_CMD_NOT_ALLOWED" 225 225 "AAL_STATUS_INVALID_SIG" 226 226 "AAL_STATUS_INVALID_SETTING" 227 227 "AAL_STATUS_CALIB_ERROR" 228 228 "AAL_STATUS_77GHz_PLL_UNLOCKED" 229 229 "AAL_STATUS_BB_ERROR" 230 230 "AAL_STATUS_PARAM_ERROR" 231 231 "AAL_STATUS_INVALID_CMD" 232 232 "AAL_STATUS_UNDERFLOW" 233 233 "AAL_STATUS_OVERFLOW" 234 234 "AAL_STATUS_CMD_SEQ_REC" 235 235 "AAL_STATUS_RMP_ERROR" 236 236 "AAL_STATUS_MON_LIMIT_ERROR" 237 237 "AAL_STATUS_MON_CRC_ERROR" 238 238 "AAL_STATUS_ERROR" 239 239 "AAL_STATUS_UNKNOWN_CMD" DEFAULT_VALUE "" /end COMPU_VTAB_RANGE
/begin COMPU_VTAB_RANGE AAL_MSG.OLD_6 "" 49 0 0 "AAL_OK" 1 1 "AAL_SPI_FAILED" 2 2 "AAL_SPI_TRANSFER_FAILED" 3 3 "AAL_RIF_CONFIG_FAILED" 4 4 "AAL_WRONG_DECFACTOR" 5 5 "AAL_WRONG_MMICADDR" 6 6 "AAL_BUFFER_NOTEMPTY" 7 7 "AAL_MODPARA_NOTSET" 8 8 "AAL_MONCONFIG_NOTSET" 32 32 "AAL_WRONG_TRAMP" 33 33 "AAL_WRONG_FSTART" 34 34 "AAL_WRONG_NFSTEP" 35 35 "AAL_WRONG_NSEQ" 36 36 "AAL_WRONG_NSPON" 37 37 "AAL_WRONG_MINFREQ" 38 38 "AAL_WRONG_MAXFREQ" 39 39 "AAL_WRONG_MAXSWING" 40 40 "AAL_WRONG_ANT_CHOICE" 41 41 "AAL_RAMPTIME2SMALL" 64 64 "AAL_WRONG_FIRMEWARE" 65 65 "AAL_FIRMEWARE_RUNNING" 66 66 "AAL_FIRMWARE_TIMEOUT" 67 67 "AAL_FWRESULTS_FAILED" 68 68 "AAL_DEL_OLD_FW_FAILED" 69 69 "AAL_WRONG_RUNFW_NRPARAMS" 70 70 "AAL_WRONG_RUNFW_NRRESULT" 71 71 "AAL_FW_NOT_STARTED" 72 72 "AAL_FW_NOT_FINISHED" 73 73 "AAL_FW_STATUS_COUNT_EMPTY" 74 74 "AAL_FW_FAILED" 75 75 "AAL_FW_SEQFULL" 76 76 "AAL_UNLOCK_ERROR" 96 96 "AAL_ENABLERXTX_FAILED" 224 224 "AAL_STATUS_CMD_NOT_ALLOWED" 225 225 "AAL_STATUS_INVALID_SIG" 226 226 "AAL_STATUS_INVALID_SETTING" 227 227 "AAL_STATUS_CALIB_ERROR" 228 228 "AAL_STATUS_77GHz_PLL_UNLOCKED" 229 229 "AAL_STATUS_BB_ERROR" 230 230 "AAL_STATUS_PARAM_ERROR" 231 231 "AAL_STATUS_INVALID_CMD" 232 232 "AAL_STATUS_UNDERFLOW" 233 233 "AAL_STATUS_OVERFLOW" 234 234 "AAL_STATUS_CMD_SEQ_REC" 235 235 "AAL_STATUS_RMP_ERROR" 236 236 "AAL_STATUS_MON_LIMIT_ERROR" 237 237 "AAL_STATUS_MON_CRC_ERROR" 238 238 "AAL_STATUS_ERROR" 239 239 "AAL_STATUS_UNKNOWN_CMD" DEFAULT_VALUE "" /end COMPU_VTAB_RANGE
/begin COMPU_VTAB_RANGE AAL_MSG.OLD_7 "" 48 0 0 "AAL_OK" 1 1 "AAL_SPI_FAILED" 2 2 "AAL_SPI_TRANSFER_FAILED" 3 3 "AAL_RIF_CONFIG_FAILED" 4 4 "AAL_WRONG_MMICADDR" 5 5 "AAL_BUFFER_NOTEMPTY" 6 6 "AAL_BUFFER_OVERFLOW" 7 7 "AAL_MODPARA_NOTSET" 32 32 "AAL_WRONG_TRAMP" 33 33 "AAL_WRONG_FSTART" 34 34 "AAL_WRONG_NFSTEP" 35 35 "AAL_WRONG_NSEQ" 36 36 "AAL_WRONG_MINFREQ" 37 37 "AAL_WRONG_MAXFREQ" 38 38 "AAL_WRONG_MAXSWING" 39 39 "AAL_WRONG_ANT_CHOICE" 40 40 "AAL_RAMPTIME2SMALL" 48 48 "AAL_WRONG_NSPON" 49 49 "AAL_WRONG_DECFACTOR" 64 64 "AAL_WRONG_FIRMEWARE" 65 65 "AAL_FIRMWARE_TIMEOUT" 66 66 "AAL_FWRESULTS_FAILED" 67 67 "AAL_DEL_OLD_FW_FAILED" 68 68 "AAL_WRONG_RUNFW_NRPARAMS" 69 69 "AAL_WRONG_RUNFW_NRRESULT" 70 70 "AAL_FW_NOT_STARTED" 71 71 "AAL_FW_STATUS_COUNT_EMPTY" 72 72 "AAL_FW_FAILED" 96 96 "AAL_ENABLERXTX_FAILED" 112 112 "AAL_MMICSTATUS_ERROR" 113 113 "AAL_MMICSTATUS_OKPIN_FAILED" 224 224 "AAL_STATUS_CMD_NOT_ALLOWED" 225 225 "AAL_STATUS_INVALID_SIG" 226 226 "AAL_STATUS_INVALID_SETTING" 227 227 "AAL_STATUS_CALIB_ERROR" 228 228 "AAL_STATUS_77GHz_PLL_UNLOCKED" 229 229 "AAL_STATUS_BB_ERROR" 230 230 "AAL_STATUS_PARAM_ERROR" 231 231 "AAL_STATUS_INVALID_CMD" 232 232 "AAL_STATUS_UNDERFLOW" 233 233 "AAL_STATUS_OVERFLOW" 234 234 "AAL_STATUS_CMD_SEQ_REC" 235 235 "AAL_STATUS_RMP_ERROR" 236 236 "AAL_STATUS_MON_LIMIT_ERROR" 237 237 "AAL_STATUS_MON_CRC_ERROR" 238 238 "AAL_STATUS_ERROR" 239 239 "AAL_STATUS_UNKNOWN_CMD" 4096 4096 "AAL_FIRMEWARE_RUNNING" DEFAULT_VALUE "" /end COMPU_VTAB_RANGE
/begin COMPU_VTAB_RANGE AAL_MSG.OLD_8 "" 50 0 0 "AAL_OK" 1 1 "AAL_SPI_FAILED" 2 2 "AAL_SPI_TRANSFER_FAILED" 3 3 "AAL_RIF_CONFIG_FAILED" 4 4 "AAL_WRONG_MMICADDR" 5 5 "AAL_BUFFER_NOTEMPTY" 6 6 "AAL_BUFFER_OVERFLOW" 7 7 "AAL_MODPARA_NOTSET" 32 32 "AAL_WRONG_TRAMP" 33 33 "AAL_WRONG_FSTART" 34 34 "AAL_WRONG_NFSTEP" 35 35 "AAL_WRONG_NSEQ" 36 36 "AAL_WRONG_MINFREQ" 37 37 "AAL_WRONG_MAXFREQ" 38 38 "AAL_WRONG_MAXSWING" 39 39 "AAL_WRONG_ANT_CHOICE" 40 40 "AAL_RAMPTIME2SMALL" 48 48 "AAL_WRONG_NSPON" 49 49 "AAL_WRONG_DECFACTOR" 64 64 "AAL_WRONG_FIRMEWARE" 65 65 "AAL_FIRMWARE_TIMEOUT" 66 66 "AAL_FWRESULTS_FAILED" 67 67 "AAL_DEL_OLD_FW_FAILED" 68 68 "AAL_WRONG_RUNFW_NRPARAMS" 69 69 "AAL_WRONG_RUNFW_NRRESULT" 70 70 "AAL_FW_NOT_STARTED" 71 71 "AAL_FW_STATUS_COUNT_EMPTY" 72 72 "AAL_FW_FAILED" 96 96 "AAL_ENABLERXTX_FAILED" 112 112 "AAL_MMICSTATUS_ERROR" 113 113 "AAL_MMICSTATUS_OKPIN_FAILED" 128 128 "AAL_RFSP_CRC_NOTFOUND" 129 129 "AAL_RFSP_RMPCRC_ERROR" 224 224 "AAL_STATUS_CMD_NOT_ALLOWED" 225 225 "AAL_STATUS_INVALID_SIG" 226 226 "AAL_STATUS_INVALID_SETTING" 227 227 "AAL_STATUS_CALIB_ERROR" 228 228 "AAL_STATUS_77GHz_PLL_UNLOCKED" 229 229 "AAL_STATUS_BB_ERROR" 230 230 "AAL_STATUS_PARAM_ERROR" 231 231 "AAL_STATUS_INVALID_CMD" 232 232 "AAL_STATUS_UNDERFLOW" 233 233 "AAL_STATUS_OVERFLOW" 234 234 "AAL_STATUS_CMD_SEQ_REC" 235 235 "AAL_STATUS_RMP_ERROR" 236 236 "AAL_STATUS_MON_LIMIT_ERROR" 237 237 "AAL_STATUS_MON_CRC_ERROR" 238 238 "AAL_STATUS_ERROR" 239 239 "AAL_STATUS_UNKNOWN_CMD" 4096 4096 "AAL_FIRMEWARE_RUNNING" DEFAULT_VALUE "" /end COMPU_VTAB_RANGE
/begin COMPU_VTAB AAL_MSG_Copy1 "enumeration table" TAB_VERB 56 0 "AAL_OK" 1 "AAL_SPI_FAILED" 2 "AAL_SPI_TRANSFER_FAILED" 3 "AAL_RIF_CONFIG_FAILED" 4 "AAL_WRONG_MMICADDR" 5 "AAL_BUFFER_NOTEMPTY" 6 "AAL_BUFFER_OVERFLOW" 7 "AAL_MODPARA_NOTSET" 8 "AAL_FWSTATE_NOTSET" 32 "AAL_WRONG_TRAMP" 33 "AAL_WRONG_FSTART" 34 "AAL_WRONG_NFSTEP" 35 "AAL_WRONG_NSEQ" 36 "AAL_WRONG_MINFREQ" 37 "AAL_WRONG_MAXFREQ" 38 "AAL_WRONG_MAXSWING" 39 "AAL_WRONG_ANT_CHOICE" 40 "AAL_RAMPTIME2SMALL" 48 "AAL_WRONG_NSPON" 49 "AAL_WRONG_DECFACTOR" 64 "AAL_WRONG_FIRMEWARE" 65 "AAL_FIRMWARE_TIMEOUT" 66 "AAL_FWRESULTS_FAILED" 67 "AAL_DEL_OLD_FW_FAILED" 68 "AAL_WRONG_RUNFW_NRPARAMS" 69 "AAL_WRONG_RUNFW_NRRESULT" 70 "AAL_FW_NOT_STARTED" 71 "AAL_FW_STATUS_COUNT_EMPTY" 72 "AAL_FW_FAILED" 96 "AAL_ENABLERXTX_FAILED" 97 "AAL_FORCECALIB_FAILED" 112 "AAL_MMICSTATUS_ERROR" 113 "AAL_MMICSTATUS_OKPIN_FAILED" 128 "AAL_RFSP_CRC_NOTFOUND" 129 "AAL_MONRSFP_WRITECRC_ERR" 130 "AAL_MONRFSP_ERROR" 144 "AAL_MMIC_MISSING_FACTORYDATA" 145 "AAL_MMIC_VERSION_FACTORYDATA_ERROR" 224 "AAL_STATUS_CMD_NOT_ALLOWED" 225 "AAL_STATUS_INVALID_SIG" 226 "AAL_STATUS_INVALID_SETTING" 227 "AAL_STATUS_CALIB_ERROR" 228 "AAL_STATUS_77GHz_PLL_UNLOCKED" 229 "AAL_STATUS_BB_ERROR" 230 "AAL_STATUS_PARAM_ERROR" 231 "AAL_STATUS_INVALID_CMD" 232 "AAL_STATUS_UNDERFLOW" 233 "AAL_STATUS_OVERFLOW" 234 "AAL_STATUS_GENERAL_ERROR" 234 "AAL_STATUS_CMD_SEQ_REC" 235 "AAL_STATUS_RMP_ERROR" 236 "AAL_STATUS_MON_LIMIT_ERROR" 237 "AAL_STATUS_MON_CRC_ERROR" 238 "AAL_STATUS_ERROR" 239 "AAL_STATUS_UNKNOWN_CMD" 4096 "AAL_FIRMEWARE_RUNNING" /end COMPU_VTAB
/begin COMPU_VTAB AAL_MSG_Copy3 "enumeration table" TAB_VERB 61 0 "AAL_OK" 1 "AAL_SPI_FAILED" 2 "AAL_SPI_TRANSFER_FAILED" 3 "AAL_RIF_CONFIG_FAILED" 4 "AAL_WRONG_MMICADDR" 5 "AAL_BUFFER_NOTEMPTY" 6 "AAL_BUFFER_OVERFLOW" 7 "AAL_RMPMEM_OVERFLOW" 8 "AAL_RMPMEM_WRITE_FAILED" 9 "AAL_MODPARA_NOTSET" 10 "AAL_FWSTATE_NOTSET" 11 "AAL_STATEMACHINE_FAILED" 12 "AAL_HARDRESET_FAILED" 13 "AAL_RESET_ERROR" 32 "AAL_WRONG_TRAMP" 33 "AAL_WRONG_FSTART" 34 "AAL_WRONG_NFSTEP" 35 "AAL_WRONG_NSEQ" 36 "AAL_WRONG_MINFREQ" 37 "AAL_WRONG_MAXFREQ" 38 "AAL_WRONG_MAXSWING" 39 "AAL_WRONG_ANT_CHOICE" 40 "AAL_RAMPTIME2SMALL" 48 "AAL_WRONG_NSPON" 49 "AAL_WRONG_DECFACTOR" 64 "AAL_WRONG_FIRMEWARE" 65 "AAL_FIRMWARE_TIMEOUT" 66 "AAL_FWRESULTS_FAILED" 67 "AAL_DEL_OLD_FW_FAILED" 68 "AAL_WRONG_RUNFW_NRPARAMS" 69 "AAL_WRONG_RUNFW_NRRESULT" 70 "AAL_FW_NOT_STARTED" 71 "AAL_FW_STATUS_COUNT_EMPTY" 72 "AAL_FW_FAILED" 96 "AAL_ENABLERXTX_FAILED" 97 "AAL_FORCECALIB_FAILED" 112 "AAL_MMICSTATUS_ERROR" 113 "AAL_MMICSTATUS_OKPIN_FAILED" 128 "AAL_RFSP_CRC_NOTFOUND" 129 "AAL_MONRSFP_WRITECRC_ERR" 130 "AAL_MONRFSP_ERROR" 144 "AAL_MMIC_MISSING_FACTORYDATA" 145 "AAL_MMIC_VERSION_FACTORYDATA_ERROR" 224 "AAL_STATUS_CMD_NOT_ALLOWED" 225 "AAL_STATUS_INVALID_SIG" 226 "AAL_STATUS_INVALID_SETTING" 227 "AAL_STATUS_CALIB_ERROR" 228 "AAL_STATUS_77GHz_PLL_UNLOCKED" 229 "AAL_STATUS_BB_ERROR" 230 "AAL_STATUS_PARAM_ERROR" 231 "AAL_STATUS_INVALID_CMD" 232 "AAL_STATUS_UNDERFLOW" 233 "AAL_STATUS_OVERFLOW" 234 "AAL_STATUS_GENERAL_ERROR" 234 "AAL_STATUS_CMD_SEQ_REC" 235 "AAL_STATUS_RMP_ERROR" 236 "AAL_STATUS_MON_LIMIT_ERROR" 237 "AAL_STATUS_MON_CRC_ERROR" 238 "AAL_STATUS_ERROR" 239 "AAL_STATUS_UNKNOWN_CMD" 4096 "AAL_FIRMEWARE_RUNNING" /end COMPU_VTAB
/begin COMPU_VTAB_RANGE AccState "" 8 0 0 "ACC_MAINSWITCH_OFF" 1 1 "ACC_INIT" 2 2 "ACC_STANDBY" 3 3 "ACC_ACTIVE" 4 4 "ACC_OVERRIDE" 5 5 "ACC_RESERVED" 6 6 "ACC_REVERSIBLE_ERROR" 7 7 "ACC_IRREVERSIBLE_ERROR" DEFAULT_VALUE "" /end COMPU_VTAB_RANGE
/begin COMPU_VTAB AcceleratorPedalStrategyPrivate "enumeration table" TAB_VERB 2 0 "cooperation" 1 "limitation" /end COMPU_VTAB
/begin COMPU_VTAB_RANGE ActorState "" 3 0 0 "ActorState_Off" 1 1 "ActorState_Standby" 2 2 "ActorState_On" DEFAULT_VALUE "" /end COMPU_VTAB_RANGE
/begin COMPU_VTAB_RANGE ActuationState "" 3 0 0 "ActuationState_Off" 1 1 "ActuationState_Standby" 2 2 "ActuationState_On" DEFAULT_VALUE "" /end COMPU_VTAB_RANGE
/begin COMPU_VTAB_RANGE Availability "" 2 0 0 "unavailable" 1 1 "available" DEFAULT_VALUE "" /end COMPU_VTAB_RANGE
/begin COMPU_VTAB AvailableConfigurations "enumeration table" TAB_VERB 1 0 "PL_Radar" /end COMPU_VTAB
/begin COMPU_VTAB BehaviorExecutionRecommendation "enumeration table" TAB_VERB 4 0 "invalidAndNotRecommended" 1 "validButNotRecommended" 2 "validAndRecommended" 3 "validWithTimestamp" /end COMPU_VTAB
/begin COMPU_VTAB_RANGE BehaviorStrategy "" 3 0 0 "tipl" 1 1 "fm" 2 2 "imba" DEFAULT_VALUE "" /end COMPU_VTAB_RANGE
/begin COMPU_VTAB_RANGE BehaviorStrategy.OLD_1 "" 5 0 0 "undefinedStrategy" 1 1 "trafficInParallelLanes" 2 2 "collisionFreeManeuvering" 3 3 "noStrategy" 4 4 "allStrategies" DEFAULT_VALUE "" /end COMPU_VTAB_RANGE
/begin COMPU_VTAB_RANGE BehaviorStrategyType "" 2 0 0 "BS_TIPL" 1 1 "BS_FM" DEFAULT_VALUE "" /end COMPU_VTAB_RANGE
/begin COMPU_VTAB_RANGE BehaviorType "" 7 0 0 "AccTipl" 1 1 "AebFullBrakeTipl" 2 2 "FcwTipl" 3 3 "AebFullBrakeFm" 4 4 "AebPartialBrakeTipl" 5 5 "AccImba" 6 6 "FtaTipl" DEFAULT_VALUE "" /end COMPU_VTAB_RANGE
/begin COMPU_VTAB_RANGE BehaviorType.OLD_1 "" 7 0 0 "AccTipl" 1 1 "AebFullBrakeTipl" 2 2 "FcwTipl" 3 3 "AebFm" 4 4 "AebPartialBrakeTipl" 5 5 "AccImba" 6 6 "FtaTipl" DEFAULT_VALUE "" /end COMPU_VTAB_RANGE
/begin COMPU_VTAB BehaviorType_Copy1 "enumeration table" TAB_VERB 9 0 "AccTipl" 1 "AebFullBrakeTipl" 2 "EbaTipl" 3 "EbaFm" 4 "FcwTipl" 5 "AebFullBrakeFm" 6 "AebPartialBrakeTipl" 7 "AccImba" 8 "FtaTipl" /end COMPU_VTAB
/begin COMPU_VTAB BlindnessIndicatorUniqueId "enumeration table" TAB_VERB 10 0 "undefinedId" 1 "thetaMIMOId" 2 "crossCorrId" 3 "nRefId" 4 "treeResultId" 5 "fusObjId" 6 "thetaMIMOMasterId" 7 "crossMIMOCombiId" 8 "thetaMIMORateId" 9 "numLocsId" /end COMPU_VTAB
/begin COMPU_VTAB_RANGE BlindnessValidityState "" 3 0 0 "invalid" 1 1 "init" 255 255 "valid" DEFAULT_VALUE "" /end COMPU_VTAB_RANGE
/begin COMPU_VTAB BoundaryType "enumeration table" TAB_VERB 21 0 "Virtual" 1 "Unknown" 2 "Dashed" 3 "Solid" 4 "DashedExcept" 5 "SolidExcept" 6 "RoadEdge" 7 "ConstructionElement" 8 "Curbstone" 9 "TrafficStatic" 10 "UnknownRaised" 11 "RoadEdgeFlat" 12 "RoadEdgeDropped" 13 "RoadEdgeRaised" 14 "TrafficBarrier" 15 "ConstructionBarriers" 16 "TrafficControlDevices" 17 "ParkedVehicles" 18 "UnknownRaisedOverridable" 19 "UnknownRaisedNotOverridable" 20 "UnknownRaisedUnderridable" /end COMPU_VTAB
/begin COMPU_VTAB_RANGE C_PLM "" 6 0 0 "EGO_COURSE_LANE_MODEL" 1 1 "EGO_HIST_TRACK_LANE_MODEL" 2 2 "OBJECT_HIST_TRACK_LANE_MODEL" 3 3 "STATIC_SENSOR_LANE_MODEL" 4 4 "NUMBER_OF_PLM_TYPES" 255 255 "INVALID_PLM_TYPE" DEFAULT_VALUE "" /end COMPU_VTAB_RANGE
/begin COMPU_VTAB_RANGE CanSM_BusOffRecoveryStateType_Enum "" 7 1 1 "CANSM_BOR_IDLE" 2 2 "CANSM_S_BUS_OFF_CHECK" 3 3 "CANSM_S_NO_BUS_OFF" 4 4 "CANSM_S_BUS_OFF_RECOVERY_L1" 5 5 "CANSM_S_RESTART_CC" 6 6 "CANSM_S_RESTART_CC_WAIT" 7 7 "CANSM_S_BUS_OFF_RECOVERY_L2" DEFAULT_VALUE "" /end COMPU_VTAB_RANGE
/begin COMPU_VTAB_RANGE CanSM_NetworkModeStateType_Enum "" 7 0 0 "CANSM_BSM_S_NOCOM" 1 1 "CANSM_BSM_S_SILENTCOM" 2 2 "CANSM_BSM_S_FULLCOM" 3 3 "CANSM_BSM_S_NOT_INITIALIZED" 4 4 "CANSM_BSM_S_PRE_NOCOM" 5 5 "CANSM_BSM_S_PRE_FULLCOM" 6 6 "CANSM_BSM_S_CHANGE_BAUDRATE" DEFAULT_VALUE "" /end COMPU_VTAB_RANGE
/begin COMPU_VTAB_RANGE CanSM_TimerStateType_Enum "" 4 1 1 "CANSM_TIMER_INIT" 2 2 "CANSM_TIMER_RUNNING" 3 3 "CANSM_TIMER_ELAPSED" 4 4 "CANSM_TIMER_CANCELLED" DEFAULT_VALUE "" /end COMPU_VTAB_RANGE
/begin COMPU_VTAB_RANGE CancelationType "" 3 0 0 "CT_NONE" 1 1 "CT_ALL" 2 2 "CT_SPEED_LIMIT" DEFAULT_VALUE "" /end COMPU_VTAB_RANGE
/begin COMPU_VTAB_RANGE ComfortLaneDrivingState "" 5 0 0 "COMFORT_LANE_DRIVING_OFF" 1 1 "COMFORT_LANE_DRIVING_STANDBY" 2 2 "COMFORT_LANE_DRIVING_LONGITUDINAL_CONTROL" 3 3 "COMFORT_LANE_DRIVING_LATERAL_CONTROL" 4 4 "COMFORT_LANE_DRIVING_FULL_CONTROL" DEFAULT_VALUE "" /end COMPU_VTAB_RANGE
/begin COMPU_VTAB_RANGE ConnectionType "" 4 0 0 "CT_UNKNOWN" 1 1 "CT_SOLID_LINE" 2 2 "CT_DASHED_LINE" 3 3 "CT_UNCROSSABLE" DEFAULT_VALUE "" /end COMPU_VTAB_RANGE
/begin COMPU_VTAB CounterLimit "enumeration table" TAB_VERB 2 0 "LOWER" 1 "UPPER" /end COMPU_VTAB
/begin COMPU_VTAB CrcRegType "enumeration table" TAB_VERB 2 1 "Rif_CrcReg_disabled" 2 "Rif_CrcReg_enabled" /end COMPU_VTAB
/begin COMPU_VTAB DSP_ALIGNMENT_MODES "enumeration table" TAB_VERB 3 0 "AlignmentModeOff" 1 "AlignmentModeCornerReflector" 2 "AlignmentModeFlatPlate" /end COMPU_VTAB
/begin COMPU_VTAB DYNCALDYNSTATE "enumeration table" TAB_VERB 5 0 "DYNCALI_INIT" 1 "DYNCALIB_CALCULATE" 2 "DYNCALIB_NVMUPDATE" 3 "DYNCALIB_ERROR" 4 "DYNCALIB_SUCCESS" /end COMPU_VTAB
/begin COMPU_VTAB_RANGE DaCoreStates "" 7 0 0 "DC_INVALID" 1 1 "DC_NOT_INITIALIZED" 2 2 "DC_STARTUP" 3 3 "DC_AVAILABLE" 4 4 "DC_SAFE" 5 5 "DC_SHUTDOWN" 6 6 "DC_OOS" DEFAULT_VALUE "" /end COMPU_VTAB_RANGE
/begin COMPU_VTAB DefinedTargetMotionGoal "enumeration table" TAB_VERB 1 0 "doConstantDeceleration" /end COMPU_VTAB
/begin COMPU_VTAB_RANGE DegreeOfAssistance "" 6 0 0 "DOA_NotAvailable" 1 1 "DOA_Informing" 2 2 "DOA_Warning" 3 3 "DOA_Assisting" 4 4 "DOA_PAuto" 5 5 "DOA_FAuto" DEFAULT_VALUE "" /end COMPU_VTAB_RANGE
/begin COMPU_VTAB_RANGE Drivability "" 3 0 0 "DRIVABILITY_YES" 1 1 "DRIVABILITY_NO" 2 2 "DRIVABILITY_ONLY_EMERGENCY" DEFAULT_VALUE "" /end COMPU_VTAB_RANGE
/begin COMPU_VTAB_RANGE DriverSteeringActivity "" 6 0 0 "DriverSteeringActivity_NotKnown" 1 1 "DriverSteeringActivity_None" 2 2 "DriverSteeringActivity_Low" 3 3 "DriverSteeringActivity_Medium" 4 4 "DriverSteeringActivity_High" 5 5 "DriverSteeringActivity_Excessive" DEFAULT_VALUE "" /end COMPU_VTAB_RANGE
/begin COMPU_VTAB_RANGE DrivingDirection "" 3 0 0 "DD_UNKNOWN" 1 1 "DD_EGO_DIRECTION" 2 2 "DD_ONCOMING" DEFAULT_VALUE "" /end COMPU_VTAB_RANGE
/begin COMPU_VTAB_RANGE DrivingProfile "" 4 0 0 "DP_Eco" 1 1 "DP_Normal" 2 2 "DP_Comfortable" 3 3 "DP_Sport" DEFAULT_VALUE "" /end COMPU_VTAB_RANGE
/begin COMPU_VTAB_RANGE DrivingState "" 3 0 0 "Forwards" 1 1 "Backwards" 2 2 "Standstill" DEFAULT_VALUE "" /end COMPU_VTAB_RANGE
/begin COMPU_VTAB_RANGE DrivingTask "" 11 0 0 "DT_UNKNOWN" 1 1 "DT_LANE_KEEPING_0" 2 2 "DT_LANE_KEEPING_1" 3 3 "DT_LANE_KEEPING_2" 4 4 "DT_LANE_CHANGE_01" 5 5 "DT_LANE_CHANGE_10" 6 6 "DT_LANE_CHANGE_12" 7 7 "DT_LANE_CHANGE_21" 8 8 "DT_OUT_OF_BOUNDS_LEFT" 9 9 "DT_OUT_OF_BOUNDS_RIGHT" 10 10 "DT_COUNT" DEFAULT_VALUE "" /end COMPU_VTAB_RANGE
/begin COMPU_VTAB_RANGE DrivingTask.OLD_1 "" 10 0 0 "DT_UNKNOWN" 1 1 "DT_LANE_KEEPING_0" 2 2 "DT_LANE_KEEPING_1" 3 3 "DT_LANE_KEEPING_2" 4 4 "DT_LANE_CHANGE_01" 5 5 "DT_LANE_CHANGE_10" 6 6 "DT_LANE_CHANGE_12" 7 7 "DT_LANE_CHANGE_21" 8 8 "DT_OUT_OF_BOUNDS_LEFT" 9 9 "DT_OUT_OF_BOUNDS_RIGHT" DEFAULT_VALUE "" /end COMPU_VTAB_RANGE
/begin COMPU_VTAB DynCalibState "enumeration table" TAB_VERB 11 0 "NO_CALIBRATION" 1 "EOL_START" 2 "EOL_STOP" 3 "SDA_START" 4 "SDA_STOP" 5 "EOL_CONTINUE" 6 "SDA_CONTINUE" 7 "STC_START" 8 "STC_CONTINUE" 9 "STC_STOP" 10 "STC_PAUSE" /end COMPU_VTAB
/begin COMPU_VTAB DynCalibStatus "enumeration table" TAB_VERB 11 0 "NO_CALIB_PROCESS" 1 "EOL_RUNNING" 2 "EOL_PASSED" 3 "EOL_FAILED" 4 "SDA_RUNNING" 5 "SDA_PASSED" 6 "SDA_FAILED" 7 "STC_RUNNING" 8 "STC_PASSED" 9 "STC_FAILED" 10 "STC_PAUSED" /end COMPU_VTAB
/begin COMPU_VTAB Dynamic1DMotionGoal "enumeration table" TAB_VERB 2 0 "doTargetBraking" 1 "followNotSupportedByEmg" /end COMPU_VTAB
/begin COMPU_VTAB Dynamic1DMotionGoal_v0 "enumeration table" TAB_VERB 1 0 "doTargetBraking" /end COMPU_VTAB
/begin COMPU_VTAB Dynamic2DMotionGoal "enumeration table" TAB_VERB 1 0 "evadeLaterallyByKeepingSafetyDistance" /end COMPU_VTAB
/begin COMPU_VTAB EAalAntenna "enumeration table" TAB_VERB 4 0 "AalAnt1" 1 "AalAnt2" 2 "AalAnt3" 160 "AalAntOff" /end COMPU_VTAB
/begin COMPU_VTAB EAalMsg "enumeration table" TAB_VERB 86 0 "enAalOk" 1 "enAalSpiFailed" 2 "enAalSpiTransferFailed" 3 "enAalRifConfigFailed" 4 "enAalWrongMmicaddr" 5 "enAalBufferNotempty" 6 "enAalBufferOverflow" 7 "enAalRmpmemOverflow" 8 "enAalRmpmemWriteFailed" 9 "enAalModparaNotset" 10 "enAalFwstateNotset" 11 "enAalStatemachineFailed" 12 "enAalHardresetFailed" 13 "enAalResetError" 14 "enAalRifResetFailed" 15 "enAalRifCalibFailed" 16 "enAalModrepeatctrMax" 17 "enAalWrongTramp" 18 "enAalWrongFstart" 19 "enAalWrongNfstep" 20 "enAalWrongNseq" 21 "enAalWrongMinfreq" 22 "enAalWrongMaxfreq" 23 "enAalWrongSamplefreq" 24 "enAalWrongAntChoice" 25 "enAalRamptime2small" 26 "enAalSetCwrampFailed" 27 "enAalWrongHighpassfreq" 28 "enAalWrongMinmaxfreq" 29 "enAalWrongNspon" 30 "enAalWrongDecfactor" 31 "enAalWrongFirmeware" 32 "enAalFirmwareTimeout" 33 "enAalFwresultsFailed" 34 "enAalDelOldFwFailed" 35 "enAalWrongRunfwNrparams" 36 "enAalWrongRunfwNrresult" 37 "enAalFwNotStarted" 38 "enAalFwStatusCountEmpty" 39 "enAalFwFailed" 40 "enAalFwAreaFailed" 41 "enAalRxsVersionFailed" 42 "enAalEnablerxtxFailed" 43 "enAalForcecalibFailed" 44 "enAalCalibsubfuncFailed" 45 "enAalMmicstatusError" 46 "enAalMmicstatusOkpinFailed" 47 "enAalMmicstatusRxError" 48 "enAalMmicstatusTxError" 49 "enAalMmicstatusRxtxError" 50 "enAalRfspCrcNotfound" 51 "enAalMonrsfpWritecrcErr" 52 "enAalMonrfspError" 53 "enAalMmicMissingFactorydata" 54 "enAalMmicVersionFactorydataError" 55 "enAalFirmewareRunning" 56 "enAalStatusUnknownFwstatus" 57 "enAalStatusCmdNotAllowed" 58 "enAalStatusInvalidSig" 59 "enAalStatusInvalidSetting" 60 "enAalStatusCalibError" 61 "enAalStatus77GhzPllUnlocked" 62 "enAalStatusBbError" 63 "enAalStatusParamError" 64 "enAalStatusInvalidCmd" 65 "enAalStatusUnderflow" 66 "enAalStatusOverflow" 67 "enAalStatusGeneralError" 68 "enAalStatusRmpError" 69 "enAalStatusMonLimitError" 70 "enAalStatusMonCrcError" 71 "enAalStatusError" 72 "enAalStatusUnknownCmd" 73 "enAalRmpRdyTrigFailed" 74 "enAalRmpTrigSignalFailed" 75 "enAalResetRmpTrigSignalFailed" 76 "enAalSetAfeRegForwardRmpFailed" 77 "enAalPadGuardFailed" 78 "enAalRxsVersionChargePumpNotSupported" 79 "enAalSpiTransferPreviousTransferFailed" 80 "enAalSpiTransferReadVerifyFailed" 81 "enAalSpiTransferReadFailed" 82 "enAalSpiTransferWriteVerifyFailed" 83 "enAalSpiTransferWriteFailed" 84 "enAalWriteFixRegFailed" 85 "enAalWriteFwAreaFailed" /end COMPU_VTAB
/begin COMPU_VTAB EAccMode "enumeration table" TAB_VERB 2 0 "base" 1 "stopAndGo" /end COMPU_VTAB
/begin COMPU_VTAB_RANGE EBLDEVAL_X_SensorType "" 3 0 0 "SINGLE_SENSOR" 1 1 "MASTER_SENSOR" 2 2 "SLAVE_SENSOR" DEFAULT_VALUE "" /end COMPU_VTAB_RANGE
/begin COMPU_VTAB_RANGE EBLDIndicatorState "" 3 0 0 "INVALID" 1 1 "NOT_BLIND" 2 2 "BLIND" DEFAULT_VALUE "" /end COMPU_VTAB_RANGE
/begin COMPU_VTAB EBepProcstep "enumeration table" TAB_VERB 6 0 "enBepProcstepUntilDistx" 1 "enBepProcstepMoving" 2 "enBepProcstepEverySecond" 3 "enBepProcstepAllOther" 4 "enBepProcstepAllOtherDuplicate" 255 "enBepProcstepNotSet" /end COMPU_VTAB
/begin COMPU_VTAB EBepReflectionFilterStatus "enumeration table" TAB_VERB 20 0 "enValid" 1 "enNotProcessed" 2 "enInvalidDet" 3 "enDistanceLessZero" 4 "enRcsTooSmall" 5 "enDvqlyTooLow" 6 "enAngqlyTooLow" 7 "enAngqlyTooLowTwotarg" 8 "enMovingSnrTooLow" 9 "enVambMaxTooLow" 10 "enVambMax1Max2TooSimilar" 11 "enRcsNearrangeTooSmall" 12 "enPlantTest" 13 "enVambDiffFov" 14 "enAngSimoInsideMimoCentral" 15 "enInvalidInputDataVar" 16 "enRcsmaxNearrangeTooSmall" 17 "enVarInvalidCplxamps" 18 "enAngSnrsEqZero" 255 "enInValidNotSet" /end COMPU_VTAB
/begin COMPU_VTAB EBepReflectionPlsDeleteMode "enumeration table" TAB_VERB 4 0 "enPlsValid" 1 "enPlsDvqlyVambTooLow" 2 "enPlsLocintlistFull" 3 "enPlsLocextlistFull" /end COMPU_VTAB
/begin COMPU_VTAB_RANGE ECommandType "" 3 0 0 "NO_COMMAND" 1 1 "CONNECT" 2 2 "DISCONNECT" DEFAULT_VALUE "" /end COMPU_VTAB_RANGE
/begin COMPU_VTAB_RANGE EControlState "" 3 0 0 "CONTROL_STATE_NOUPDATE" 1 1 "CONTROL_STATE_START" 2 2 "CONTROL_STATE_STOP" DEFAULT_VALUE "" /end COMPU_VTAB_RANGE
/begin COMPU_VTAB_RANGE ECopyHandshake "" 3 0 0 "NOT_REQUIRED" 1 1 "REQUIRED" 2 2 "COPY_DONE" DEFAULT_VALUE "" /end COMPU_VTAB_RANGE
/begin COMPU_VTAB ECutInLevel "enumeration table" TAB_VERB 4 0 "no" 1 "low" 2 "medium" 3 "high" /end COMPU_VTAB
/begin COMPU_VTAB EDefaultState "enumeration table" TAB_VERB 3 0 "init" 1 "normal" 2 "na" /end COMPU_VTAB
/begin COMPU_VTAB_RANGE EDetailledErrorCode "" 60 0 0 "ERROR_CODE_NO_ERROR" 1 1 "ERROR_CODE_NVM_OK" 2 2 "ERROR_CODE_NVM_BUSY" 3 3 "ERROR_CODE_NVM_ERROR" 4 4 "ERROR_CODE_NVM_IDUNKNOWN" 5 5 "ERROR_CODE_NVM_WRONGLENGTH" 6 6 "ERROR_CODE_PARAM_DSDL_OK" 7 7 "ERROR_CODE_PARAM_DSDL_NOT_OK" 8 8 "ERROR_CODE_PARAM_DSDL_TRY_AGAIN_LATER" 9 9 "ERROR_CODE_PARAM_DSDL_BUSY" 10 10 "ERROR_CODE_PARAM_DSDL_POSSIBLE" 11 11 "ERROR_CODE_PARAM_ERASEPENDING" 12 12 "ERROR_CODE_PARAM_ERASEDONE" 13 13 "ERROR_CODE_PARAM_ERASEONGOING" 14 14 "ERROR_CODE_PARAM_ERASEFAILED" 15 15 "ERROR_CODE_PARAM_ERASEINIT" 16 16 "ERROR_CODE_PARAM_CRC_CORRECT" 17 17 "ERROR_CODE_PARAM_CRC_NOTCORRECT" 18 18 "ERROR_CODE_PARAM_CRC_INCOMPLETE" 19 19 "ERROR_CODE_PARAM_CRC_INIT" 20 20 "ERROR_CODE_DID_OK" 21 21 "ERROR_CODE_DID_OK_VARLENGTH" 22 22 "ERROR_CODE_ID_INVALIDRANGE" 23 23 "ERROR_CODE_DATA_INVALIDRANGE" 24 24 "ERROR_CODE_ACTIONNOTSUPPORTED" 25 25 "ERROR_CODE_SEQUENCEERROR" 26 26 "ERROR_CODE_CAN_BUSOFF" 27 27 "ERROR_CODE_CANMESSAGEERROR" 28 28 "ERROR_CODE_CANQBITERROR" 29 29 "ERROR_CODE_ENGINEISRUNNING" 30 30 "ERROR_CODE_VEHICLESPEEDTOOHIGH" 31 31 "ERROR_CODE_DID_INVALID" 32 32 "ERROR_CODE_ERROR_HIGHTEMPERATURE" 33 33 "ERROR_CODE_ERROR_HIGHVOLTAGE" 34 34 "ERROR_CODE_ERROR_LOWVOLTAGE" 35 35 "ERROR_CODE_INCORRECT_LENGTH" 36 36 "ERROR_CODE_DCMBUFFEROVERFLOW" 37 37 "ERROR_CODE_REPEAT_REQUEST" 38 38 "ERROR_CODE_ERROR_FAILUREPREVENTSEXECUTION" 39 39 "ERROR_CODE_REQ_OUT_OF_RANGE" 40 40 "ERROR_CODE_ACCESS_DENIED" 41 41 "ERROR_CODE_INCORRECT_KEY" 42 42 "ERROR_CODE_EXCEEDED_ATTEMPTS" 43 43 "ERROR_CODE_TIMERROR_CODE_DELAY_NOT_EXPIRED" 44 44 "ERROR_CODE_UP_DONWLOAD_NOT_ACCEPTED" 45 45 "ERROR_CODE_DATA_TRANSFER_SUSPENDED" 46 46 "ERROR_CODE_PROGRAMMING_FAILURE" 47 47 "ERROR_CODE_INCORRECT_BLOCK_SEQUENCE" 48 48 "ERROR_CODE_HIGH_RPM" 49 49 "ERROR_CODE_LOW_RPM" 50 50 "ERROR_CODE_ENGINERROR_CODE_NOT_RUNNING" 51 51 "ERROR_CODE_LOW_ENGINERROR_CODE_RUNTIME" 52 52 "ERROR_CODE_LOW_TEMPERATURE" 53 53 "ERROR_CODE_VEHICLE_SPEED_LOW" 54 54 "ERROR_CODE_WSCRH_OPEN_CIRCUIT" 55 55 "ERROR_CODE_CODING_NOT_AVAILABLE" 56 56 "ERROR_CODE_PARAM_NOT_AVAILABLE" 57 57 "ERROR_CODE_CALIBRATION_NOT_AVAILABLE" 58 58 "ERROR_CODE_COMPONENT_IN_ERROR_STATE" 59 59 "ERROR_CODE_COMPONENT_IN_INIT_STATE" DEFAULT_VALUE "" /end COMPU_VTAB_RANGE
/begin COMPU_VTAB_RANGE EDiaInternalStates "" 18 0 0 "DIA_INTERNAL_STATE_IDLE" 1 1 "DIA_INTERNAL_STATE_CHECK_START_REQUEST_PARAMS" 2 2 "DIA_INTERNAL_STATE_CHECK_PRECONDITIONS" 3 3 "DIA_INTERNAL_STATE_CHECK_START_COMPONENT_STATE" 4 4 "DIA_INTERNAL_STATE_INIT_ERROR" 5 5 "DIA_INTERNAL_STATE_WAITING_START" 6 6 "DIA_INTERNAL_STATE_START_ERROR" 7 7 "DIA_INTERNAL_STATE_WAITING_RUNNING" 8 8 "DIA_INTERNAL_STATE_CHECK_RUN_TO_STOP_REQUEST" 9 9 "DIA_INTERNAL_STATE_CHECK_STOP_CONDITIONS" 10 10 "DIA_INTERNAL_STATE_CHECK_STOP_COMPONENT_STATE" 11 11 "DIA_INTERNAL_STATE_TWICE_STARTED" 12 12 "DIA_INTERNAL_STATE_PROCESS_STOP" 13 13 "DIA_INTERNAL_STATE_WAITING_STOP" 14 14 "DIA_INTERNAL_STATE_STOP_ERROR" 15 15 "DIA_INTERNAL_STATE_STOPPED" 16 16 "DIA_INTERNAL_STATE_CHECK_IDLE_TO_STOP_REQUEST" 17 17 "DIA_INTERNAL_STATE_STOP_BUT_NEVER_STARTED" DEFAULT_VALUE "" /end COMPU_VTAB_RANGE
/begin COMPU_VTAB EStatus "enumeration table" TAB_VERB 4 0 "init" 1 "passive" 2 "active" 255 "error" /end COMPU_VTAB
/begin RECORD_LAYOUT __Float16_Value FNC_VALUES 1 FLOAT16_IEEE ROW_DIR DIRECT /end RECORD_LAYOUT
/begin RECORD_LAYOUT __Float32_Value FNC_VALUES 1 FLOAT32_IEEE ROW_DIR DIRECT /end RECORD_LAYOUT
/begin RECORD_LAYOUT __UByte_Value FNC_VALUES 1 UBYTE ROW_DIR DIRECT /end RECORD_LAYOUT
/begin RECORD_LAYOUT __UWord_Value FNC_VALUES 1 UWORD ROW_DIR DIRECT /end RECORD_LAYOUT
/begin GROUP Aurix "Measurements when using Infineon Aurix"
 /begin REF_MEASUREMENT VX1000.POD.mon.aurix.aurora.rxFreqKHz VX1000.POD.mon.aurix.dapFreqkHz VX1000.POD.mon.aurix.errorMsgCnt VX1000.POD.mon.aurix.lastAddrBeforeEcuOverrun VX1000.POD.mon.aurix.retransmitCnt /end REF_MEASUREMENT
/end GROUP
/begin GROUP BaseModule "VX1060, VX113x, VX1161.3x internal Measurements"
 /begin REF_MEASUREMENT VX1000.BM.mon.bmTemperature VX1000.BM.mon.monEvtCntDword VX1000.BM.mon.te.tfifo.extRamMaxByte VX1000.BM.mon.xcpSocket0.freeTLBs VX1000.BM.mon.xcpSocket1.freeTLBs VX1000.BM.mon.xcpSocket2.freeTLBs VX1000.BM.mon.xcpSocket3.freeTLBs VX1000.BM.mon.xcpe.evtFifoMax /end REF_MEASUREMENT
 /begin SUB_GROUP HSSL Serial /end SUB_GROUP
/end GROUP
/begin GROUP HSSL ""
 /begin REF_MEASUREMENT VX1000.BM.mon.hssl.TxFreqKHz VX1000.BM.mon.hssl.pipe0RxCnt VX1000.BM.mon.hssl.pipe1RxCnt VX1000.BM.mon.hssl.pipe2RxCnt VX1000.BM.mon.hssl.retransDLCnt VX1000.BM.mon.hssl.retransULCnt /end REF_MEASUREMENT
/end GROUP
/begin GROUP LRR "Kommentar" ROOT
 /begin REF_MEASUREMENT _Dem_AllEventsState._82_ _Dem_AllEventsState._82_._debounceLevel _Dem_AllEventsState._82_._state _Dem_AllEventsState8._82_ _Dem_AllEventsState8._82_._lastReportedEvent _Dem_AllEventsStatusByte._82_ _Dem_Cfg_DebArTime_Paramset1._44_ _Dem_Cfg_DebArTime_Paramset1._44_._FDCThreshold _Dem_Cfg_DebArTime_Paramset1._44_._SuspiciousThreshold _Dem_Cfg_DebArTime_Paramset1._44_._TimeFailedThreshold _Dem_Cfg_DebArTime_Paramset1._44_._TimePassedThreshold _Dem_Cfg_EnvEventId2EnvData._82_ _Dem_Cfg_EnvEventId2EnvData._82_._extDataId _Dem_Cfg_EnvEventId2EnvData._82_._freezeFrameId _Dem_EvtCategoryPrio._5_ _Dem_EvtCategoryPrio._5_._evtcatprio _Dem_MapEventIdToDtcId._82_ _FiM_Cfg_NumOffsetEvent_auo._83_ _NvM_Prv_RamMirror_au8._82_ /end REF_MEASUREMENT
/end GROUP
/begin GROUP Nexus "Measurements when using Nexus AUX Trace Interface of PowerPC MCUs"
 /begin REF_MEASUREMENT VX1000.POD.mon.nexus.aurora.rxFreqKHz VX1000.POD.mon.nexus.aux.freqKHz VX1000.POD.mon.nexus.ecuOverrunCnt VX1000.POD.mon.nexus.ecuStallCnt VX1000.POD.mon.nexus.lastAddrBeforeEcuOverrun /end REF_MEASUREMENT
/end GROUP
/begin GROUP POD "VX14xx POD internal Measurements"
 /begin REF_MEASUREMENT VX1000.POD.mon.aurora.fifo.bufferUtilByte VX1000.POD.mon.aurora.fifo.din_fifo_usedw VX1000.POD.mon.aurora.fifo.dout_fifo_usedw VX1000.POD.mon.monEvtCntDword VX1000.POD.mon.pcie.overloadCnt VX1000.POD.mon.pod.temperature VX1000.POD.mon.trace.adconInputCnt VX1000.POD.mon.trace.adfilOutputCnt VX1000.POD.mon.traceBuffer.externalMax VX1000.POD.mon.traceBuffer.outMax /end REF_MEASUREMENT
 /begin SUB_GROUP Aurix Nexus RH850 RIF RTPDMM /end SUB_GROUP
/end GROUP
/begin GROUP RH850 "Measurements when using Renesas RH850 Data Trace"
 /begin REF_MEASUREMENT VX1000.POD.mon.rh850.aud.audFifoMax VX1000.POD.mon.rh850.aurora.rxFreqKHz VX1000.POD.mon.rh850.ecuOverrunCnt VX1000.POD.mon.rh850.lastAddrBeforeEcuOverrun VX1000.POD.mon.rh850.lastErrorMsgInfo /end REF_MEASUREMENT
/end GROUP
/begin GROUP RIF "Measurements when using the Radar RAW Data Interface" /begin REF_MEASUREMENT VX1000.POD.mon.rif1.crcErrorCnt /end REF_MEASUREMENT /end GROUP
/begin GROUP RTPDMM "Measurements when using the TI TMS570 RTP/DMM Data Trace Interface"
 /begin REF_MEASUREMENT VX1000.POD.mon.rtpdmm.dmmFreqKHz VX1000.POD.mon.rtpdmm.dmmStopCnt VX1000.POD.mon.rtpdmm.rtpFreqKHz VX1000.POD.mon.rtpdmm.rtpStopCnt /end REF_MEASUREMENT
/end GROUP
/begin GROUP Serial ""
 /begin REF_MEASUREMENT VX1000.BM.mon.serial.niosMaxDapLoad VX1000.BM.mon.serial.niosOldaOverruns VX1000.BM.mon.serial.targetIfRetryCounter /end REF_MEASUREMENT
/end GROUP
/begin GROUP SystemInfo "VX1060, VX113x, VX1621, VX1161.3x internal Measurements"
 /begin REF_CHARACTERISTIC VX1000.sys.usrCustomer VX1000.sys.usrPosition VX1000.sys.usrProject VX1000.sys.usrSample /end REF_CHARACTERISTIC
 /begin REF_MEASUREMENT VX1000.sys.ecuEdJtagId VX1000.sys.ecuJtagId VX1000.sys.ecuProcName VX1000.sys.ecuProcNameLen VX1000.sys.fpgaLeftVer VX1000.sys.fpgaLeftVer.build VX1000.sys.fpgaLeftVer.major VX1000.sys.fpgaLeftVer.minor VX1000.sys.fwVer VX1000.sys.fwVer.build VX1000.sys.fwVer.major VX1000.sys.fwVer.minor VX1000.sys.parentArticleNumber VX1000.sys.parentSerialNumber VX1000.sys.podECUIdMiscNumber VX1000.sys.podECUIdMuster VX1000.sys.podECUIdPosition VX1000.sys.podECUIdProject VX1000.sys.podFpgaVer VX1000.sys.podFpgaVer.build VX1000.sys.podFpgaVer.major VX1000.sys.podFpgaVer.minor VX1000.sys.podFwVer VX1000.sys.podFwVer.build VX1000.sys.podFwVer.major VX1000.sys.podFwVer.minor VX1000.sys.podHwTypeRev VX1000.sys.podTemp VX1000.sys.podVX1902HwTypeRev VX1000.sys.podVX1902VectorSerNo VX1000.sys.podVectorArtNo VX1000.sys.podVectorSerNo VX1000.sys.upTimeS VX1000.sys.vectorArtNo VX1000.sys.vectorSerNo VX1000.sys.vx1161SlotNumber /end REF_MEASUREMENT
/end GROUP
/begin GROUP VX1000 "VX1000 Internal Signals" ROOT /begin SUB_GROUP BaseModule POD SystemInfo XPOD /end SUB_GROUP /end GROUP
/begin GROUP XPOD "VX1621 internal Measurements"
 /begin REF_MEASUREMENT VX1000.xpod.ECU_IF_voltage VX1000.xpod.EMEM_voltage VX1000.xpod.Temperature VX1000.xpod.monEvtCntDword /end REF_MEASUREMENT
/end GROUP
/end MODULE
/end PROJECT
