/* generated by ASAP2 Modifier - ASAP2 Tool-Set Version 18.0.10 */
ASAP2_VERSION 1 71
/begin PROJECT RADAR_GEN5 ""
/begin HEADER "" VERSION "TO_BE_FILLED" /end HEADER
/begin MODULE RADAR_GEN5 ""
/begin MOD_PAR "" ADDR_EPK 0x800BC9CC EPK "$ SW built by jenkins on par-aurix-4288-jb8xv-57r3x-lj8dg at 2024/11/21 23:23:33 $" /end MOD_PAR
/begin MOD_COMMON "" ALIGNMENT_BYTE 1 ALIGNMENT_WORD 2 ALIGNMENT_LONG 4 ALIGNMENT_FLOAT16_IEEE 2 ALIGNMENT_FLOAT32_IEEE 4 ALIGNMENT_FLOAT64_IEEE 4 ALIGNMENT_INT64 4 /end MOD_COMMON
/begin IF_DATA XCP
 /begin PROTOCOL_LAYER 0x0100 0x09C4 0xC8 0x00 0x00 0x00 0x00 0x00 0xFA 0x0200 BYTE_ORDER_MSB_LAST ADDRESS_GRANULARITY_BYTE OPTIONAL_CMD PROGRAM_PREPARE OPTIONAL_CMD PROGRAM_RESET OPTIONAL_CMD PROGRAM OPTIONAL_CMD PROGRAM_CLEAR OPTIONAL_CMD PROGRAM_START OPTIONAL_CMD ALLOC_ODT_ENTRY OPTIONAL_CMD ALLOC_ODT OPTIONAL_CMD ALLOC_DAQ OPTIONAL_CMD FREE_DAQ OPTIONAL_CMD GET_DAQ_EVENT_INFO OPTIONAL_CMD GET_DAQ_RESOLUTION_INFO OPTIONAL_CMD GET_DAQ_PROCESSOR_INFO OPTIONAL_CMD GET_DAQ_CLOCK OPTIONAL_CMD START_STOP_SYNCH OPTIONAL_CMD START_STOP_DAQ_LIST OPTIONAL_CMD GET_DAQ_LIST_MODE OPTIONAL_CMD SET_DAQ_LIST_MODE OPTIONAL_CMD WRITE_DAQ OPTIONAL_CMD SET_DAQ_PTR OPTIONAL_CMD CLEAR_DAQ_LIST OPTIONAL_CMD SHORT_DOWNLOAD OPTIONAL_CMD DOWNLOAD_MAX OPTIONAL_CMD DOWNLOAD OPTIONAL_CMD SHORT_UPLOAD OPTIONAL_CMD UPLOAD OPTIONAL_CMD SET_MTA OPTIONAL_CMD GET_COMM_MODE_INFO /end PROTOCOL_LAYER
 /begin DAQ DYNAMIC 0x00 0x1B 0x00 OPTIMISATION_TYPE_DEFAULT ADDRESS_EXTENSION_FREE IDENTIFICATION_FIELD_TYPE_RELATIVE_BYTE GRANULARITY_ODT_ENTRY_SIZE_DAQ_BYTE 0xF8 OVERLOAD_INDICATION_PID /begin STIM GRANULARITY_ODT_ENTRY_SIZE_STIM_BYTE 0xF8 /end STIM /begin TIMESTAMP_SUPPORTED 0x01 SIZE_DWORD UNIT_1US /end TIMESTAMP_SUPPORTED /begin EVENT "core0_t10" "core0_t10" 0x01 DAQ 0xFF 0x0A 0x06 0x00 /end EVENT /begin EVENT "core0_t20" "core0_t20" 0x02 DAQ 0xFF 0x14 0x06 0x00 /end EVENT /begin EVENT "core0_t50" "core0_t50" 0x19 DAQ 0xFF 0x32 0x06 0x00 /end EVENT /begin EVENT "core0_bg" "core0_bg" 0x04 DAQ 0xFF 0x32 0x06 0x00 /end EVENT /begin EVENT "core0_t100" "core0_t10" 0x03 DAQ 0xFF 0x64 0x06 0x00 /end EVENT /begin EVENT "core1_t10" "core1_t10" 0x05 DAQ 0xFF 0x0A 0x06 0x00 /end EVENT /begin EVENT "core1_t20" "core1_t20" 0x06 DAQ 0xFF 0x14 0x06 0x00 /end EVENT /begin EVENT "core1_bg" "core1_bg" 0x08 DAQ 0xFF 0x32 0x06 0x00 /end EVENT /begin EVENT "core1_t100" "core1_t10" 0x07 DAQ 0xFF 0x64 0x06 0x00 /end EVENT /begin EVENT "core2_t10" "core2_t10" 0x09 DAQ 0xFF 0x0A 0x06 0x00 /end EVENT /begin EVENT "core2_t20" "core2_t20" 0x0A DAQ 0xFF 0x14 0x06 0x00 /end EVENT /begin EVENT "core2_bg" "core2_bg" 0x0C DAQ 0xFF 0x32 0x06 0x00 /end EVENT /begin EVENT "core2_t100" "core2_t10" 0x0B DAQ 0xFF 0x64 0x06 0x00 /end EVENT /begin EVENT "core3_t10" "core3_t10" 0x0D DAQ 0xFF 0x0A 0x06 0x00 /end EVENT /begin EVENT "core3_t20" "core3_t20" 0x0E DAQ 0xFF 0x14 0x06 0x00 /end EVENT /begin EVENT "core3_bg" "core3_bg" 0x10 DAQ 0xFF 0x32 0x06 0x00 /end EVENT /begin EVENT "core3_t100" "core3_t10" 0x0F DAQ 0xFF 0x64 0x06 0x00 /end EVENT /begin EVENT "core4_t10" "core4_t10" 0x11 DAQ 0xFF 0x0A 0x06 0x00 /end EVENT /begin EVENT "core4_t20" "core4_t20" 0x12 DAQ 0xFF 0x14 0x06 0x00 /end EVENT /begin EVENT "core4_t100" "core4_t10" 0x13 DAQ 0xFF 0x64 0x06 0x00 /end EVENT /begin EVENT "core4_bg" "core4_bg" 0x14 DAQ 0xFF 0x32 0x06 0x00 /end EVENT /begin EVENT "core5_t10" "core5_t10" 0x15 DAQ 0xFF 0x0A 0x06 0x00 /end EVENT /begin EVENT "core5_t20" "core5_t20" 0x16 DAQ 0xFF 0x14 0x06 0x00 /end EVENT /begin EVENT "core5_t100" "core5_t10" 0x17 DAQ 0xFF 0x64 0x06 0x00 /end EVENT /begin EVENT "core5_bg" "core5_bg" 0x18 DAQ 0xFF 0x32 0x06 0x00 /end EVENT /begin EVENT "VX113x" "VX113x" 0x8000 DAQ 0xFF 0x0A 0x06 0x00 /end EVENT /begin EVENT "VX14xx" "VX14xx" 0x8001 DAQ 0xFF 0x0A 0x06 0x00 /end EVENT
  /begin EVENT "MEAS_OBJ_HIL_BYPASS_EV" "MEAS_OBJ_" 0x1B DAQ 0xFF 0x32 0x06 0xFE /end EVENT
  /begin EVENT "STIM_OBJ_HIL_BYPASS_EV" "STIM_OBJ_" 0x1C STIM 0xFF 0x32 0x06 0xFF /end EVENT
  /begin EVENT "mE4029F2B" "mE4029F2B" 0x60 DAQ 0xFF 0x01 0x07 0x00 /end EVENT
  /begin EVENT "m70BEDAAD" "m70BEDAAD" 0x61 DAQ 0xFF 0x01 0x07 0x00 /end EVENT
  /begin EVENT "m4BF866C4" "m4BF866C4" 0x62 DAQ 0xFF 0x01 0x07 0x00 /end EVENT
  /begin EVENT "m5C5DFE49" "m5C5DFE49" 0x63 DAQ 0xFF 0x01 0x07 0x00 /end EVENT
  /begin EVENT "m5F02D6B7" "m5F02D6B7" 0x64 DAQ 0xFF 0x01 0x07 0x00 /end EVENT
  /begin EVENT "m8DE2D5EF" "m8DE2D5EF" 0x65 DAQ 0xFF 0x01 0x07 0x00 /end EVENT
  /begin EVENT "mD24807A4" "mD24807A4" 0x66 DAQ 0xFF 0x01 0x07 0x00 /end EVENT
  /begin EVENT "mB38B253F" "mB38B253F" 0x67 DAQ 0xFF 0x01 0x07 0x00 /end EVENT
  /begin EVENT "mF6CC185E" "mF6CC185E" 0x68 DAQ 0xFF 0x01 0x07 0x00 /end EVENT
  /begin EVENT "m6314FA1E" "m6314FA1E" 0x69 DAQ 0xFF 0x01 0x07 0x00 /end EVENT
  /begin EVENT "m19B438EF" "m19B438EF" 0x6A DAQ 0xFF 0x01 0x07 0x00 /end EVENT
  /begin EVENT "mF69D72B0" "mF69D72B0" 0x6B DAQ 0xFF 0x01 0x07 0x00 /end EVENT
  /begin EVENT "m02018FD3" "m02018FD3" 0x6C DAQ 0xFF 0x01 0x07 0x00 /end EVENT
  /begin EVENT "m51B893B4" "m51B893B4" 0x6D DAQ 0xFF 0x01 0x07 0x00 /end EVENT
  /begin EVENT "mE109D0C6" "mE109D0C6" 0x6E DAQ 0xFF 0x01 0x07 0x00 /end EVENT
  /begin EVENT "mEA0B778A" "mEA0B778A" 0x6F DAQ 0xFF 0x01 0x07 0x00 /end EVENT
  /begin EVENT "m2529E72F" "m2529E72F" 0x70 DAQ 0xFF 0x01 0x07 0x00 /end EVENT
  /begin EVENT "mE208A9DF" "mE208A9DF" 0x71 DAQ 0xFF 0x01 0x07 0x00 /end EVENT
  /begin EVENT "m52452F75" "m52452F75" 0x72 DAQ 0xFF 0x01 0x07 0x00 /end EVENT
  /begin EVENT "m00C89390" "m00C89390" 0x73 DAQ 0xFF 0x01 0x07 0x00 /end EVENT
  /begin EVENT "m7371B6A3" "m7371B6A3" 0x74 DAQ 0xFF 0x01 0x07 0x00 /end EVENT
  /begin EVENT "mF9D928E1" "mF9D928E1" 0x75 DAQ 0xFF 0x01 0x07 0x00 /end EVENT
  /begin EVENT "m6650D7E3" "m6650D7E3" 0x76 DAQ 0xFF 0x01 0x07 0x00 /end EVENT
  /begin EVENT "m7686B35C" "m7686B35C" 0x77 DAQ 0xFF 0x01 0x07 0x00 /end EVENT
  /begin EVENT "m028AD5B1" "m028AD5B1" 0x78 DAQ 0xFF 0x01 0x07 0x00 /end EVENT
  /begin EVENT "m388DCE1F" "m388DCE1F" 0x79 DAQ 0xFF 0x01 0x07 0x00 /end EVENT
  /begin EVENT "m277C35A2" "m277C35A2" 0x7A DAQ 0xFF 0x01 0x07 0x00 /end EVENT
  /begin EVENT "m3DDD8D96" "m3DDD8D96" 0x7B DAQ 0xFF 0x01 0x07 0x00 /end EVENT
  /begin EVENT "m03DB45A3" "m03DB45A3" 0x7C DAQ 0xFF 0x01 0x07 0x00 /end EVENT
  /begin EVENT "m4366BBD7" "m4366BBD7" 0x7D DAQ 0xFF 0x01 0x07 0x00 /end EVENT
  /begin EVENT "m2EFE43D5" "m2EFE43D5" 0x7E DAQ 0xFF 0x01 0x07 0x00 /end EVENT
  /begin EVENT "mA6B5A082" "mA6B5A082" 0x7F DAQ 0xFF 0x01 0x07 0x00 /end EVENT
  /begin EVENT "m129E7905" "m129E7905" 0x80 DAQ 0xFF 0x01 0x07 0x00 /end EVENT
  /begin EVENT "m6D96C5B7" "m6D96C5B7" 0x81 DAQ 0xFF 0x01 0x07 0x00 /end EVENT
  /begin EVENT "m4B5389F7" "m4B5389F7" 0x82 DAQ 0xFF 0x01 0x07 0x00 /end EVENT
  /begin EVENT "m05E4EEDA" "m05E4EEDA" 0x83 DAQ 0xFF 0x01 0x07 0x00 /end EVENT
  /begin EVENT "mAEE755BF" "mAEE755BF" 0x84 DAQ 0xFF 0x01 0x07 0x00 /end EVENT
  /begin EVENT "m8D34A18B" "m8D34A18B" 0x85 DAQ 0xFF 0x01 0x07 0x00 /end EVENT
  /begin EVENT "mBDF372E6" "mBDF372E6" 0x86 DAQ 0xFF 0x01 0x07 0x00 /end EVENT
  /begin EVENT "m673397A9" "m673397A9" 0x87 DAQ 0xFF 0x01 0x07 0x00 /end EVENT
  /begin EVENT "m09AF22B6" "m09AF22B6" 0x88 DAQ 0xFF 0x01 0x07 0x00 /end EVENT
  /begin EVENT "mED88301C" "mED88301C" 0x89 DAQ 0xFF 0x01 0x07 0x00 /end EVENT
  /begin EVENT "m5B30E0EC" "m5B30E0EC" 0x8A DAQ 0xFF 0x01 0x07 0x00 /end EVENT
  /begin EVENT "mD4FEA742" "mD4FEA742" 0x8B DAQ 0xFF 0x01 0x07 0x00 /end EVENT
  /begin EVENT "m6971EE33" "m6971EE33" 0x8C DAQ 0xFF 0x01 0x07 0x00 /end EVENT
  /begin EVENT "mF4236A7C" "mF4236A7C" 0x8D DAQ 0xFF 0x01 0x07 0x00 /end EVENT
  /begin EVENT "m169D989B" "m169D989B" 0x8E DAQ 0xFF 0x01 0x07 0x00 /end EVENT
  /begin EVENT "mE2D4D7CC" "mE2D4D7CC" 0x8F DAQ 0xFF 0x01 0x07 0x00 /end EVENT
  /begin EVENT "m74793D25" "m74793D25" 0x90 DAQ 0xFF 0x01 0x07 0x00 /end EVENT
  /begin EVENT "m54AAE2D2" "m54AAE2D2" 0x91 DAQ 0xFF 0x01 0x07 0x00 /end EVENT
  /begin EVENT "m44150998" "m44150998" 0x92 DAQ 0xFF 0x01 0x07 0x00 /end EVENT
  /begin EVENT "mC37BEA6B" "mC37BEA6B" 0x93 DAQ 0xFF 0x01 0x07 0x00 /end EVENT
  /begin EVENT "m7FC38E8C" "m7FC38E8C" 0x94 DAQ 0xFF 0x01 0x07 0x00 /end EVENT
  /begin EVENT "mE6EAC0BB" "mE6EAC0BB" 0x95 DAQ 0xFF 0x01 0x07 0x00 /end EVENT
  /begin EVENT "mF1BBE94A" "mF1BBE94A" 0x96 DAQ 0xFF 0x01 0x07 0x00 /end EVENT
  /begin EVENT "mC4AD6325" "mC4AD6325" 0x97 DAQ 0xFF 0x01 0x07 0x00 /end EVENT
  /begin EVENT "m5CC13641" "m5CC13641" 0x98 DAQ 0xFF 0x01 0x07 0x00 /end EVENT
  /begin EVENT "mF632389D" "mF632389D" 0x99 DAQ 0xFF 0x01 0x07 0x00 /end EVENT
  /begin EVENT "m7896344C" "m7896344C" 0x9A DAQ 0xFF 0x01 0x07 0x00 /end EVENT
  /begin EVENT "mEE42867E" "mEE42867E" 0x9B DAQ 0xFF 0x01 0x07 0x00 /end EVENT
  /begin EVENT "m8BE7C754" "m8BE7C754" 0x9C DAQ 0xFF 0x01 0x07 0x00 /end EVENT
  /begin EVENT "mC4CC89CB" "mC4CC89CB" 0x9D DAQ 0xFF 0x01 0x07 0x00 /end EVENT
  /begin EVENT "m31224576" "m31224576" 0x9E DAQ 0xFF 0x01 0x07 0x00 /end EVENT
  /begin EVENT "mD95C1093" "mD95C1093" 0x9F DAQ 0xFF 0x01 0x07 0x00 /end EVENT
  /begin EVENT "m8188E012" "m8188E012" 0xA0 DAQ 0xFF 0x01 0x07 0x00 /end EVENT
  /begin EVENT "mC7DA7622" "mC7DA7622" 0xA1 DAQ 0xFF 0x01 0x07 0x00 /end EVENT
  /begin EVENT "mE8669EED" "mE8669EED" 0xA2 DAQ 0xFF 0x01 0x07 0x00 /end EVENT
  /begin EVENT "m09329641" "m09329641" 0xA3 DAQ 0xFF 0x01 0x07 0x00 /end EVENT
  /begin EVENT "m06F98A9B" "m06F98A9B" 0xA4 DAQ 0xFF 0x01 0x07 0x00 /end EVENT
  /begin EVENT "m7E05614E" "m7E05614E" 0xA5 DAQ 0xFF 0x01 0x07 0x00 /end EVENT
  /begin EVENT "mB8101AB9" "mB8101AB9" 0xA6 DAQ 0xFF 0x01 0x07 0x00 /end EVENT
  /begin EVENT "m12332BF5" "m12332BF5" 0xA7 DAQ 0xFF 0x01 0x07 0x00 /end EVENT
  /begin EVENT "m392C484C" "m392C484C" 0xA8 DAQ 0xFF 0x01 0x07 0x00 /end EVENT
  /begin EVENT "m848A8F95" "m848A8F95" 0xA9 DAQ 0xFF 0x01 0x07 0x00 /end EVENT
  /begin EVENT "m9ED6D216" "m9ED6D216" 0xAA DAQ 0xFF 0x01 0x07 0x00 /end EVENT
  /begin EVENT "m08CC2D2D" "m08CC2D2D" 0xAB DAQ 0xFF 0x01 0x07 0x00 /end EVENT
  /begin EVENT "mAF0D9F32" "mAF0D9F32" 0xAC DAQ 0xFF 0x01 0x07 0x00 /end EVENT
  /begin EVENT "mDFE0C184" "mDFE0C184" 0xAD DAQ 0xFF 0x01 0x07 0x00 /end EVENT
  /begin EVENT "mDFDD3AD5" "mDFDD3AD5" 0xAE DAQ 0xFF 0x01 0x07 0x00 /end EVENT
  /begin EVENT "mEEA804F6" "mEEA804F6" 0xAF DAQ 0xFF 0x01 0x07 0x00 /end EVENT
  /begin EVENT "m0414D557" "m0414D557" 0xB0 DAQ 0xFF 0x01 0x07 0x00 /end EVENT
  /begin EVENT "mC82DE476" "mC82DE476" 0xB1 DAQ 0xFF 0x01 0x07 0x00 /end EVENT
  /begin EVENT "m33C063AB" "m33C063AB" 0xB2 DAQ 0xFF 0x01 0x07 0x00 /end EVENT
  /begin EVENT "mE1BEAD6E" "mE1BEAD6E" 0xB3 DAQ 0xFF 0x01 0x07 0x00 /end EVENT
  /begin EVENT "m54F6BBC4" "m54F6BBC4" 0xB4 DAQ 0xFF 0x01 0x07 0x00 /end EVENT
  /begin EVENT "mC565C863" "mC565C863" 0xB5 DAQ 0xFF 0x01 0x07 0x00 /end EVENT
  /begin EVENT "m7179D09A" "m7179D09A" 0xB6 DAQ 0xFF 0x01 0x07 0x00 /end EVENT
  /begin EVENT "m6A649DB9" "m6A649DB9" 0xB7 DAQ 0xFF 0x01 0x07 0x00 /end EVENT
  /begin EVENT "mF2BC9B45" "mF2BC9B45" 0xB8 DAQ 0xFF 0x01 0x07 0x00 /end EVENT
  /begin EVENT "m53D5E515" "m53D5E515" 0xB9 DAQ 0xFF 0x01 0x07 0x00 /end EVENT
  /begin EVENT "m7A8CF7FF" "m7A8CF7FF" 0xBA DAQ 0xFF 0x01 0x07 0x00 /end EVENT
  /begin EVENT "m5AC46730" "m5AC46730" 0xBB DAQ 0xFF 0x01 0x07 0x00 /end EVENT
  /begin EVENT "m66D06668" "m66D06668" 0xBC DAQ 0xFF 0x01 0x07 0x00 /end EVENT
  /begin EVENT "mE9087761" "mE9087761" 0xBD DAQ 0xFF 0x01 0x07 0x00 /end EVENT
  /begin EVENT "m3560D369" "m3560D369" 0xBE DAQ 0xFF 0x01 0x07 0x00 /end EVENT
  /begin EVENT "m5C40F8A1" "m5C40F8A1" 0xBF DAQ 0xFF 0x01 0x07 0x00 /end EVENT
  /begin EVENT "mBDBBCDD0" "mBDBBCDD0" 0xC0 DAQ 0xFF 0x01 0x07 0x00 /end EVENT
  /begin EVENT "m65BDCC00" "m65BDCC00" 0xC1 DAQ 0xFF 0x01 0x07 0x00 /end EVENT
  /begin EVENT "mA5838F33" "mA5838F33" 0xC2 DAQ 0xFF 0x01 0x07 0x00 /end EVENT
  /begin EVENT "m6E47103C" "m6E47103C" 0xC3 DAQ 0xFF 0x01 0x07 0x00 /end EVENT
  /begin EVENT "m63D7CBB2" "m63D7CBB2" 0xC4 DAQ 0xFF 0x01 0x07 0x00 /end EVENT
  /begin EVENT "m126B2864" "m126B2864" 0xC5 DAQ 0xFF 0x01 0x07 0x00 /end EVENT
  /begin EVENT "m82532E9C" "m82532E9C" 0xC6 DAQ 0xFF 0x01 0x07 0x00 /end EVENT
  /begin EVENT "m58C5B550" "m58C5B550" 0xC7 DAQ 0xFF 0x01 0x07 0x00 /end EVENT
  /begin EVENT "mA67C4AEE" "mA67C4AEE" 0xC8 DAQ 0xFF 0x01 0x07 0x00 /end EVENT
  /begin EVENT "mEAE04E35" "mEAE04E35" 0xC9 DAQ 0xFF 0x01 0x07 0x00 /end EVENT
  /begin EVENT "mE9028870" "mE9028870" 0xCA DAQ 0xFF 0x01 0x07 0x00 /end EVENT
  /begin EVENT "m3E8F7CDC" "m3E8F7CDC" 0xCB DAQ 0xFF 0x01 0x07 0x00 /end EVENT
  /begin EVENT "mD4F3BD9C" "mD4F3BD9C" 0xCC DAQ 0xFF 0x01 0x07 0x00 /end EVENT
  /begin EVENT "mDD2854F0" "mDD2854F0" 0xCD DAQ 0xFF 0x01 0x07 0x00 /end EVENT
  /begin EVENT "m7BC5120A" "m7BC5120A" 0xCE DAQ 0xFF 0x01 0x07 0x00 /end EVENT
  /begin EVENT "mC51CE417" "mC51CE417" 0xCF DAQ 0xFF 0x01 0x07 0x00 /end EVENT
  /begin EVENT "mFA705FEC" "mFA705FEC" 0xD0 DAQ 0xFF 0x01 0x07 0x00 /end EVENT
  /begin EVENT "m80E15BDA" "m80E15BDA" 0xD1 DAQ 0xFF 0x01 0x07 0x00 /end EVENT
  /begin EVENT "m42CE439F" "m42CE439F" 0xD2 DAQ 0xFF 0x01 0x07 0x00 /end EVENT
  /begin EVENT "mD2F99AA4" "mD2F99AA4" 0xD3 DAQ 0xFF 0x01 0x07 0x00 /end EVENT
  /begin EVENT "m119E79D1" "m119E79D1" 0xD4 DAQ 0xFF 0x01 0x07 0x00 /end EVENT
  /begin EVENT "m88C2462A" "m88C2462A" 0xD5 DAQ 0xFF 0x01 0x07 0x00 /end EVENT
  /begin EVENT "m475A1500" "m475A1500" 0xD6 DAQ 0xFF 0x01 0x07 0x00 /end EVENT
  /begin EVENT "m60806075" "m60806075" 0xD7 DAQ 0xFF 0x01 0x07 0x00 /end EVENT
  /begin EVENT "m87AD3F00" "m87AD3F00" 0xD8 DAQ 0xFF 0x01 0x07 0x00 /end EVENT
  /begin EVENT "mD177BD67" "mD177BD67" 0xD9 DAQ 0xFF 0x01 0x07 0x00 /end EVENT
  /begin EVENT "m944AFDC6" "m944AFDC6" 0xDA DAQ 0xFF 0x01 0x07 0x00 /end EVENT
  /begin EVENT "m496328A6" "m496328A6" 0xDB DAQ 0xFF 0x01 0x07 0x00 /end EVENT
  /begin EVENT "mE6295B24" "mE6295B24" 0xDC DAQ 0xFF 0x01 0x07 0x00 /end EVENT
  /begin EVENT "mC963B22B" "mC963B22B" 0xDD DAQ 0xFF 0x01 0x07 0x00 /end EVENT
  /begin EVENT "mF56939BC" "mF56939BC" 0xDE DAQ 0xFF 0x01 0x07 0x00 /end EVENT
  /begin EVENT "mB3E1B4DE" "mB3E1B4DE" 0xDF DAQ 0xFF 0x01 0x07 0x00 /end EVENT
  /begin EVENT "m866622E4" "m866622E4" 0xE0 DAQ 0xFF 0x01 0x07 0x00 /end EVENT
  /begin EVENT "m989473B3" "m989473B3" 0xE1 DAQ 0xFF 0x01 0x07 0x00 /end EVENT
  /begin EVENT "m1C91E65A" "m1C91E65A" 0xE2 DAQ 0xFF 0x01 0x07 0x00 /end EVENT
  /begin EVENT "m4B02AF13" "m4B02AF13" 0xE3 DAQ 0xFF 0x01 0x07 0x00 /end EVENT
  /begin EVENT "m45B92363" "m45B92363" 0xE4 DAQ 0xFF 0x01 0x07 0x00 /end EVENT
  /begin EVENT "m3FEE3B55" "m3FEE3B55" 0xE5 DAQ 0xFF 0x01 0x07 0x00 /end EVENT
  /begin EVENT "m11F974E1" "m11F974E1" 0xE6 DAQ 0xFF 0x01 0x07 0x00 /end EVENT
  /begin EVENT "mD69E898D" "mD69E898D" 0xE7 DAQ 0xFF 0x01 0x07 0x00 /end EVENT
  /begin EVENT "m5DF41B25" "m5DF41B25" 0xE8 DAQ 0xFF 0x01 0x07 0x00 /end EVENT
  /begin EVENT "m56BA8788" "m56BA8788" 0xE9 DAQ 0xFF 0x01 0x07 0x00 /end EVENT
  /begin EVENT "m8C2D8D4B" "m8C2D8D4B" 0xEA DAQ 0xFF 0x01 0x07 0x00 /end EVENT
  /begin EVENT "m402B52DF" "m402B52DF" 0xEB DAQ 0xFF 0x01 0x07 0x00 /end EVENT
  /begin EVENT "m86C305AD" "m86C305AD" 0xEC DAQ 0xFF 0x01 0x07 0x00 /end EVENT
  /begin EVENT "m45350840" "m45350840" 0xED DAQ 0xFF 0x01 0x07 0x00 /end EVENT
  /begin EVENT "m72760766" "m72760766" 0xEE DAQ 0xFF 0x01 0x07 0x00 /end EVENT
  /begin EVENT "m2B987656" "m2B987656" 0xEF DAQ 0xFF 0x01 0x07 0x00 /end EVENT
  /begin EVENT "m05253F6B" "m05253F6B" 0xF0 DAQ 0xFF 0x01 0x07 0x00 /end EVENT
  /begin EVENT "m0BB27A34" "m0BB27A34" 0xF1 DAQ 0xFF 0x01 0x07 0x00 /end EVENT
  /begin EVENT "m7C47122F" "m7C47122F" 0xF2 DAQ 0xFF 0x01 0x07 0x00 /end EVENT
  /begin EVENT "mC1BDC313" "mC1BDC313" 0xF3 DAQ 0xFF 0x01 0x07 0x00 /end EVENT
  /begin EVENT "m21D839FE" "m21D839FE" 0xF4 DAQ 0xFF 0x01 0x07 0x00 /end EVENT
  /begin EVENT "m03770C27" "m03770C27" 0xF5 DAQ 0xFF 0x01 0x07 0x00 /end EVENT
  /begin EVENT "mFD97D8CD" "mFD97D8CD" 0xF6 DAQ 0xFF 0x01 0x07 0x00 /end EVENT
  /begin EVENT "m7CD848A3" "m7CD848A3" 0xF7 DAQ 0xFF 0x01 0x07 0x00 /end EVENT
  /begin EVENT "mE0E1DBB4" "mE0E1DBB4" 0xF8 DAQ 0xFF 0x01 0x07 0x00 /end EVENT
  /begin EVENT "m6CF04904" "m6CF04904" 0xF9 DAQ 0xFF 0x01 0x07 0x00 /end EVENT
  /begin EVENT "mDF0CC1F5" "mDF0CC1F5" 0xFA DAQ 0xFF 0x01 0x07 0x00 /end EVENT
  /begin EVENT "m48C6BF9A" "m48C6BF9A" 0xFB DAQ 0xFF 0x01 0x07 0x00 /end EVENT
  /begin EVENT "mD1D823E0" "mD1D823E0" 0xFC DAQ 0xFF 0x01 0x07 0x00 /end EVENT
  /begin EVENT "m2B47D09B" "m2B47D09B" 0xFD DAQ 0xFF 0x01 0x07 0x00 /end EVENT
  /begin EVENT "m852F4A9C" "m852F4A9C" 0xFE DAQ 0xFF 0x01 0x07 0x00 /end EVENT
  /begin EVENT "mA9A88C89" "mA9A88C89" 0xFF DAQ 0xFF 0x01 0x07 0x00 /end EVENT
  /begin EVENT "m1AF1D69E" "m1AF1D69E" 0x100 DAQ 0xFF 0x01 0x07 0x00 /end EVENT
  /begin EVENT "m7B525483" "m7B525483" 0x101 DAQ 0xFF 0x01 0x07 0x00 /end EVENT
  /begin EVENT "m384950A0" "m384950A0" 0x102 DAQ 0xFF 0x01 0x07 0x00 /end EVENT
  /begin EVENT "m9A5FBBBD" "m9A5FBBBD" 0x103 DAQ 0xFF 0x01 0x07 0x00 /end EVENT
  /begin EVENT "m21337D0A" "m21337D0A" 0x104 DAQ 0xFF 0x01 0x07 0x00 /end EVENT
  /begin EVENT "m6B040FBA" "m6B040FBA" 0x105 DAQ 0xFF 0x01 0x07 0x00 /end EVENT
  /begin EVENT "mC85D2DE8" "mC85D2DE8" 0x106 DAQ 0xFF 0x01 0x07 0x00 /end EVENT
  /begin EVENT "m6C289367" "m6C289367" 0x107 DAQ 0xFF 0x01 0x07 0x00 /end EVENT
  /begin EVENT "m4F7D73D6" "m4F7D73D6" 0x108 DAQ 0xFF 0x01 0x07 0x00 /end EVENT
  /begin EVENT "m7DDD9FFC" "m7DDD9FFC" 0x109 DAQ 0xFF 0x01 0x07 0x00 /end EVENT
  /begin EVENT "m4C264577" "m4C264577" 0x10A DAQ 0xFF 0x01 0x07 0x00 /end EVENT
  /begin EVENT "mB48E3FF6" "mB48E3FF6" 0x10B DAQ 0xFF 0x01 0x07 0x00 /end EVENT
 /end DAQ
/end IF_DATA
/begin CHARACTERISTIC BUILD_COMMIT_ID "" ASCII 0x800BCA62 __UBYTE_Z 0 NO_COMPU_METHOD 0 255 READ_ONLY NUMBER 48 /end CHARACTERISTIC
/begin CHARACTERISTIC BUILD_REPOSITORY "" ASCII 0x800BC94E __UBYTE_Z 0 NO_COMPU_METHOD 0 255 READ_ONLY NUMBER 96 /end CHARACTERISTIC
/begin CHARACTERISTIC BUILD_SW_VERSION "" ASCII 0x800BB8B8 __UBYTE_Z 0 NO_COMPU_METHOD 0 255 READ_ONLY NUMBER 150 /end CHARACTERISTIC
/begin MEASUREMENT _FepMainDataPacket_st._OpMode "" UBYTE NO_COMPU_METHOD 0 0 0 255 BYTE_ORDER MSB_LAST ECU_ADDRESS 0x5000D834 ECU_ADDRESS_EXTENSION 0x4 /end MEASUREMENT
/begin MEASUREMENT _g_PL_AD_fw_OneDrivingSW_dsm_StateManagement_SscRunnable_SscRunnable_m_daCoreStateNotification_out_local.m_daCoreState "" ULONG NO_COMPU_METHOD 0 0 0 4294967295 BYTE_ORDER MSB_LAST ECU_ADDRESS 0xB0002F28 ECU_ADDRESS_EXTENSION 0x1 /end MEASUREMENT
/begin MEASUREMENT _g_PL_AD_fw_OneDrivingSW_fct_fct_mainproc_ods_fct_ods_fct_mainproc_RunnableMainProc.m_portFunctionStates.m_states.m_accState "" UBYTE AccStates 0 0 0 255 BYTE_ORDER MSB_LAST ECU_ADDRESS 0xB009508A ECU_ADDRESS_EXTENSION 0x2 /end MEASUREMENT
/begin MEASUREMENT _g_PL_AD_fw_OneDrivingSW_fct_fct_mainproc_ods_fct_ods_fct_mainproc_RunnableMainProc.m_portFunctionStates.m_states.m_aebCfmEbaState "" UBYTE AebStates 0 0 0 255 BYTE_ORDER MSB_LAST ECU_ADDRESS 0xB0095071 ECU_ADDRESS_EXTENSION 0x2 /end MEASUREMENT
/begin MEASUREMENT _g_PL_AD_fw_OneDrivingSW_fct_fct_mainproc_ods_fct_ods_fct_mainproc_RunnableMainProc.m_portFunctionStates.m_states.m_aebCfmFullBrakeState "" UBYTE AebStates 0 0 0 255 BYTE_ORDER MSB_LAST ECU_ADDRESS 0xB0095070 ECU_ADDRESS_EXTENSION 0x2 /end MEASUREMENT
/begin MEASUREMENT _g_PL_AD_fw_OneDrivingSW_fct_fct_mainproc_ods_fct_ods_fct_mainproc_RunnableMainProc.m_portFunctionStates.m_states.m_aebCfmPrefillState "" UBYTE AebStates 0 0 0 255 BYTE_ORDER MSB_LAST ECU_ADDRESS 0xB0095072 ECU_ADDRESS_EXTENSION 0x2 /end MEASUREMENT
/begin MEASUREMENT _g_PL_AD_fw_OneDrivingSW_fct_fct_mainproc_ods_fct_ods_fct_mainproc_RunnableMainProc.m_portFunctionStates.m_states.m_aebCfmWarningAcousticState "" UBYTE AebStates 0 0 0 255 BYTE_ORDER MSB_LAST ECU_ADDRESS 0xB0095074 ECU_ADDRESS_EXTENSION 0x2 /end MEASUREMENT
/begin MEASUREMENT _g_PL_AD_fw_OneDrivingSW_fct_fct_mainproc_ods_fct_ods_fct_mainproc_RunnableMainProc.m_portFunctionStates.m_states.m_aebTiplLongEbaState "" UBYTE AebStates 0 0 0 255 BYTE_ORDER MSB_LAST ECU_ADDRESS 0xB0095075 ECU_ADDRESS_EXTENSION 0x2 /end MEASUREMENT
/begin MEASUREMENT _g_PL_AD_fw_OneDrivingSW_fct_fct_mainproc_ods_fct_ods_fct_mainproc_RunnableMainProc.m_portFunctionStates.m_states.m_aebTiplLongFullBrakeState "" UBYTE AebStates 0 0 0 255 BYTE_ORDER MSB_LAST ECU_ADDRESS 0xB0095077 ECU_ADDRESS_EXTENSION 0x2 /end MEASUREMENT
/begin MEASUREMENT _g_PL_AD_fw_OneDrivingSW_fct_fct_mainproc_ods_fct_ods_fct_mainproc_RunnableMainProc.m_portFunctionStates.m_states.m_aebTiplLongLatentInformationState "" UBYTE AebStates 0 0 0 255 BYTE_ORDER MSB_LAST ECU_ADDRESS 0xB009507B ECU_ADDRESS_EXTENSION 0x2 /end MEASUREMENT
/begin MEASUREMENT _g_PL_AD_fw_OneDrivingSW_fct_fct_mainproc_ods_fct_ods_fct_mainproc_RunnableMainProc.m_portFunctionStates.m_states.m_aebTiplLongOncomingEbaState "" UBYTE AebStates 0 0 0 255 BYTE_ORDER MSB_LAST ECU_ADDRESS 0xB0095076 ECU_ADDRESS_EXTENSION 0x2 /end MEASUREMENT
/begin MEASUREMENT _g_PL_AD_fw_OneDrivingSW_fct_fct_mainproc_ods_fct_ods_fct_mainproc_RunnableMainProc.m_portFunctionStates.m_states.m_aebTiplLongOncomingFullBrakeState "" UBYTE AebStates 0 0 0 255 BYTE_ORDER MSB_LAST ECU_ADDRESS 0xB0095079 ECU_ADDRESS_EXTENSION 0x2 /end MEASUREMENT
/begin MEASUREMENT _g_PL_AD_fw_OneDrivingSW_fct_fct_mainproc_ods_fct_ods_fct_mainproc_RunnableMainProc.m_portFunctionStates.m_states.m_aebTiplLongOncomingPrefillState "" UBYTE AebStates 0 0 0 255 BYTE_ORDER MSB_LAST ECU_ADDRESS 0xB009507A ECU_ADDRESS_EXTENSION 0x2 /end MEASUREMENT
/begin MEASUREMENT _g_PL_AD_fw_OneDrivingSW_fct_fct_mainproc_ods_fct_ods_fct_mainproc_RunnableMainProc.m_portFunctionStates.m_states.m_aebTiplLongPartialBrakeState "" UBYTE AebStates 0 0 0 255 BYTE_ORDER MSB_LAST ECU_ADDRESS 0xB0095078 ECU_ADDRESS_EXTENSION 0x2 /end MEASUREMENT
/begin MEASUREMENT _g_PL_AD_fw_OneDrivingSW_fct_fct_mainproc_ods_fct_ods_fct_mainproc_RunnableMainProc.m_portFunctionStates.m_states.m_aebTiplLongPrefillState "" UBYTE AebStates 0 0 0 255 BYTE_ORDER MSB_LAST ECU_ADDRESS 0xB009507C ECU_ADDRESS_EXTENSION 0x2 /end MEASUREMENT
/begin MEASUREMENT _g_PL_AD_fw_OneDrivingSW_fct_fct_mainproc_ods_fct_ods_fct_mainproc_RunnableMainProc.m_portFunctionStates.m_states.m_aebTiplLongWarningAcousticState "" UBYTE AebStates 0 0 0 255 BYTE_ORDER MSB_LAST ECU_ADDRESS 0xB009507D ECU_ADDRESS_EXTENSION 0x2 /end MEASUREMENT
/begin MEASUREMENT _g_PL_AD_fw_OneDrivingSW_fct_fct_mainproc_ods_fct_ods_fct_mainproc_RunnableMainProc.m_portFunctionStates.m_states.m_aebTiplLongWarningHapticState "" UBYTE AebStates 0 0 0 255 BYTE_ORDER MSB_LAST ECU_ADDRESS 0xB009507F ECU_ADDRESS_EXTENSION 0x2 /end MEASUREMENT
/begin MEASUREMENT _g_PL_AD_fw_OneDrivingSW_fct_fct_mainproc_ods_fct_ods_fct_mainproc_RunnableMainProc.m_portFunctionStates.m_states.m_aebTiplTurnFullBrakeState "" UBYTE AebStates 0 0 0 255 BYTE_ORDER MSB_LAST ECU_ADDRESS 0xB0095080 ECU_ADDRESS_EXTENSION 0x2 /end MEASUREMENT
/begin MEASUREMENT _g_PL_AD_fw_OneDrivingSW_fct_fct_mainproc_ods_fct_ods_fct_mainproc_RunnableMainProc.m_portFunctionStates.m_states.m_aebTiplTurnPrefillState "" UBYTE AebStates 0 0 0 255 BYTE_ORDER MSB_LAST ECU_ADDRESS 0xB0095081 ECU_ADDRESS_EXTENSION 0x2 /end MEASUREMENT
/begin MEASUREMENT _g_PL_AD_fw_OneDrivingSW_fct_fct_mainproc_ods_fct_ods_fct_mainproc_RunnableMainProc.m_portFunctionStates.m_states.m_aebTiplTurnPrefillState "" UBYTE AebStates 0 0 0 255 BYTE_ORDER MSB_LAST ECU_ADDRESS 0xB0095081 ECU_ADDRESS_EXTENSION 0x2 /end MEASUREMENT
/begin MEASUREMENT _g_PL_AD_fw_OneDrivingSW_fct_fct_mainproc_ods_fct_ods_fct_mainproc_RunnableMainProc.m_portFunctionStates.m_states.m_aebTixlPrefillState "" UBYTE AebStates 0 0 0 255 BYTE_ORDER MSB_LAST ECU_ADDRESS 0xB0095083 ECU_ADDRESS_EXTENSION 0x2 /end MEASUREMENT
/begin MEASUREMENT _g_PL_AD_fw_OneDrivingSW_fct_fct_mainproc_ods_fct_ods_fct_mainproc_RunnableMainProc.m_portFunctionStates.m_states.m_aebTixlWarningAcousticState "" UBYTE AebStates 0 0 0 255 BYTE_ORDER MSB_LAST ECU_ADDRESS 0xB0095084 ECU_ADDRESS_EXTENSION 0x2 /end MEASUREMENT
/begin MEASUREMENT _g_PL_AD_fw_OneDrivingSW_fct_fct_mainproc_ods_fct_ods_fct_mainproc_RunnableMainProc.m_portFunctionStates.m_states.m_standstillState "" UBYTE AebStates 0 0 0 255 BYTE_ORDER MSB_LAST ECU_ADDRESS 0xB0095085 ECU_ADDRESS_EXTENSION 0x2 /end MEASUREMENT
/begin MEASUREMENT _g_PL_AD_fw_OneDrivingSW_perEnv_EnvModel_PerDepRunnable_PerDepRunnable_m_assoFeedbackPort_out_local.m_sequenceNumber "" UWORD NO_COMPU_METHOD 0 0 0 65535 BYTE_ORDER MSB_LAST ECU_ADDRESS 0xB008385A ECU_ADDRESS_EXTENSION 0x2 /end MEASUREMENT
/begin MEASUREMENT _g_PL_AD_fw_OneDrivingSW_perEnv_EnvModel_PerDepRunnable_PerDepRunnable_m_depIntrospectionPort_out_local.m_sequenceNumber "" UWORD NO_COMPU_METHOD 0 0 0 65535 BYTE_ORDER MSB_LAST ECU_ADDRESS 0xB0084692 ECU_ADDRESS_EXTENSION 0x2 /end MEASUREMENT
/begin MEASUREMENT _g_PL_AD_fw_OneDrivingSW_perEnv_EnvModel_PerDepRunnable_PerDepRunnable_m_depPort_out_local.m_sequenceNumber "" UWORD NO_COMPU_METHOD 0 0 0 65535 BYTE_ORDER MSB_LAST ECU_ADDRESS 0xB00852A2 ECU_ADDRESS_EXTENSION 0x2 /end MEASUREMENT
/begin MEASUREMENT _g_PL_AD_fw_OneDrivingSW_perEnv_EnvModel_PerEimTprRunnable_PerEimTprRunnable_m_fusObjPort_out_local.FusObj_st.i0.b_un.b_st.AdditionalSensorAssociated_b "" UBYTE NO_COMPU_METHOD 0 0 0 1 BIT_MASK 0x8 BYTE_ORDER MSB_LAST ECU_ADDRESS 0x6001C48C /end MEASUREMENT
/begin MEASUREMENT _g_PL_AD_fw_OneDrivingSW_perEnv_EnvModel_PerEimTprRunnable_PerEimTprRunnable_m_fusObjPort_out_local.FusObj_st.i0.dxv_sw "" SWORD NO_COMPU_METHOD 0 0 -32768 32767 BYTE_ORDER MSB_LAST ECU_ADDRESS 0x6001C43E /end MEASUREMENT
/begin MEASUREMENT _g_PL_AD_fw_OneDrivingSW_perEnv_EnvModel_PerEimTprRunnable_PerEimTprRunnable_m_fusObjPort_out_local.FusObj_st.i1.b_un.b_st.AdditionalSensorAssociated_b "" UBYTE NO_COMPU_METHOD 0 0 0 1 BIT_MASK 0x8 BYTE_ORDER MSB_LAST ECU_ADDRESS 0x6001C564 /end MEASUREMENT
/begin MEASUREMENT _g_PL_AD_fw_OneDrivingSW_perEnv_EnvModel_PerEimTprRunnable_PerEimTprRunnable_m_fusObjPort_out_local.FusObj_st.i1.dxv_sw "" SWORD NO_COMPU_METHOD 0 0 -32768 32767 BYTE_ORDER MSB_LAST ECU_ADDRESS 0x6001C516 /end MEASUREMENT
/begin MEASUREMENT _g_PL_AD_fw_OneDrivingSW_perEnv_EnvModel_PerEimTprRunnable_PerEimTprRunnable_m_fusObjPort_out_local.FusObj_st.i2.dxv_sw "" SWORD NO_COMPU_METHOD 0 0 -32768 32767 BYTE_ORDER MSB_LAST ECU_ADDRESS 0x6001C5EE /end MEASUREMENT
/begin MEASUREMENT _g_PL_AD_fw_OneDrivingSW_perEnv_EnvModel_PerSepRunnable_PerSepRunnable_m_hvmSepPort_out_local.m_sequenceNumber "" UWORD NO_COMPU_METHOD 0 0 0 65535 BYTE_ORDER MSB_LAST ECU_ADDRESS 0xB008DECA ECU_ADDRESS_EXTENSION 0x2 /end MEASUREMENT
/begin MEASUREMENT _g_PL_AD_fw_OneDrivingSW_perEnv_EnvModel_PerSepRunnable_PerSepRunnable_m_sepPort_out_local.m_sequenceNumber "" UWORD NO_COMPU_METHOD 0 0 0 65535 BYTE_ORDER MSB_LAST ECU_ADDRESS 0xB008DF02 ECU_ADDRESS_EXTENSION 0x2 /end MEASUREMENT
/begin MEASUREMENT _g_PL_AD_fw_OneDrivingSW_perHv_HV_PerPmeRunnable_PerPmeRunnable.m_controller.m_HistBuffer.m_hostVehHist.tAbsTimeStamp_ul "" ULONG NO_COMPU_METHOD 0 0 0 4294967295 BYTE_ORDER MSB_LAST ECU_ADDRESS 0xB006DE28 ECU_ADDRESS_EXTENSION 0x1 /end MEASUREMENT
/begin MEASUREMENT _g_PL_AD_fw_OneDrivingSW_sitBa_Ba_timba_TimbaRunnable_m_targetGatewayObjects_local.m_objectDataList.i0.m_dx.m_value "" FLOAT32_IEEE NO_COMPU_METHOD 0 0 -3.4028234663852886E+38 3.4028234663852886E+38 BYTE_ORDER MSB_LAST ECU_ADDRESS 0x70010FC0 ECU_ADDRESS_EXTENSION 0x1 /end MEASUREMENT
/begin MEASUREMENT _g_PL_AD_fw_OneDrivingSW_sitBs_Bs_RunnableBehaviorStrategyLead_RunnableBehaviorStrategyLead_m_serviceStatus_out_local.m_oosId "" ULONG NO_COMPU_METHOD 0 0 0 4294967295 BYTE_ORDER MSB_LAST ECU_ADDRESS 0x60015548 ECU_ADDRESS_EXTENSION 0x2 /end MEASUREMENT
/begin MEASUREMENT _g_PL_AD_fw_Radar_1R1V_rpc_XilObjBypassingRunnable_XilObjBypassingRunnable.m_bypassFailedCounter "" ULONG NO_COMPU_METHOD 0 0 0 4294967295 BYTE_ORDER MSB_LAST ECU_ADDRESS 0xB0056264 ECU_ADDRESS_EXTENSION 0x1 /end MEASUREMENT
/begin MEASUREMENT _g_PL_AD_fw_Radar_1R1V_rpc_XilObjBypassingRunnable_XilObjBypassingRunnable.m_bypassInactiveCounter "" ULONG NO_COMPU_METHOD 0 0 0 4294967295 BYTE_ORDER MSB_LAST ECU_ADDRESS 0xB005625C ECU_ADDRESS_EXTENSION 0x1 /end MEASUREMENT
/begin MEASUREMENT _g_PL_AD_fw_Radar_1R1V_rpc_XilObjBypassingRunnable_XilObjBypassingRunnable.m_bypassSuccessfulCounter "" ULONG NO_COMPU_METHOD 0 0 0 4294967295 BYTE_ORDER MSB_LAST ECU_ADDRESS 0xB0056260 ECU_ADDRESS_EXTENSION 0x1 /end MEASUREMENT
/begin CHARACTERISTIC _g_PL_AD_fw_Radar_1R1V_rpc_XilObjBypassingRunnable_XilObjBypassingRunnable._m_pad_hilActive_par "" VALUE 0xB0056258 __UByte_Value 0 NO_COMPU_METHOD 0 255 ECU_ADDRESS_EXTENSION 0x1 BYTE_ORDER MSB_LAST /end CHARACTERISTIC
/begin CHARACTERISTIC _g_PL_AD_fw_Radar_1R1V_rpc_XilObjBypassingRunnable_XilObjBypassingRunnable._m_pad_radarObjPort_par_out "" VALUE 0xB0056250 __UByte_Value 0 NO_COMPU_METHOD 0 255 ECU_ADDRESS_EXTENSION 0x1 BYTE_ORDER MSB_LAST /end CHARACTERISTIC
/begin CHARACTERISTIC _g_PL_AD_fw_Radar_1R1V_rpc_XilObjBypassingRunnable_XilObjBypassingRunnable._m_pad_radarObjPort_par_out "" VALUE 0xB0056250 __UByte_Value 0 NO_COMPU_METHOD 0 255 ECU_ADDRESS_EXTENSION 0x1 BYTE_ORDER MSB_LAST /end CHARACTERISTIC
/begin MEASUREMENT _g_PL_AD_fw_Radar_1R1V_rpc_XilObjBypassingRunnable_XilObjBypassingRunnable.m_status "" UBYTE EStatus 0 0 0 255 BYTE_ORDER MSB_LAST ECU_ADDRESS 0xB0056259 ECU_ADDRESS_EXTENSION 0x1 /end MEASUREMENT
/begin MEASUREMENT _g_PL_AD_fw_Radar_1R1V_rpc_XilObjBypassingRunnable_XilObjBypassingRunnable.m_unknownErrorCounter "" ULONG NO_COMPU_METHOD 0 0 0 4294967295 BYTE_ORDER MSB_LAST ECU_ADDRESS 0xB005626C ECU_ADDRESS_EXTENSION 0x1 /end MEASUREMENT
/begin MEASUREMENT _g_PL_AD_fw_Radar_1R1V_rpc_XilObjBypassingRunnable_XilObjBypassingRunnable.m_vxFailureCounter "" ULONG NO_COMPU_METHOD 0 0 0 4294967295 BYTE_ORDER MSB_LAST ECU_ADDRESS 0xB0056268 ECU_ADDRESS_EXTENSION 0x1 /end MEASUREMENT
/begin CHARACTERISTIC _g_PL_AD_fw_Radar_1R1V_rpc_XilObjBypassingRunnable_XilObjBypassingRunnable_m_pad_radarObjPort_par_out_local.TChangeableMemPool._._._m_arrayPool._0_._elem.CInternal._._m_sequenceNumber "" VALUE 0xB00572AA __UWord_Value 0 NO_COMPU_METHOD 0 65535 ECU_ADDRESS_EXTENSION 0x1 BYTE_ORDER MSB_LAST /end CHARACTERISTIC
/begin CHARACTERISTIC _g_PL_AD_fw_Radar_1R1V_rpc_XilObjBypassingRunnable_XilObjBypassingRunnable_m_pad_radarObjPort_par_out_local.TChangeableMemPool._._._m_arrayPool._0_._elem._m_alignment._m_AbsRefTimeN "" VALUE 0xB00572B8 __ULong_Value 0 NO_COMPU_METHOD 0 4294967295 ECU_ADDRESS_EXTENSION 0x1 BYTE_ORDER MSB_LAST /end CHARACTERISTIC
/begin CHARACTERISTIC _g_PL_AD_fw_Radar_1R1V_rpc_XilObjBypassingRunnable_XilObjBypassingRunnable_m_pad_radarObjPort_par_out_local.TChangeableMemPool._._._m_arrayPool._0_._elem._m_alignment._m_alpAzimuthAngOffsetN "" VALUE 0xB00572C4 __SWord_Value 0 NO_COMPU_METHOD -32768 32767 ECU_ADDRESS_EXTENSION 0x1 BYTE_ORDER MSB_LAST /end CHARACTERISTIC
/begin CHARACTERISTIC _g_PL_AD_fw_Radar_1R1V_rpc_XilObjBypassingRunnable_XilObjBypassingRunnable_m_pad_radarObjPort_par_out_local.TChangeableMemPool._._._m_arrayPool._0_._elem._m_alignment._m_alpMountAngleN "" VALUE 0xB00572C2 __SWord_Value 0 NO_COMPU_METHOD -32768 32767 ECU_ADDRESS_EXTENSION 0x1 BYTE_ORDER MSB_LAST /end CHARACTERISTIC
/begin CHARACTERISTIC _g_PL_AD_fw_Radar_1R1V_rpc_XilObjBypassingRunnable_XilObjBypassingRunnable_m_pad_radarObjPort_par_out_local.TChangeableMemPool._._._m_arrayPool._0_._elem._m_alignment._m_dLongitudinalOffsetRearAxisN "" VALUE 0xB00572BE __SWord_Value 0 NO_COMPU_METHOD -32768 32767 ECU_ADDRESS_EXTENSION 0x1 BYTE_ORDER MSB_LAST /end CHARACTERISTIC
/begin CHARACTERISTIC _g_PL_AD_fw_Radar_1R1V_rpc_XilObjBypassingRunnable_XilObjBypassingRunnable_m_pad_radarObjPort_par_out_local.TChangeableMemPool._._._m_arrayPool._0_._elem._m_alignment._m_dMountElevationN "" VALUE 0xB00572BC __UWord_Value 0 NO_COMPU_METHOD 0 65535 ECU_ADDRESS_EXTENSION 0x1 BYTE_ORDER MSB_LAST /end CHARACTERISTIC
/begin CHARACTERISTIC _g_PL_AD_fw_Radar_1R1V_rpc_XilObjBypassingRunnable_XilObjBypassingRunnable_m_pad_radarObjPort_par_out_local.TChangeableMemPool._._._m_arrayPool._0_._elem._m_alignment._m_dMountOffsetN "" VALUE 0xB00572C0 __SWord_Value 0 NO_COMPU_METHOD -32768 32767 ECU_ADDRESS_EXTENSION 0x1 BYTE_ORDER MSB_LAST /end CHARACTERISTIC
/begin CHARACTERISTIC _g_PL_AD_fw_Radar_1R1V_rpc_XilObjBypassingRunnable_XilObjBypassingRunnable_m_pad_radarObjPort_par_out_local.TChangeableMemPool._._._m_arrayPool._0_._elem._m_objectInformation._0_._Valid_b "" VALUE 0xB0057313 __UByte_Value 0 NO_COMPU_METHOD 0 255 ECU_ADDRESS_EXTENSION 0x1 BYTE_ORDER MSB_LAST /end CHARACTERISTIC
/begin CHARACTERISTIC _g_PL_AD_fw_Radar_1R1V_rpc_XilObjBypassingRunnable_XilObjBypassingRunnable_m_pad_radarObjPort_par_out_local.TChangeableMemPool._._._m_arrayPool._0_._elem._m_objectInformation._0_._m_HandleN "" VALUE 0xB0057312 __UByte_Value 0 NO_COMPU_METHOD 0 255 ECU_ADDRESS_EXTENSION 0x1 BYTE_ORDER MSB_LAST /end CHARACTERISTIC
/begin CHARACTERISTIC _g_PL_AD_fw_Radar_1R1V_rpc_XilObjBypassingRunnable_XilObjBypassingRunnable_m_pad_radarObjPort_par_out_local.TChangeableMemPool._._._m_arrayPool._0_._elem._m_objectInformation._0_._m_alpPiVarYawAngleN "" VALUE 0xB0057308 __UWord_Value 0 NO_COMPU_METHOD 0 65535 ECU_ADDRESS_EXTENSION 0x1 BYTE_ORDER MSB_LAST /end CHARACTERISTIC
/begin CHARACTERISTIC _g_PL_AD_fw_Radar_1R1V_rpc_XilObjBypassingRunnable_XilObjBypassingRunnable_m_pad_radarObjPort_par_out_local.TChangeableMemPool._._._m_arrayPool._0_._elem._m_objectInformation._0_._m_alpPiYawAngleN "" VALUE 0xB0057302 __SWord_Value 0 NO_COMPU_METHOD -32768 32767 ECU_ADDRESS_EXTENSION 0x1 BYTE_ORDER MSB_LAST /end CHARACTERISTIC
/begin CHARACTERISTIC _g_PL_AD_fw_Radar_1R1V_rpc_XilObjBypassingRunnable_XilObjBypassingRunnable_m_pad_radarObjPort_par_out_local.TChangeableMemPool._._._m_arrayPool._0_._elem._m_objectInformation._0_._m_axN "" VALUE 0xB00572FE __SWord_Value 0 NO_COMPU_METHOD -32768 32767 ECU_ADDRESS_EXTENSION 0x1 BYTE_ORDER MSB_LAST /end CHARACTERISTIC
/begin CHARACTERISTIC _g_PL_AD_fw_Radar_1R1V_rpc_XilObjBypassingRunnable_XilObjBypassingRunnable_m_pad_radarObjPort_par_out_local.TChangeableMemPool._._._m_arrayPool._0_._elem._m_objectInformation._0_._m_ayN "" VALUE 0xB0057300 __SWord_Value 0 NO_COMPU_METHOD -32768 32767 ECU_ADDRESS_EXTENSION 0x1 BYTE_ORDER MSB_LAST /end CHARACTERISTIC
/begin CHARACTERISTIC _g_PL_AD_fw_Radar_1R1V_rpc_XilObjBypassingRunnable_XilObjBypassingRunnable_m_pad_radarObjPort_par_out_local.TChangeableMemPool._._._m_arrayPool._0_._elem._m_objectInformation._0_._m_dLengthN "" VALUE 0xB0057306 __SWord_Value 0 NO_COMPU_METHOD -32768 32767 ECU_ADDRESS_EXTENSION 0x1 BYTE_ORDER MSB_LAST /end CHARACTERISTIC
/begin CHARACTERISTIC _g_PL_AD_fw_Radar_1R1V_rpc_XilObjBypassingRunnable_XilObjBypassingRunnable_m_pad_radarObjPort_par_out_local.TChangeableMemPool._._._m_arrayPool._0_._elem._m_objectInformation._0_._m_dVarLengthN "" VALUE 0xB005730C __UWord_Value 0 NO_COMPU_METHOD 0 65535 ECU_ADDRESS_EXTENSION 0x1 BYTE_ORDER MSB_LAST /end CHARACTERISTIC
/begin CHARACTERISTIC _g_PL_AD_fw_Radar_1R1V_rpc_XilObjBypassingRunnable_XilObjBypassingRunnable_m_pad_radarObjPort_par_out_local.TChangeableMemPool._._._m_arrayPool._0_._elem._m_objectInformation._0_._m_dVarWidthN "" VALUE 0xB005730A __UWord_Value 0 NO_COMPU_METHOD 0 65535 ECU_ADDRESS_EXTENSION 0x1 BYTE_ORDER MSB_LAST /end CHARACTERISTIC
/begin CHARACTERISTIC _g_PL_AD_fw_Radar_1R1V_rpc_XilObjBypassingRunnable_XilObjBypassingRunnable_m_pad_radarObjPort_par_out_local.TChangeableMemPool._._._m_arrayPool._0_._elem._m_objectInformation._0_._m_dWidthN "" VALUE 0xB0057304 __SWord_Value 0 NO_COMPU_METHOD -32768 32767 ECU_ADDRESS_EXTENSION 0x1 BYTE_ORDER MSB_LAST /end CHARACTERISTIC
/begin CHARACTERISTIC _g_PL_AD_fw_Radar_1R1V_rpc_XilObjBypassingRunnable_XilObjBypassingRunnable_m_pad_radarObjPort_par_out_local.TChangeableMemPool._._._m_arrayPool._0_._elem._m_objectInformation._0_._m_dxN "" VALUE 0xB00572F4 __SWord_Value 0 NO_COMPU_METHOD -32768 32767 ECU_ADDRESS_EXTENSION 0x1 BYTE_ORDER MSB_LAST /end CHARACTERISTIC
/begin CHARACTERISTIC _g_PL_AD_fw_Radar_1R1V_rpc_XilObjBypassingRunnable_XilObjBypassingRunnable_m_pad_radarObjPort_par_out_local.TChangeableMemPool._._._m_arrayPool._0_._elem._m_objectInformation._0_._m_dyN "" VALUE 0xB00572F6 __SWord_Value 0 NO_COMPU_METHOD -32768 32767 ECU_ADDRESS_EXTENSION 0x1 BYTE_ORDER MSB_LAST /end CHARACTERISTIC
/begin CHARACTERISTIC _g_PL_AD_fw_Radar_1R1V_rpc_XilObjBypassingRunnable_XilObjBypassingRunnable_m_pad_radarObjPort_par_out_local.TChangeableMemPool._._._m_arrayPool._0_._elem._m_objectInformation._0_._m_dzN "" VALUE 0xB00572F8 __SWord_Value 0 NO_COMPU_METHOD -32768 32767 ECU_ADDRESS_EXTENSION 0x1 BYTE_ORDER MSB_LAST /end CHARACTERISTIC
/begin CHARACTERISTIC _g_PL_AD_fw_Radar_1R1V_rpc_XilObjBypassingRunnable_XilObjBypassingRunnable_m_pad_radarObjPort_par_out_local.TChangeableMemPool._._._m_arrayPool._0_._elem._m_objectInformation._0_._m_isObjectAsil "" VALUE 0xB0057314 __UByte_Value 0 NO_COMPU_METHOD 0 255 ECU_ADDRESS_EXTENSION 0x1 BYTE_ORDER MSB_LAST /end CHARACTERISTIC
/begin CHARACTERISTIC _g_PL_AD_fw_Radar_1R1V_rpc_XilObjBypassingRunnable_XilObjBypassingRunnable_m_pad_radarObjPort_par_out_local.TChangeableMemPool._._._m_arrayPool._0_._elem._m_objectInformation._0_._m_perObjectType._m_prob1FourPlusWheelerN "" VALUE 0xB00572CE __UByte_Value 0 NO_COMPU_METHOD 0 255 ECU_ADDRESS_EXTENSION 0x1 BYTE_ORDER MSB_LAST /end CHARACTERISTIC
/begin CHARACTERISTIC _g_PL_AD_fw_Radar_1R1V_rpc_XilObjBypassingRunnable_XilObjBypassingRunnable_m_pad_radarObjPort_par_out_local.TChangeableMemPool._._._m_arrayPool._0_._elem._m_objectInformation._0_._m_perObjectType._m_prob1FourWheelUnknownN "" VALUE 0xB00572D6 __UByte_Value 0 NO_COMPU_METHOD 0 255 ECU_ADDRESS_EXTENSION 0x1 BYTE_ORDER MSB_LAST /end CHARACTERISTIC
/begin CHARACTERISTIC _g_PL_AD_fw_Radar_1R1V_rpc_XilObjBypassingRunnable_XilObjBypassingRunnable_m_pad_radarObjPort_par_out_local.TChangeableMemPool._._._m_arrayPool._0_._elem._m_objectInformation._0_._m_perObjectType._m_prob1MobileN "" VALUE 0xB00572CB __UByte_Value 0 NO_COMPU_METHOD 0 255 ECU_ADDRESS_EXTENSION 0x1 BYTE_ORDER MSB_LAST /end CHARACTERISTIC
/begin CHARACTERISTIC _g_PL_AD_fw_Radar_1R1V_rpc_XilObjBypassingRunnable_XilObjBypassingRunnable_m_pad_radarObjPort_par_out_local.TChangeableMemPool._._._m_arrayPool._0_._elem._m_objectInformation._0_._m_perObjectType._m_prob1MovUnknownN "" VALUE 0xB00572D1 __UByte_Value 0 NO_COMPU_METHOD 0 255 ECU_ADDRESS_EXTENSION 0x1 BYTE_ORDER MSB_LAST /end CHARACTERISTIC
/begin CHARACTERISTIC _g_PL_AD_fw_Radar_1R1V_rpc_XilObjBypassingRunnable_XilObjBypassingRunnable_m_pad_radarObjPort_par_out_local.TChangeableMemPool._._._m_arrayPool._0_._elem._m_objectInformation._0_._m_perObjectType._m_prob1NonObstacleN "" VALUE 0xB00572C9 __UByte_Value 0 NO_COMPU_METHOD 0 255 ECU_ADDRESS_EXTENSION 0x1 BYTE_ORDER MSB_LAST /end CHARACTERISTIC
/begin CHARACTERISTIC _g_PL_AD_fw_Radar_1R1V_rpc_XilObjBypassingRunnable_XilObjBypassingRunnable_m_pad_radarObjPort_par_out_local.TChangeableMemPool._._._m_arrayPool._0_._elem._m_objectInformation._0_._m_perObjectType._m_prob1ObstUnknownN "" VALUE 0xB00572CD __UByte_Value 0 NO_COMPU_METHOD 0 255 ECU_ADDRESS_EXTENSION 0x1 BYTE_ORDER MSB_LAST /end CHARACTERISTIC
/begin CHARACTERISTIC _g_PL_AD_fw_Radar_1R1V_rpc_XilObjBypassingRunnable_XilObjBypassingRunnable_m_pad_radarObjPort_par_out_local.TChangeableMemPool._._._m_arrayPool._0_._elem._m_objectInformation._0_._m_perObjectType._m_prob1ObstacleN "" VALUE 0xB00572C8 __UByte_Value 0 NO_COMPU_METHOD 0 255 ECU_ADDRESS_EXTENSION 0x1 BYTE_ORDER MSB_LAST /end CHARACTERISTIC
/begin CHARACTERISTIC _g_PL_AD_fw_Radar_1R1V_rpc_XilObjBypassingRunnable_XilObjBypassingRunnable_m_pad_radarObjPort_par_out_local.TChangeableMemPool._._._m_arrayPool._0_._elem._m_objectInformation._0_._m_perObjectType._m_prob1PassengerCarN "" VALUE 0xB00572D4 __UByte_Value 0 NO_COMPU_METHOD 0 255 ECU_ADDRESS_EXTENSION 0x1 BYTE_ORDER MSB_LAST /end CHARACTERISTIC
/begin CHARACTERISTIC _g_PL_AD_fw_Radar_1R1V_rpc_XilObjBypassingRunnable_XilObjBypassingRunnable_m_pad_radarObjPort_par_out_local.TChangeableMemPool._._._m_arrayPool._0_._elem._m_objectInformation._0_._m_perObjectType._m_prob1PedestrianN "" VALUE 0xB00572D0 __UByte_Value 0 NO_COMPU_METHOD 0 255 ECU_ADDRESS_EXTENSION 0x1 BYTE_ORDER MSB_LAST /end CHARACTERISTIC
/begin CHARACTERISTIC _g_PL_AD_fw_Radar_1R1V_rpc_XilObjBypassingRunnable_XilObjBypassingRunnable_m_pad_radarObjPort_par_out_local.TChangeableMemPool._._._m_arrayPool._0_._elem._m_objectInformation._0_._m_perObjectType._m_prob1RoadsideBarrierN "" VALUE 0xB00572D2 __UByte_Value 0 NO_COMPU_METHOD 0 255 ECU_ADDRESS_EXTENSION 0x1 BYTE_ORDER MSB_LAST /end CHARACTERISTIC
/begin CHARACTERISTIC _g_PL_AD_fw_Radar_1R1V_rpc_XilObjBypassingRunnable_XilObjBypassingRunnable_m_pad_radarObjPort_par_out_local.TChangeableMemPool._._._m_arrayPool._0_._elem._m_objectInformation._0_._m_perObjectType._m_prob1StatUnknownN "" VALUE 0xB00572D3 __UByte_Value 0 NO_COMPU_METHOD 0 255 ECU_ADDRESS_EXTENSION 0x1 BYTE_ORDER MSB_LAST /end CHARACTERISTIC
/begin CHARACTERISTIC _g_PL_AD_fw_Radar_1R1V_rpc_XilObjBypassingRunnable_XilObjBypassingRunnable_m_pad_radarObjPort_par_out_local.TChangeableMemPool._._._m_arrayPool._0_._elem._m_objectInformation._0_._m_perObjectType._m_prob1StationaryN "" VALUE 0xB00572CC __UByte_Value 0 NO_COMPU_METHOD 0 255 ECU_ADDRESS_EXTENSION 0x1 BYTE_ORDER MSB_LAST /end CHARACTERISTIC
/begin CHARACTERISTIC _g_PL_AD_fw_Radar_1R1V_rpc_XilObjBypassingRunnable_XilObjBypassingRunnable_m_pad_radarObjPort_par_out_local.TChangeableMemPool._._._m_arrayPool._0_._elem._m_objectInformation._0_._m_perObjectType._m_prob1TruckN "" VALUE 0xB00572D5 __UByte_Value 0 NO_COMPU_METHOD 0 255 ECU_ADDRESS_EXTENSION 0x1 BYTE_ORDER MSB_LAST /end CHARACTERISTIC
/begin CHARACTERISTIC _g_PL_AD_fw_Radar_1R1V_rpc_XilObjBypassingRunnable_XilObjBypassingRunnable_m_pad_radarObjPort_par_out_local.TChangeableMemPool._._._m_arrayPool._0_._elem._m_objectInformation._0_._m_perObjectType._m_prob1TwoWheelerN "" VALUE 0xB00572CF __UByte_Value 0 NO_COMPU_METHOD 0 255 ECU_ADDRESS_EXTENSION 0x1 BYTE_ORDER MSB_LAST /end CHARACTERISTIC
/begin CHARACTERISTIC _g_PL_AD_fw_Radar_1R1V_rpc_XilObjBypassingRunnable_XilObjBypassingRunnable_m_pad_radarObjPort_par_out_local.TChangeableMemPool._._._m_arrayPool._0_._elem._m_objectInformation._0_._m_perObjectType._m_prob1UnknownN "" VALUE 0xB00572CA __UByte_Value 0 NO_COMPU_METHOD 0 255 ECU_ADDRESS_EXTENSION 0x1 BYTE_ORDER MSB_LAST /end CHARACTERISTIC
/begin CHARACTERISTIC _g_PL_AD_fw_Radar_1R1V_rpc_XilObjBypassingRunnable_XilObjBypassingRunnable_m_pad_radarObjPort_par_out_local.TChangeableMemPool._._._m_arrayPool._0_._elem._m_objectInformation._0_._m_prob1HasBeenObservedMovingN "" VALUE 0xB0057311 __UByte_Value 0 NO_COMPU_METHOD 0 255 ECU_ADDRESS_EXTENSION 0x1 BYTE_ORDER MSB_LAST /end CHARACTERISTIC
/begin CHARACTERISTIC _g_PL_AD_fw_Radar_1R1V_rpc_XilObjBypassingRunnable_XilObjBypassingRunnable_m_pad_radarObjPort_par_out_local.TChangeableMemPool._._._m_arrayPool._0_._elem._m_objectInformation._0_._m_prob1MovingN "" VALUE 0xB0057310 __UByte_Value 0 NO_COMPU_METHOD 0 255 ECU_ADDRESS_EXTENSION 0x1 BYTE_ORDER MSB_LAST /end CHARACTERISTIC
/begin CHARACTERISTIC _g_PL_AD_fw_Radar_1R1V_rpc_XilObjBypassingRunnable_XilObjBypassingRunnable_m_pad_radarObjPort_par_out_local.TChangeableMemPool._._._m_arrayPool._0_._elem._m_objectInformation._0_._m_varAxN "" VALUE 0xB00572EC __SLong_Value 0 NO_COMPU_METHOD -2147483648 2147483647 ECU_ADDRESS_EXTENSION 0x1 BYTE_ORDER MSB_LAST /end CHARACTERISTIC
/begin CHARACTERISTIC _g_PL_AD_fw_Radar_1R1V_rpc_XilObjBypassingRunnable_XilObjBypassingRunnable_m_pad_radarObjPort_par_out_local.TChangeableMemPool._._._m_arrayPool._0_._elem._m_objectInformation._0_._m_varAyN "" VALUE 0xB00572F0 __SLong_Value 0 NO_COMPU_METHOD -2147483648 2147483647 ECU_ADDRESS_EXTENSION 0x1 BYTE_ORDER MSB_LAST /end CHARACTERISTIC
/begin CHARACTERISTIC _g_PL_AD_fw_Radar_1R1V_rpc_XilObjBypassingRunnable_XilObjBypassingRunnable_m_pad_radarObjPort_par_out_local.TChangeableMemPool._._._m_arrayPool._0_._elem._m_objectInformation._0_._m_varDxN "" VALUE 0xB00572DC __SLong_Value 0 NO_COMPU_METHOD -2147483648 2147483647 ECU_ADDRESS_EXTENSION 0x1 BYTE_ORDER MSB_LAST /end CHARACTERISTIC
/begin CHARACTERISTIC _g_PL_AD_fw_Radar_1R1V_rpc_XilObjBypassingRunnable_XilObjBypassingRunnable_m_pad_radarObjPort_par_out_local.TChangeableMemPool._._._m_arrayPool._0_._elem._m_objectInformation._0_._m_varDyN "" VALUE 0xB00572E0 __SLong_Value 0 NO_COMPU_METHOD -2147483648 2147483647 ECU_ADDRESS_EXTENSION 0x1 BYTE_ORDER MSB_LAST /end CHARACTERISTIC
/begin CHARACTERISTIC _g_PL_AD_fw_Radar_1R1V_rpc_XilObjBypassingRunnable_XilObjBypassingRunnable_m_pad_radarObjPort_par_out_local.TChangeableMemPool._._._m_arrayPool._0_._elem._m_objectInformation._0_._m_varVxN "" VALUE 0xB00572E4 __SLong_Value 0 NO_COMPU_METHOD -2147483648 2147483647 ECU_ADDRESS_EXTENSION 0x1 BYTE_ORDER MSB_LAST /end CHARACTERISTIC
/begin CHARACTERISTIC _g_PL_AD_fw_Radar_1R1V_rpc_XilObjBypassingRunnable_XilObjBypassingRunnable_m_pad_radarObjPort_par_out_local.TChangeableMemPool._._._m_arrayPool._0_._elem._m_objectInformation._0_._m_varVyN "" VALUE 0xB00572E8 __SLong_Value 0 NO_COMPU_METHOD -2147483648 2147483647 ECU_ADDRESS_EXTENSION 0x1 BYTE_ORDER MSB_LAST /end CHARACTERISTIC
/begin CHARACTERISTIC _g_PL_AD_fw_Radar_1R1V_rpc_XilObjBypassingRunnable_XilObjBypassingRunnable_m_pad_radarObjPort_par_out_local.TChangeableMemPool._._._m_arrayPool._0_._elem._m_objectInformation._0_._m_vxN "" VALUE 0xB00572FA __SWord_Value 0 NO_COMPU_METHOD -32768 32767 ECU_ADDRESS_EXTENSION 0x1 BYTE_ORDER MSB_LAST /end CHARACTERISTIC
/begin CHARACTERISTIC _g_PL_AD_fw_Radar_1R1V_rpc_XilObjBypassingRunnable_XilObjBypassingRunnable_m_pad_radarObjPort_par_out_local.TChangeableMemPool._._._m_arrayPool._0_._elem._m_objectInformation._0_._m_vyN "" VALUE 0xB00572FC __SWord_Value 0 NO_COMPU_METHOD -32768 32767 ECU_ADDRESS_EXTENSION 0x1 BYTE_ORDER MSB_LAST /end CHARACTERISTIC
/begin CHARACTERISTIC _g_PL_AD_fw_Radar_1R1V_rpc_XilObjBypassingRunnable_XilObjBypassingRunnable_m_pad_radarObjPort_par_out_local.TChangeableMemPool._._._m_arrayPool._0_._elem._m_objectInformation._0_._m_wExistProbN "" VALUE 0xB005730E __UWord_Value 0 NO_COMPU_METHOD 0 65535 ECU_ADDRESS_EXTENSION 0x1 BYTE_ORDER MSB_LAST /end CHARACTERISTIC
/begin CHARACTERISTIC _g_PL_AD_fw_Radar_1R1V_rpc_XilObjBypassingRunnable_XilObjBypassingRunnable_m_pad_radarObjPort_par_out_local.TChangeableMemPool._._._m_arrayPool._0_._elem._m_objectInformation._1_._Valid_b "" VALUE 0xB0057363 __UByte_Value 0 NO_COMPU_METHOD 0 255 ECU_ADDRESS_EXTENSION 0x1 BYTE_ORDER MSB_LAST /end CHARACTERISTIC
/begin CHARACTERISTIC _g_PL_AD_fw_Radar_1R1V_rpc_XilObjBypassingRunnable_XilObjBypassingRunnable_m_pad_radarObjPort_par_out_local.TChangeableMemPool._._._m_arrayPool._0_._elem._m_objectInformation._1_._m_HandleN "" VALUE 0xB0057362 __UByte_Value 0 NO_COMPU_METHOD 0 255 ECU_ADDRESS_EXTENSION 0x1 BYTE_ORDER MSB_LAST /end CHARACTERISTIC
/begin CHARACTERISTIC _g_PL_AD_fw_Radar_1R1V_rpc_XilObjBypassingRunnable_XilObjBypassingRunnable_m_pad_radarObjPort_par_out_local.TChangeableMemPool._._._m_arrayPool._0_._elem._m_objectInformation._1_._m_alpPiVarYawAngleN "" VALUE 0xB0057358 __UWord_Value 0 NO_COMPU_METHOD 0 65535 ECU_ADDRESS_EXTENSION 0x1 BYTE_ORDER MSB_LAST /end CHARACTERISTIC
/begin CHARACTERISTIC _g_PL_AD_fw_Radar_1R1V_rpc_XilObjBypassingRunnable_XilObjBypassingRunnable_m_pad_radarObjPort_par_out_local.TChangeableMemPool._._._m_arrayPool._0_._elem._m_objectInformation._1_._m_alpPiYawAngleN "" VALUE 0xB0057352 __SWord_Value 0 NO_COMPU_METHOD -32768 32767 ECU_ADDRESS_EXTENSION 0x1 BYTE_ORDER MSB_LAST /end CHARACTERISTIC
/begin CHARACTERISTIC _g_PL_AD_fw_Radar_1R1V_rpc_XilObjBypassingRunnable_XilObjBypassingRunnable_m_pad_radarObjPort_par_out_local.TChangeableMemPool._._._m_arrayPool._0_._elem._m_objectInformation._1_._m_axN "" VALUE 0xB005734E __SWord_Value 0 NO_COMPU_METHOD -32768 32767 ECU_ADDRESS_EXTENSION 0x1 BYTE_ORDER MSB_LAST /end CHARACTERISTIC
/begin CHARACTERISTIC _g_PL_AD_fw_Radar_1R1V_rpc_XilObjBypassingRunnable_XilObjBypassingRunnable_m_pad_radarObjPort_par_out_local.TChangeableMemPool._._._m_arrayPool._0_._elem._m_objectInformation._1_._m_ayN "" VALUE 0xB0057350 __SWord_Value 0 NO_COMPU_METHOD -32768 32767 ECU_ADDRESS_EXTENSION 0x1 BYTE_ORDER MSB_LAST /end CHARACTERISTIC
/begin CHARACTERISTIC _g_PL_AD_fw_Radar_1R1V_rpc_XilObjBypassingRunnable_XilObjBypassingRunnable_m_pad_radarObjPort_par_out_local.TChangeableMemPool._._._m_arrayPool._0_._elem._m_objectInformation._1_._m_dLengthN "" VALUE 0xB0057356 __SWord_Value 0 NO_COMPU_METHOD -32768 32767 ECU_ADDRESS_EXTENSION 0x1 BYTE_ORDER MSB_LAST /end CHARACTERISTIC
/begin CHARACTERISTIC _g_PL_AD_fw_Radar_1R1V_rpc_XilObjBypassingRunnable_XilObjBypassingRunnable_m_pad_radarObjPort_par_out_local.TChangeableMemPool._._._m_arrayPool._0_._elem._m_objectInformation._1_._m_dVarLengthN "" VALUE 0xB005735C __UWord_Value 0 NO_COMPU_METHOD 0 65535 ECU_ADDRESS_EXTENSION 0x1 BYTE_ORDER MSB_LAST /end CHARACTERISTIC
/begin CHARACTERISTIC _g_PL_AD_fw_Radar_1R1V_rpc_XilObjBypassingRunnable_XilObjBypassingRunnable_m_pad_radarObjPort_par_out_local.TChangeableMemPool._._._m_arrayPool._0_._elem._m_objectInformation._1_._m_dVarWidthN "" VALUE 0xB005735A __UWord_Value 0 NO_COMPU_METHOD 0 65535 ECU_ADDRESS_EXTENSION 0x1 BYTE_ORDER MSB_LAST /end CHARACTERISTIC
/begin CHARACTERISTIC _g_PL_AD_fw_Radar_1R1V_rpc_XilObjBypassingRunnable_XilObjBypassingRunnable_m_pad_radarObjPort_par_out_local.TChangeableMemPool._._._m_arrayPool._0_._elem._m_objectInformation._1_._m_dWidthN "" VALUE 0xB0057354 __SWord_Value 0 NO_COMPU_METHOD -32768 32767 ECU_ADDRESS_EXTENSION 0x1 BYTE_ORDER MSB_LAST /end CHARACTERISTIC
/begin CHARACTERISTIC _g_PL_AD_fw_Radar_1R1V_rpc_XilObjBypassingRunnable_XilObjBypassingRunnable_m_pad_radarObjPort_par_out_local.TChangeableMemPool._._._m_arrayPool._0_._elem._m_objectInformation._1_._m_dxN "" VALUE 0xB0057344 __SWord_Value 0 NO_COMPU_METHOD -32768 32767 ECU_ADDRESS_EXTENSION 0x1 BYTE_ORDER MSB_LAST /end CHARACTERISTIC
/begin CHARACTERISTIC _g_PL_AD_fw_Radar_1R1V_rpc_XilObjBypassingRunnable_XilObjBypassingRunnable_m_pad_radarObjPort_par_out_local.TChangeableMemPool._._._m_arrayPool._0_._elem._m_objectInformation._1_._m_dyN "" VALUE 0xB0057346 __SWord_Value 0 NO_COMPU_METHOD -32768 32767 ECU_ADDRESS_EXTENSION 0x1 BYTE_ORDER MSB_LAST /end CHARACTERISTIC
/begin CHARACTERISTIC _g_PL_AD_fw_Radar_1R1V_rpc_XilObjBypassingRunnable_XilObjBypassingRunnable_m_pad_radarObjPort_par_out_local.TChangeableMemPool._._._m_arrayPool._0_._elem._m_objectInformation._1_._m_dzN "" VALUE 0xB0057348 __SWord_Value 0 NO_COMPU_METHOD -32768 32767 ECU_ADDRESS_EXTENSION 0x1 BYTE_ORDER MSB_LAST /end CHARACTERISTIC
/begin CHARACTERISTIC _g_PL_AD_fw_Radar_1R1V_rpc_XilObjBypassingRunnable_XilObjBypassingRunnable_m_pad_radarObjPort_par_out_local.TChangeableMemPool._._._m_arrayPool._0_._elem._m_objectInformation._1_._m_isObjectAsil "" VALUE 0xB0057364 __UByte_Value 0 NO_COMPU_METHOD 0 255 ECU_ADDRESS_EXTENSION 0x1 BYTE_ORDER MSB_LAST /end CHARACTERISTIC
/begin CHARACTERISTIC _g_PL_AD_fw_Radar_1R1V_rpc_XilObjBypassingRunnable_XilObjBypassingRunnable_m_pad_radarObjPort_par_out_local.TChangeableMemPool._._._m_arrayPool._0_._elem._m_objectInformation._1_._m_perObjectType._m_prob1FourPlusWheelerN "" VALUE 0xB005731E __UByte_Value 0 NO_COMPU_METHOD 0 255 ECU_ADDRESS_EXTENSION 0x1 BYTE_ORDER MSB_LAST /end CHARACTERISTIC
/begin CHARACTERISTIC _g_PL_AD_fw_Radar_1R1V_rpc_XilObjBypassingRunnable_XilObjBypassingRunnable_m_pad_radarObjPort_par_out_local.TChangeableMemPool._._._m_arrayPool._0_._elem._m_objectInformation._1_._m_perObjectType._m_prob1FourWheelUnknownN "" VALUE 0xB0057326 __UByte_Value 0 NO_COMPU_METHOD 0 255 ECU_ADDRESS_EXTENSION 0x1 BYTE_ORDER MSB_LAST /end CHARACTERISTIC
/begin CHARACTERISTIC _g_PL_AD_fw_Radar_1R1V_rpc_XilObjBypassingRunnable_XilObjBypassingRunnable_m_pad_radarObjPort_par_out_local.TChangeableMemPool._._._m_arrayPool._0_._elem._m_objectInformation._1_._m_perObjectType._m_prob1MobileN "" VALUE 0xB005731B __UByte_Value 0 NO_COMPU_METHOD 0 255 ECU_ADDRESS_EXTENSION 0x1 BYTE_ORDER MSB_LAST /end CHARACTERISTIC
/begin CHARACTERISTIC _g_PL_AD_fw_Radar_1R1V_rpc_XilObjBypassingRunnable_XilObjBypassingRunnable_m_pad_radarObjPort_par_out_local.TChangeableMemPool._._._m_arrayPool._0_._elem._m_objectInformation._1_._m_perObjectType._m_prob1MovUnknownN "" VALUE 0xB0057321 __UByte_Value 0 NO_COMPU_METHOD 0 255 ECU_ADDRESS_EXTENSION 0x1 BYTE_ORDER MSB_LAST /end CHARACTERISTIC
/begin CHARACTERISTIC _g_PL_AD_fw_Radar_1R1V_rpc_XilObjBypassingRunnable_XilObjBypassingRunnable_m_pad_radarObjPort_par_out_local.TChangeableMemPool._._._m_arrayPool._0_._elem._m_objectInformation._1_._m_perObjectType._m_prob1NonObstacleN "" VALUE 0xB0057319 __UByte_Value 0 NO_COMPU_METHOD 0 255 ECU_ADDRESS_EXTENSION 0x1 BYTE_ORDER MSB_LAST /end CHARACTERISTIC
/begin CHARACTERISTIC _g_PL_AD_fw_Radar_1R1V_rpc_XilObjBypassingRunnable_XilObjBypassingRunnable_m_pad_radarObjPort_par_out_local.TChangeableMemPool._._._m_arrayPool._0_._elem._m_objectInformation._1_._m_perObjectType._m_prob1ObstUnknownN "" VALUE 0xB005731D __UByte_Value 0 NO_COMPU_METHOD 0 255 ECU_ADDRESS_EXTENSION 0x1 BYTE_ORDER MSB_LAST /end CHARACTERISTIC
/begin CHARACTERISTIC _g_PL_AD_fw_Radar_1R1V_rpc_XilObjBypassingRunnable_XilObjBypassingRunnable_m_pad_radarObjPort_par_out_local.TChangeableMemPool._._._m_arrayPool._0_._elem._m_objectInformation._1_._m_perObjectType._m_prob1ObstacleN "" VALUE 0xB0057318 __UByte_Value 0 NO_COMPU_METHOD 0 255 ECU_ADDRESS_EXTENSION 0x1 BYTE_ORDER MSB_LAST /end CHARACTERISTIC
/begin CHARACTERISTIC _g_PL_AD_fw_Radar_1R1V_rpc_XilObjBypassingRunnable_XilObjBypassingRunnable_m_pad_radarObjPort_par_out_local.TChangeableMemPool._._._m_arrayPool._0_._elem._m_objectInformation._1_._m_perObjectType._m_prob1PassengerCarN "" VALUE 0xB0057324 __UByte_Value 0 NO_COMPU_METHOD 0 255 ECU_ADDRESS_EXTENSION 0x1 BYTE_ORDER MSB_LAST /end CHARACTERISTIC
/begin CHARACTERISTIC _g_PL_AD_fw_Radar_1R1V_rpc_XilObjBypassingRunnable_XilObjBypassingRunnable_m_pad_radarObjPort_par_out_local.TChangeableMemPool._._._m_arrayPool._0_._elem._m_objectInformation._1_._m_perObjectType._m_prob1PedestrianN "" VALUE 0xB0057320 __UByte_Value 0 NO_COMPU_METHOD 0 255 ECU_ADDRESS_EXTENSION 0x1 BYTE_ORDER MSB_LAST /end CHARACTERISTIC
/begin CHARACTERISTIC _g_PL_AD_fw_Radar_1R1V_rpc_XilObjBypassingRunnable_XilObjBypassingRunnable_m_pad_radarObjPort_par_out_local.TChangeableMemPool._._._m_arrayPool._0_._elem._m_objectInformation._1_._m_perObjectType._m_prob1RoadsideBarrierN "" VALUE 0xB0057322 __UByte_Value 0 NO_COMPU_METHOD 0 255 ECU_ADDRESS_EXTENSION 0x1 BYTE_ORDER MSB_LAST /end CHARACTERISTIC
/begin CHARACTERISTIC _g_PL_AD_fw_Radar_1R1V_rpc_XilObjBypassingRunnable_XilObjBypassingRunnable_m_pad_radarObjPort_par_out_local.TChangeableMemPool._._._m_arrayPool._0_._elem._m_objectInformation._1_._m_perObjectType._m_prob1StatUnknownN "" VALUE 0xB0057323 __UByte_Value 0 NO_COMPU_METHOD 0 255 ECU_ADDRESS_EXTENSION 0x1 BYTE_ORDER MSB_LAST /end CHARACTERISTIC
/begin CHARACTERISTIC _g_PL_AD_fw_Radar_1R1V_rpc_XilObjBypassingRunnable_XilObjBypassingRunnable_m_pad_radarObjPort_par_out_local.TChangeableMemPool._._._m_arrayPool._0_._elem._m_objectInformation._1_._m_perObjectType._m_prob1StationaryN "" VALUE 0xB005731C __UByte_Value 0 NO_COMPU_METHOD 0 255 ECU_ADDRESS_EXTENSION 0x1 BYTE_ORDER MSB_LAST /end CHARACTERISTIC
/begin CHARACTERISTIC _g_PL_AD_fw_Radar_1R1V_rpc_XilObjBypassingRunnable_XilObjBypassingRunnable_m_pad_radarObjPort_par_out_local.TChangeableMemPool._._._m_arrayPool._0_._elem._m_objectInformation._1_._m_perObjectType._m_prob1TruckN "" VALUE 0xB0057325 __UByte_Value 0 NO_COMPU_METHOD 0 255 ECU_ADDRESS_EXTENSION 0x1 BYTE_ORDER MSB_LAST /end CHARACTERISTIC
/begin CHARACTERISTIC _g_PL_AD_fw_Radar_1R1V_rpc_XilObjBypassingRunnable_XilObjBypassingRunnable_m_pad_radarObjPort_par_out_local.TChangeableMemPool._._._m_arrayPool._0_._elem._m_objectInformation._1_._m_perObjectType._m_prob1TwoWheelerN "" VALUE 0xB005731F __UByte_Value 0 NO_COMPU_METHOD 0 255 ECU_ADDRESS_EXTENSION 0x1 BYTE_ORDER MSB_LAST /end CHARACTERISTIC
/begin CHARACTERISTIC _g_PL_AD_fw_Radar_1R1V_rpc_XilObjBypassingRunnable_XilObjBypassingRunnable_m_pad_radarObjPort_par_out_local.TChangeableMemPool._._._m_arrayPool._0_._elem._m_objectInformation._1_._m_perObjectType._m_prob1UnknownN "" VALUE 0xB005731A __UByte_Value 0 NO_COMPU_METHOD 0 255 ECU_ADDRESS_EXTENSION 0x1 BYTE_ORDER MSB_LAST /end CHARACTERISTIC
/begin CHARACTERISTIC _g_PL_AD_fw_Radar_1R1V_rpc_XilObjBypassingRunnable_XilObjBypassingRunnable_m_pad_radarObjPort_par_out_local.TChangeableMemPool._._._m_arrayPool._0_._elem._m_objectInformation._1_._m_prob1HasBeenObservedMovingN "" VALUE 0xB0057361 __UByte_Value 0 NO_COMPU_METHOD 0 255 ECU_ADDRESS_EXTENSION 0x1 BYTE_ORDER MSB_LAST /end CHARACTERISTIC
/begin CHARACTERISTIC _g_PL_AD_fw_Radar_1R1V_rpc_XilObjBypassingRunnable_XilObjBypassingRunnable_m_pad_radarObjPort_par_out_local.TChangeableMemPool._._._m_arrayPool._0_._elem._m_objectInformation._1_._m_prob1MovingN "" VALUE 0xB0057360 __UByte_Value 0 NO_COMPU_METHOD 0 255 ECU_ADDRESS_EXTENSION 0x1 BYTE_ORDER MSB_LAST /end CHARACTERISTIC
/begin CHARACTERISTIC _g_PL_AD_fw_Radar_1R1V_rpc_XilObjBypassingRunnable_XilObjBypassingRunnable_m_pad_radarObjPort_par_out_local.TChangeableMemPool._._._m_arrayPool._0_._elem._m_objectInformation._1_._m_varAxN "" VALUE 0xB005733C __SLong_Value 0 NO_COMPU_METHOD -2147483648 2147483647 ECU_ADDRESS_EXTENSION 0x1 BYTE_ORDER MSB_LAST /end CHARACTERISTIC
/begin CHARACTERISTIC _g_PL_AD_fw_Radar_1R1V_rpc_XilObjBypassingRunnable_XilObjBypassingRunnable_m_pad_radarObjPort_par_out_local.TChangeableMemPool._._._m_arrayPool._0_._elem._m_objectInformation._1_._m_varAyN "" VALUE 0xB0057340 __SLong_Value 0 NO_COMPU_METHOD -2147483648 2147483647 ECU_ADDRESS_EXTENSION 0x1 BYTE_ORDER MSB_LAST /end CHARACTERISTIC
/begin CHARACTERISTIC _g_PL_AD_fw_Radar_1R1V_rpc_XilObjBypassingRunnable_XilObjBypassingRunnable_m_pad_radarObjPort_par_out_local.TChangeableMemPool._._._m_arrayPool._0_._elem._m_objectInformation._1_._m_varDxN "" VALUE 0xB005732C __SLong_Value 0 NO_COMPU_METHOD -2147483648 2147483647 ECU_ADDRESS_EXTENSION 0x1 BYTE_ORDER MSB_LAST /end CHARACTERISTIC
/begin CHARACTERISTIC _g_PL_AD_fw_Radar_1R1V_rpc_XilObjBypassingRunnable_XilObjBypassingRunnable_m_pad_radarObjPort_par_out_local.TChangeableMemPool._._._m_arrayPool._0_._elem._m_objectInformation._1_._m_varDyN "" VALUE 0xB0057330 __SLong_Value 0 NO_COMPU_METHOD -2147483648 2147483647 ECU_ADDRESS_EXTENSION 0x1 BYTE_ORDER MSB_LAST /end CHARACTERISTIC
/begin CHARACTERISTIC _g_PL_AD_fw_Radar_1R1V_rpc_XilObjBypassingRunnable_XilObjBypassingRunnable_m_pad_radarObjPort_par_out_local.TChangeableMemPool._._._m_arrayPool._0_._elem._m_objectInformation._1_._m_varVxN "" VALUE 0xB0057334 __SLong_Value 0 NO_COMPU_METHOD -2147483648 2147483647 ECU_ADDRESS_EXTENSION 0x1 BYTE_ORDER MSB_LAST /end CHARACTERISTIC
/begin CHARACTERISTIC _g_PL_AD_fw_Radar_1R1V_rpc_XilObjBypassingRunnable_XilObjBypassingRunnable_m_pad_radarObjPort_par_out_local.TChangeableMemPool._._._m_arrayPool._0_._elem._m_objectInformation._1_._m_varVyN "" VALUE 0xB0057338 __SLong_Value 0 NO_COMPU_METHOD -2147483648 2147483647 ECU_ADDRESS_EXTENSION 0x1 BYTE_ORDER MSB_LAST /end CHARACTERISTIC
/begin CHARACTERISTIC _g_PL_AD_fw_Radar_1R1V_rpc_XilObjBypassingRunnable_XilObjBypassingRunnable_m_pad_radarObjPort_par_out_local.TChangeableMemPool._._._m_arrayPool._0_._elem._m_objectInformation._1_._m_vxN "" VALUE 0xB005734A __SWord_Value 0 NO_COMPU_METHOD -32768 32767 ECU_ADDRESS_EXTENSION 0x1 BYTE_ORDER MSB_LAST /end CHARACTERISTIC
/begin CHARACTERISTIC _g_PL_AD_fw_Radar_1R1V_rpc_XilObjBypassingRunnable_XilObjBypassingRunnable_m_pad_radarObjPort_par_out_local.TChangeableMemPool._._._m_arrayPool._0_._elem._m_objectInformation._1_._m_vyN "" VALUE 0xB005734C __SWord_Value 0 NO_COMPU_METHOD -32768 32767 ECU_ADDRESS_EXTENSION 0x1 BYTE_ORDER MSB_LAST /end CHARACTERISTIC
/begin CHARACTERISTIC _g_PL_AD_fw_Radar_1R1V_rpc_XilObjBypassingRunnable_XilObjBypassingRunnable_m_pad_radarObjPort_par_out_local.TChangeableMemPool._._._m_arrayPool._0_._elem._m_objectInformation._1_._m_wExistProbN "" VALUE 0xB005735E __UWord_Value 0 NO_COMPU_METHOD 0 65535 ECU_ADDRESS_EXTENSION 0x1 BYTE_ORDER MSB_LAST /end CHARACTERISTIC
/begin CHARACTERISTIC _g_PL_AD_fw_Radar_1R1V_rpc_XilObjBypassingRunnable_XilObjBypassingRunnable_m_pad_radarObjPort_par_out_local.TChangeableMemPool._._._m_arrayPool._0_._elem._m_objectInformation._2_._Valid_b "" VALUE 0xB00573B3 __UByte_Value 0 NO_COMPU_METHOD 0 255 ECU_ADDRESS_EXTENSION 0x1 BYTE_ORDER MSB_LAST /end CHARACTERISTIC
/begin CHARACTERISTIC _g_PL_AD_fw_Radar_1R1V_rpc_XilObjBypassingRunnable_XilObjBypassingRunnable_m_pad_radarObjPort_par_out_local.TChangeableMemPool._._._m_arrayPool._0_._elem._m_objectInformation._2_._m_HandleN "" VALUE 0xB00573B2 __UByte_Value 0 NO_COMPU_METHOD 0 255 ECU_ADDRESS_EXTENSION 0x1 BYTE_ORDER MSB_LAST /end CHARACTERISTIC
/begin CHARACTERISTIC _g_PL_AD_fw_Radar_1R1V_rpc_XilObjBypassingRunnable_XilObjBypassingRunnable_m_pad_radarObjPort_par_out_local.TChangeableMemPool._._._m_arrayPool._0_._elem._m_objectInformation._2_._m_alpPiVarYawAngleN "" VALUE 0xB00573A8 __UWord_Value 0 NO_COMPU_METHOD 0 65535 ECU_ADDRESS_EXTENSION 0x1 BYTE_ORDER MSB_LAST /end CHARACTERISTIC
/begin CHARACTERISTIC _g_PL_AD_fw_Radar_1R1V_rpc_XilObjBypassingRunnable_XilObjBypassingRunnable_m_pad_radarObjPort_par_out_local.TChangeableMemPool._._._m_arrayPool._0_._elem._m_objectInformation._2_._m_alpPiYawAngleN "" VALUE 0xB00573A2 __SWord_Value 0 NO_COMPU_METHOD -32768 32767 ECU_ADDRESS_EXTENSION 0x1 BYTE_ORDER MSB_LAST /end CHARACTERISTIC
/begin CHARACTERISTIC _g_PL_AD_fw_Radar_1R1V_rpc_XilObjBypassingRunnable_XilObjBypassingRunnable_m_pad_radarObjPort_par_out_local.TChangeableMemPool._._._m_arrayPool._0_._elem._m_objectInformation._2_._m_axN "" VALUE 0xB005739E __SWord_Value 0 NO_COMPU_METHOD -32768 32767 ECU_ADDRESS_EXTENSION 0x1 BYTE_ORDER MSB_LAST /end CHARACTERISTIC
/begin CHARACTERISTIC _g_PL_AD_fw_Radar_1R1V_rpc_XilObjBypassingRunnable_XilObjBypassingRunnable_m_pad_radarObjPort_par_out_local.TChangeableMemPool._._._m_arrayPool._0_._elem._m_objectInformation._2_._m_ayN "" VALUE 0xB00573A0 __SWord_Value 0 NO_COMPU_METHOD -32768 32767 ECU_ADDRESS_EXTENSION 0x1 BYTE_ORDER MSB_LAST /end CHARACTERISTIC
/begin CHARACTERISTIC _g_PL_AD_fw_Radar_1R1V_rpc_XilObjBypassingRunnable_XilObjBypassingRunnable_m_pad_radarObjPort_par_out_local.TChangeableMemPool._._._m_arrayPool._0_._elem._m_objectInformation._2_._m_dLengthN "" VALUE 0xB00573A6 __SWord_Value 0 NO_COMPU_METHOD -32768 32767 ECU_ADDRESS_EXTENSION 0x1 BYTE_ORDER MSB_LAST /end CHARACTERISTIC
/begin CHARACTERISTIC _g_PL_AD_fw_Radar_1R1V_rpc_XilObjBypassingRunnable_XilObjBypassingRunnable_m_pad_radarObjPort_par_out_local.TChangeableMemPool._._._m_arrayPool._0_._elem._m_objectInformation._2_._m_dVarLengthN "" VALUE 0xB00573AC __UWord_Value 0 NO_COMPU_METHOD 0 65535 ECU_ADDRESS_EXTENSION 0x1 BYTE_ORDER MSB_LAST /end CHARACTERISTIC
/begin CHARACTERISTIC _g_PL_AD_fw_Radar_1R1V_rpc_XilObjBypassingRunnable_XilObjBypassingRunnable_m_pad_radarObjPort_par_out_local.TChangeableMemPool._._._m_arrayPool._0_._elem._m_objectInformation._2_._m_dVarWidthN "" VALUE 0xB00573AA __UWord_Value 0 NO_COMPU_METHOD 0 65535 ECU_ADDRESS_EXTENSION 0x1 BYTE_ORDER MSB_LAST /end CHARACTERISTIC
/begin CHARACTERISTIC _g_PL_AD_fw_Radar_1R1V_rpc_XilObjBypassingRunnable_XilObjBypassingRunnable_m_pad_radarObjPort_par_out_local.TChangeableMemPool._._._m_arrayPool._0_._elem._m_objectInformation._2_._m_dWidthN "" VALUE 0xB00573A4 __SWord_Value 0 NO_COMPU_METHOD -32768 32767 ECU_ADDRESS_EXTENSION 0x1 BYTE_ORDER MSB_LAST /end CHARACTERISTIC
/begin CHARACTERISTIC _g_PL_AD_fw_Radar_1R1V_rpc_XilObjBypassingRunnable_XilObjBypassingRunnable_m_pad_radarObjPort_par_out_local.TChangeableMemPool._._._m_arrayPool._0_._elem._m_objectInformation._2_._m_dxN "" VALUE 0xB0057394 __SWord_Value 0 NO_COMPU_METHOD -32768 32767 ECU_ADDRESS_EXTENSION 0x1 BYTE_ORDER MSB_LAST /end CHARACTERISTIC
/begin CHARACTERISTIC _g_PL_AD_fw_Radar_1R1V_rpc_XilObjBypassingRunnable_XilObjBypassingRunnable_m_pad_radarObjPort_par_out_local.TChangeableMemPool._._._m_arrayPool._0_._elem._m_objectInformation._2_._m_dyN "" VALUE 0xB0057396 __SWord_Value 0 NO_COMPU_METHOD -32768 32767 ECU_ADDRESS_EXTENSION 0x1 BYTE_ORDER MSB_LAST /end CHARACTERISTIC
/begin COMPU_METHOD AAL_MSG "enumeration table" TAB_VERB "%.0" "" COMPU_TAB_REF AAL_MSG /end COMPU_METHOD
/begin COMPU_METHOD AAL_MSG.OLD_Copy1 "enumeration table" TAB_VERB "%.0" "" COMPU_TAB_REF AAL_MSG.OLD_1 /end COMPU_METHOD
/begin COMPU_METHOD AAL_MSG.OLD_Copy2 "enumeration table" TAB_VERB "%.0" "" COMPU_TAB_REF AAL_MSG.OLD_2 /end COMPU_METHOD
/begin COMPU_METHOD AAL_MSG.OLD_Copy3 "enumeration table" TAB_VERB "%.0" "" COMPU_TAB_REF AAL_MSG.OLD_3 /end COMPU_METHOD
/begin COMPU_METHOD AAL_MSG.OLD_Copy4 "enumeration table" TAB_VERB "%.0" "" COMPU_TAB_REF AAL_MSG.OLD_4 /end COMPU_METHOD
/begin COMPU_METHOD AAL_MSG.OLD_Copy5 "enumeration table" TAB_VERB "%.0" "" COMPU_TAB_REF AAL_MSG.OLD_5 /end COMPU_METHOD
/begin COMPU_METHOD AAL_MSG.OLD_Copy6 "enumeration table" TAB_VERB "%.0" "" COMPU_TAB_REF AAL_MSG.OLD_6 /end COMPU_METHOD
/begin COMPU_METHOD AAL_MSG.OLD_Copy7 "enumeration table" TAB_VERB "%.0" "" COMPU_TAB_REF AAL_MSG.OLD_7 /end COMPU_METHOD
/begin COMPU_METHOD AAL_MSG.OLD_Copy8 "enumeration table" TAB_VERB "%.0" "" COMPU_TAB_REF AAL_MSG.OLD_8 /end COMPU_METHOD
/begin COMPU_METHOD AAL_MSG_Copy1 "enumeration table" TAB_VERB "%.0" "" COMPU_TAB_REF AAL_MSG_Copy1 /end COMPU_METHOD
/begin COMPU_METHOD AAL_MSG_Copy3 "enumeration table" TAB_VERB "%.0" "" COMPU_TAB_REF AAL_MSG_Copy3 /end COMPU_METHOD
/begin COMPU_METHOD AbdMainStates "enumeration table" TAB_VERB "%.0" "" COMPU_TAB_REF AbdMainStates /end COMPU_METHOD
/begin COMPU_METHOD AbsStatus "enumeration table" TAB_VERB "%.0" "" COMPU_TAB_REF AbsStatus /end COMPU_METHOD
/begin COMPU_METHOD AccPlusBehavior "enumeration table" TAB_VERB "%.0" "" COMPU_TAB_REF AccPlusBehavior /end COMPU_METHOD
/begin COMPU_METHOD AccState "enumeration table" TAB_VERB "%.0" "" COMPU_TAB_REF AccState /end COMPU_METHOD
/begin COMPU_METHOD AccStateMachineInteractionType "enumeration table" TAB_VERB "%.0" "" COMPU_TAB_REF AccStateMachineInteractionType /end COMPU_METHOD
/begin COMPU_METHOD AccStates "enumeration table" TAB_VERB "%.0" "" COMPU_TAB_REF AccStates /end COMPU_METHOD
/begin COMPU_METHOD AcceleratorOverrideStrategy "enumeration table" TAB_VERB "%.0" "" COMPU_TAB_REF AcceleratorOverrideStrategy /end COMPU_METHOD
/begin COMPU_METHOD Action "enumeration table" TAB_VERB "%.0" "" COMPU_TAB_REF Action /end COMPU_METHOD
/begin COMPU_METHOD ActivationRequest "enumeration table" TAB_VERB "%.0" "" COMPU_TAB_REF ActivationRequest /end COMPU_METHOD
/begin COMPU_METHOD ActorState "enumeration table" TAB_VERB "%.0" "" COMPU_TAB_REF ActorState /end COMPU_METHOD
/begin COMPU_METHOD ActuationConstraint "enumeration table" TAB_VERB "%.0" "" COMPU_TAB_REF ActuationConstraint /end COMPU_METHOD
/begin COMPU_METHOD ActuationState "enumeration table" TAB_VERB "%.0" "" COMPU_TAB_REF ActuationState /end COMPU_METHOD
/begin COMPU_METHOD AebStates "enumeration table" TAB_VERB "%.0" "" COMPU_TAB_REF AebStates /end COMPU_METHOD
/begin COMPU_METHOD ArbitrationStates "enumeration table" TAB_VERB "%.0" "" COMPU_TAB_REF ArbitrationStates /end COMPU_METHOD
/begin COMPU_METHOD Availability "enumeration table" TAB_VERB "%.0" "" COMPU_TAB_REF Availability /end COMPU_METHOD
/begin COMPU_METHOD AvailableConfigurations "enumeration table" TAB_VERB "%.0" "" COMPU_TAB_REF AvailableConfigurations /end COMPU_METHOD
/begin COMPU_METHOD AveragingWeightType "enumeration table" TAB_VERB "%.0" "" COMPU_TAB_REF AveragingWeightType /end COMPU_METHOD
/begin COMPU_METHOD BdaMode "enumeration table" TAB_VERB "%.0" "" COMPU_TAB_REF BdaMode /end COMPU_METHOD
/begin COMPU_METHOD BdcMainStates "enumeration table" TAB_VERB "%.0" "" COMPU_TAB_REF BdcMainStates /end COMPU_METHOD
/begin COMPU_METHOD BdcStateConstants "enumeration table" TAB_VERB "%.0" "" COMPU_TAB_REF BdcStateConstants /end COMPU_METHOD
/begin COMPU_METHOD BdcStateOfdStandstillCv "enumeration table" TAB_VERB "%.0" "" COMPU_TAB_REF BdcStateOfdStandstillCv /end COMPU_METHOD
/begin COMPU_METHOD BdcTargets "enumeration table" TAB_VERB "%.0" "" COMPU_TAB_REF BdcTargets /end COMPU_METHOD
/begin COMPU_METHOD BehaviorExecutionRecommendation "enumeration table" TAB_VERB "%.0" "" COMPU_TAB_REF BehaviorExecutionRecommendation /end COMPU_METHOD
/begin COMPU_METHOD BehaviorRelatedObjectStatus "enumeration table" TAB_VERB "%.0" "" COMPU_TAB_REF BehaviorRelatedObjectStatus /end COMPU_METHOD
/begin COMPU_METHOD BehaviorStrategy "enumeration table" TAB_VERB "%.0" "" COMPU_TAB_REF BehaviorStrategy /end COMPU_METHOD
/begin COMPU_METHOD BehaviorStrategy.OLD_Copy1 "enumeration table" TAB_VERB "%.0" "" COMPU_TAB_REF BehaviorStrategy.OLD_1 /end COMPU_METHOD
/begin COMPU_METHOD BehaviorStrategyType "enumeration table" TAB_VERB "%.0" "" COMPU_TAB_REF BehaviorStrategyType /end COMPU_METHOD
/begin COMPU_METHOD BehaviorStrategy_Copy1 "enumeration table" TAB_VERB "%.0" "" COMPU_TAB_REF BehaviorStrategy_Copy1 /end COMPU_METHOD
/begin COMPU_METHOD BehaviorType "enumeration table" TAB_VERB "%.0" "" COMPU_TAB_REF BehaviorType /end COMPU_METHOD
/begin COMPU_METHOD BehaviorType.OLD_Copy1 "enumeration table" TAB_VERB "%.0" "" COMPU_TAB_REF BehaviorType.OLD_1 /end COMPU_METHOD
/begin COMPU_METHOD BehaviorType_Copy1 "enumeration table" TAB_VERB "%.0" "" COMPU_TAB_REF BehaviorType_Copy1 /end COMPU_METHOD
/begin COMPU_METHOD BlindnessIndicatorUniqueId "enumeration table" TAB_VERB "%.0" "" COMPU_TAB_REF BlindnessIndicatorUniqueId /end COMPU_METHOD
/begin COMPU_METHOD BlindnessValidityState "enumeration table" TAB_VERB "%.0" "" COMPU_TAB_REF BlindnessValidityState /end COMPU_METHOD
/begin COMPU_METHOD BorderState "enumeration table" TAB_VERB "%.0" "" COMPU_TAB_REF BorderState /end COMPU_METHOD
/begin COMPU_METHOD BoundaryType "enumeration table" TAB_VERB "%.0" "" COMPU_TAB_REF BoundaryType /end COMPU_METHOD
/begin COMPU_METHOD ButtonStatus "enumeration table" TAB_VERB "%.0" "" COMPU_TAB_REF ButtonStatus /end COMPU_METHOD
/begin COMPU_METHOD C_PLM "enumeration table" TAB_VERB "%.0" "" COMPU_TAB_REF C_PLM /end COMPU_METHOD
/begin COMPU_METHOD C_PLM_Copy1 "enumeration table" TAB_VERB "%.0" "" COMPU_TAB_REF C_PLM_Copy1 /end COMPU_METHOD
/begin COMPU_METHOD CalculatorResult "enumeration table" TAB_VERB "%.0" "" COMPU_TAB_REF CalculatorResult /end COMPU_METHOD
/begin COMPU_METHOD CanSM_BusOffRecoveryStateType_Enum "enumeration table" TAB_VERB "%.0" "" COMPU_TAB_REF CanSM_BusOffRecoveryStateType_Enum /end COMPU_METHOD
/begin COMPU_METHOD CanSM_NetworkModeStateType_Enum "enumeration table" TAB_VERB "%.0" "" COMPU_TAB_REF CanSM_NetworkModeStateType_Enum /end COMPU_METHOD
/begin COMPU_METHOD CanSM_TimerStateType_Enum "enumeration table" TAB_VERB "%.0" "" COMPU_TAB_REF CanSM_TimerStateType_Enum /end COMPU_METHOD
/begin COMPU_METHOD CancelationType "enumeration table" TAB_VERB "%.0" "" COMPU_TAB_REF CancelationType /end COMPU_METHOD
/begin COMPU_METHOD ClassificationType "enumeration table" TAB_VERB "%.0" "" COMPU_TAB_REF ClassificationType /end COMPU_METHOD
/begin COMPU_METHOD ColdPathType "enumeration table" TAB_VERB "%.0" "" COMPU_TAB_REF ColdPathType /end COMPU_METHOD
/begin COMPU_METHOD ComfortLaneDrivingState "enumeration table" TAB_VERB "%.0" "" COMPU_TAB_REF ComfortLaneDrivingState /end COMPU_METHOD
/begin COMPU_METHOD ConnectionType "enumeration table" TAB_VERB "%.0" "" COMPU_TAB_REF ConnectionType /end COMPU_METHOD
/begin COMPU_METHOD ContributingType "enumeration table" TAB_VERB "%.0" "" COMPU_TAB_REF ContributingType /end COMPU_METHOD
/begin COMPU_METHOD ControlStrategy "enumeration table" TAB_VERB "%.0" "" COMPU_TAB_REF ControlStrategy /end COMPU_METHOD
/begin COMPU_METHOD CounterLimit "enumeration table" TAB_VERB "%.0" "" COMPU_TAB_REF CounterLimit /end COMPU_METHOD
/begin COMPU_METHOD CrcRegType "enumeration table" TAB_VERB "%.0" "" COMPU_TAB_REF CrcRegType /end COMPU_METHOD
/begin COMPU_METHOD CruiseControlModeInput "enumeration table" TAB_VERB "%.0" "" COMPU_TAB_REF CruiseControlModeInput /end COMPU_METHOD
/begin COMPU_METHOD CruiseMode "enumeration table" TAB_VERB "%.0" "" COMPU_TAB_REF CruiseMode /end COMPU_METHOD
/begin COMPU_METHOD CscRoundAboutState "enumeration table" TAB_VERB "%.0" "" COMPU_TAB_REF CscRoundAboutState /end COMPU_METHOD
/begin COMPU_METHOD CurrentLane "enumeration table" TAB_VERB "%.0" "" COMPU_TAB_REF CurrentLane /end COMPU_METHOD
/begin COMPU_METHOD DSP_ALIGNMENT_MODES "enumeration table" TAB_VERB "%.0" "" COMPU_TAB_REF DSP_ALIGNMENT_MODES /end COMPU_METHOD
/begin COMPU_METHOD DYNCALDYNSTATE "enumeration table" TAB_VERB "%.0" "" COMPU_TAB_REF DYNCALDYNSTATE /end COMPU_METHOD
/begin COMPU_METHOD DaCoreStates "enumeration table" TAB_VERB "%.0" "" COMPU_TAB_REF DaCoreStates /end COMPU_METHOD
/begin COMPU_METHOD DefinedTargetMotionGoal "enumeration table" TAB_VERB "%.0" "" COMPU_TAB_REF DefinedTargetMotionGoal /end COMPU_METHOD
/begin COMPU_METHOD DegreeOfAssistance "enumeration table" TAB_VERB "%.0" "" COMPU_TAB_REF DegreeOfAssistance /end COMPU_METHOD
/begin COMPU_METHOD DinMainStates "enumeration table" TAB_VERB "%.0" "" COMPU_TAB_REF DinMainStates /end COMPU_METHOD
/begin COMPU_METHOD DirectionIndicator "enumeration table" TAB_VERB "%.0" "" COMPU_TAB_REF DirectionIndicator /end COMPU_METHOD
/begin COMPU_METHOD DirectionIndicatorStatus "enumeration table" TAB_VERB "%.0" "" COMPU_TAB_REF DirectionIndicatorStatus /end COMPU_METHOD
/begin COMPU_METHOD DoorStatus "enumeration table" TAB_VERB "%.0" "" COMPU_TAB_REF DoorStatus /end COMPU_METHOD
/begin COMPU_METHOD Drivability "enumeration table" TAB_VERB "%.0" "" COMPU_TAB_REF Drivability /end COMPU_METHOD
/begin COMPU_METHOD DriveMode "enumeration table" TAB_VERB "%.0" "" COMPU_TAB_REF DriveMode /end COMPU_METHOD
/begin COMPU_METHOD DriveMode_Copy1 "enumeration table" TAB_VERB "%.0" "" COMPU_TAB_REF DriveMode_Copy1 /end COMPU_METHOD
/begin COMPU_METHOD DriverDrowsinessLevel "enumeration table" TAB_VERB "%.0" "" COMPU_TAB_REF DriverDrowsinessLevel /end COMPU_METHOD
/begin COMPU_METHOD DriverGazingSide "enumeration table" TAB_VERB "%.0" "" COMPU_TAB_REF DriverGazingSide /end COMPU_METHOD
/begin COMPU_METHOD DriverModelDmsStatus "enumeration table" TAB_VERB "%.0" "" COMPU_TAB_REF DriverModelDmsStatus /end COMPU_METHOD
/begin COMPU_METHOD DriverModelDriverAttention "enumeration table" TAB_VERB "%.0" "" COMPU_TAB_REF DriverModelDriverAttention /end COMPU_METHOD
/begin COMPU_METHOD DriverModelDriverDrowsinessLevel "enumeration table" TAB_VERB "%.0" "" COMPU_TAB_REF DriverModelDriverDrowsinessLevel /end COMPU_METHOD
/begin COMPU_METHOD DriverModelDriverPresence "enumeration table" TAB_VERB "%.0" "" COMPU_TAB_REF DriverModelDriverPresence /end COMPU_METHOD
/begin COMPU_METHOD DriverModelDriverSpoofing "enumeration table" TAB_VERB "%.0" "" COMPU_TAB_REF DriverModelDriverSpoofing /end COMPU_METHOD
/begin COMPU_METHOD DriverModelLaneChangeIntentionSide "enumeration table" TAB_VERB "%.0" "" COMPU_TAB_REF DriverModelLaneChangeIntentionSide /end COMPU_METHOD
/begin COMPU_METHOD DriverMonitoringSystemStatus "enumeration table" TAB_VERB "%.0" "" COMPU_TAB_REF DriverMonitoringSystemStatus /end COMPU_METHOD
/begin COMPU_METHOD DriverOvertakeIntentionState "enumeration table" TAB_VERB "%.0" "" COMPU_TAB_REF DriverOvertakeIntentionState /end COMPU_METHOD
/begin COMPU_METHOD DriverPresence "enumeration table" TAB_VERB "%.0" "" COMPU_TAB_REF DriverPresence /end COMPU_METHOD
/begin COMPU_METHOD DriverSpoofing "enumeration table" TAB_VERB "%.0" "" COMPU_TAB_REF DriverSpoofing /end COMPU_METHOD
/begin COMPU_METHOD DriverSteeringActivity "enumeration table" TAB_VERB "%.0" "" COMPU_TAB_REF DriverSteeringActivity /end COMPU_METHOD
/begin COMPU_METHOD DrivingDirection "enumeration table" TAB_VERB "%.0" "" COMPU_TAB_REF DrivingDirection /end COMPU_METHOD
/begin COMPU_METHOD DrivingProfile "enumeration table" TAB_VERB "%.0" "" COMPU_TAB_REF DrivingProfile /end COMPU_METHOD
/begin COMPU_METHOD DrivingSense "enumeration table" TAB_VERB "%.0" "" COMPU_TAB_REF DrivingSense /end COMPU_METHOD
/begin COMPU_METHOD DrivingState "enumeration table" TAB_VERB "%.0" "" COMPU_TAB_REF DrivingState /end COMPU_METHOD
/begin COMPU_METHOD DrivingTask "enumeration table" TAB_VERB "%.0" "" COMPU_TAB_REF DrivingTask /end COMPU_METHOD
/begin COMPU_METHOD DrivingTask.OLD_Copy1 "enumeration table" TAB_VERB "%.0" "" COMPU_TAB_REF DrivingTask.OLD_1 /end COMPU_METHOD
/begin COMPU_METHOD DynCalibState "enumeration table" TAB_VERB "%.0" "" COMPU_TAB_REF DynCalibState /end COMPU_METHOD
/begin COMPU_METHOD DynCalibStatus "enumeration table" TAB_VERB "%.0" "" COMPU_TAB_REF DynCalibStatus /end COMPU_METHOD
/begin COMPU_METHOD Dynamic1DMotionGoal "enumeration table" TAB_VERB "%.0" "" COMPU_TAB_REF Dynamic1DMotionGoal /end COMPU_METHOD
/begin COMPU_METHOD Dynamic1DMotionGoal_v0 "enumeration table" TAB_VERB "%.0" "" COMPU_TAB_REF Dynamic1DMotionGoal_v0 /end COMPU_METHOD
/begin COMPU_METHOD Dynamic2DMotionGoal "enumeration table" TAB_VERB "%.0" "" COMPU_TAB_REF Dynamic2DMotionGoal /end COMPU_METHOD
/begin COMPU_METHOD EAalAntenna "enumeration table" TAB_VERB "%.0" "" COMPU_TAB_REF EAalAntenna /end COMPU_METHOD
/begin COMPU_METHOD EAalMsg "enumeration table" TAB_VERB "%.0" "" COMPU_TAB_REF EAalMsg /end COMPU_METHOD
/begin COMPU_METHOD EAccMode "enumeration table" TAB_VERB "%.0" "" COMPU_TAB_REF EAccMode /end COMPU_METHOD
/begin COMPU_METHOD EAccStandStillActivationMode "enumeration table" TAB_VERB "%.0" "" COMPU_TAB_REF EAccStandStillActivationMode /end COMPU_METHOD
/begin COMPU_METHOD EBLDEVAL_X_SensorType "enumeration table" TAB_VERB "%.0" "" COMPU_TAB_REF EBLDEVAL_X_SensorType /end COMPU_METHOD
/begin COMPU_METHOD EBLDIndicatorState "enumeration table" TAB_VERB "%.0" "" COMPU_TAB_REF EBLDIndicatorState /end COMPU_METHOD
/begin COMPU_METHOD EBepProcstep "enumeration table" TAB_VERB "%.0" "" COMPU_TAB_REF EBepProcstep /end COMPU_METHOD
/begin COMPU_METHOD EBepReflectionFilterStatus "enumeration table" TAB_VERB "%.0" "" COMPU_TAB_REF EBepReflectionFilterStatus /end COMPU_METHOD
/begin COMPU_METHOD EBepReflectionPlsDeleteMode "enumeration table" TAB_VERB "%.0" "" COMPU_TAB_REF EBepReflectionPlsDeleteMode /end COMPU_METHOD
/begin COMPU_METHOD ECommandType "enumeration table" TAB_VERB "%.0" "" COMPU_TAB_REF ECommandType /end COMPU_METHOD
/begin COMPU_METHOD EControlState "enumeration table" TAB_VERB "%.0" "" COMPU_TAB_REF EControlState /end COMPU_METHOD
/begin COMPU_METHOD ECopyHandshake "enumeration table" TAB_VERB "%.0" "" COMPU_TAB_REF ECopyHandshake /end COMPU_METHOD
/begin COMPU_METHOD ECutInLevel "enumeration table" TAB_VERB "%.0" "" COMPU_TAB_REF ECutInLevel /end COMPU_METHOD
/begin COMPU_METHOD EDefaultState "enumeration table" TAB_VERB "%.0" "" COMPU_TAB_REF EDefaultState /end COMPU_METHOD
/begin COMPU_METHOD EDetailledErrorCode "enumeration table" TAB_VERB "%.0" "" COMPU_TAB_REF EDetailledErrorCode /end COMPU_METHOD
/begin COMPU_METHOD EDiaInternalStates "enumeration table" TAB_VERB "%.0" "" COMPU_TAB_REF EDiaInternalStates /end COMPU_METHOD
/begin COMPU_METHOD EDiaInternalStates_Copy1 "enumeration table" TAB_VERB "%.0" "" COMPU_TAB_REF EDiaInternalStates_Copy1 /end COMPU_METHOD
/begin COMPU_METHOD EDriveTrainConfig "enumeration table" TAB_VERB "%.0" "" COMPU_TAB_REF EDriveTrainConfig /end COMPU_METHOD
/begin COMPU_METHOD EErrorIDs "enumeration table" TAB_VERB "%.0" "" COMPU_TAB_REF EErrorIDs /end COMPU_METHOD
/begin COMPU_METHOD ELineLength "enumeration table" TAB_VERB "%.0" "" COMPU_TAB_REF ELineLength /end COMPU_METHOD
/begin COMPU_METHOD EMEM_voltage.CONVERSION "@@@@RuleName created by CANape" LINEAR "%3.1" "" COEFFS_LINEAR 0.0015209960937500001 0 /end COMPU_METHOD
/begin COMPU_METHOD EMainState "enumeration table" TAB_VERB "%.0" "" COMPU_TAB_REF EMainState /end COMPU_METHOD
/begin COMPU_METHOD EManagerDatasetStatus "enumeration table" TAB_VERB "%.0" "" COMPU_TAB_REF EManagerDatasetStatus /end COMPU_METHOD
/begin COMPU_METHOD EMovementState "enumeration table" TAB_VERB "%.0" "" COMPU_TAB_REF EMovementState /end COMPU_METHOD
/begin COMPU_METHOD EObjectClass "enumeration table" TAB_VERB "%.0" "" COMPU_TAB_REF EObjectClass /end COMPU_METHOD
/begin COMPU_METHOD EObjectLane "enumeration table" TAB_VERB "%.0" "" COMPU_TAB_REF EObjectLane /end COMPU_METHOD
/begin COMPU_METHOD EObjectPreSelect "enumeration table" TAB_VERB "%.0" "" COMPU_TAB_REF EObjectPreSelect /end COMPU_METHOD
/begin COMPU_METHOD EObjectQualifierCMS "enumeration table" TAB_VERB "%.0" "" COMPU_TAB_REF EObjectQualifierCMS /end COMPU_METHOD
/begin COMPU_METHOD EObjectQualifierDTR "enumeration table" TAB_VERB "%.0" "" COMPU_TAB_REF EObjectQualifierDTR /end COMPU_METHOD
/begin COMPU_METHOD EObstacleClassification "enumeration table" TAB_VERB "%.0" "" COMPU_TAB_REF EObstacleClassification /end COMPU_METHOD
/begin COMPU_METHOD EOrientAngle "enumeration table" TAB_VERB "%.0" "" COMPU_TAB_REF EOrientAngle /end COMPU_METHOD
/begin COMPU_METHOD EOrientAngleFault "enumeration table" TAB_VERB "%.0" "" COMPU_TAB_REF EOrientAngleFault /end COMPU_METHOD
/begin COMPU_METHOD EQ_LSB_0_00048828125 "" LINEAR "%13.11" "" COEFFS_LINEAR 0.00048828125 0 /end COMPU_METHOD
/begin COMPU_METHOD EQ_LSB_0_03125 "" LINEAR "%9.5" "" COEFFS_LINEAR 0.03125 0 /end COMPU_METHOD
/begin COMPU_METHOD EReferenceVelocityConfig "enumeration table" TAB_VERB "%.0" "" COMPU_TAB_REF EReferenceVelocityConfig /end COMPU_METHOD
/begin COMPU_METHOD ERifStatus "enumeration table" TAB_VERB "%.0" "" COMPU_TAB_REF ERifStatus /end COMPU_METHOD
/begin COMPU_METHOD ERxsOcpDir "enumeration table" TAB_VERB "%.0" "" COMPU_TAB_REF ERxsOcpDir /end COMPU_METHOD
/begin COMPU_METHOD ESacEpsPfArchType "enumeration table" TAB_VERB "%.0" "" COMPU_TAB_REF ESacEpsPfArchType /end COMPU_METHOD
/begin COMPU_METHOD ESetSpeedRoundingStrategy "enumeration table" TAB_VERB "%.0" "" COMPU_TAB_REF ESetSpeedRoundingStrategy /end COMPU_METHOD
/begin COMPU_METHOD EState "enumeration table" TAB_VERB "%.0" "" COMPU_TAB_REF EState /end COMPU_METHOD
/begin COMPU_METHOD EStatus "enumeration table" TAB_VERB "%.0" "" COMPU_TAB_REF EStatus /end COMPU_METHOD
/begin COMPU_METHOD ESteeringAngleCalibrationType "enumeration table" TAB_VERB "%.0" "" COMPU_TAB_REF ESteeringAngleCalibrationType /end COMPU_METHOD
/begin COMPU_METHOD ESteeringTorqueCalibrationType "enumeration table" TAB_VERB "%.0" "" COMPU_TAB_REF ESteeringTorqueCalibrationType /end COMPU_METHOD
/begin COMPU_METHOD ETimeGapProcessesingStrategy "enumeration table" TAB_VERB "%.0" "" COMPU_TAB_REF ETimeGapProcessesingStrategy /end COMPU_METHOD
/begin COMPU_METHOD EVarSrchRng "enumeration table" TAB_VERB "%.0" "" COMPU_TAB_REF EVarSrchRng /end COMPU_METHOD
/begin COMPU_METHOD EVarSteps "enumeration table" TAB_VERB "%.0" "" COMPU_TAB_REF EVarSteps /end COMPU_METHOD
/begin COMPU_METHOD EVariantIdx "enumeration table" TAB_VERB "%.0" "" COMPU_TAB_REF EVariantIdx /end COMPU_METHOD
/begin COMPU_METHOD EVariantIdx_Copy1 "enumeration table" TAB_VERB "%.0" "" COMPU_TAB_REF EVariantIdx_Copy1 /end COMPU_METHOD
/begin COMPU_METHOD EgoLaneChangeDirection "enumeration table" TAB_VERB "%.0" "" COMPU_TAB_REF EgoLaneChangeDirection /end COMPU_METHOD
/begin COMPU_METHOD EgoLaneChangePossibility "enumeration table" TAB_VERB "%.0" "" COMPU_TAB_REF EgoLaneChangePossibility /end COMPU_METHOD
/begin COMPU_METHOD EgoLaneChangeSituation "enumeration table" TAB_VERB "%.0" "" COMPU_TAB_REF EgoLaneChangeSituation /end COMPU_METHOD
/begin COMPU_METHOD EgoLaneChangeState "enumeration table" TAB_VERB "%.0" "" COMPU_TAB_REF EgoLaneChangeState /end COMPU_METHOD
/begin COMPU_METHOD EmsStandstillIndication "enumeration table" TAB_VERB "%.0" "" COMPU_TAB_REF EmsStandstillIndication /end COMPU_METHOD
/begin COMPU_METHOD EmsWheelMovingDirection "enumeration table" TAB_VERB "%.0" "" COMPU_TAB_REF EmsWheelMovingDirection /end COMPU_METHOD
/begin COMPU_METHOD EntryState "enumeration table" TAB_VERB "%.0" "" COMPU_TAB_REF EntryState /end COMPU_METHOD
/begin COMPU_METHOD EstConstraintMode "enumeration table" TAB_VERB "%.0" "" COMPU_TAB_REF EstConstraintMode /end COMPU_METHOD
/begin COMPU_METHOD Etype_Postprocessing_SteeringInterfaceType "enumeration table" TAB_VERB "%.0" "" COMPU_TAB_REF Etype_Postprocessing_SteeringInterfaceType /end COMPU_METHOD
/begin COMPU_METHOD EventId "enumeration table" TAB_VERB "%.0" "" COMPU_TAB_REF EventId /end COMPU_METHOD
/begin COMPU_METHOD EventId_Copy1 "enumeration table" TAB_VERB "%.0" "" COMPU_TAB_REF EventId_Copy1 /end COMPU_METHOD
/begin COMPU_METHOD EventId_Copy2 "enumeration table" TAB_VERB "%.0" "" COMPU_TAB_REF EventId_Copy2 /end COMPU_METHOD
/begin COMPU_METHOD EventId_Copy3 "enumeration table" TAB_VERB "%.0" "" COMPU_TAB_REF EventId_Copy3 /end COMPU_METHOD
/begin COMPU_METHOD EventStatus "enumeration table" TAB_VERB "%.0" "" COMPU_TAB_REF EventStatus /end COMPU_METHOD
/begin COMPU_METHOD ExecutionRecommendation "enumeration table" TAB_VERB "%.0" "" COMPU_TAB_REF ExecutionRecommendation /end COMPU_METHOD
/begin COMPU_METHOD EyesOnRoad "enumeration table" TAB_VERB "%.0" "" COMPU_TAB_REF EyesOnRoad /end COMPU_METHOD
/begin COMPU_METHOD FCTRequest "enumeration table" TAB_VERB "%.0" "" COMPU_TAB_REF FCTRequest /end COMPU_METHOD
/begin COMPU_METHOD FCTRequest_Copy1 "enumeration table" TAB_VERB "%.0" "" COMPU_TAB_REF FCTRequest_Copy1 /end COMPU_METHOD
/begin COMPU_METHOD FEP_Statemachine_State_t "enumeration table" TAB_VERB "%.0" "" COMPU_TAB_REF FEP_Statemachine_State_t /end COMPU_METHOD
/begin COMPU_METHOD FadeStrategy "enumeration table" TAB_VERB "%.0" "" COMPU_TAB_REF FadeStrategy /end COMPU_METHOD
/begin COMPU_METHOD FailureClusterStatus "enumeration table" TAB_VERB "%.0" "" COMPU_TAB_REF FailureClusterStatus /end COMPU_METHOD
/begin COMPU_METHOD FctFunctionId "enumeration table" TAB_VERB "%.0" "" COMPU_TAB_REF FctFunctionId /end COMPU_METHOD
/begin COMPU_METHOD FcwSetting "enumeration table" TAB_VERB "%.0" "" COMPU_TAB_REF FcwSetting /end COMPU_METHOD
/begin COMPU_METHOD FilterMode "enumeration table" TAB_VERB "%.0" "" COMPU_TAB_REF FilterMode /end COMPU_METHOD
/begin COMPU_METHOD FilteringPhase "enumeration table" TAB_VERB "%.0" "" COMPU_TAB_REF FilteringPhase /end COMPU_METHOD
/begin COMPU_METHOD FocAccSoStates "enumeration table" TAB_VERB "%.0" "" COMPU_TAB_REF FocAccSoStates /end COMPU_METHOD
/begin COMPU_METHOD FocMainStates "enumeration table" TAB_VERB "%.0" "" COMPU_TAB_REF FocMainStates /end COMPU_METHOD
/begin COMPU_METHOD FourTruthValue "enumeration table" TAB_VERB "%.0" "" COMPU_TAB_REF FourTruthValue /end COMPU_METHOD
/begin COMPU_METHOD FusionUpdateType "enumeration table" TAB_VERB "%.0" "" COMPU_TAB_REF FusionUpdateType /end COMPU_METHOD
/begin COMPU_METHOD HSM_FunctionTag "enumeration table" TAB_VERB "%.0" "" COMPU_TAB_REF HSM_FunctionTag /end COMPU_METHOD
/begin COMPU_METHOD HSM_ModeTag "enumeration table" TAB_VERB "%.0" "" COMPU_TAB_REF HSM_ModeTag /end COMPU_METHOD
/begin COMPU_METHOD HSM_PortStatusTag "enumeration table" TAB_VERB "%.0" "" COMPU_TAB_REF HSM_PortStatusTag /end COMPU_METHOD
/begin COMPU_METHOD HV_SERVICE_AVAILABILITY_STATES "enumeration table" TAB_VERB "%.0" "" COMPU_TAB_REF HV_SERVICE_AVAILABILITY_STATES /end COMPU_METHOD
/begin COMPU_METHOD HandsOnDetectionInputData "enumeration table" TAB_VERB "%.0" "" COMPU_TAB_REF HandsOnDetectionInputData /end COMPU_METHOD
/begin COMPU_METHOD HandsOnDetectionSensorType "enumeration table" TAB_VERB "%.0" "" COMPU_TAB_REF HandsOnDetectionSensorType /end COMPU_METHOD
/begin COMPU_METHOD HandsOnDetectionState "enumeration table" TAB_VERB "%.0" "" COMPU_TAB_REF HandsOnDetectionState /end COMPU_METHOD
/begin COMPU_METHOD HapticWarningViaBrakeProfile "enumeration table" TAB_VERB "%.0" "" COMPU_TAB_REF HapticWarningViaBrakeProfile /end COMPU_METHOD
/begin COMPU_METHOD HazardLightsStatus "enumeration table" TAB_VERB "%.0" "" COMPU_TAB_REF HazardLightsStatus /end COMPU_METHOD
/begin COMPU_METHOD HmiAudioNotificationIdEnum "enumeration table" TAB_VERB "%.0" "" COMPU_TAB_REF HmiAudioNotificationIdEnum /end COMPU_METHOD
/begin COMPU_METHOD HmiAuxiliarySymbolEnum "enumeration table" TAB_VERB "%.0" "" COMPU_TAB_REF HmiAuxiliarySymbolEnum /end COMPU_METHOD
/begin COMPU_METHOD HmiDisplayedTextMessageIdEnum "enumeration table" TAB_VERB "%.0" "" COMPU_TAB_REF HmiDisplayedTextMessageIdEnum /end COMPU_METHOD
/begin COMPU_METHOD HmiHandOfTraffic "enumeration table" TAB_VERB "%.0" "" COMPU_TAB_REF HmiHandOfTraffic /end COMPU_METHOD
/begin COMPU_METHOD HmiHwaStatusEnum "enumeration table" TAB_VERB "%.0" "" COMPU_TAB_REF HmiHwaStatusEnum /end COMPU_METHOD
/begin COMPU_METHOD HmiIndicatorLampRequestSide "enumeration table" TAB_VERB "%.0" "" COMPU_TAB_REF HmiIndicatorLampRequestSide /end COMPU_METHOD
/begin COMPU_METHOD HmiPopupTextMessageEnum "enumeration table" TAB_VERB "%.0" "" COMPU_TAB_REF HmiPopupTextMessageEnum /end COMPU_METHOD
/begin COMPU_METHOD HmiSymbolColorSetSpeedEnum "enumeration table" TAB_VERB "%.0" "" COMPU_TAB_REF HmiSymbolColorSetSpeedEnum /end COMPU_METHOD
/begin COMPU_METHOD IIR2FilterStates "enumeration table" TAB_VERB "%.0" "" COMPU_TAB_REF IIR2FilterStates /end COMPU_METHOD
/begin COMPU_METHOD IcmDebugSyncPoints_t "enumeration table" TAB_VERB "%.0" "" COMPU_TAB_REF IcmDebugSyncPoints_t /end COMPU_METHOD
/begin COMPU_METHOD IcmDet "enumeration table" TAB_VERB "%.0" "" COMPU_TAB_REF IcmDet /end COMPU_METHOD
/begin COMPU_METHOD IcmDetInd "enumeration table" TAB_VERB "%.0" "" COMPU_TAB_REF IcmDetInd /end COMPU_METHOD
/begin COMPU_METHOD IcmDetInd_Copy1 "enumeration table" TAB_VERB "%.0" "" COMPU_TAB_REF IcmDetInd_Copy1 /end COMPU_METHOD
/begin COMPU_METHOD IcmDetSubState "enumeration table" TAB_VERB "%.0" "" COMPU_TAB_REF IcmDetSubState /end COMPU_METHOD
/begin COMPU_METHOD IcmDetSubState_Copy1 "enumeration table" TAB_VERB "%.0" "" COMPU_TAB_REF IcmDetSubState_Copy1 /end COMPU_METHOD
/begin COMPU_METHOD IcmDet_Copy1 "enumeration table" TAB_VERB "%.0" "" COMPU_TAB_REF IcmDet_Copy1 /end COMPU_METHOD
/begin COMPU_METHOD IcmMainState "enumeration table" TAB_VERB "%.0" "" COMPU_TAB_REF IcmMainState /end COMPU_METHOD
/begin COMPU_METHOD IcmMainState_Copy1 "enumeration table" TAB_VERB "%.0" "" COMPU_TAB_REF IcmMainState_Copy1 /end COMPU_METHOD
/begin COMPU_METHOD IcmRepSubState "enumeration table" TAB_VERB "%.0" "" COMPU_TAB_REF IcmRepSubState /end COMPU_METHOD
/begin COMPU_METHOD IcmRepSubState_Copy1 "enumeration table" TAB_VERB "%.0" "" COMPU_TAB_REF IcmRepSubState_Copy1 /end COMPU_METHOD
/begin COMPU_METHOD IfxPort_Mode "enumeration table" TAB_VERB "%.0" "" COMPU_TAB_REF IfxPort_Mode /end COMPU_METHOD
/begin COMPU_METHOD IfxPort_PadDriver "enumeration table" TAB_VERB "%.0" "" COMPU_TAB_REF IfxPort_PadDriver /end COMPU_METHOD
/begin COMPU_METHOD ImageRelationProvider "enumeration table" TAB_VERB "%.0" "" COMPU_TAB_REF ImageRelationProvider /end COMPU_METHOD
/begin COMPU_METHOD IndicatorBlindnessState "enumeration table" TAB_VERB "%.0" "" COMPU_TAB_REF IndicatorBlindnessState /end COMPU_METHOD
/begin COMPU_METHOD InternalConsistencyOfMultipleSitPaths "enumeration table" TAB_VERB "%.0" "" COMPU_TAB_REF InternalConsistencyOfMultipleSitPaths /end COMPU_METHOD
/begin COMPU_METHOD LSACombiSwitchFunctionSel "enumeration table" TAB_VERB "%.0" "" COMPU_TAB_REF LSACombiSwitchFunctionSel /end COMPU_METHOD
/begin COMPU_METHOD LSAManualBeamSel "enumeration table" TAB_VERB "%.0" "" COMPU_TAB_REF LSAManualBeamSel /end COMPU_METHOD
/begin COMPU_METHOD LaneAssociation "enumeration table" TAB_VERB "%.0" "" COMPU_TAB_REF LaneAssociation /end COMPU_METHOD
/begin COMPU_METHOD LaneBorderColor "enumeration table" TAB_VERB "%.0" "" COMPU_TAB_REF LaneBorderColor /end COMPU_METHOD
/begin COMPU_METHOD LaneBorderType "enumeration table" TAB_VERB "%.0" "" COMPU_TAB_REF LaneBorderType /end COMPU_METHOD
/begin COMPU_METHOD LaneChangeObjectRelevance "enumeration table" TAB_VERB "%.0" "" COMPU_TAB_REF LaneChangeObjectRelevance /end COMPU_METHOD
/begin COMPU_METHOD LaneId "enumeration table" TAB_VERB "%.0" "" COMPU_TAB_REF LaneId /end COMPU_METHOD
/begin COMPU_METHOD LaneSensitivityButton "enumeration table" TAB_VERB "%.0" "" COMPU_TAB_REF LaneSensitivityButton /end COMPU_METHOD
/begin COMPU_METHOD LateralDrivingState "enumeration table" TAB_VERB "%.0" "" COMPU_TAB_REF LateralDrivingState /end COMPU_METHOD
/begin COMPU_METHOD LateralIntention "enumeration table" TAB_VERB "%.0" "" COMPU_TAB_REF LateralIntention /end COMPU_METHOD
/begin COMPU_METHOD LcState "enumeration table" TAB_VERB "%.0" "" COMPU_TAB_REF LcState /end COMPU_METHOD
/begin COMPU_METHOD LcmStateId "enumeration table" TAB_VERB "%.0" "" COMPU_TAB_REF LcmStateId /end COMPU_METHOD
/begin COMPU_METHOD LightFunctionSelHMI "enumeration table" TAB_VERB "%.0" "" COMPU_TAB_REF LightFunctionSelHMI /end COMPU_METHOD
/begin COMPU_METHOD LineSource "enumeration table" TAB_VERB "%.0" "" COMPU_TAB_REF LineSource /end COMPU_METHOD
/begin COMPU_METHOD LocIntStatus "enumeration table" TAB_VERB "%.0" "" COMPU_TAB_REF LocIntStatus /end COMPU_METHOD
/begin COMPU_METHOD LongitudinalControlSettingState "enumeration table" TAB_VERB "%.0" "" COMPU_TAB_REF LongitudinalControlSettingState /end COMPU_METHOD
/begin COMPU_METHOD LongitudinalPosition "enumeration table" TAB_VERB "%.0" "" COMPU_TAB_REF LongitudinalPosition /end COMPU_METHOD
/begin COMPU_METHOD ManualLaneChangeSupportState "enumeration table" TAB_VERB "%.0" "" COMPU_TAB_REF ManualLaneChangeSupportState /end COMPU_METHOD
/begin COMPU_METHOD MetaState "enumeration table" TAB_VERB "%.0" "" COMPU_TAB_REF MetaState /end COMPU_METHOD
/begin COMPU_METHOD MissingLaneMarkingOnMiddleLaneScenario "enumeration table" TAB_VERB "%.0" "" COMPU_TAB_REF MissingLaneMarkingOnMiddleLaneScenario /end COMPU_METHOD
/begin COMPU_METHOD MixStates "enumeration table" TAB_VERB "%.0" "" COMPU_TAB_REF MixStates /end COMPU_METHOD
/begin COMPU_METHOD MotionGoal "enumeration table" TAB_VERB "%.0" "" COMPU_TAB_REF MotionGoal /end COMPU_METHOD
/begin COMPU_METHOD MotionModelType "enumeration table" TAB_VERB "%.0" "" COMPU_TAB_REF MotionModelType /end COMPU_METHOD
/begin COMPU_METHOD MotionModelType.OLD_Copy1 "enumeration table" TAB_VERB "%.0" "" COMPU_TAB_REF MotionModelType.OLD_1 /end COMPU_METHOD
/begin COMPU_METHOD MotionType "enumeration table" TAB_VERB "%.0" "" COMPU_TAB_REF MotionType /end COMPU_METHOD
/begin COMPU_METHOD MotionType_Copy1 "enumeration table" TAB_VERB "%.0" "" COMPU_TAB_REF MotionType_Copy1 /end COMPU_METHOD
/begin COMPU_METHOD NO_FORMULA "" IDENTICAL "%6.2" "" /end COMPU_METHOD
/begin COMPU_METHOD N_dSW_ub "Norming of distances (Laengs und Quer)" LINEAR "%10.7" "m" COEFFS_LINEAR 0.0078125 0 /end COMPU_METHOD
/begin COMPU_METHOD N_fak2UW_uw "Norming of Faktoren zw. 0 u 2" LINEAR "%16.15" "-" COEFFS_LINEAR 3.0517578125E-05 0 /end COMPU_METHOD
/begin COMPU_METHOD N_fak4SW_uw "Norming of Faktoren zw. -4 u 4" LINEAR "%14.13" "-" COEFFS_LINEAR 0.0001220703125 0 /end COMPU_METHOD
/begin COMPU_METHOD N_tUL_uw "Norming of time (Zeitluecke und Differenzzeiten)" LINEAR "%19.11" "s" COEFFS_LINEAR 0.00048828125 0 /end COMPU_METHOD
/begin COMPU_METHOD N_tUW_uw "Norming of time (Zeitluecke und Differenzzeiten)" LINEAR "%14.11" "s" COEFFS_LINEAR 0.00048828125 0 /end COMPU_METHOD
/begin COMPU_METHOD N_vSW_uw "Norming of velocity" LINEAR "%11.8" "m/s" COEFFS_LINEAR 0.00390625 0 /end COMPU_METHOD
/begin COMPU_METHOD NeighboringVehicleAugmentedData "enumeration table" TAB_VERB "%.0" "" COMPU_TAB_REF NeighboringVehicleAugmentedData /end COMPU_METHOD
/begin COMPU_METHOD NeighboringVehicleType "enumeration table" TAB_VERB "%.0" "" COMPU_TAB_REF NeighboringVehicleType /end COMPU_METHOD
/begin COMPU_METHOD ObjectClassification "enumeration table" TAB_VERB "%.0" "" COMPU_TAB_REF ObjectClassification /end COMPU_METHOD
/begin COMPU_METHOD ObjectClassificationType "enumeration table" TAB_VERB "%.0" "" COMPU_TAB_REF ObjectClassificationType /end COMPU_METHOD
/begin COMPU_METHOD ObjectDrivingDirection "enumeration table" TAB_VERB "%.0" "" COMPU_TAB_REF ObjectDrivingDirection /end COMPU_METHOD
/begin COMPU_VTAB_RANGE AAL_MSG "" 51 0 0 "AAL_OK" 1 1 "AAL_SPI_FAILED" 2 2 "AAL_SPI_TRANSFER_FAILED" 3 3 "AAL_RIF_CONFIG_FAILED" 4 4 "AAL_WRONG_MMICADDR" 5 5 "AAL_BUFFER_NOTEMPTY" 6 6 "AAL_BUFFER_OVERFLOW" 7 7 "AAL_MODPARA_NOTSET" 8 8 "AAL_FWSTATE_NOTSET" 32 32 "AAL_WRONG_TRAMP" 33 33 "AAL_WRONG_FSTART" 34 34 "AAL_WRONG_NFSTEP" 35 35 "AAL_WRONG_NSEQ" 36 36 "AAL_WRONG_MINFREQ" 37 37 "AAL_WRONG_MAXFREQ" 38 38 "AAL_WRONG_MAXSWING" 39 39 "AAL_WRONG_ANT_CHOICE" 40 40 "AAL_RAMPTIME2SMALL" 48 48 "AAL_WRONG_NSPON" 49 49 "AAL_WRONG_DECFACTOR" 64 64 "AAL_WRONG_FIRMEWARE" 65 65 "AAL_FIRMWARE_TIMEOUT" 66 66 "AAL_FWRESULTS_FAILED" 67 67 "AAL_DEL_OLD_FW_FAILED" 68 68 "AAL_WRONG_RUNFW_NRPARAMS" 69 69 "AAL_WRONG_RUNFW_NRRESULT" 70 70 "AAL_FW_NOT_STARTED" 71 71 "AAL_FW_STATUS_COUNT_EMPTY" 72 72 "AAL_FW_FAILED" 96 96 "AAL_ENABLERXTX_FAILED" 112 112 "AAL_MMICSTATUS_ERROR" 113 113 "AAL_MMICSTATUS_OKPIN_FAILED" 128 128 "AAL_RFSP_CRC_NOTFOUND" 129 129 "AAL_RFSP_RMPCRC_ERROR" 224 224 "AAL_STATUS_CMD_NOT_ALLOWED" 225 225 "AAL_STATUS_INVALID_SIG" 226 226 "AAL_STATUS_INVALID_SETTING" 227 227 "AAL_STATUS_CALIB_ERROR" 228 228 "AAL_STATUS_77GHz_PLL_UNLOCKED" 229 229 "AAL_STATUS_BB_ERROR" 230 230 "AAL_STATUS_PARAM_ERROR" 231 231 "AAL_STATUS_INVALID_CMD" 232 232 "AAL_STATUS_UNDERFLOW" 233 233 "AAL_STATUS_OVERFLOW" 234 234 "AAL_STATUS_CMD_SEQ_REC" 235 235 "AAL_STATUS_RMP_ERROR" 236 236 "AAL_STATUS_MON_LIMIT_ERROR" 237 237 "AAL_STATUS_MON_CRC_ERROR" 238 238 "AAL_STATUS_ERROR" 239 239 "AAL_STATUS_UNKNOWN_CMD" 4096 4096 "AAL_FIRMEWARE_RUNNING" DEFAULT_VALUE "" /end COMPU_VTAB_RANGE
/begin COMPU_VTAB_RANGE AAL_MSG.OLD_1 "" 20 0 0 "AAL_OK" 1 1 "AAL_WRONG_MMICADDR" 2 2 "AAL_BUFFER_NOTEMPTY" 3 3 "AAL_WRONG_TRAMP" 4 4 "AAL_WRONG_FSTART" 5 5 "AAL_WRONG_NFSTEP" 6 6 "AAL_WRONG_NSEQ" 7 7 "AAL_WRONG_FIRMEWARE" 8 8 "AAL_WRONG_OLDFIRMEWARE_RUNNING" 9 9 "AAL_WRONG_RUNFW_NRPARAMS" 10 10 "AAL_WRONG_RUNFW_NRRESULT" 11 11 "AAL_WRONG_RMPTIME_SEQ" 12 12 "AAL_WRONG_NSPON" 13 13 "AAL_WRONG_MINFREQ" 14 14 "AAL_WRONG_MAXFREQ" 15 15 "AAL_WRONG_MAXSWING" 16 16 "AAL_FW_NOT_STARTED" 17 17 "AAL_FW_NOT_FINISHED" 18 18 "AAL_FW_FAILED" 19 19 "AAL_FW_SEQFULL" DEFAULT_VALUE "" /end COMPU_VTAB_RANGE
/begin COMPU_VTAB_RANGE AAL_MSG.OLD_2 "" 19 0 0 "AAL_OK" 1 1 "AAL_WRONG_MMICADDR" 2 2 "AAL_BUFFER_NOTEMPTY" 25 25 "AAL_WRONG_TRAMP" 26 26 "AAL_WRONG_FSTART" 27 27 "AAL_WRONG_NFSTEP" 28 28 "AAL_WRONG_NSEQ" 29 29 "AAL_WRONG_NSPON" 30 30 "AAL_WRONG_MINFREQ" 31 31 "AAL_WRONG_MAXFREQ" 32 32 "AAL_WRONG_MAXSWING" 50 50 "AAL_WRONG_FIRMEWARE" 51 51 "AAL_WRONG_OLDFIRMEWARE_RUNNING" 52 52 "AAL_WRONG_RUNFW_NRPARAMS" 53 53 "AAL_WRONG_RUNFW_NRRESULT" 54 54 "AAL_FW_NOT_STARTED" 55 55 "AAL_FW_NOT_FINISHED" 56 56 "AAL_FW_FAILED" 57 57 "AAL_FW_SEQFULL" DEFAULT_VALUE "" /end COMPU_VTAB_RANGE
/begin COMPU_VTAB_RANGE AAL_MSG.OLD_3 "" 23 0 0 "AAL_OK" 1 1 "AAL_WRONG_MMICADDR" 2 2 "AAL_BUFFER_NOTEMPTY" 25 25 "AAL_WRONG_TRAMP" 26 26 "AAL_WRONG_FSTART" 27 27 "AAL_WRONG_NFSTEP" 28 28 "AAL_WRONG_NSEQ" 29 29 "AAL_WRONG_NSPON" 30 30 "AAL_WRONG_MINFREQ" 31 31 "AAL_WRONG_MAXFREQ" 32 32 "AAL_WRONG_MAXSWING" 50 50 "AAL_WRONG_FIRMEWARE" 51 51 "AAL_FIRMEWARE_RUNNING" 52 52 "AAL_FIRMWARE_TIMEOUT" 53 53 "AAL_FWRESULTS_FAILED" 54 54 "AAL_DEL_OLD_FW_FAILED" 55 55 "AAL_WRONG_RUNFW_NRPARAMS" 56 56 "AAL_WRONG_RUNFW_NRRESULT" 57 57 "AAL_FW_NOT_STARTED" 58 58 "AAL_FW_NOT_FINISHED" 59 59 "AAL_FW_STATUS_COUNT_EMPTY" 60 60 "AAL_FW_FAILED" 61 61 "AAL_FW_SEQFULL" DEFAULT_VALUE "" /end COMPU_VTAB_RANGE
/begin COMPU_VTAB_RANGE AAL_MSG.OLD_4 "" 45 0 0 "AAL_OK" 1 1 "AAL_SPI_FAILED" 2 2 "AAL_RIF_CONFIG_FAILED" 3 3 "AAL_WRONG_DECFACTOR" 4 4 "AAL_WRONG_MMICADDR" 5 5 "AAL_BUFFER_NOTEMPTY" 6 6 "AAL_MODPARA_NOTSET" 7 7 "AAL_MONCONFIG_NOTSET" 25 25 "AAL_WRONG_TRAMP" 26 26 "AAL_WRONG_FSTART" 27 27 "AAL_WRONG_NFSTEP" 28 28 "AAL_WRONG_NSEQ" 29 29 "AAL_WRONG_NSPON" 30 30 "AAL_WRONG_MINFREQ" 31 31 "AAL_WRONG_MAXFREQ" 32 32 "AAL_WRONG_MAXSWING" 33 33 "AAL_WRONG_ANT_CHOICE" 50 50 "AAL_WRONG_FIRMEWARE" 51 51 "AAL_FIRMEWARE_RUNNING" 52 52 "AAL_FIRMWARE_TIMEOUT" 53 53 "AAL_FWRESULTS_FAILED" 54 54 "AAL_DEL_OLD_FW_FAILED" 55 55 "AAL_WRONG_RUNFW_NRPARAMS" 56 56 "AAL_WRONG_RUNFW_NRRESULT" 57 57 "AAL_FW_NOT_STARTED" 58 58 "AAL_FW_NOT_FINISHED" 59 59 "AAL_FW_STATUS_COUNT_EMPTY" 60 60 "AAL_FW_FAILED" 61 61 "AAL_FW_SEQFULL" 224 224 "AAL_STATUS_CMD_NOT_ALLOWED" 225 225 "AAL_STATUS_INVALID_SIG" 226 226 "AAL_STATUS_INVALID_SETTING" 227 227 "AAL_STATUS_CALIB_ERROR" 228 228 "AAL_STATUS_77GHz_PLL_UNLOCKED" 229 229 "AAL_STATUS_BB_ERROR" 230 230 "AAL_STATUS_PARAM_ERROR" 231 231 "AAL_STATUS_INVALID_CMD" 232 232 "AAL_STATUS_UNDERFLOW" 233 233 "AAL_STATUS_OVERFLOW" 234 234 "AAL_STATUS_CMD_SEQ_REC" 235 235 "AAL_STATUS_RMP_ERROR" 236 236 "AAL_STATUS_MON_LIMIT_ERROR" 237 237 "AAL_STATUS_MON_CRC_ERROR" 238 238 "AAL_STATUS_ERROR" 239 239 "AAL_STATUS_UNKNOWN_CMD" DEFAULT_VALUE "" /end COMPU_VTAB_RANGE
/begin COMPU_VTAB_RANGE AAL_MSG.OLD_5 "" 47 0 0 "AAL_OK" 1 1 "AAL_SPI_FAILED" 2 2 "AAL_SPI_TRANSFER_FAILED" 3 3 "AAL_RIF_CONFIG_FAILED" 4 4 "AAL_WRONG_DECFACTOR" 5 5 "AAL_WRONG_MMICADDR" 6 6 "AAL_BUFFER_NOTEMPTY" 7 7 "AAL_MODPARA_NOTSET" 8 8 "AAL_MONCONFIG_NOTSET" 25 25 "AAL_WRONG_TRAMP" 26 26 "AAL_WRONG_FSTART" 27 27 "AAL_WRONG_NFSTEP" 28 28 "AAL_WRONG_NSEQ" 29 29 "AAL_WRONG_NSPON" 30 30 "AAL_WRONG_MINFREQ" 31 31 "AAL_WRONG_MAXFREQ" 32 32 "AAL_WRONG_MAXSWING" 33 33 "AAL_WRONG_ANT_CHOICE" 34 34 "AAL_WAITTIME2SMALL" 50 50 "AAL_WRONG_FIRMEWARE" 51 51 "AAL_FIRMEWARE_RUNNING" 52 52 "AAL_FIRMWARE_TIMEOUT" 53 53 "AAL_FWRESULTS_FAILED" 54 54 "AAL_DEL_OLD_FW_FAILED" 55 55 "AAL_WRONG_RUNFW_NRPARAMS" 56 56 "AAL_WRONG_RUNFW_NRRESULT" 57 57 "AAL_FW_NOT_STARTED" 58 58 "AAL_FW_NOT_FINISHED" 59 59 "AAL_FW_STATUS_COUNT_EMPTY" 60 60 "AAL_FW_FAILED" 61 61 "AAL_FW_SEQFULL" 224 224 "AAL_STATUS_CMD_NOT_ALLOWED" 225 225 "AAL_STATUS_INVALID_SIG" 226 226 "AAL_STATUS_INVALID_SETTING" 227 227 "AAL_STATUS_CALIB_ERROR" 228 228 "AAL_STATUS_77GHz_PLL_UNLOCKED" 229 229 "AAL_STATUS_BB_ERROR" 230 230 "AAL_STATUS_PARAM_ERROR" 231 231 "AAL_STATUS_INVALID_CMD" 232 232 "AAL_STATUS_UNDERFLOW" 233 233 "AAL_STATUS_OVERFLOW" 234 234 "AAL_STATUS_CMD_SEQ_REC" 235 235 "AAL_STATUS_RMP_ERROR" 236 236 "AAL_STATUS_MON_LIMIT_ERROR" 237 237 "AAL_STATUS_MON_CRC_ERROR" 238 238 "AAL_STATUS_ERROR" 239 239 "AAL_STATUS_UNKNOWN_CMD" DEFAULT_VALUE "" /end COMPU_VTAB_RANGE
/begin COMPU_VTAB_RANGE AAL_MSG.OLD_6 "" 49 0 0 "AAL_OK" 1 1 "AAL_SPI_FAILED" 2 2 "AAL_SPI_TRANSFER_FAILED" 3 3 "AAL_RIF_CONFIG_FAILED" 4 4 "AAL_WRONG_DECFACTOR" 5 5 "AAL_WRONG_MMICADDR" 6 6 "AAL_BUFFER_NOTEMPTY" 7 7 "AAL_MODPARA_NOTSET" 8 8 "AAL_MONCONFIG_NOTSET" 32 32 "AAL_WRONG_TRAMP" 33 33 "AAL_WRONG_FSTART" 34 34 "AAL_WRONG_NFSTEP" 35 35 "AAL_WRONG_NSEQ" 36 36 "AAL_WRONG_NSPON" 37 37 "AAL_WRONG_MINFREQ" 38 38 "AAL_WRONG_MAXFREQ" 39 39 "AAL_WRONG_MAXSWING" 40 40 "AAL_WRONG_ANT_CHOICE" 41 41 "AAL_RAMPTIME2SMALL" 64 64 "AAL_WRONG_FIRMEWARE" 65 65 "AAL_FIRMEWARE_RUNNING" 66 66 "AAL_FIRMWARE_TIMEOUT" 67 67 "AAL_FWRESULTS_FAILED" 68 68 "AAL_DEL_OLD_FW_FAILED" 69 69 "AAL_WRONG_RUNFW_NRPARAMS" 70 70 "AAL_WRONG_RUNFW_NRRESULT" 71 71 "AAL_FW_NOT_STARTED" 72 72 "AAL_FW_NOT_FINISHED" 73 73 "AAL_FW_STATUS_COUNT_EMPTY" 74 74 "AAL_FW_FAILED" 75 75 "AAL_FW_SEQFULL" 76 76 "AAL_UNLOCK_ERROR" 96 96 "AAL_ENABLERXTX_FAILED" 224 224 "AAL_STATUS_CMD_NOT_ALLOWED" 225 225 "AAL_STATUS_INVALID_SIG" 226 226 "AAL_STATUS_INVALID_SETTING" 227 227 "AAL_STATUS_CALIB_ERROR" 228 228 "AAL_STATUS_77GHz_PLL_UNLOCKED" 229 229 "AAL_STATUS_BB_ERROR" 230 230 "AAL_STATUS_PARAM_ERROR" 231 231 "AAL_STATUS_INVALID_CMD" 232 232 "AAL_STATUS_UNDERFLOW" 233 233 "AAL_STATUS_OVERFLOW" 234 234 "AAL_STATUS_CMD_SEQ_REC" 235 235 "AAL_STATUS_RMP_ERROR" 236 236 "AAL_STATUS_MON_LIMIT_ERROR" 237 237 "AAL_STATUS_MON_CRC_ERROR" 238 238 "AAL_STATUS_ERROR" 239 239 "AAL_STATUS_UNKNOWN_CMD" DEFAULT_VALUE "" /end COMPU_VTAB_RANGE
/begin COMPU_VTAB_RANGE AAL_MSG.OLD_7 "" 48 0 0 "AAL_OK" 1 1 "AAL_SPI_FAILED" 2 2 "AAL_SPI_TRANSFER_FAILED" 3 3 "AAL_RIF_CONFIG_FAILED" 4 4 "AAL_WRONG_MMICADDR" 5 5 "AAL_BUFFER_NOTEMPTY" 6 6 "AAL_BUFFER_OVERFLOW" 7 7 "AAL_MODPARA_NOTSET" 32 32 "AAL_WRONG_TRAMP" 33 33 "AAL_WRONG_FSTART" 34 34 "AAL_WRONG_NFSTEP" 35 35 "AAL_WRONG_NSEQ" 36 36 "AAL_WRONG_MINFREQ" 37 37 "AAL_WRONG_MAXFREQ" 38 38 "AAL_WRONG_MAXSWING" 39 39 "AAL_WRONG_ANT_CHOICE" 40 40 "AAL_RAMPTIME2SMALL" 48 48 "AAL_WRONG_NSPON" 49 49 "AAL_WRONG_DECFACTOR" 64 64 "AAL_WRONG_FIRMEWARE" 65 65 "AAL_FIRMWARE_TIMEOUT" 66 66 "AAL_FWRESULTS_FAILED" 67 67 "AAL_DEL_OLD_FW_FAILED" 68 68 "AAL_WRONG_RUNFW_NRPARAMS" 69 69 "AAL_WRONG_RUNFW_NRRESULT" 70 70 "AAL_FW_NOT_STARTED" 71 71 "AAL_FW_STATUS_COUNT_EMPTY" 72 72 "AAL_FW_FAILED" 96 96 "AAL_ENABLERXTX_FAILED" 112 112 "AAL_MMICSTATUS_ERROR" 113 113 "AAL_MMICSTATUS_OKPIN_FAILED" 224 224 "AAL_STATUS_CMD_NOT_ALLOWED" 225 225 "AAL_STATUS_INVALID_SIG" 226 226 "AAL_STATUS_INVALID_SETTING" 227 227 "AAL_STATUS_CALIB_ERROR" 228 228 "AAL_STATUS_77GHz_PLL_UNLOCKED" 229 229 "AAL_STATUS_BB_ERROR" 230 230 "AAL_STATUS_PARAM_ERROR" 231 231 "AAL_STATUS_INVALID_CMD" 232 232 "AAL_STATUS_UNDERFLOW" 233 233 "AAL_STATUS_OVERFLOW" 234 234 "AAL_STATUS_CMD_SEQ_REC" 235 235 "AAL_STATUS_RMP_ERROR" 236 236 "AAL_STATUS_MON_LIMIT_ERROR" 237 237 "AAL_STATUS_MON_CRC_ERROR" 238 238 "AAL_STATUS_ERROR" 239 239 "AAL_STATUS_UNKNOWN_CMD" 4096 4096 "AAL_FIRMEWARE_RUNNING" DEFAULT_VALUE "" /end COMPU_VTAB_RANGE
/begin COMPU_VTAB_RANGE AAL_MSG.OLD_8 "" 50 0 0 "AAL_OK" 1 1 "AAL_SPI_FAILED" 2 2 "AAL_SPI_TRANSFER_FAILED" 3 3 "AAL_RIF_CONFIG_FAILED" 4 4 "AAL_WRONG_MMICADDR" 5 5 "AAL_BUFFER_NOTEMPTY" 6 6 "AAL_BUFFER_OVERFLOW" 7 7 "AAL_MODPARA_NOTSET" 32 32 "AAL_WRONG_TRAMP" 33 33 "AAL_WRONG_FSTART" 34 34 "AAL_WRONG_NFSTEP" 35 35 "AAL_WRONG_NSEQ" 36 36 "AAL_WRONG_MINFREQ" 37 37 "AAL_WRONG_MAXFREQ" 38 38 "AAL_WRONG_MAXSWING" 39 39 "AAL_WRONG_ANT_CHOICE" 40 40 "AAL_RAMPTIME2SMALL" 48 48 "AAL_WRONG_NSPON" 49 49 "AAL_WRONG_DECFACTOR" 64 64 "AAL_WRONG_FIRMEWARE" 65 65 "AAL_FIRMWARE_TIMEOUT" 66 66 "AAL_FWRESULTS_FAILED" 67 67 "AAL_DEL_OLD_FW_FAILED" 68 68 "AAL_WRONG_RUNFW_NRPARAMS" 69 69 "AAL_WRONG_RUNFW_NRRESULT" 70 70 "AAL_FW_NOT_STARTED" 71 71 "AAL_FW_STATUS_COUNT_EMPTY" 72 72 "AAL_FW_FAILED" 96 96 "AAL_ENABLERXTX_FAILED" 112 112 "AAL_MMICSTATUS_ERROR" 113 113 "AAL_MMICSTATUS_OKPIN_FAILED" 128 128 "AAL_RFSP_CRC_NOTFOUND" 129 129 "AAL_RFSP_RMPCRC_ERROR" 224 224 "AAL_STATUS_CMD_NOT_ALLOWED" 225 225 "AAL_STATUS_INVALID_SIG" 226 226 "AAL_STATUS_INVALID_SETTING" 227 227 "AAL_STATUS_CALIB_ERROR" 228 228 "AAL_STATUS_77GHz_PLL_UNLOCKED" 229 229 "AAL_STATUS_BB_ERROR" 230 230 "AAL_STATUS_PARAM_ERROR" 231 231 "AAL_STATUS_INVALID_CMD" 232 232 "AAL_STATUS_UNDERFLOW" 233 233 "AAL_STATUS_OVERFLOW" 234 234 "AAL_STATUS_CMD_SEQ_REC" 235 235 "AAL_STATUS_RMP_ERROR" 236 236 "AAL_STATUS_MON_LIMIT_ERROR" 237 237 "AAL_STATUS_MON_CRC_ERROR" 238 238 "AAL_STATUS_ERROR" 239 239 "AAL_STATUS_UNKNOWN_CMD" 4096 4096 "AAL_FIRMEWARE_RUNNING" DEFAULT_VALUE "" /end COMPU_VTAB_RANGE
/begin COMPU_VTAB AAL_MSG_Copy1 "enumeration table" TAB_VERB 56 0 "AAL_OK" 1 "AAL_SPI_FAILED" 2 "AAL_SPI_TRANSFER_FAILED" 3 "AAL_RIF_CONFIG_FAILED" 4 "AAL_WRONG_MMICADDR" 5 "AAL_BUFFER_NOTEMPTY" 6 "AAL_BUFFER_OVERFLOW" 7 "AAL_MODPARA_NOTSET" 8 "AAL_FWSTATE_NOTSET" 32 "AAL_WRONG_TRAMP" 33 "AAL_WRONG_FSTART" 34 "AAL_WRONG_NFSTEP" 35 "AAL_WRONG_NSEQ" 36 "AAL_WRONG_MINFREQ" 37 "AAL_WRONG_MAXFREQ" 38 "AAL_WRONG_MAXSWING" 39 "AAL_WRONG_ANT_CHOICE" 40 "AAL_RAMPTIME2SMALL" 48 "AAL_WRONG_NSPON" 49 "AAL_WRONG_DECFACTOR" 64 "AAL_WRONG_FIRMEWARE" 65 "AAL_FIRMWARE_TIMEOUT" 66 "AAL_FWRESULTS_FAILED" 67 "AAL_DEL_OLD_FW_FAILED" 68 "AAL_WRONG_RUNFW_NRPARAMS" 69 "AAL_WRONG_RUNFW_NRRESULT" 70 "AAL_FW_NOT_STARTED" 71 "AAL_FW_STATUS_COUNT_EMPTY" 72 "AAL_FW_FAILED" 96 "AAL_ENABLERXTX_FAILED" 97 "AAL_FORCECALIB_FAILED" 112 "AAL_MMICSTATUS_ERROR" 113 "AAL_MMICSTATUS_OKPIN_FAILED" 128 "AAL_RFSP_CRC_NOTFOUND" 129 "AAL_MONRSFP_WRITECRC_ERR" 130 "AAL_MONRFSP_ERROR" 144 "AAL_MMIC_MISSING_FACTORYDATA" 145 "AAL_MMIC_VERSION_FACTORYDATA_ERROR" 224 "AAL_STATUS_CMD_NOT_ALLOWED" 225 "AAL_STATUS_INVALID_SIG" 226 "AAL_STATUS_INVALID_SETTING" 227 "AAL_STATUS_CALIB_ERROR" 228 "AAL_STATUS_77GHz_PLL_UNLOCKED" 229 "AAL_STATUS_BB_ERROR" 230 "AAL_STATUS_PARAM_ERROR" 231 "AAL_STATUS_INVALID_CMD" 232 "AAL_STATUS_UNDERFLOW" 233 "AAL_STATUS_OVERFLOW" 234 "AAL_STATUS_GENERAL_ERROR" 234 "AAL_STATUS_CMD_SEQ_REC" 235 "AAL_STATUS_RMP_ERROR" 236 "AAL_STATUS_MON_LIMIT_ERROR" 237 "AAL_STATUS_MON_CRC_ERROR" 238 "AAL_STATUS_ERROR" 239 "AAL_STATUS_UNKNOWN_CMD" 4096 "AAL_FIRMEWARE_RUNNING" /end COMPU_VTAB
/begin COMPU_VTAB AAL_MSG_Copy3 "enumeration table" TAB_VERB 61 0 "AAL_OK" 1 "AAL_SPI_FAILED" 2 "AAL_SPI_TRANSFER_FAILED" 3 "AAL_RIF_CONFIG_FAILED" 4 "AAL_WRONG_MMICADDR" 5 "AAL_BUFFER_NOTEMPTY" 6 "AAL_BUFFER_OVERFLOW" 7 "AAL_RMPMEM_OVERFLOW" 8 "AAL_RMPMEM_WRITE_FAILED" 9 "AAL_MODPARA_NOTSET" 10 "AAL_FWSTATE_NOTSET" 11 "AAL_STATEMACHINE_FAILED" 12 "AAL_HARDRESET_FAILED" 13 "AAL_RESET_ERROR" 32 "AAL_WRONG_TRAMP" 33 "AAL_WRONG_FSTART" 34 "AAL_WRONG_NFSTEP" 35 "AAL_WRONG_NSEQ" 36 "AAL_WRONG_MINFREQ" 37 "AAL_WRONG_MAXFREQ" 38 "AAL_WRONG_MAXSWING" 39 "AAL_WRONG_ANT_CHOICE" 40 "AAL_RAMPTIME2SMALL" 48 "AAL_WRONG_NSPON" 49 "AAL_WRONG_DECFACTOR" 64 "AAL_WRONG_FIRMEWARE" 65 "AAL_FIRMWARE_TIMEOUT" 66 "AAL_FWRESULTS_FAILED" 67 "AAL_DEL_OLD_FW_FAILED" 68 "AAL_WRONG_RUNFW_NRPARAMS" 69 "AAL_WRONG_RUNFW_NRRESULT" 70 "AAL_FW_NOT_STARTED" 71 "AAL_FW_STATUS_COUNT_EMPTY" 72 "AAL_FW_FAILED" 96 "AAL_ENABLERXTX_FAILED" 97 "AAL_FORCECALIB_FAILED" 112 "AAL_MMICSTATUS_ERROR" 113 "AAL_MMICSTATUS_OKPIN_FAILED" 128 "AAL_RFSP_CRC_NOTFOUND" 129 "AAL_MONRSFP_WRITECRC_ERR" 130 "AAL_MONRFSP_ERROR" 144 "AAL_MMIC_MISSING_FACTORYDATA" 145 "AAL_MMIC_VERSION_FACTORYDATA_ERROR" 224 "AAL_STATUS_CMD_NOT_ALLOWED" 225 "AAL_STATUS_INVALID_SIG" 226 "AAL_STATUS_INVALID_SETTING" 227 "AAL_STATUS_CALIB_ERROR" 228 "AAL_STATUS_77GHz_PLL_UNLOCKED" 229 "AAL_STATUS_BB_ERROR" 230 "AAL_STATUS_PARAM_ERROR" 231 "AAL_STATUS_INVALID_CMD" 232 "AAL_STATUS_UNDERFLOW" 233 "AAL_STATUS_OVERFLOW" 234 "AAL_STATUS_GENERAL_ERROR" 234 "AAL_STATUS_CMD_SEQ_REC" 235 "AAL_STATUS_RMP_ERROR" 236 "AAL_STATUS_MON_LIMIT_ERROR" 237 "AAL_STATUS_MON_CRC_ERROR" 238 "AAL_STATUS_ERROR" 239 "AAL_STATUS_UNKNOWN_CMD" 4096 "AAL_FIRMEWARE_RUNNING" /end COMPU_VTAB
/begin COMPU_VTAB AbdMainStates "enumeration table" TAB_VERB 5 0 "passive_state" 1 "active_state" 2 "brakeonly_state" 3 "standstill_state" 4 "suspend_state" /end COMPU_VTAB
/begin COMPU_VTAB AbsStatus "enumeration table" TAB_VERB 3 0 "available" 1 "active" 2 "not_available" /end COMPU_VTAB
/begin COMPU_VTAB AccPlusBehavior "enumeration table" TAB_VERB 4 0 "NONE" 1 "SLA_REACTION" 2 "CSA_REACTION" 3 "SP_REACTION" /end COMPU_VTAB
/begin COMPU_VTAB_RANGE AccState "" 8 0 0 "ACC_MAINSWITCH_OFF" 1 1 "ACC_INIT" 2 2 "ACC_STANDBY" 3 3 "ACC_ACTIVE" 4 4 "ACC_OVERRIDE" 5 5 "ACC_RESERVED" 6 6 "ACC_REVERSIBLE_ERROR" 7 7 "ACC_IRREVERSIBLE_ERROR" DEFAULT_VALUE "" /end COMPU_VTAB_RANGE
/begin COMPU_VTAB AccStateMachineInteractionType "enumeration table" TAB_VERB 4 0 "NoEvent" 1 "ActivationRequest" 2 "DriveOffRequest" 3 "DeactivationRequest" /end COMPU_VTAB
/begin COMPU_VTAB AccStates "enumeration table" TAB_VERB 14 0 "disabledInit" 1 "disabledOff" 2 "failure" 4 "passiveNotAvailable" 5 "passiveAvailable" 6 "activeStandWait" 7 "activeStandActive" 8 "activeDriveOff" 9 "activeActiveControl" 10 "activeSuspend" 11 "fadeout" 12 "fadeoutStandSecure" 13 "fadeoutBom" 14 "numStates" /end COMPU_VTAB
/begin COMPU_VTAB AcceleratorOverrideStrategy "enumeration table" TAB_VERB 2 0 "cooperation" 1 "limitation" /end COMPU_VTAB
/begin COMPU_VTAB Action "enumeration table" TAB_VERB 4 0 "none" 1 "risingEdge" 2 "fallingEdge" 3 "longPress" /end COMPU_VTAB
/begin COMPU_VTAB ActivationRequest "enumeration table" TAB_VERB 4 0 "off" 1 "comfort" 2 "dynamic" 3 "emergency" /end COMPU_VTAB
/begin COMPU_VTAB_RANGE ActorState "" 3 0 0 "ActorState_Off" 1 1 "ActorState_Standby" 2 2 "ActorState_On" DEFAULT_VALUE "" /end COMPU_VTAB_RANGE
/begin COMPU_VTAB ActuationConstraint "enumeration table" TAB_VERB 2 0 "none" 1 "no_propulsion" /end COMPU_VTAB
/begin COMPU_VTAB_RANGE ActuationState "" 3 0 0 "ActuationState_Off" 1 1 "ActuationState_Standby" 2 2 "ActuationState_On" DEFAULT_VALUE "" /end COMPU_VTAB_RANGE
/begin COMPU_VTAB AebStates "enumeration table" TAB_VERB 8 0 "disabled" 1 "suppressed" 2 "available" 3 "active" 4 "fadeOutAlign" 5 "fadeOutRamp" 13 "failure" 15 "invalid" /end COMPU_VTAB
/begin COMPU_VTAB ArbitrationStates "enumeration table" TAB_VERB 4 0 "off" 1 "noArbitration" 2 "activeControl" 3 "activeSuspend" /end COMPU_VTAB
/begin COMPU_VTAB_RANGE Availability "" 2 0 0 "unavailable" 1 1 "available" DEFAULT_VALUE "" /end COMPU_VTAB_RANGE
/begin COMPU_VTAB AvailableConfigurations "enumeration table" TAB_VERB 1 0 "PL_Radar" /end COMPU_VTAB
/begin COMPU_VTAB AveragingWeightType "enumeration table" TAB_VERB 2 0 "ErrorMeasure" 1 "Sigmoid" /end COMPU_VTAB
/begin COMPU_VTAB BdaMode "enumeration table" TAB_VERB 3 0 "lks" 1 "tjaIca" 2 "cruise" /end COMPU_VTAB
/begin COMPU_VTAB BdcMainStates "enumeration table" TAB_VERB 4 0 "passive" 1 "active" 2 "standstill" 3 "suspend" /end COMPU_VTAB
/begin COMPU_VTAB BdcStateConstants "enumeration table" TAB_VERB 4 0 "passive" 1 "calcprofile" 2 "active_Prof" 3 "active_Max" /end COMPU_VTAB
/begin COMPU_VTAB BdcStateOfdStandstillCv "enumeration table" TAB_VERB 4 0 "novalue" 1 "optvalue" 2 "maxvalue" 3 "tolvalue" /end COMPU_VTAB
/begin COMPU_VTAB BdcTargets "enumeration table" TAB_VERB 5 0 "notarget" 1 "lotarget" 2 "potarget" 3 "sotarget" 4 "imtarget" /end COMPU_VTAB
/begin COMPU_VTAB BehaviorExecutionRecommendation "enumeration table" TAB_VERB 4 0 "invalidAndNotRecommended" 1 "validButNotRecommended" 2 "validAndRecommended" 3 "validWithTimestamp" /end COMPU_VTAB
/begin COMPU_VTAB BehaviorRelatedObjectStatus "enumeration table" TAB_VERB 3 0 "invalid" 1 "available" 2 "regulatedUpon" /end COMPU_VTAB
/begin COMPU_VTAB_RANGE BehaviorStrategy "" 3 0 0 "tipl" 1 1 "fm" 2 2 "imba" DEFAULT_VALUE "" /end COMPU_VTAB_RANGE
/begin COMPU_VTAB_RANGE BehaviorStrategy.OLD_1 "" 5 0 0 "undefinedStrategy" 1 1 "trafficInParallelLanes" 2 2 "collisionFreeManeuvering" 3 3 "noStrategy" 4 4 "allStrategies" DEFAULT_VALUE "" /end COMPU_VTAB_RANGE
/begin COMPU_VTAB_RANGE BehaviorStrategyType "" 2 0 0 "BS_TIPL" 1 1 "BS_FM" DEFAULT_VALUE "" /end COMPU_VTAB_RANGE
/begin COMPU_VTAB BehaviorStrategy_Copy1 "enumeration table" TAB_VERB 6 0 "bsUndefined" 1 "bsTipl" 2 "bsImba" 3 "bsCfm" 4 "bsTixl" 10 "bsSit2d" /end COMPU_VTAB
/begin COMPU_VTAB_RANGE BehaviorType "" 7 0 0 "AccTipl" 1 1 "AebFullBrakeTipl" 2 2 "FcwTipl" 3 3 "AebFullBrakeFm" 4 4 "AebPartialBrakeTipl" 5 5 "AccImba" 6 6 "FtaTipl" DEFAULT_VALUE "" /end COMPU_VTAB_RANGE
/begin COMPU_VTAB_RANGE BehaviorType.OLD_1 "" 7 0 0 "AccTipl" 1 1 "AebFullBrakeTipl" 2 2 "FcwTipl" 3 3 "AebFm" 4 4 "AebPartialBrakeTipl" 5 5 "AccImba" 6 6 "FtaTipl" DEFAULT_VALUE "" /end COMPU_VTAB_RANGE
/begin COMPU_VTAB BehaviorType_Copy1 "enumeration table" TAB_VERB 9 0 "AccTipl" 1 "AebFullBrakeTipl" 2 "EbaTipl" 3 "EbaFm" 4 "FcwTipl" 5 "AebFullBrakeFm" 6 "AebPartialBrakeTipl" 7 "AccImba" 8 "FtaTipl" /end COMPU_VTAB
/begin COMPU_VTAB BlindnessIndicatorUniqueId "enumeration table" TAB_VERB 11 0 "undefinedId" 1 "thetaMIMOId" 2 "crossCorrId" 3 "nRefId" 4 "treeResultId" 5 "fusObjId" 6 "thetaMIMOMasterId" 7 "crossMIMOCombiId" 8 "numLocsId" 9 "nRefMIMOCombiId" 10 "scrIndcrId" /end COMPU_VTAB
/begin COMPU_VTAB_RANGE BlindnessValidityState "" 3 0 0 "invalid" 1 1 "init" 255 255 "valid" DEFAULT_VALUE "" /end COMPU_VTAB_RANGE
/begin COMPU_VTAB BorderState "enumeration table" TAB_VERB 4 0 "unknown" 1 "emptyBorder" 2 "behindEgo" 3 "valid" /end COMPU_VTAB
/begin COMPU_VTAB BoundaryType "enumeration table" TAB_VERB 21 0 "Virtual" 1 "Unknown" 2 "Dashed" 3 "Solid" 4 "DashedExcept" 5 "SolidExcept" 6 "RoadEdge" 7 "ConstructionElement" 8 "Curbstone" 9 "TrafficStatic" 10 "UnknownRaised" 11 "RoadEdgeFlat" 12 "RoadEdgeDropped" 13 "RoadEdgeRaised" 14 "TrafficBarrier" 15 "ConstructionBarriers" 16 "TrafficControlDevices" 17 "ParkedVehicles" 18 "UnknownRaisedOverridable" 19 "UnknownRaisedNotOverridable" 20 "UnknownRaisedUnderridable" /end COMPU_VTAB
/begin COMPU_VTAB ButtonStatus "enumeration table" TAB_VERB 3 0 "NotPressed" 1 "Pressed" 2 "NotFitted" /end COMPU_VTAB
/begin COMPU_VTAB_RANGE C_PLM "" 6 0 0 "EGO_COURSE_LANE_MODEL" 1 1 "EGO_HIST_TRACK_LANE_MODEL" 2 2 "OBJECT_HIST_TRACK_LANE_MODEL" 3 3 "STATIC_SENSOR_LANE_MODEL" 4 4 "NUMBER_OF_PLM_TYPES" 255 255 "INVALID_PLM_TYPE" DEFAULT_VALUE "" /end COMPU_VTAB_RANGE
/begin COMPU_VTAB C_PLM_Copy1 "enumeration table" TAB_VERB 7 0 "EGO_COURSE_LANE_MODEL" 1 "EGO_HIST_TRACK_LANE_MODEL" 2 "OBJECT_HIST_TRACK_LANE_MODEL" 3 "STATIC_SENSOR_LANE_MODEL" 4 "NUMBER_OF_PLM_TYPES" 5 "EXTRAPOLATED_MODEL" 255 "INVALID_PLM_TYPE" /end COMPU_VTAB
/begin COMPU_VTAB CalculatorResult "enumeration table" TAB_VERB 38 0 "notCalled" 1 "valid" 2 "reactionNotRequired" 3 "reactionRequired" 4 "reactionFinished" 10 "invalid" 11 "invalidTargetObject" 12 "invalidBehaviorSpec" 13 "parameterSetMissing" 14 "invalidEgoCurrentTrajectory" 15 "egoNotDrivingForward" 16 "invalidTrajectoryConstruction" 17 "wrongReactionPatternType" 18 "noStaticBorder" 19 "gciCreationFailed" 20 "preconditionsFailed" 21 "featureNotSupported" 22 "egoNotDrivingForwardAfterLatency" 23 "staticBordersResampleFailed" 24 "couldNotDetermineObjectTrajectory" 25 "notImplemented" 30 "invalidNormalBrake" 31 "invalidImmediateBrake" 32 "invalidLimitedImmediateBrake" 33 "maxVelocityReductionLimitReached" 34 "situationIsDeescalated" 40 "egoStabilizationCouldNotBeDetermined" 41 "targetStatesNotFound" 42 "steeringTrajectoryWithParallelAlignmentFailed" 43 "parallelAlignmentTrajectoryFailed" 44 "recommendedExecutionTimeInvalid" 45 "collisionAvoidableLongitudinally" 46 "solutionBeyondTimeHorizon" 47 "lambdaForLateralDisplacementNotFound" 50 "staticBordersTooShort" 60 "egoNotYetStabilized" 61 "egoStabilizationTimeBelowThreshold" 62 "egoStabilizedButBehaviorCurrentlyNotExecuted" /end COMPU_VTAB
/begin COMPU_VTAB_RANGE CanSM_BusOffRecoveryStateType_Enum "" 7 1 1 "CANSM_BOR_IDLE" 2 2 "CANSM_S_BUS_OFF_CHECK" 3 3 "CANSM_S_NO_BUS_OFF" 4 4 "CANSM_S_BUS_OFF_RECOVERY_L1" 5 5 "CANSM_S_RESTART_CC" 6 6 "CANSM_S_RESTART_CC_WAIT" 7 7 "CANSM_S_BUS_OFF_RECOVERY_L2" DEFAULT_VALUE "" /end COMPU_VTAB_RANGE
/begin COMPU_VTAB_RANGE CanSM_NetworkModeStateType_Enum "" 7 0 0 "CANSM_BSM_S_NOCOM" 1 1 "CANSM_BSM_S_SILENTCOM" 2 2 "CANSM_BSM_S_FULLCOM" 3 3 "CANSM_BSM_S_NOT_INITIALIZED" 4 4 "CANSM_BSM_S_PRE_NOCOM" 5 5 "CANSM_BSM_S_PRE_FULLCOM" 6 6 "CANSM_BSM_S_CHANGE_BAUDRATE" DEFAULT_VALUE "" /end COMPU_VTAB_RANGE
/begin COMPU_VTAB_RANGE CanSM_TimerStateType_Enum "" 4 1 1 "CANSM_TIMER_INIT" 2 2 "CANSM_TIMER_RUNNING" 3 3 "CANSM_TIMER_ELAPSED" 4 4 "CANSM_TIMER_CANCELLED" DEFAULT_VALUE "" /end COMPU_VTAB_RANGE
/begin COMPU_VTAB_RANGE CancelationType "" 3 0 0 "CT_NONE" 1 1 "CT_ALL" 2 2 "CT_SPEED_LIMIT" DEFAULT_VALUE "" /end COMPU_VTAB_RANGE
/begin COMPU_VTAB ClassificationType "enumeration table" TAB_VERB 4 0 "unknown" 1 "obstacle" 2 "curb" 3 "underrideable" /end COMPU_VTAB
/begin COMPU_VTAB ColdPathType "enumeration table" TAB_VERB 4 0 "COLDPATH_INVALID" 1 "COLDPATH_LASTTC" 2 "COLDPATH_EGO" 3 "COLDPATH_VIDEO" /end COMPU_VTAB
/begin COMPU_VTAB_RANGE ComfortLaneDrivingState "" 5 0 0 "COMFORT_LANE_DRIVING_OFF" 1 1 "COMFORT_LANE_DRIVING_STANDBY" 2 2 "COMFORT_LANE_DRIVING_LONGITUDINAL_CONTROL" 3 3 "COMFORT_LANE_DRIVING_LATERAL_CONTROL" 4 4 "COMFORT_LANE_DRIVING_FULL_CONTROL" DEFAULT_VALUE "" /end COMPU_VTAB_RANGE
/begin COMPU_VTAB_RANGE ConnectionType "" 4 0 0 "CT_UNKNOWN" 1 1 "CT_SOLID_LINE" 2 2 "CT_DASHED_LINE" 3 3 "CT_UNCROSSABLE" DEFAULT_VALUE "" /end COMPU_VTAB_RANGE
/begin COMPU_VTAB ContributingType "enumeration table" TAB_VERB 4 0 "none" 1 "precedingObject" 2 "preprecedingObject" 3 "trafficLightForBraking" /end COMPU_VTAB
/begin COMPU_VTAB ControlStrategy "enumeration table" TAB_VERB 11 0 "none" 1 "brakeToStandstill" 2 "brakePartially" 3 "reactOnExternalObject" 4 "brakePartiallyOnTrafficLight" 5 "brakeOnTrafficLight" 6 "brakePartiallyOnStopSign" 7 "brakeOnStopSign" 8 "controlOnSpeedLimits" 9 "controlOnCurveSpeed" 10 "controlOnSpeedProfile" /end COMPU_VTAB
/begin COMPU_VTAB CounterLimit "enumeration table" TAB_VERB 2 0 "LOWER" 1 "UPPER" /end COMPU_VTAB
/begin COMPU_VTAB CrcRegType "enumeration table" TAB_VERB 2 1 "Rif_CrcReg_disabled" 2 "Rif_CrcReg_enabled" /end COMPU_VTAB
/begin COMPU_VTAB CruiseControlModeInput "enumeration table" TAB_VERB 2 0 "ADAPTIVE_CRUISE_CONTROL" 1 "CRUISE_CONTROL" /end COMPU_VTAB
/begin COMPU_VTAB CruiseMode "enumeration table" TAB_VERB 3 0 "NotEnabled" 1 "ACC" 2 "CC" /end COMPU_VTAB
/begin COMPU_VTAB CscRoundAboutState "enumeration table" TAB_VERB 7 0 "no_rbt" 1 "rbt_entry" 2 "rbt_inflection_pt_entry" 3 "rbt_circle" 4 "rbt_inflection_pt_exit" 5 "rbt_exit" 6 "rbt_blocked" /end COMPU_VTAB
/begin COMPU_VTAB CurrentLane "enumeration table" TAB_VERB 4 0 "none" 1 "originLane" 2 "targetLane" 3 "invalidLane" /end COMPU_VTAB
/begin COMPU_VTAB DSP_ALIGNMENT_MODES "enumeration table" TAB_VERB 3 0 "AlignmentModeOff" 1 "AlignmentModeCornerReflector" 2 "AlignmentModeFlatPlate" /end COMPU_VTAB
/begin COMPU_VTAB DYNCALDYNSTATE "enumeration table" TAB_VERB 5 0 "DYNCALI_INIT" 1 "DYNCALIB_CALCULATE" 2 "DYNCALIB_NVMUPDATE" 3 "DYNCALIB_ERROR" 4 "DYNCALIB_SUCCESS" /end COMPU_VTAB
/begin COMPU_VTAB_RANGE DaCoreStates "" 7 0 0 "DC_INVALID" 1 1 "DC_NOT_INITIALIZED" 2 2 "DC_STARTUP" 3 3 "DC_AVAILABLE" 4 4 "DC_SAFE" 5 5 "DC_SHUTDOWN" 6 6 "DC_OOS" DEFAULT_VALUE "" /end COMPU_VTAB_RANGE
/begin COMPU_VTAB DefinedTargetMotionGoal "enumeration table" TAB_VERB 1 0 "doConstantDeceleration" /end COMPU_VTAB
/begin COMPU_VTAB_RANGE DegreeOfAssistance "" 6 0 0 "DOA_NotAvailable" 1 1 "DOA_Informing" 2 2 "DOA_Warning" 3 3 "DOA_Assisting" 4 4 "DOA_PAuto" 5 5 "DOA_FAuto" DEFAULT_VALUE "" /end COMPU_VTAB_RANGE
/begin COMPU_VTAB DinMainStates "enumeration table" TAB_VERB 3 0 "passive" 1 "active" 2 "suspend" /end COMPU_VTAB
/begin COMPU_VTAB DirectionIndicator "enumeration table" TAB_VERB 3 0 "off" 1 "on" 255 "error" /end COMPU_VTAB
/begin COMPU_VTAB DirectionIndicatorStatus "enumeration table" TAB_VERB 4 0 "neutral" 1 "left" 2 "right" 3 "bothActive" /end COMPU_VTAB
/begin COMPU_VTAB DoorStatus "enumeration table" TAB_VERB 4 0 "Init" 1 "Closed" 2 "Open" 3 "Error" /end COMPU_VTAB
/begin COMPU_VTAB_RANGE Drivability "" 3 0 0 "DRIVABILITY_YES" 1 1 "DRIVABILITY_NO" 2 2 "DRIVABILITY_ONLY_EMERGENCY" DEFAULT_VALUE "" /end COMPU_VTAB_RANGE
/begin COMPU_VTAB DriveMode "enumeration table" TAB_VERB 3 0 "ECO" 1 "COMFORT" 2 "DYNAMIC" /end COMPU_VTAB
/begin COMPU_VTAB DriveMode_Copy1 "enumeration table" TAB_VERB 4 0 "normal" 1 "comfort" 2 "eco" 3 "dynamic" /end COMPU_VTAB
/begin COMPU_VTAB DriverDrowsinessLevel "enumeration table" TAB_VERB 4 0 "unknown" 1 "notFatigue" 2 "fatigue" 3 "highlyFatigue" /end COMPU_VTAB
/begin COMPU_VTAB DriverGazingSide "enumeration table" TAB_VERB 3 0 "unknown" 1 "leftSideGazing" 2 "rightSideGazing" /end COMPU_VTAB
/begin COMPU_VTAB DriverModelDmsStatus "enumeration table" TAB_VERB 3 0 "cameraBlocked" 1 "cameraNotAvailable" 2 "cameraActive" /end COMPU_VTAB
/begin COMPU_VTAB DriverModelDriverAttention "enumeration table" TAB_VERB 4 0 "noValidData" 1 "inattentive" 2 "slightlyInattentive" 3 "attentive" /end COMPU_VTAB
/begin COMPU_VTAB DriverModelDriverDrowsinessLevel "enumeration table" TAB_VERB 4 0 "noValidData" 1 "drowsy" 2 "slightlyDrowsy" 3 "notDrowsy" /end COMPU_VTAB
/begin COMPU_VTAB DriverModelDriverPresence "enumeration table" TAB_VERB 4 0 "noValidData" 1 "notVisible" 2 "notPresent" 3 "present" /end COMPU_VTAB
/begin COMPU_VTAB DriverModelDriverSpoofing "enumeration table" TAB_VERB 3 0 "noValidData" 1 "noMisuseDetected" 2 "misuseDetected" /end COMPU_VTAB
/begin COMPU_VTAB DriverModelLaneChangeIntentionSide "enumeration table" TAB_VERB 3 0 "noValidData" 1 "laneChangeIntentionLeft" 2 "laneChangeIntentionRight" /end COMPU_VTAB
/begin COMPU_VTAB DriverMonitoringSystemStatus "enumeration table" TAB_VERB 5 0 "unknown" 1 "off" 2 "init" 3 "cameraBlocked" 4 "active" /end COMPU_VTAB
/begin COMPU_VTAB DriverOvertakeIntentionState "enumeration table" TAB_VERB 3 0 "NoOvertakeIntention" 1 "OvertakeIntentionGiven" 2 "OvertakeIntentionExpired" /end COMPU_VTAB
/begin COMPU_VTAB DriverPresence "enumeration table" TAB_VERB 3 0 "unknown" 1 "notPresent" 2 "present" /end COMPU_VTAB
/begin COMPU_VTAB DriverSpoofing "enumeration table" TAB_VERB 3 0 "unknown" 1 "notDetected" 2 "detected" /end COMPU_VTAB
/begin COMPU_VTAB_RANGE DriverSteeringActivity "" 6 0 0 "DriverSteeringActivity_NotKnown" 1 1 "DriverSteeringActivity_None" 2 2 "DriverSteeringActivity_Low" 3 3 "DriverSteeringActivity_Medium" 4 4 "DriverSteeringActivity_High" 5 5 "DriverSteeringActivity_Excessive" DEFAULT_VALUE "" /end COMPU_VTAB_RANGE
/begin COMPU_VTAB_RANGE DrivingDirection "" 3 0 0 "DD_UNKNOWN" 1 1 "DD_EGO_DIRECTION" 2 2 "DD_ONCOMING" DEFAULT_VALUE "" /end COMPU_VTAB_RANGE
/begin COMPU_VTAB_RANGE DrivingProfile "" 4 0 0 "DP_Eco" 1 1 "DP_Normal" 2 2 "DP_Comfortable" 3 3 "DP_Sport" DEFAULT_VALUE "" /end COMPU_VTAB_RANGE
/begin COMPU_VTAB DrivingSense "enumeration table" TAB_VERB 3 0 "Unknown" 1 "Left" 2 "Right" /end COMPU_VTAB
/begin COMPU_VTAB_RANGE DrivingState "" 3 0 0 "Forwards" 1 1 "Backwards" 2 2 "Standstill" DEFAULT_VALUE "" /end COMPU_VTAB_RANGE
/begin COMPU_VTAB_RANGE DrivingTask "" 11 0 0 "DT_UNKNOWN" 1 1 "DT_LANE_KEEPING_0" 2 2 "DT_LANE_KEEPING_1" 3 3 "DT_LANE_KEEPING_2" 4 4 "DT_LANE_CHANGE_01" 5 5 "DT_LANE_CHANGE_10" 6 6 "DT_LANE_CHANGE_12" 7 7 "DT_LANE_CHANGE_21" 8 8 "DT_OUT_OF_BOUNDS_LEFT" 9 9 "DT_OUT_OF_BOUNDS_RIGHT" 10 10 "DT_COUNT" DEFAULT_VALUE "" /end COMPU_VTAB_RANGE
/begin COMPU_VTAB_RANGE DrivingTask.OLD_1 "" 10 0 0 "DT_UNKNOWN" 1 1 "DT_LANE_KEEPING_0" 2 2 "DT_LANE_KEEPING_1" 3 3 "DT_LANE_KEEPING_2" 4 4 "DT_LANE_CHANGE_01" 5 5 "DT_LANE_CHANGE_10" 6 6 "DT_LANE_CHANGE_12" 7 7 "DT_LANE_CHANGE_21" 8 8 "DT_OUT_OF_BOUNDS_LEFT" 9 9 "DT_OUT_OF_BOUNDS_RIGHT" DEFAULT_VALUE "" /end COMPU_VTAB_RANGE
/begin COMPU_VTAB DynCalibState "enumeration table" TAB_VERB 11 0 "NO_CALIBRATION" 1 "EOL_START" 2 "EOL_STOP" 3 "SDA_START" 4 "SDA_STOP" 5 "EOL_CONTINUE" 6 "SDA_CONTINUE" 7 "STC_START" 8 "STC_CONTINUE" 9 "STC_STOP" 10 "STC_PAUSE" /end COMPU_VTAB
/begin COMPU_VTAB DynCalibStatus "enumeration table" TAB_VERB 11 0 "NO_CALIB_PROCESS" 1 "EOL_RUNNING" 2 "EOL_PASSED" 3 "EOL_FAILED" 4 "SDA_RUNNING" 5 "SDA_PASSED" 6 "SDA_FAILED" 7 "STC_RUNNING" 8 "STC_PASSED" 9 "STC_FAILED" 10 "STC_PAUSED" /end COMPU_VTAB
/begin COMPU_VTAB Dynamic1DMotionGoal "enumeration table" TAB_VERB 2 0 "doTargetBraking" 1 "followNotSupportedByEmg" /end COMPU_VTAB
/begin COMPU_VTAB Dynamic1DMotionGoal_v0 "enumeration table" TAB_VERB 1 0 "doTargetBraking" /end COMPU_VTAB
/begin COMPU_VTAB Dynamic2DMotionGoal "enumeration table" TAB_VERB 1 0 "evadeLaterallyByKeepingSafetyDistance" /end COMPU_VTAB
/begin COMPU_VTAB EAalAntenna "enumeration table" TAB_VERB 4 0 "AalAnt1" 1 "AalAnt2" 2 "AalAnt3" 160 "AalAntOff" /end COMPU_VTAB
/begin COMPU_VTAB EAalMsg "enumeration table" TAB_VERB 86 0 "enAalOk" 1 "enAalSpiFailed" 2 "enAalSpiTransferFailed" 3 "enAalRifConfigFailed" 4 "enAalWrongMmicaddr" 5 "enAalBufferNotempty" 6 "enAalBufferOverflow" 7 "enAalRmpmemOverflow" 8 "enAalRmpmemWriteFailed" 9 "enAalModparaNotset" 10 "enAalFwstateNotset" 11 "enAalStatemachineFailed" 12 "enAalHardresetFailed" 13 "enAalResetError" 14 "enAalRifResetFailed" 15 "enAalRifCalibFailed" 16 "enAalModrepeatctrMax" 17 "enAalWrongTramp" 18 "enAalWrongFstart" 19 "enAalWrongNfstep" 20 "enAalWrongNseq" 21 "enAalWrongMinfreq" 22 "enAalWrongMaxfreq" 23 "enAalWrongSamplefreq" 24 "enAalWrongAntChoice" 25 "enAalRamptime2small" 26 "enAalSetCwrampFailed" 27 "enAalWrongHighpassfreq" 28 "enAalWrongMinmaxfreq" 29 "enAalWrongNspon" 30 "enAalWrongDecfactor" 31 "enAalWrongFirmeware" 32 "enAalFirmwareTimeout" 33 "enAalFwresultsFailed" 34 "enAalDelOldFwFailed" 35 "enAalWrongRunfwNrparams" 36 "enAalWrongRunfwNrresult" 37 "enAalFwNotStarted" 38 "enAalFwStatusCountEmpty" 39 "enAalFwFailed" 40 "enAalFwAreaFailed" 41 "enAalRxsVersionFailed" 42 "enAalEnablerxtxFailed" 43 "enAalForcecalibFailed" 44 "enAalCalibsubfuncFailed" 45 "enAalMmicstatusError" 46 "enAalMmicstatusOkpinFailed" 47 "enAalMmicstatusRxError" 48 "enAalMmicstatusTxError" 49 "enAalMmicstatusRxtxError" 50 "enAalRfspCrcNotfound" 51 "enAalMonrsfpWritecrcErr" 52 "enAalMonrfspError" 53 "enAalMmicMissingFactorydata" 54 "enAalMmicVersionFactorydataError" 55 "enAalFirmewareRunning" 56 "enAalStatusUnknownFwstatus" 57 "enAalStatusCmdNotAllowed" 58 "enAalStatusInvalidSig" 59 "enAalStatusInvalidSetting" 60 "enAalStatusCalibError" 61 "enAalStatus77GhzPllUnlocked" 62 "enAalStatusBbError" 63 "enAalStatusParamError" 64 "enAalStatusInvalidCmd" 65 "enAalStatusUnderflow" 66 "enAalStatusOverflow" 67 "enAalStatusGeneralError" 68 "enAalStatusRmpError" 69 "enAalStatusMonLimitError" 70 "enAalStatusMonCrcError" 71 "enAalStatusError" 72 "enAalStatusUnknownCmd" 73 "enAalRmpRdyTrigFailed" 74 "enAalRmpTrigSignalFailed" 75 "enAalResetRmpTrigSignalFailed" 76 "enAalSetAfeRegForwardRmpFailed" 77 "enAalPadGuardFailed" 78 "enAalRxsVersionChargePumpNotSupported" 79 "enAalSpiTransferPreviousTransferFailed" 80 "enAalSpiTransferReadVerifyFailed" 81 "enAalSpiTransferReadFailed" 82 "enAalSpiTransferWriteVerifyFailed" 83 "enAalSpiTransferWriteFailed" 84 "enAalWriteFixRegFailed" 85 "enAalWriteFwAreaFailed" /end COMPU_VTAB
/begin COMPU_VTAB EAccMode "enumeration table" TAB_VERB 2 0 "base" 1 "stopAndGo" /end COMPU_VTAB
/begin COMPU_VTAB EAccStandStillActivationMode "enumeration table" TAB_VERB 2 0 "singleActivationStrategy" 1 "doubleActivationStrategy" /end COMPU_VTAB
/begin COMPU_VTAB_RANGE EBLDEVAL_X_SensorType "" 3 0 0 "SINGLE_SENSOR" 1 1 "MASTER_SENSOR" 2 2 "SLAVE_SENSOR" DEFAULT_VALUE "" /end COMPU_VTAB_RANGE
/begin COMPU_VTAB_RANGE EBLDIndicatorState "" 3 0 0 "INVALID" 1 1 "NOT_BLIND" 2 2 "BLIND" DEFAULT_VALUE "" /end COMPU_VTAB_RANGE
/begin COMPU_VTAB EBepProcstep "enumeration table" TAB_VERB 6 0 "enBepProcstepUntilDistx" 1 "enBepProcstepMoving" 2 "enBepProcstepEverySecond" 3 "enBepProcstepAllOther" 4 "enBepProcstepAllOtherDuplicate" 255 "enBepProcstepNotSet" /end COMPU_VTAB
/begin COMPU_VTAB EBepReflectionFilterStatus "enumeration table" TAB_VERB 20 0 "enValid" 1 "enNotProcessed" 2 "enInvalidDet" 3 "enDistanceLessZero" 4 "enRcsTooSmall" 5 "enDvqlyTooLow" 6 "enAngqlyTooLow" 7 "enAngqlyTooLowTwotarg" 8 "enMovingSnrTooLow" 9 "enVambMaxTooLow" 10 "enVambMax1Max2TooSimilar" 11 "enRcsNearrangeTooSmall" 12 "enPlantTest" 13 "enVambDiffFov" 14 "enAngSimoInsideMimoCentral" 15 "enInvalidInputDataVar" 16 "enRcsmaxNearrangeTooSmall" 17 "enVarInvalidCplxamps" 18 "enAngSnrsEqZero" 255 "enInValidNotSet" /end COMPU_VTAB
/begin COMPU_VTAB EBepReflectionPlsDeleteMode "enumeration table" TAB_VERB 4 0 "enPlsValid" 1 "enPlsDvqlyVambTooLow" 2 "enPlsLocintlistFull" 3 "enPlsLocextlistFull" /end COMPU_VTAB
/begin COMPU_VTAB_RANGE ECommandType "" 3 0 0 "NO_COMMAND" 1 1 "CONNECT" 2 2 "DISCONNECT" DEFAULT_VALUE "" /end COMPU_VTAB_RANGE
/begin COMPU_VTAB_RANGE EControlState "" 3 0 0 "CONTROL_STATE_NOUPDATE" 1 1 "CONTROL_STATE_START" 2 2 "CONTROL_STATE_STOP" DEFAULT_VALUE "" /end COMPU_VTAB_RANGE
/begin COMPU_VTAB_RANGE ECopyHandshake "" 3 0 0 "NOT_REQUIRED" 1 1 "REQUIRED" 2 2 "COPY_DONE" DEFAULT_VALUE "" /end COMPU_VTAB_RANGE
/begin COMPU_VTAB ECutInLevel "enumeration table" TAB_VERB 4 0 "no" 1 "low" 2 "medium" 3 "high" /end COMPU_VTAB
/begin COMPU_VTAB EDefaultState "enumeration table" TAB_VERB 3 0 "init" 1 "normal" 2 "na" /end COMPU_VTAB
/begin COMPU_VTAB_RANGE EDetailledErrorCode "" 60 0 0 "ERROR_CODE_NO_ERROR" 1 1 "ERROR_CODE_NVM_OK" 2 2 "ERROR_CODE_NVM_BUSY" 3 3 "ERROR_CODE_NVM_ERROR" 4 4 "ERROR_CODE_NVM_IDUNKNOWN" 5 5 "ERROR_CODE_NVM_WRONGLENGTH" 6 6 "ERROR_CODE_PARAM_DSDL_OK" 7 7 "ERROR_CODE_PARAM_DSDL_NOT_OK" 8 8 "ERROR_CODE_PARAM_DSDL_TRY_AGAIN_LATER" 9 9 "ERROR_CODE_PARAM_DSDL_BUSY" 10 10 "ERROR_CODE_PARAM_DSDL_POSSIBLE" 11 11 "ERROR_CODE_PARAM_ERASEPENDING" 12 12 "ERROR_CODE_PARAM_ERASEDONE" 13 13 "ERROR_CODE_PARAM_ERASEONGOING" 14 14 "ERROR_CODE_PARAM_ERASEFAILED" 15 15 "ERROR_CODE_PARAM_ERASEINIT" 16 16 "ERROR_CODE_PARAM_CRC_CORRECT" 17 17 "ERROR_CODE_PARAM_CRC_NOTCORRECT" 18 18 "ERROR_CODE_PARAM_CRC_INCOMPLETE" 19 19 "ERROR_CODE_PARAM_CRC_INIT" 20 20 "ERROR_CODE_DID_OK" 21 21 "ERROR_CODE_DID_OK_VARLENGTH" 22 22 "ERROR_CODE_ID_INVALIDRANGE" 23 23 "ERROR_CODE_DATA_INVALIDRANGE" 24 24 "ERROR_CODE_ACTIONNOTSUPPORTED" 25 25 "ERROR_CODE_SEQUENCEERROR" 26 26 "ERROR_CODE_CAN_BUSOFF" 27 27 "ERROR_CODE_CANMESSAGEERROR" 28 28 "ERROR_CODE_CANQBITERROR" 29 29 "ERROR_CODE_ENGINEISRUNNING" 30 30 "ERROR_CODE_VEHICLESPEEDTOOHIGH" 31 31 "ERROR_CODE_DID_INVALID" 32 32 "ERROR_CODE_ERROR_HIGHTEMPERATURE" 33 33 "ERROR_CODE_ERROR_HIGHVOLTAGE" 34 34 "ERROR_CODE_ERROR_LOWVOLTAGE" 35 35 "ERROR_CODE_INCORRECT_LENGTH" 36 36 "ERROR_CODE_DCMBUFFEROVERFLOW" 37 37 "ERROR_CODE_REPEAT_REQUEST" 38 38 "ERROR_CODE_ERROR_FAILUREPREVENTSEXECUTION" 39 39 "ERROR_CODE_REQ_OUT_OF_RANGE" 40 40 "ERROR_CODE_ACCESS_DENIED" 41 41 "ERROR_CODE_INCORRECT_KEY" 42 42 "ERROR_CODE_EXCEEDED_ATTEMPTS" 43 43 "ERROR_CODE_TIMERROR_CODE_DELAY_NOT_EXPIRED" 44 44 "ERROR_CODE_UP_DONWLOAD_NOT_ACCEPTED" 45 45 "ERROR_CODE_DATA_TRANSFER_SUSPENDED" 46 46 "ERROR_CODE_PROGRAMMING_FAILURE" 47 47 "ERROR_CODE_INCORRECT_BLOCK_SEQUENCE" 48 48 "ERROR_CODE_HIGH_RPM" 49 49 "ERROR_CODE_LOW_RPM" 50 50 "ERROR_CODE_ENGINERROR_CODE_NOT_RUNNING" 51 51 "ERROR_CODE_LOW_ENGINERROR_CODE_RUNTIME" 52 52 "ERROR_CODE_LOW_TEMPERATURE" 53 53 "ERROR_CODE_VEHICLE_SPEED_LOW" 54 54 "ERROR_CODE_WSCRH_OPEN_CIRCUIT" 55 55 "ERROR_CODE_CODING_NOT_AVAILABLE" 56 56 "ERROR_CODE_PARAM_NOT_AVAILABLE" 57 57 "ERROR_CODE_CALIBRATION_NOT_AVAILABLE" 58 58 "ERROR_CODE_COMPONENT_IN_ERROR_STATE" 59 59 "ERROR_CODE_COMPONENT_IN_INIT_STATE" DEFAULT_VALUE "" /end COMPU_VTAB_RANGE
/begin COMPU_VTAB_RANGE EDiaInternalStates "" 18 0 0 "DIA_INTERNAL_STATE_IDLE" 1 1 "DIA_INTERNAL_STATE_CHECK_START_REQUEST_PARAMS" 2 2 "DIA_INTERNAL_STATE_CHECK_PRECONDITIONS" 3 3 "DIA_INTERNAL_STATE_CHECK_START_COMPONENT_STATE" 4 4 "DIA_INTERNAL_STATE_INIT_ERROR" 5 5 "DIA_INTERNAL_STATE_WAITING_START" 6 6 "DIA_INTERNAL_STATE_START_ERROR" 7 7 "DIA_INTERNAL_STATE_WAITING_RUNNING" 8 8 "DIA_INTERNAL_STATE_CHECK_RUN_TO_STOP_REQUEST" 9 9 "DIA_INTERNAL_STATE_CHECK_STOP_CONDITIONS" 10 10 "DIA_INTERNAL_STATE_CHECK_STOP_COMPONENT_STATE" 11 11 "DIA_INTERNAL_STATE_TWICE_STARTED" 12 12 "DIA_INTERNAL_STATE_PROCESS_STOP" 13 13 "DIA_INTERNAL_STATE_WAITING_STOP" 14 14 "DIA_INTERNAL_STATE_STOP_ERROR" 15 15 "DIA_INTERNAL_STATE_STOPPED" 16 16 "DIA_INTERNAL_STATE_CHECK_IDLE_TO_STOP_REQUEST" 17 17 "DIA_INTERNAL_STATE_STOP_BUT_NEVER_STARTED" DEFAULT_VALUE "" /end COMPU_VTAB_RANGE
/begin COMPU_VTAB EDiaInternalStates_Copy1 "enumeration table" TAB_VERB 17 0 "DIA_INTERNAL_STATE_IDLE" 1 "DIA_INTERNAL_STATE_CHECK_START_REQUEST_PARAMS" 2 "DIA_INTERNAL_STATE_CHECK_PRECONDITIONS" 3 "DIA_INTERNAL_STATE_CHECK_START_COMPONENT_STATE" 4 "DIA_INTERNAL_STATE_INIT_ERROR" 5 "DIA_INTERNAL_STATE_START_ERROR" 6 "DIA_INTERNAL_STATE_WAITING_RUNNING" 7 "DIA_INTERNAL_STATE_CHECK_RUN_TO_STOP_REQUEST" 8 "DIA_INTERNAL_STATE_CHECK_STOP_CONDITIONS" 9 "DIA_INTERNAL_STATE_CHECK_STOP_COMPONENT_STATE" 10 "DIA_INTERNAL_STATE_TWICE_STARTED" 11 "DIA_INTERNAL_STATE_PROCESS_STOP" 12 "DIA_INTERNAL_STATE_WAITING_STOP" 13 "DIA_INTERNAL_STATE_STOP_ERROR" 14 "DIA_INTERNAL_STATE_STOPPED" 15 "DIA_INTERNAL_STATE_CHECK_IDLE_TO_STOP_REQUEST" 16 "DIA_INTERNAL_STATE_STOP_BUT_NEVER_STARTED" /end COMPU_VTAB
/begin COMPU_VTAB EDriveTrainConfig "enumeration table" TAB_VERB 3 0 "fwd" 1 "rwd" 2 "awd" /end COMPU_VTAB
/begin COMPU_VTAB EErrorIDs "enumeration table" TAB_VERB 36 70 "E_DataLostError" 71 "E_AssignFullDataLostError" 72 "E_ReleaseFullDataLostError" 73 "E_DataFullDataLostError" 74 "E_MempoolFullError" 75 "E_NoMempoolError" 76 "E_MempoolAlreadyConnected" 77 "E_ConnectCommandError" 78 "E_DisconnectCommandError" 79 "E_DoubleConnectError" 80 "E_RemoveSubscriberError" 81 "E_CRCError" 82 "E_PlacementReserveError" 83 "E_SizeMismatchError" 84 "E_InvalidPointerError" 85 "E_InvalidSequenceNumberError" 86 "E_SubscriberOverflowError" 87 "E_PortCommandOverflowError" 88 "E_RecorderOverflowError" 89 "E_InselSelectError" 90 "E_NoLastDeliveryToBeReservedError" 91 "E_SenderReceiverConcurrencyError" 92 "E_PortProxyUnassociatedError" 93 "E_PortProxyDoubleConnectionError" 94 "E_SenderPortInvalidProxyError" 95 "E_SenderPortDoubleProxyConnectionError" 96 "E_ReceiverPortInvalidProxyError" 97 "E_ReceiverPortDoubleProxyConnectionError" 98 "E_AssignError" 99 "E_AssignCounterError" 100 "E_ReleaseError" 101 "E_COOLSharedMemoryMemPoolError" 102 "E_COOLSharedMemoryMemSetPortDataPoolError" 103 "E_COOLInterDomainContainerError" 104 "E_MeasurementIdOutOfRange" 105 "E_IncorrectBaseClassError" /end COMPU_VTAB
/begin COMPU_VTAB ELineLength "enumeration table" TAB_VERB 7 0 "class0" 1 "class1" 2 "class2" 3 "class3" 4 "class4" 5 "class5" 6 "class6" /end COMPU_VTAB
/begin COMPU_VTAB EMainState "enumeration table" TAB_VERB 4 0 "init" 1 "normal" 2 "defaults" 3 "error" /end COMPU_VTAB
/begin COMPU_VTAB EManagerDatasetStatus "enumeration table" TAB_VERB 4 0 "notEvaluated" 1 "notAvailable" 2 "incompatible" 3 "valid" /end COMPU_VTAB
/begin COMPU_VTAB EMovementState "enumeration table" TAB_VERB 8 0 "none" 1 "moving" 2 "stopped" 3 "stationary" 4 "oncoming" 5 "stoppedOncoming" 6 "starting" 7 "crossing" /end COMPU_VTAB
/begin COMPU_VTAB EObjectClass "enumeration table" TAB_VERB 11 0 "point" 1 "pedestrian" 2 "bicycle" 3 "motorbike" 4 "car" 5 "truck" 6 "wide" 7 "animal" 8 "unknown" 9 "twoWheeler" 14 "noClass" /end COMPU_VTAB
/begin COMPU_VTAB EObjectLane "enumeration table" TAB_VERB 6 0 "noLane" 1 "ego" 2 "firstLeft" 3 "firstRight" 4 "secondLeft" 5 "secondRight" /end COMPU_VTAB
/begin COMPU_VTAB EObjectPreSelect "enumeration table" TAB_VERB 10 0 "notSelected" 1 "firstEgo" 2 "secondEgo" 3 "firstLeft" 4 "secondLeft" 5 "otherLeftCutIn" 6 "firstRight" 7 "secondRight" 8 "otherCutInRight" 9 "crossing" /end COMPU_VTAB
/begin COMPU_VTAB EObjectQualifierCMS "enumeration table" TAB_VERB 4 0 "noQual" 1 "longCollisionWarn" 2 "longCollisionBrake" 3 "fusion" /end COMPU_VTAB
/begin COMPU_VTAB EObjectQualifierDTR "enumeration table" TAB_VERB 3 0 "noQual" 1 "accept" 2 "fusion" /end COMPU_VTAB
/begin COMPU_VTAB EObstacleClassification "enumeration table" TAB_VERB 4 0 "noClass" 1 "obstacleHigh" 2 "obstacleLow" 3 "noObstacle" /end COMPU_VTAB
/begin COMPU_VTAB EOrientAngle "enumeration table" TAB_VERB 10 0 "noObject" 1 "deg_0_360" 2 "deg_45" 3 "deg_90" 4 "deg_135" 5 "deg_180" 6 "deg_225" 7 "deg_270" 8 "deg_315" 9 "no_angle" /end COMPU_VTAB
/begin COMPU_VTAB EOrientAngleFault "enumeration table" TAB_VERB 4 0 "pm_180" 1 "pm_90" 2 "pm_45" 3 "pm_22d5" /end COMPU_VTAB
/begin COMPU_VTAB EReferenceVelocityConfig "enumeration table" TAB_VERB 3 0 "none" 1 "radar" 2 "gnss" /end COMPU_VTAB
/begin COMPU_VTAB ERifStatus "enumeration table" TAB_VERB 12 0 "enRifOk" 1 "enRifConfEnableTimeoutErr" 2 "enRifConfDisableTimeoutErr" 3 "enRifConfResetTimeoutErr" 4 "enRifDataCrcErr" 5 "enRifDataCounterErr" 6 "enRifDfuLkstpErr" 7 "enRifRegCrcErr" 8 "enRifSftyCtrlErr" 9 "enRifCalDeskewErr" 10 "enRifCalTimeoutErr" 11 "enRifHwRegisterErr" /end COMPU_VTAB
/begin COMPU_VTAB ERxsOcpDir "enumeration table" TAB_VERB 3 -1 "enOcpDirIgnore" 0 "enOcpDirDown" 1 "enOcpDirUp" /end COMPU_VTAB
/begin COMPU_VTAB ESacEpsPfArchType "enumeration table" TAB_VERB 3 0 "EpsMotorTorqueCoordination" 1 "EpsTbtCoordination" 2 "EpsMotorTorqueCoordinationJlr" /end COMPU_VTAB
/begin COMPU_VTAB ESetSpeedRoundingStrategy "enumeration table" TAB_VERB 3 0 "roundingDown" 1 "roundingUp" 2 "roundingNearest" /end COMPU_VTAB
/begin COMPU_VTAB_RANGE EState "" 2 0 0 "NET_VALID" 1 1 "NET_ERROR_INVALID" DEFAULT_VALUE "" /end COMPU_VTAB_RANGE
/begin COMPU_VTAB EStatus "enumeration table" TAB_VERB 4 0 "init" 1 "passive" 2 "active" 255 "error" /end COMPU_VTAB
/begin COMPU_VTAB ESteeringAngleCalibrationType "enumeration table" TAB_VERB 3 0 "SteeringAngleCalibrationOff" 1 "SteeringAngleCalibrationAngleOn" 2 "SteeringAngleCalibrationYawRateOn" /end COMPU_VTAB
/begin COMPU_VTAB ESteeringTorqueCalibrationType "enumeration table" TAB_VERB 2 0 "SteeringTorqueCalibrationOff" 1 "SteeringTorqueCalibrationOn" /end COMPU_VTAB
/begin COMPU_VTAB ETimeGapProcessesingStrategy "enumeration table" TAB_VERB 2 0 "readTimeGapIndex" 1 "calculateTimeGapIndex" /end COMPU_VTAB
/begin COMPU_VTAB EVarSrchRng "enumeration table" TAB_VERB 3 0 "enSrPre" 1 "enSrSo" 2 "enSrAll" /end COMPU_VTAB
/begin COMPU_VTAB EVarSteps "enumeration table" TAB_VERB 5 0 "enNoStep" 1 "enPreStep" 2 "enPreStepTt" 3 "enSoStep" 4 "enAllStep" /end COMPU_VTAB
/begin COMPU_VTAB EVariantIdx "enumeration table" TAB_VERB 5 0 "na" 0 "ods_emg_drivemode_comfort_all" 1 "ods_emg_drivemode_dynamic_all" 2 "ods_emg_drivemode_eco_all" 3 "ods_emg_drivemode_normal_all" /end COMPU_VTAB
/begin COMPU_VTAB EVariantIdx_Copy1 "enumeration table" TAB_VERB 3 0 "na" 0 "ods_defender_all" 1 "ods_golf_all" /end COMPU_VTAB
/begin COMPU_VTAB EgoLaneChangeDirection "enumeration table" TAB_VERB 3 0 "none" 1 "left" 2 "right" /end COMPU_VTAB
/begin COMPU_VTAB EgoLaneChangePossibility "enumeration table" TAB_VERB 3 0 "unknown" 1 "possible" 2 "notPossible" /end COMPU_VTAB
/begin COMPU_VTAB EgoLaneChangeSituation "enumeration table" TAB_VERB 4 0 "invalid" 1 "slowSpeed" 2 "city" 3 "highway" /end COMPU_VTAB
/begin COMPU_VTAB EgoLaneChangeState "enumeration table" TAB_VERB 6 0 "inactive" 1 "intended" 2 "aborted" 3 "executed" 4 "returnToStartLane" 5 "finished" /end COMPU_VTAB
/begin COMPU_VTAB EmsStandstillIndication "enumeration table" TAB_VERB 3 0 "notStandstill" 1 "standstill" 3 "standstillReliable" /end COMPU_VTAB
/begin COMPU_VTAB EmsWheelMovingDirection "enumeration table" TAB_VERB 4 0 "undetermined" 1 "forward" 2 "backward" 3 "wheelStandstill" /end COMPU_VTAB
/begin COMPU_VTAB EntryState "enumeration table" TAB_VERB 3 0 "init" 1 "upToDate" 2 "writing" /end COMPU_VTAB
/begin COMPU_VTAB EstConstraintMode "enumeration table" TAB_VERB 4 0 "NONE" 1 "LIMIT_MIN" 2 "LIMIT_MAX" 3 "CONST" /end COMPU_VTAB
/begin COMPU_VTAB Etype_Postprocessing_SteeringInterfaceType "enumeration table" TAB_VERB 2 0 "Angle" 1 "Torque" /end COMPU_VTAB
/begin COMPU_VTAB_RANGE EventId "" 44 0 0 "RIF_CONF_ENABLE_TIMEOUT" 1 1 "RIF_CONF_DISABLE_TIMEOUT" 2 2 "RIF_CONF_RESET_TIMEOUT" 3 3 "RIF_DATA_CRC" 4 4 "RIF_DATA_COUNTER" 5 5 "RIF_DFU_LKSTP" 6 6 "RIF_REG_CRC" 7 7 "RIF_SFTY_CTRL" 8 8 "RIF_CAL_DESKEW" 9 9 "RIF_CAL_TIMEOUT" 10 10 "SPU_INT_TIMEOUT" 11 11 "SPU_MON_STAT_REG" 12 12 "SPU_HW_INIT" 13 13 "SPU_SBST" 14 14 "MMIC_CONFIG_FAILED" 15 15 "MMIC_MODRUN_FAILED" 16 16 "MMIC_EVALMON_FAILED" 17 17 "MMIC_TXLOWPOW_ERR" 18 18 "MMIC_TXAMPDRFT_ERR" 19 19 "MMIC_TXPHADRFT_ERR" 20 20 "MMIC_RXAMPDRFT_ERR" 21 21 "MMIC_RXPHADRFT_ERR" 22 22 "MMIC_RXGAIN_ERR" 23 23 "MMIC_RXCORFRQ_ERR" 24 24 "MMIC_UNDERVOLT_ERR" 25 25 "MMIC_BALLBREAK_ERR" 26 26 "MMIC_MBC_ERR" 27 27 "MMIC_OVERVOLT_ERR" 28 28 "MMIC_PLLDLDUNLOCK_ERR" 29 29 "MMIC_SPISEGV_ERR" 30 30 "MMIC_LVDS_ERR" 31 31 "MMIC_RMP_ERR" 32 32 "MMIC_RFSP_ERR" 33 33 "MMIC_SNR_ERR" 34 34 "MMIC_OVERTEMP_ERR" 35 35 "MMIC_VERSION_FACTORYDATA_ERR" 36 36 "MMIC_MISSING_FACTORYDATA" 37 37 "ANTENNA_DIAGRAM_ERR" 38 38 "ERROR_DSP_INTERNAL" 39 39 "SPU_CONF_SLOT_REG_CRC" 40 40 "RIF_HW_REGISTER_ERR" 41 41 "SPU_EMEM_INTERFACE" 42 42 "SPU_RIF_INTERFACE" 43 43 "EVENTS_SIZE" DEFAULT_VALUE "" /end COMPU_VTAB_RANGE
/begin COMPU_VTAB EventId_Copy1 "enumeration table" TAB_VERB 46 0 "RIF_CONF_ENABLE_TIMEOUT" 1 "RIF_CONF_DISABLE_TIMEOUT" 2 "RIF_CONF_RESET_TIMEOUT" 3 "RIF_DATA_CRC" 4 "RIF_DATA_COUNTER" 5 "RIF_DFU_LKSTP" 6 "RIF_REG_CRC" 7 "RIF_SFTY_CTRL" 8 "RIF_CAL_DESKEW" 9 "RIF_CAL_TIMEOUT" 10 "SPU_INT_TIMEOUT" 11 "SPU_MON_STAT_REG" 12 "SPU_HW_INIT" 13 "SPU_SBST" 14 "MMIC_CONFIG_FAILED" 15 "MMIC_MODRUN_FAILED" 16 "MMIC_EVALMON_FAILED" 17 "MMIC_TXLOWPOW_ERR" 18 "MMIC_TXAMPDRFT_ERR" 19 "MMIC_TXPHADRFT_ERR" 20 "MMIC_RXAMPDRFT_ERR" 21 "MMIC_RXPHADRFT_ERR" 22 "MMIC_RXGAIN_ERR" 23 "MMIC_RXCORFRQ_ERR" 24 "MMIC_UNDERVOLT_ERR" 25 "MMIC_BALLBREAK_ERR" 26 "MMIC_MBC_ERR" 27 "MMIC_OVERVOLT_ERR" 28 "MMIC_PLLDLDUNLOCK_ERR" 29 "MMIC_SPISEGV_ERR" 30 "MMIC_LVDS_ERR" 31 "MMIC_RMP_ERR" 32 "MMIC_RFSP_ERR" 33 "MMIC_SNR_ERR" 34 "MMIC_OVERTEMP_ERR" 35 "MMIC_VERSION_FACTORYDATA_ERR" 36 "MMIC_MISSING_FACTORYDATA" 37 "ANTENNA_DIAGRAM_ERR" 38 "DSP_INTERNAL_ASSERT" 39 "SPU_CONF_SLOT_REG_CRC" 40 "RIF_HW_REGISTER_ERR" 41 "SPU_EMEM_INTERFACE" 42 "SPU_RIF_INTERFACE" 43 "MMIC_INTERNAL_ERR" 44 "SPU_EXEC_TIME" 45 "EVENTS_SIZE" /end COMPU_VTAB
/begin COMPU_VTAB EventId_Copy2 "enumeration table" TAB_VERB 49 0 "RIF_CONF_ENABLE_TIMEOUT" 1 "RIF_CONF_DISABLE_TIMEOUT" 2 "RIF_CONF_RESET_TIMEOUT" 3 "RIF_DATA_CRC" 4 "RIF_DATA_COUNTER" 5 "RIF_DFU_LKSTP" 6 "RIF_REG_CRC" 7 "RIF_SFTY_CTRL" 8 "RIF_CAL_DESKEW" 9 "RIF_CAL_TIMEOUT" 10 "SPU_INT_TIMEOUT" 11 "SPU_MON_STAT_REG" 12 "SPU_HW_INIT" 13 "SPU_SBST" 14 "MMIC_CONFIG_FAILED" 15 "MMIC_MODRUN_FAILED" 16 "MMIC_EVALMON_FAILED" 17 "MMIC_TXLOWPOW_ERR" 18 "MMIC_TXAMPDRFT_ERR" 19 "MMIC_TXPHADRFT_ERR" 20 "MMIC_RXAMPDRFT_ERR" 21 "MMIC_RXPHADRFT_ERR" 22 "MMIC_RXGAIN_ERR" 23 "MMIC_RXCORFRQ_ERR" 24 "MMIC_UNDERVOLT_ERR" 25 "MMIC_BALLBREAK_ERR" 26 "MMIC_MBC_ERR" 27 "MMIC_OVERVOLT_ERR" 28 "MMIC_PLLDLDUNLOCK_ERR" 29 "MMIC_SPISEGV_ERR" 30 "MMIC_LVDS_ERR" 31 "MMIC_RMP_ERR" 32 "MMIC_RFSP_ERR" 33 "MMIC_SNR_ERR" 34 "MMIC_OVERTEMP_ERR" 35 "MMIC_VERSION_FACTORYDATA_ERR" 36 "MMIC_MISSING_FACTORYDATA" 37 "ANTENNA_DIAGRAM_ERR" 38 "DSP_INTERNAL_ASSERT" 39 "SPU_CONF_SLOT_REG_CRC" 40 "RIF_HW_REGISTER_ERR" 41 "SPU_EMEM_INTERFACE" 42 "SPU_RIF_INTERFACE" 43 "MMIC_INTERNAL_ERR" 44 "SPU_EXEC_TIME" 45 "SPU_CTRL_FLOW_CRC" 46 "SPU_SM_CTRL_STAT" 47 "SPU_ERR_INT" 48 "EVENTS_SIZE" /end COMPU_VTAB
/begin COMPU_VTAB EventId_Copy3 "enumeration table" TAB_VERB 57 0 "enRifConfEnableTimeout" 1 "enRifConfDisableTimeout" 2 "enRifConfResetTimeout" 3 "enRifDataCrc" 4 "enRifDataCounter" 5 "enRifDfuLkstp" 6 "enRifRegCrc" 7 "enRifSftyCtrl" 8 "enRifCalDeskew" 9 "enRifCalTimeout" 10 "enSpuIntTimeout" 11 "enSpuMonStatReg" 12 "enSpuHwInit" 13 "enSpuSbst" 14 "enMmicConfigFailed" 15 "enMmicModrunFailed" 16 "enMmicEvalmonFailed" 17 "enMmicTxlowpowErr" 18 "enMmicTxampdrftErr" 19 "enMmicTxphadrftErr" 20 "enMmicRxampdrftErr" 21 "enMmicRxphadrftErr" 22 "enMmicRxgainErr" 23 "enMmicRxcorfrqErr" 24 "enMmicUndervoltErr" 25 "enMmicBallbreakErr" 26 "enMmicMbcErr" 27 "enMmicOvervoltErr" 28 "enMmicPlldldunlockErr" 29 "enMmicSpisegvErr" 30 "enMmicLvdsErr" 31 "enMmicRmpErr" 32 "enMmicRfspErr" 33 "enMmicSnrErr" 34 "enMmicOvertempErr" 35 "enMmicVersionFactorydataErr" 36 "enMmicMissingFactorydata" 37 "enAntennaDiagramErr" 38 "enDspInternalAssert" 39 "enSpuConfSlotRegCrc" 40 "enRifHwRegister" 41 "enSpuEmemInterface" 42 "enSpuRifInterface" 43 "enMmicInternalErr" 44 "enSpuExecTime" 45 "enSpuCtrlFlowCrc" 46 "enSpuSmCtrlStat" 47 "enSpuErrInt" 48 "enSpuCmemDataInconsistency" 49 "enMmicMbcErrLt" 50 "enMmicBallbreakErrLt" 51 "enMmicPlldldunlockErrLt" 52 "enMmicOvertempState" 53 "enDspInputRangeErr" 54 "enDspMissedCycleErr" 55 "enDspCycleTimeExceededErr" 56 "enEventsSize" /end COMPU_VTAB
/begin COMPU_VTAB EventStatus "enumeration table" TAB_VERB 7 0 "noUpdate" 1 "passed" 2 "failed" 3 "prePassed" 4 "preFailed" 5 "freeze" 6 "reset" /end COMPU_VTAB
/begin COMPU_VTAB_RANGE ExecutionRecommendation "" 3 0 0 "INVALID_AND_NOT_RECOMMENDED" 1 1 "VALID_BUT_NOT_RECOMMENDED" 2 2 "VALID_AND_RECOMMENDED" DEFAULT_VALUE "" /end COMPU_VTAB_RANGE
/begin COMPU_VTAB EyesOnRoad "enumeration table" TAB_VERB 4 0 "unknown" 1 "eyesOnRoad" 2 "eyesOffRoadDrivingTaskRelated" 3 "eyesOffRoadNotDrivingTaskRelated" /end COMPU_VTAB
/begin COMPU_VTAB_RANGE FCTRequest "" 4 0 0 "FCTREQ_NO_REQUEST" 1 1 "FCTREQ_HOLD" 2 2 "FCTREQ_ACKNOWLEDGE" 3 3 "FCTREQ_DRIVE_OFF" DEFAULT_VALUE "" /end COMPU_VTAB_RANGE
/begin COMPU_VTAB FCTRequest_Copy1 "enumeration table" TAB_VERB 3 0 "FCTREQ_NO_REQUEST" 1 "FCTREQ_DRIVE_OFF" 2 "FCTREQ_HOLD" /end COMPU_VTAB
/begin COMPU_VTAB FEP_Statemachine_State_t "enumeration table" TAB_VERB 7 0 "FepStateSpuBypass" 1 "FepStateMod1stFft" 2 "FepStateIcmProc" 3 "FepState2ndFftIntDet" 4 "FepStateLog2PowSpect" 5 "FepStateDone" 6 "FepStateError" /end COMPU_VTAB
/begin COMPU_VTAB FadeStrategy "enumeration table" TAB_VERB 3 0 "immediate" 1 "fast" 2 "soft" /end COMPU_VTAB
/begin COMPU_VTAB FailureClusterStatus "enumeration table" TAB_VERB 2 0 "active" 1 "inactive" /end COMPU_VTAB
/begin COMPU_VTAB FctFunctionId "enumeration table" TAB_VERB 39 0 "invalid" 1 "aebTiplLongLatentInformation" 2 "aebTiplLongPrePrecedingWarning" 3 "aebTiplLongWarningAcoustic" 4 "aebTiplLongWarningHaptic" 5 "aebTiplLongPrefill" 6 "aebTiplLongPartialBrake" 7 "aebTiplLongFullBrake" 8 "aebTiplLongEba" 9 "aebTiplLongEss" 10 "aebTiplLongAes" 11 "aebTiplLongOncomingPrefill" 12 "aebTiplLongOncomingFullBrake" 13 "aebTiplLongOncomingEba" 14 "aebTiplLongOncomingEss" 15 "aebTiplLongOncomingAes" 16 "aebCfmStartPrevention" 17 "aebCfmWarningAcoustic" 18 "aebCfmPrefill" 19 "aebCfmFullBrake" 20 "aebCfmEba" 21 "aebTiplTurnPrefill" 22 "aebTiplTurnFullBrake" 23 "aebTixlWarningAcoustic" 24 "aebTixlPrefill" 25 "aebTixlFullBrake" 26 "aebStandstill" 27 "alc" 28 "est" 29 "hfLong" 30 "hfLongLat" 31 "lksLat" 32 "lssElkReH" 33 "lssElkReV" 34 "lssElkOcv" 35 "lssElkOt" 36 "lssElkPed" 37 "lssLdwLat" 38 "lssLkaLat" /end COMPU_VTAB
/begin COMPU_VTAB FcwSetting "enumeration table" TAB_VERB 8 0 "earlyWarning" 1 "mediumWarning" 2 "lateWarning" 3 "autoTimedWarning" 4 "customerMode0" 5 "customerMode1" 6 "customerMode2" 7 "customerMode3" /end COMPU_VTAB
/begin COMPU_VTAB FilterMode "enumeration table" TAB_VERB 3 0 "None" 1 "Weak" 2 "Strong" /end COMPU_VTAB
/begin COMPU_VTAB FilteringPhase "enumeration table" TAB_VERB 3 0 "Init" 1 "Filtering" 2 "Inactive" /end COMPU_VTAB
/begin COMPU_VTAB FocAccSoStates "enumeration table" TAB_VERB 3 0 "inactive" 1 "partial" 2 "full" /end COMPU_VTAB
/begin COMPU_VTAB FocMainStates "enumeration table" TAB_VERB 4 0 "passive" 1 "active" 2 "suspend" 3 "standstill" /end COMPU_VTAB
/begin COMPU_VTAB FourTruthValue "enumeration table" TAB_VERB 4 0 "no" 1 "yes" 2 "unknown" 3 "infoNotAvailable" /end COMPU_VTAB
/begin COMPU_VTAB FusionUpdateType "enumeration table" TAB_VERB 2 0 "Kalman1DStandard" 1 "Kalman1DWithVarianceAnalysis" /end COMPU_VTAB
/begin COMPU_VTAB HSM_FunctionTag "enumeration table" TAB_VERB 77 0 "HSM_FUNC_NONE" 1 "HSM_FUNC_VERSION" 2 "HSM_FUNC_DIAGNOSTICS" 3 "HSM_FUNC_SESSION_LOGIN" 4 "HSM_FUNC_SESSION_LOGOUT" 5 "HSM_FUNC_SESSION_STATUS" 6 "HSM_FUNC_SESSION_CLOSE" 7 "HSM_FUNC_CANCEL_JOB" 8 "HSM_FUNC_CHECKSUM_START" 9 "HSM_FUNC_CHECKSUM_UPDATE" 10 "HSM_FUNC_CHECKSUM_FINISH" 11 "HSM_FUNC_HASH_START" 12 "HSM_FUNC_HASH_UPDATE" 13 "HSM_FUNC_HASH_FINISH" 14 "HSM_FUNC_SIGN_GENERATE_START" 15 "HSM_FUNC_SIGN_GENERATE_UPDATE" 16 "HSM_FUNC_SIGN_GENERATE_FINISH" 17 "HSM_FUNC_SIGN_VERIFY_START" 18 "HSM_FUNC_SIGN_VERIFY_UPDATE" 19 "HSM_FUNC_SIGN_VERIFY_FINISH" 20 "HSM_FUNC_MAC_GENERATE_START" 21 "HSM_FUNC_MAC_GENERATE_UPDATE" 22 "HSM_FUNC_MAC_GENERATE_FINISH" 23 "HSM_FUNC_MAC_VERIFY_START" 24 "HSM_FUNC_MAC_VERIFY_UPDATE" 25 "HSM_FUNC_MAC_VERIFY_FINISH" 26 "HSM_FUNC_ENCRYPT_START" 27 "HSM_FUNC_ENCRYPT_UPDATE" 28 "HSM_FUNC_ENCRYPT_FINISH" 29 "HSM_FUNC_DECRYPT_START_X" 30 "HSM_FUNC_DECRYPT_UPDATE_X" 31 "HSM_FUNC_DECRYPT_FINISH_X" 32 "HSM_FUNC_AUTH_ENCRYPT_START" 33 "HSM_FUNC_AUTH_UPDATE" 34 "HSM_FUNC_AUTH_ENCRYPT_FINISH" 35 "HSM_FUNC_AUTH_DECRYPT_START_X" 36 "HSM_FUNC_AUTH_DECRYPT_FINISH_X" 37 "HSM_FUNC_ASYM_ENCRYPT" 38 "HSM_FUNC_ASYM_DECRYPT" 39 "HSM_FUNC_RANDOM_GENERATE" 40 "HSM_FUNC_TRUE_RANDOM_GENERATE" 41 "HSM_FUNC_RANDOM_SEED_EXTEND" 42 "HSM_FUNC_SHE_ENCRYPT_ECB" 43 "HSM_FUNC_SHE_DECRYPT_ECB" 44 "HSM_FUNC_SHE_ENCRYPT_CBC" 45 "HSM_FUNC_SHE_DECRYPT_CBC" 46 "HSM_FUNC_SHE_MAC_GENERATE" 47 "HSM_FUNC_SHE_MAC_VERIFY" 48 "HSM_FUNC_SHE_LOAD_KEY" 49 "HSM_FUNC_SHE_LOAD_KEY_EXTENDED" 50 "HSM_FUNC_SHE_LOAD_PLAIN_KEY" 51 "HSM_FUNC_SHE_EXPORT_RAM_KEY" 52 "HSM_FUNC_SHE_GET_ID" 53 "HSM_FUNC_SHE_INIT_RNG" 54 "HSM_FUNC_SHE_EXTEND_SEED" 55 "HSM_FUNC_SHE_RND" 56 "HSM_FUNC_SHE_SECURE_BOOT" 57 "HSM_FUNC_SHE_SECURE_BOOT_FAILURE" 58 "HSM_FUNC_SHE_SECURE_BOOT_OK" 59 "HSM_FUNC_SHE_DEBUG_CHALLENGE" 60 "HSM_FUNC_SHE_DEBUG_AUTHORIZE" 61 "HSM_FUNC_CHECKSUM" 62 "HSM_FUNC_HASH" 63 "HSM_FUNC_MAC_GENERATE" 64 "HSM_FUNC_MAC_VERIFY" 65 "HSM_FUNC_ENCRYPT" 66 "HSM_FUNC_DECRYPT" 67 "HSM_FUNC_AUTH_ENCRYPT" 68 "HSM_FUNC_AUTH_DECRYPT_X" 69 "HSM_FUNC_SIGN_GENERATE" 70 "HSM_FUNC_SIGN_VERIFY" 71 "HSM_FUNC_DATA_READ_ADAPTED2APP" 72 "HSM_FUNC_DATA_WRITE_ADAPTED2APP" 73 "HSM_FUNC_DATA_DELETE_ADAPTED2APP" 74 "HSM_FUNC_BULK_MAC_VERIFY" 75 "HSM_FUNC_BULK_MAC_GENERATE" 2147483647 "HSM_FUNC_RESERVED" /end COMPU_VTAB
/begin COMPU_VTAB HSM_ModeTag "enumeration table" TAB_VERB 8 1 "HSM_MODE_NOT_STARTED" 2 "HSM_MODE_BOOTING" 3 "HSM_MODE_BOOTLOADER" 4 "HSM_MODE_CORE_APP" 5 "HSM_MODE_INVALID" 6 "HSM_MODE_CORE_APP_STOPPED" 7 "HSM_MODE_SUSPENDED" 2147483647 "HSM_MODE_RESERVED" /end COMPU_VTAB
/begin COMPU_VTAB HSM_PortStatusTag "enumeration table" TAB_VERB 5 0 "HSM_STATUS_IDLE" 1 "HSM_STATUS_PENDING" 2 "HSM_STATUS_PROCESSING" 3 "HSM_STATUS_COMPLETE" 2147483647 "HSM_PORTSTATUS_RESERVED" /end COMPU_VTAB
/begin COMPU_VTAB HV_SERVICE_AVAILABILITY_STATES "enumeration table" TAB_VERB 4 0 "UNAVAILABLE" 1 "AVAILABLE" 2 "HEALING" 3 "DEGRADING" /end COMPU_VTAB
/begin COMPU_VTAB HandsOnDetectionInputData "enumeration table" TAB_VERB 4 0 "notProvided" 1 "unknown" 2 "noValidContactDetected" 3 "validContactDetected" /end COMPU_VTAB
/begin COMPU_VTAB HandsOnDetectionSensorType "enumeration table" TAB_VERB 3 0 "unknown" 1 "torque" 2 "capacitive" /end COMPU_VTAB
/begin COMPU_VTAB HandsOnDetectionState "enumeration table" TAB_VERB 3 0 "noValidData" 1 "noValidContact" 2 "validContact" /end COMPU_VTAB
/begin COMPU_VTAB_RANGE HapticWarningViaBrakeProfile "" 2 0 0 "NO_WARNING" 7 7 "MAX_SEVERITY" DEFAULT_VALUE "" /end COMPU_VTAB_RANGE
/begin COMPU_VTAB HazardLightsStatus "enumeration table" TAB_VERB 2 0 "notActive" 1 "active" /end COMPU_VTAB
/begin COMPU_VTAB HmiAudioNotificationIdEnum "enumeration table" TAB_VERB 6 0 "noSoundNotification" 1 "notification" 2 "warning" 3 "minimalRiskManeuverSafeStop" 4 "handsOffWarningStage3" 5 "lcrAudioNotification" /end COMPU_VTAB
/begin COMPU_VTAB HmiAuxiliarySymbolEnum "enumeration table" TAB_VERB 23 0 "noDisplay" 1 "collisionWarningBlue" 2 "collisionWarningYellow" 3 "collisionWarningOrange" 4 "collisionWarningRed" 5 "latentWarningIcon" 6 "handsOnAnimationTakeOverRequestYellow" 7 "handsOnAnimationTakeOverRequestRed" 8 "elkAuxiliarySymbolLeft" 9 "elkAuxiliarySymbolRight" 10 "roundaboutSymbol" 11 "strongBrakingAreaSymbol" 12 "dynamicAreaPassedSymbol" 13 "stop" 14 "speedBump" 15 "trafficLights" 16 "railwayCrossing" 17 "yield" 18 "friction" 19 "noCloudConnection" 20 "intersectionWithPriorityIssue" 21 "unknownWarning" 22 "pedestrianCrossing" /end COMPU_VTAB
/begin COMPU_VTAB HmiDisplayedTextMessageIdEnum "enumeration table" TAB_VERB 90 0 "noDisplay" 1 "approachingUnreleasedHighwaySection" 2 "unreleasedHighwaySection" 3 "approachingEndOfHighway" 4 "vehicleNotOnHighway" 5 "laneMarkingsNotPresent" 6 "approachingEndOfLane" 7 "endOfLane" 8 "approachingNarrowLane" 9 "laneWidthTooNarrow" 10 "approachingNarrowCurve" 11 "narrowCurve" 12 "approachingTunnel" 13 "tunnel" 14 "approachingTollGate" 15 "tollGates" 16 "approachingHighwayExit" 17 "highwayExit" 18 "pleaseApplyBrakes" 19 "frontVehicleTooClose" 20 "espIntervention" 21 "espSwitchedOff" 22 "sensorBlocked" 23 "reduceSetSpeed" 24 "aboveSpeedRange" 25 "wrongGearSelected" 26 "otherDriverAssistanceFunctionActive" 27 "pleaseFocusOnTheRoad" 28 "driverNotFocusedOnTheRoad" 29 "pleaseTakeABreak" 30 "takeABreak" 31 "cameraUnableToSeeFace" 32 "pleaseFastenSeatbelt" 33 "seatbeltUnfastened" 34 "openVehicleDoor" 35 "pleaseRemainReadyToInterveneAtAllTimes" 36 "driverMustRemainReadyToInterveneAtAllTimes" 37 "pleaseTakeOverVehicleControl" 38 "hwaHandsfreeNotAvailable" 39 "vehicleStoppingTakeOverVehicleControl" 40 "pleasePutYourHandsOnTheWheel" 41 "pleasePutYourHandsOnTheWheelToConductAutomatedLaneChange" 42 "shwaNotAvailable" 43 "shwaHandsfreeNotAvailable" 44 "speedOutOfRangeRemind" 45 "pleaseHoldTheSteer" 46 "welcomeToHwaHandsfree" 47 "driverDeactivation" 48 "hwaReadyToActivate" 49 "hfNotAvailableDueToProhibition" 50 "neighbouringVehicleTooClose" 51 "behaveAccordingToTheIntendedSystemUsage" 52 "roadConditionInsufficient" 53 "videoSensorBlocked" 54 "adjacentLaneObstructedAlcDisallowed" 55 "activationConditionsForAlcNotFulfilled" 56 "alcFailure" 57 "radarSensorDisturbedForwardSafetyNotAvailable" 58 "radarSensorBlockedAccAndFsfNotAvailable" 59 "laneSystemsFailureContactLocalDealer" 60 "safetyAndComfortFeaturesNotAvailPleaseClearWindscreen" 61 "laneDepartureWarningActive" 62 "emergencyLaneKeepingRoadEdgeHorizontalActive" 63 "emergencyLaneKeepingRoadEdgeVerticalActive" 64 "emergencyLaneKeepingOncomingVehicleActive" 65 "emergencyLaneKeepingSolidLineActive" 66 "emergencyLaneKeepingOvertakingVehicleActive" 67 "vehicleStoppingInLaneTakeOverVehicleControl" 68 "vehicleStoppingInNearStandstillTakeOverVehicleControl" 69 "vehicleStoppingInSecuredStandstillTakeOverVehicleControl" 70 "frequentLaneChangeAreaFollowDistanceIncreased" 71 "dynamicAreaPassed" 72 "bdaNotAvailableDueToMissingVideoSensorInformation" 73 "strongBrakingArea" 74 "roundaboutAhead" 75 "laneChangeLeftTakeOverVehicleControl" 76 "laneChangeRightTakeOverVehicleControl" 77 "stop" 78 "speedBump" 79 "trafficLights" 80 "railwayCrossing" 81 "yield" 82 "roundabout" 83 "friction" 84 "noCloudConnection" 85 "intersectionWithPriorityIssue" 86 "unknownWarning" 87 "pedestrianCrossing" 88 "adasInitializing" 89 "accIsInFailureState" /end COMPU_VTAB
/begin COMPU_VTAB HmiHandOfTraffic "enumeration table" TAB_VERB 3 0 "unkown" 1 "left" 2 "right" /end COMPU_VTAB
/begin COMPU_VTAB HmiHwaStatusEnum "enumeration table" TAB_VERB 8 0 "noDisplay" 1 "notAvailable" 2 "available" 3 "active" 4 "longitudinalOverride" 5 "lateralOverride" 6 "error" 7 "reserved" /end COMPU_VTAB
/begin COMPU_VTAB HmiIndicatorLampRequestSide "enumeration table" TAB_VERB 3 0 "noRequest" 1 "leftIndicatorLampOn" 2 "rightIndicatorLampOn" /end COMPU_VTAB
/begin COMPU_VTAB HmiPopupTextMessageEnum "enumeration table" TAB_VERB 4 0 "normalNotification" 1 "popupMessageCenter" 2 "popupMessageRight" 3 "popupMessageLeft" /end COMPU_VTAB
/begin COMPU_VTAB HmiSymbolColorSetSpeedEnum "enumeration table" TAB_VERB 8 0 "noDisplay" 1 "gray" 2 "white" 3 "green" 4 "yellow" 5 "red" 6 "blue" 7 "redFlashing" /end COMPU_VTAB
/begin COMPU_VTAB_RANGE IIR2FilterStates "" 3 0 0 "uninitialized" 1 1 "initialization" 2 2 "initialized" DEFAULT_VALUE "" /end COMPU_VTAB_RANGE
/begin COMPU_VTAB IcmDebugSyncPoints_t "enumeration table" TAB_VERB 11 0 "IcmSyncInit" 1 "IcmSyncWriteTimeData" 2 "IcmSyncReadFirstFFTResult" 3 "IcmSyncMainStateInterferenceFound" 4 "IcmSyncMainStateAllDone" 5 "IcmSyncDetectionStateIFFTdone" 6 "IcmSyncDetectionStateAlldone" 7 "IcmSyncRepairIfftSubStateEnd" 8 "IcmSyncRepairFftSubStateBegin" 9 "IcmSyncRepairFftSubStateEnd" 10 "IcmSyncSPUdone" /end COMPU_VTAB
/begin COMPU_VTAB_RANGE IcmDet "" 3 0 0 "NO_INTERFERENCE_FOUND" 1 1 "INTERFERENCE_FOUND" 2 2 "INTERFERENCE_OVER_LIMIT" DEFAULT_VALUE "" /end COMPU_VTAB_RANGE
/begin COMPU_VTAB_RANGE IcmDetInd "" 3 0 0 "INDICATOR_OFF" 1 1 "INDICATOR_LIMIT1" 2 2 "INDICATOR_LIMIT2" DEFAULT_VALUE "" /end COMPU_VTAB_RANGE
/begin COMPU_VTAB IcmDetInd_Copy1 "enumeration table" TAB_VERB 3 0 "enIndicatorOff" 1 "enIndicatorLimit1" 2 "enIndicatorLimit2" /end COMPU_VTAB
/begin COMPU_VTAB_RANGE IcmDetSubState "" 4 0 0 "DET_IFFT_STATISTIC" 1 1 "DET_IFFT" 2 2 "DET_INVWIN_THRESH" 3 3 "DET_EVAL_RESULT" DEFAULT_VALUE "" /end COMPU_VTAB_RANGE
/begin COMPU_VTAB IcmDetSubState_Copy1 "enumeration table" TAB_VERB 4 0 "enDetIfftStatistic" 1 "enDetIfft" 2 "enDetInvwinThresh" 3 "enDetEvalResult" /end COMPU_VTAB
/begin COMPU_VTAB IcmDet_Copy1 "enumeration table" TAB_VERB 3 0 "enNoInterferenceFound" 1 "enInterferenceFound" 2 "enInterferenceOverLimit" /end COMPU_VTAB
/begin COMPU_VTAB_RANGE IcmMainState "" 2 0 0 "DETECTION" 1 1 "REPAIR" DEFAULT_VALUE "" /end COMPU_VTAB_RANGE
/begin COMPU_VTAB IcmMainState_Copy1 "enumeration table" TAB_VERB 2 0 "enDetection" 1 "enRepair" /end COMPU_VTAB
/begin COMPU_VTAB_RANGE IcmRepSubState "" 2 0 0 "REP_IFFT" 1 1 "REP_FFT" DEFAULT_VALUE "" /end COMPU_VTAB_RANGE
/begin COMPU_VTAB IcmRepSubState_Copy1 "enumeration table" TAB_VERB 2 0 "enRepIfft" 1 "enRepFft" /end COMPU_VTAB
/begin COMPU_VTAB_RANGE IfxPort_Mode "" 19 0 0 "IfxPort_Mode_inputNoPullDevice" 8 8 "IfxPort_Mode_inputPullDown" 16 16 "IfxPort_Mode_inputPullUp" 128 128 "IfxPort_Mode_outputPushPullGeneral" 136 136 "IfxPort_Mode_outputPushPullAlt1" 144 144 "IfxPort_Mode_outputPushPullAlt2" 152 152 "IfxPort_Mode_outputPushPullAlt3" 160 160 "IfxPort_Mode_outputPushPullAlt4" 168 168 "IfxPort_Mode_outputPushPullAlt5" 176 176 "IfxPort_Mode_outputPushPullAlt6" 184 184 "IfxPort_Mode_outputPushPullAlt7" 192 192 "IfxPort_Mode_outputOpenDrainGeneral" 200 200 "IfxPort_Mode_outputOpenDrainAlt1" 208 208 "IfxPort_Mode_outputOpenDrainAlt2" 216 216 "IfxPort_Mode_outputOpenDrainAlt3" 224 224 "IfxPort_Mode_outputOpenDrainAlt4" 232 232 "IfxPort_Mode_outputOpenDrainAlt5" 240 240 "IfxPort_Mode_outputOpenDrainAlt6" 248 248 "IfxPort_Mode_outputOpenDrainAlt7" DEFAULT_VALUE "" /end COMPU_VTAB_RANGE
/begin COMPU_VTAB_RANGE IfxPort_PadDriver "" 8 0 0 "IfxPort_PadDriver_cmosAutomotiveSpeed1" 1 1 "IfxPort_PadDriver_cmosAutomotiveSpeed2" 2 2 "IfxPort_PadDriver_cmosAutomotiveSpeed3" 3 3 "IfxPort_PadDriver_cmosAutomotiveSpeed4" 8 8 "IfxPort_PadDriver_ttlSpeed1" 9 9 "IfxPort_PadDriver_ttlSpeed2" 10 10 "IfxPort_PadDriver_ttlSpeed3" 11 11 "IfxPort_PadDriver_ttlSpeed4" DEFAULT_VALUE "" /end COMPU_VTAB_RANGE
/begin COMPU_VTAB ImageRelationProvider "enumeration table" TAB_VERB 4 0 "none" 1 "objectCorridorRelation" 2 "ibeaRelations" 3 "ibeaRelationsOnFusObjects" /end COMPU_VTAB
/begin COMPU_VTAB IndicatorBlindnessState "enumeration table" TAB_VERB 3 0 "init" 1 "blindnessNotDetected" 2 "blindnessDetected" /end COMPU_VTAB
/begin COMPU_VTAB InternalConsistencyOfMultipleSitPaths "enumeration table" TAB_VERB 3 0 "Irrelevant" 1 "Confirmed" 2 "NotConfirmed" /end COMPU_VTAB
/begin COMPU_VTAB LSACombiSwitchFunctionSel "enumeration table" TAB_VERB 4 0 "defaultMode" 1 "autoMode" 2 "park" 3 "lowBeam" /end COMPU_VTAB
/begin COMPU_VTAB LSAManualBeamSel "enumeration table" TAB_VERB 3 0 "defaultMode" 1 "passBeam" 2 "highBeam" /end COMPU_VTAB
/begin COMPU_VTAB LaneAssociation "enumeration table" TAB_VERB 11 0 "LeftEgoLine" 1 "RightEgoLine" 2 "LeftNeighborLine" 3 "RightNeighborLine" 4 "LeftFlatRoadEdge" 5 "RightFlatRoadEdge" 6 "LeftRaisedRoadEdge" 7 "RightRaisedRoadEdge" 8 "NotSelectedCandidate" 9 "LeftEgoCourseLine" 10 "RightEgoCourseLine" /end COMPU_VTAB
/begin COMPU_VTAB LaneBorderColor "enumeration table" TAB_VERB 3 0 "white" 1 "yellow" 2 "unknown" /end COMPU_VTAB
/begin COMPU_VTAB LaneBorderType "enumeration table" TAB_VERB 7 0 "virtualLine" 1 "unknown" 2 "dashed" 3 "solid" 4 "horizontalRoadEdge" 5 "verticalRoadEdge" 6 "constructionElement" /end COMPU_VTAB
/begin COMPU_VTAB LaneChangeObjectRelevance "enumeration table" TAB_VERB 6 0 "startLaneInFrontOfEgo" 1 "targetLaneInFrontOfEgo" 2 "targetLaneBehindEgo" 3 "startLaneBehindEgo" 4 "thirdLaneInFrontOfEgo" 5 "thirdLaneBehindEgo" /end COMPU_VTAB
/begin COMPU_VTAB LaneId "enumeration table" TAB_VERB 8 0 "Ego" 1 "Left" 2 "Right" 3 "Left2nd" 4 "Right2nd" 5 "Left3rd" 6 "Right3rd" 255 "Unknown" /end COMPU_VTAB
/begin COMPU_VTAB LaneSensitivityButton "enumeration table" TAB_VERB 3 0 "low" 1 "medium" 2 "high" /end COMPU_VTAB
/begin COMPU_VTAB LateralDrivingState "enumeration table" TAB_VERB 5 0 "standStill" 1 "straightDriving" 2 "dynamicDriving" 3 "hyperDynamicDriving" 4 "postDynamicDriving" /end COMPU_VTAB
/begin COMPU_VTAB LateralIntention "enumeration table" TAB_VERB 4 0 "laneChangeLeft" 1 "laneKeeping" 2 "laneChangeRight" 3 "invalid" /end COMPU_VTAB
/begin COMPU_VTAB LcState "enumeration table" TAB_VERB 7 0 "INVALID" 1 "INIT" 2 "SHUTDOWN" 3 "PASSIVE" 4 "DEGRADED" 5 "FULL_PERFORMANCE" 6 "REINIT" /end COMPU_VTAB
/begin COMPU_VTAB LcmStateId "enumeration table" TAB_VERB 4 0 "init" 1 "passive" 2 "performing" 3 "reinit" /end COMPU_VTAB
/begin COMPU_VTAB LightFunctionSelHMI "enumeration table" TAB_VERB 3 0 "Default" 1 "ON" 2 "OFF" /end COMPU_VTAB
/begin COMPU_VTAB LineSource "enumeration table" TAB_VERB 6 0 "undefined" 1 "videoBoundary" 2 "videoHolisticEgoLine" 3 "map" 4 "roadSideBoundaryLocation" 5 "trafficParticipantTrajectory" /end COMPU_VTAB
/begin COMPU_VTAB LocIntStatus "enumeration table" TAB_VERB 2 0 "enLocIntInvalid" 1 "enLocIntValid" /end COMPU_VTAB
/begin COMPU_VTAB LongitudinalControlSettingState "enumeration table" TAB_VERB 9 0 "Off" 1 "DesiredDistanceIncreaseContinuously" 2 "DesiredDistanceIncrease" 3 "DesiredDistanceDecrease" 4 "DesiredSpeedIncreaseSmall" 5 "DesiredSpeedIncreaseLarge" 6 "DesiredSpeedDecreaseSmall" 7 "DesiredSpeedDecreaseLarge" 8 "DesiredSpeedSet" /end COMPU_VTAB
/begin COMPU_VTAB LongitudinalPosition "enumeration table" TAB_VERB 7 0 "closestFront" 1 "secondClosestFront" 2 "closestFrontLeft" 3 "closestFrontRight" 4 "secondClosestFrontLeft" 5 "secondClosestFrontRight" 255 "unknown" /end COMPU_VTAB
/begin COMPU_VTAB ManualLaneChangeSupportState "enumeration table" TAB_VERB 4 0 "singleLane" 1 "multiLaneFastest" 2 "multiLaneMiddle" 3 "multiLaneSlowest" /end COMPU_VTAB
/begin COMPU_VTAB MetaState "enumeration table" TAB_VERB 15 0 "INVALID" 1 "STARTUP" 2 "REINIT" 3 "PASSIVE" 4 "SHUTDOWN" 5 "OOS" 6 "DEGRADED" 7 "FULL_PERFORMANCE" 8 "BADCONNECTION" 9 "LONG_UNAVAILABLE" 10 "LAT_UNAVAILABLE" 11 "LIMITED_PERFORMANCE" 12 "OOS_LAT_RAMP_OUT" 13 "LAT_UNAVAILABLE_RAMP_OUT" 14 "TOTAL_NUMBER" /end COMPU_VTAB
/begin COMPU_VTAB MissingLaneMarkingOnMiddleLaneScenario "enumeration table" TAB_VERB 4 0 "LargeMiddleLaneScenario" 1 "LeftLaneLeftBorderAndEgoLaneRightBorderScenario" 2 "EgoLaneLeftBorderAndRightLaneRightBorderScenario" 255 "NoScenarioRecognized" /end COMPU_VTAB
/begin COMPU_VTAB MixStates "enumeration table" TAB_VERB 2 0 "passive" 1 "active" /end COMPU_VTAB
/begin COMPU_VTAB MotionGoal "enumeration table" TAB_VERB 6 0 "none" 1 "byTci" 2 "evade" 3 "alignWithReferenceLine" 4 "followReferenceLine" 5 "invalid" /end COMPU_VTAB
/begin COMPU_VTAB_RANGE MotionModelType "" 9 0 0 "unknown" 1 1 "nonObstacle" 2 2 "stationaryObstacle" 3 3 "unknownObstacle" 4 4 "unknownMobile" 5 5 "twoWheeler" 6 6 "fourPlusWheeler" 7 7 "pedestrian" 8 8 "numMotionModel" DEFAULT_VALUE "" /end COMPU_VTAB_RANGE
/begin COMPU_VTAB_RANGE MotionModelType.OLD_1 "" 9 0 0 "unknown" 1 1 "nonObstacle" 2 2 "stationaryObstacle" 3 3 "unknownObstacle" 4 4 "twoWheeler" 5 5 "unknownMobile" 6 6 "fourPlusWheeler" 7 7 "pedestrian" 8 8 "numMotionModel" DEFAULT_VALUE "" /end COMPU_VTAB_RANGE
/begin COMPU_VTAB_RANGE MotionType "" 2 0 0 "MotionType_Comfort" 1 1 "MotionType_Emergency" DEFAULT_VALUE "" /end COMPU_VTAB_RANGE
/begin COMPU_VTAB MotionType_Copy1 "enumeration table" TAB_VERB 4 0 "corridorKeeping" 1 "corridorChangingInLeftDirection" 2 "corridorChangingInRightDirection" 255 "unknown" /end COMPU_VTAB
/begin COMPU_VTAB NeighboringVehicleAugmentedData "enumeration table" TAB_VERB 8 0 "normalDriving" 1 "selectedAsLeadVehicle" 2 "locatedInEgoBlindSpot" 3 "closeDistanceToEgo" 4 "strongDeceleration" 5 "strongAcceleration" 6 "laneChangeToLeft" 7 "laneChangeToRight" /end COMPU_VTAB
/begin COMPU_VTAB NeighboringVehicleType "enumeration table" TAB_VERB 8 0 "vehicleNotPresent" 1 "passengerCar" 2 "truck" 3 "motorbike" 4 "other" 5 "reserved1" 6 "reserved2" 7 "error" /end COMPU_VTAB
/begin COMPU_VTAB ObjectClassification "enumeration table" TAB_VERB 9 0 "unknown" 1 "nonObstacle" 2 "stationaryObstacle" 3 "unknownObstacle" 4 "unknownMobile" 5 "twoWheeler" 6 "fourPlusWheeler" 7 "pedestrian" 8 "truck" /end COMPU_VTAB
/begin COMPU_VTAB ObjectClassificationType "enumeration table" TAB_VERB 7 0 "unspecified" 1 "twoWheeler" 2 "fourPlusWheeler" 3 "pedestrian" 20 "fourPlusWheelerUnknown" 21 "passengerCar" 22 "truck" /end COMPU_VTAB
/begin COMPU_VTAB ObjectDrivingDirection "enumeration table" TAB_VERB 4 0 "unknown" 1 "synchronous" 2 "oncoming" 3 "crossing" /end COMPU_VTAB
/begin RECORD_LAYOUT __SLong_Value FNC_VALUES 1 SLONG ROW_DIR DIRECT /end RECORD_LAYOUT
/begin RECORD_LAYOUT __SWord_Value FNC_VALUES 1 SWORD ROW_DIR DIRECT /end RECORD_LAYOUT
/begin RECORD_LAYOUT __UBYTE_Z FNC_VALUES 1 UBYTE ROW_DIR DIRECT ALIGNMENT_FLOAT64_IEEE 8 ALIGNMENT_INT64 8 /end RECORD_LAYOUT
/begin RECORD_LAYOUT __UByte_Value FNC_VALUES 1 UBYTE ROW_DIR DIRECT /end RECORD_LAYOUT
/begin RECORD_LAYOUT __ULong_Value FNC_VALUES 1 ULONG ROW_DIR DIRECT /end RECORD_LAYOUT
/begin RECORD_LAYOUT __UWord_Value FNC_VALUES 1 UWORD ROW_DIR DIRECT /end RECORD_LAYOUT
/begin GROUP Aurix "Measurements when using Infineon Aurix"
 /begin REF_MEASUREMENT VX1000.POD.mon.aurix.aurora.rxFreqKHz VX1000.POD.mon.aurix.dapFreqkHz VX1000.POD.mon.aurix.errorMsgCnt VX1000.POD.mon.aurix.lastAddrBeforeEcuOverrun VX1000.POD.mon.aurix.retransmitCnt /end REF_MEASUREMENT
/end GROUP
/begin GROUP BaseModule "VX1060, VX113x, VX1161.3x internal Measurements"
 /begin REF_MEASUREMENT VX1000.BM.mon.bmTemperature VX1000.BM.mon.monEvtCntDword VX1000.BM.mon.te.tfifo.extRamMaxByte VX1000.BM.mon.xcpSocket0.freeTLBs VX1000.BM.mon.xcpSocket1.freeTLBs VX1000.BM.mon.xcpSocket2.freeTLBs VX1000.BM.mon.xcpSocket3.freeTLBs VX1000.BM.mon.xcpe.evtFifoMax /end REF_MEASUREMENT
 /begin SUB_GROUP HSSL Serial /end SUB_GROUP
/end GROUP
/begin GROUP HSSL ""
 /begin REF_MEASUREMENT VX1000.BM.mon.hssl.TxFreqKHz VX1000.BM.mon.hssl.pipe0RxCnt VX1000.BM.mon.hssl.pipe1RxCnt VX1000.BM.mon.hssl.pipe2RxCnt VX1000.BM.mon.hssl.retransDLCnt VX1000.BM.mon.hssl.retransULCnt /end REF_MEASUREMENT
/end GROUP
/begin GROUP LRR "Kommentar" ROOT
 /begin REF_MEASUREMENT _Dem_AllEventsState._82_ _Dem_AllEventsState._82_._debounceLevel _Dem_AllEventsState._82_._state _Dem_AllEventsState8._82_ _Dem_AllEventsState8._82_._lastReportedEvent _Dem_AllEventsStatusByte._82_ _Dem_Cfg_DebArTime_Paramset1._44_ _Dem_Cfg_DebArTime_Paramset1._44_._FDCThreshold _Dem_Cfg_DebArTime_Paramset1._44_._SuspiciousThreshold _Dem_Cfg_DebArTime_Paramset1._44_._TimeFailedThreshold _Dem_Cfg_DebArTime_Paramset1._44_._TimePassedThreshold _Dem_Cfg_EnvEventId2EnvData._82_ _Dem_Cfg_EnvEventId2EnvData._82_._extDataId _Dem_Cfg_EnvEventId2EnvData._82_._freezeFrameId _Dem_EvtCategoryPrio._5_ _Dem_EvtCategoryPrio._5_._evtcatprio _Dem_MapEventIdToDtcId._82_ _FiM_Cfg_NumOffsetEvent_auo._83_ _NvM_Prv_RamMirror_au8._82_ _s_highCurvinessFactor _s_highCurvinessFactor._m_value _s_highCurvinessThreshold _s_highCurvinessThreshold._m_value _s_lowCurvinessFactor _s_lowCurvinessFactor._m_value _s_lowCurvinessThreshold _s_lowCurvinessThreshold._m_value /end REF_MEASUREMENT
/end GROUP
/begin GROUP Nexus "Measurements when using Nexus AUX Trace Interface of PowerPC MCUs"
 /begin REF_MEASUREMENT VX1000.POD.mon.nexus.aurora.rxFreqKHz VX1000.POD.mon.nexus.aux.freqKHz VX1000.POD.mon.nexus.ecuOverrunCnt VX1000.POD.mon.nexus.ecuStallCnt VX1000.POD.mon.nexus.lastAddrBeforeEcuOverrun /end REF_MEASUREMENT
/end GROUP
/begin GROUP POD "VX14xx POD internal Measurements"
 /begin REF_MEASUREMENT VX1000.POD.mon.aurora.fifo.bufferUtilByte VX1000.POD.mon.aurora.fifo.din_fifo_usedw VX1000.POD.mon.aurora.fifo.dout_fifo_usedw VX1000.POD.mon.monEvtCntDword VX1000.POD.mon.pcie.overloadCnt VX1000.POD.mon.pod.temperature VX1000.POD.mon.trace.adconInputCnt VX1000.POD.mon.trace.adfilOutputCnt VX1000.POD.mon.traceBuffer.externalMax VX1000.POD.mon.traceBuffer.outMax /end REF_MEASUREMENT
 /begin SUB_GROUP Aurix Nexus RH850 RIF RTPDMM /end SUB_GROUP
/end GROUP
/begin GROUP RH850 "Measurements when using Renesas RH850 Data Trace"
 /begin REF_MEASUREMENT VX1000.POD.mon.rh850.aud.audFifoMax VX1000.POD.mon.rh850.aurora.rxFreqKHz VX1000.POD.mon.rh850.ecuOverrunCnt VX1000.POD.mon.rh850.lastAddrBeforeEcuOverrun VX1000.POD.mon.rh850.lastErrorMsgInfo /end REF_MEASUREMENT
/end GROUP
/begin GROUP RIF "Measurements when using the Radar RAW Data Interface" /begin REF_MEASUREMENT VX1000.POD.mon.rif1.crcErrorCnt /end REF_MEASUREMENT /end GROUP
/begin GROUP RTPDMM "Measurements when using the TI TMS570 RTP/DMM Data Trace Interface"
 /begin REF_MEASUREMENT VX1000.POD.mon.rtpdmm.dmmFreqKHz VX1000.POD.mon.rtpdmm.dmmStopCnt VX1000.POD.mon.rtpdmm.rtpFreqKHz VX1000.POD.mon.rtpdmm.rtpStopCnt /end REF_MEASUREMENT
/end GROUP
/begin GROUP Serial ""
 /begin REF_MEASUREMENT VX1000.BM.mon.serial.niosMaxDapLoad VX1000.BM.mon.serial.niosOldaOverruns VX1000.BM.mon.serial.targetIfRetryCounter /end REF_MEASUREMENT
/end GROUP
/begin GROUP SystemInfo "VX1060, VX113x, VX1621, VX1161.3x internal Measurements"
 /begin REF_CHARACTERISTIC VX1000.sys.usrCustomer VX1000.sys.usrPosition VX1000.sys.usrProject VX1000.sys.usrSample /end REF_CHARACTERISTIC
 /begin REF_MEASUREMENT VX1000.sys.ecuEdJtagId VX1000.sys.ecuJtagId VX1000.sys.ecuProcName VX1000.sys.ecuProcNameLen VX1000.sys.fpgaLeftVer VX1000.sys.fpgaLeftVer.build VX1000.sys.fpgaLeftVer.major VX1000.sys.fpgaLeftVer.minor VX1000.sys.fwVer VX1000.sys.fwVer.build VX1000.sys.fwVer.major VX1000.sys.fwVer.minor VX1000.sys.parentArticleNumber VX1000.sys.parentSerialNumber VX1000.sys.podECUIdMiscNumber VX1000.sys.podECUIdMuster VX1000.sys.podECUIdPosition VX1000.sys.podECUIdProject VX1000.sys.podFpgaVer VX1000.sys.podFpgaVer.build VX1000.sys.podFpgaVer.major VX1000.sys.podFpgaVer.minor VX1000.sys.podFwVer VX1000.sys.podFwVer.build VX1000.sys.podFwVer.major VX1000.sys.podFwVer.minor VX1000.sys.podHwTypeRev VX1000.sys.podTemp VX1000.sys.podVX1902HwTypeRev VX1000.sys.podVX1902VectorSerNo VX1000.sys.podVectorArtNo VX1000.sys.podVectorSerNo VX1000.sys.upTimeS VX1000.sys.vectorArtNo VX1000.sys.vectorSerNo VX1000.sys.vx1161SlotNumber /end REF_MEASUREMENT
/end GROUP
/begin GROUP VX1000 "VX1000 Internal Signals" ROOT /begin SUB_GROUP BaseModule POD SystemInfo XPOD /end SUB_GROUP /end GROUP
/begin GROUP XPOD "VX1621 internal Measurements"
 /begin REF_MEASUREMENT VX1000.xpod.ECU_IF_voltage VX1000.xpod.EMEM_voltage VX1000.xpod.Temperature VX1000.xpod.monEvtCntDword /end REF_MEASUREMENT
/end GROUP
/end MODULE
/end PROJECT
