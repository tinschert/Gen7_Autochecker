ASAP2_VERSION 1 71
/begin PROJECT RADAR_GEN5 ""
/begin HEADER "" VERSION "TO_BE_FILLED" /end HEADER
/begin MODULE RADAR_GEN5 ""
/begin MOD_COMMON "" ALIGNMENT_BYTE 1 ALIGNMENT_WORD 2 ALIGNMENT_LONG 4 ALIGNMENT_FLOAT16_IEEE 2 ALIGNMENT_FLOAT32_IEEE 4 ALIGNMENT_FLOAT64_IEEE 4 ALIGNMENT_INT64 4 /end MOD_COMMON
/begin CHARACTERISTIC _g_PL_AD_fw_Radar_1R1V_rpc_XilObjBypassingRunnable_XilObjBypassingRunnable_m_pad_radarObjPort_par_out_local.TChangeableMemPool._._._m_arrayPool._0_._elem._m_objectInformation._2_._m_dzN "" VALUE 0xB0057398 __SWord_Value 0 NO_COMPU_METHOD -32768 32767 ECU_ADDRESS_EXTENSION 0x1 BYTE_ORDER MSB_LAST /end CHARACTERISTIC
/begin CHARACTERISTIC _g_PL_AD_fw_Radar_1R1V_rpc_XilObjBypassingRunnable_XilObjBypassingRunnable_m_pad_radarObjPort_par_out_local.TChangeableMemPool._._._m_arrayPool._0_._elem._m_objectInformation._2_._m_isObjectAsil "" VALUE 0xB00573B4 __UByte_Value 0 NO_COMPU_METHOD 0 255 ECU_ADDRESS_EXTENSION 0x1 BYTE_ORDER MSB_LAST /end CHARACTERISTIC
/begin CHARACTERISTIC _g_PL_AD_fw_Radar_1R1V_rpc_XilObjBypassingRunnable_XilObjBypassingRunnable_m_pad_radarObjPort_par_out_local.TChangeableMemPool._._._m_arrayPool._0_._elem._m_objectInformation._2_._m_perObjectType._m_prob1FourPlusWheelerN "" VALUE 0xB005736E __UByte_Value 0 NO_COMPU_METHOD 0 255 ECU_ADDRESS_EXTENSION 0x1 BYTE_ORDER MSB_LAST /end CHARACTERISTIC
/begin CHARACTERISTIC _g_PL_AD_fw_Radar_1R1V_rpc_XilObjBypassingRunnable_XilObjBypassingRunnable_m_pad_radarObjPort_par_out_local.TChangeableMemPool._._._m_arrayPool._0_._elem._m_objectInformation._2_._m_perObjectType._m_prob1FourWheelUnknownN "" VALUE 0xB0057376 __UByte_Value 0 NO_COMPU_METHOD 0 255 ECU_ADDRESS_EXTENSION 0x1 BYTE_ORDER MSB_LAST /end CHARACTERISTIC
/begin CHARACTERISTIC _g_PL_AD_fw_Radar_1R1V_rpc_XilObjBypassingRunnable_XilObjBypassingRunnable_m_pad_radarObjPort_par_out_local.TChangeableMemPool._._._m_arrayPool._0_._elem._m_objectInformation._2_._m_perObjectType._m_prob1MobileN "" VALUE 0xB005736B __UByte_Value 0 NO_COMPU_METHOD 0 255 ECU_ADDRESS_EXTENSION 0x1 BYTE_ORDER MSB_LAST /end CHARACTERISTIC
/begin CHARACTERISTIC _g_PL_AD_fw_Radar_1R1V_rpc_XilObjBypassingRunnable_XilObjBypassingRunnable_m_pad_radarObjPort_par_out_local.TChangeableMemPool._._._m_arrayPool._0_._elem._m_objectInformation._2_._m_perObjectType._m_prob1MovUnknownN "" VALUE 0xB0057371 __UByte_Value 0 NO_COMPU_METHOD 0 255 ECU_ADDRESS_EXTENSION 0x1 BYTE_ORDER MSB_LAST /end CHARACTERISTIC
/begin CHARACTERISTIC _g_PL_AD_fw_Radar_1R1V_rpc_XilObjBypassingRunnable_XilObjBypassingRunnable_m_pad_radarObjPort_par_out_local.TChangeableMemPool._._._m_arrayPool._0_._elem._m_objectInformation._2_._m_perObjectType._m_prob1NonObstacleN "" VALUE 0xB0057369 __UByte_Value 0 NO_COMPU_METHOD 0 255 ECU_ADDRESS_EXTENSION 0x1 BYTE_ORDER MSB_LAST /end CHARACTERISTIC
/begin CHARACTERISTIC _g_PL_AD_fw_Radar_1R1V_rpc_XilObjBypassingRunnable_XilObjBypassingRunnable_m_pad_radarObjPort_par_out_local.TChangeableMemPool._._._m_arrayPool._0_._elem._m_objectInformation._2_._m_perObjectType._m_prob1ObstUnknownN "" VALUE 0xB005736D __UByte_Value 0 NO_COMPU_METHOD 0 255 ECU_ADDRESS_EXTENSION 0x1 BYTE_ORDER MSB_LAST /end CHARACTERISTIC
/begin CHARACTERISTIC _g_PL_AD_fw_Radar_1R1V_rpc_XilObjBypassingRunnable_XilObjBypassingRunnable_m_pad_radarObjPort_par_out_local.TChangeableMemPool._._._m_arrayPool._0_._elem._m_objectInformation._2_._m_perObjectType._m_prob1ObstacleN "" VALUE 0xB0057368 __UByte_Value 0 NO_COMPU_METHOD 0 255 ECU_ADDRESS_EXTENSION 0x1 BYTE_ORDER MSB_LAST /end CHARACTERISTIC
/begin CHARACTERISTIC _g_PL_AD_fw_Radar_1R1V_rpc_XilObjBypassingRunnable_XilObjBypassingRunnable_m_pad_radarObjPort_par_out_local.TChangeableMemPool._._._m_arrayPool._0_._elem._m_objectInformation._2_._m_perObjectType._m_prob1PassengerCarN "" VALUE 0xB0057374 __UByte_Value 0 NO_COMPU_METHOD 0 255 ECU_ADDRESS_EXTENSION 0x1 BYTE_ORDER MSB_LAST /end CHARACTERISTIC
/begin CHARACTERISTIC _g_PL_AD_fw_Radar_1R1V_rpc_XilObjBypassingRunnable_XilObjBypassingRunnable_m_pad_radarObjPort_par_out_local.TChangeableMemPool._._._m_arrayPool._0_._elem._m_objectInformation._2_._m_perObjectType._m_prob1PedestrianN "" VALUE 0xB0057370 __UByte_Value 0 NO_COMPU_METHOD 0 255 ECU_ADDRESS_EXTENSION 0x1 BYTE_ORDER MSB_LAST /end CHARACTERISTIC
/begin CHARACTERISTIC _g_PL_AD_fw_Radar_1R1V_rpc_XilObjBypassingRunnable_XilObjBypassingRunnable_m_pad_radarObjPort_par_out_local.TChangeableMemPool._._._m_arrayPool._0_._elem._m_objectInformation._2_._m_perObjectType._m_prob1RoadsideBarrierN "" VALUE 0xB0057372 __UByte_Value 0 NO_COMPU_METHOD 0 255 ECU_ADDRESS_EXTENSION 0x1 BYTE_ORDER MSB_LAST /end CHARACTERISTIC
/begin CHARACTERISTIC _g_PL_AD_fw_Radar_1R1V_rpc_XilObjBypassingRunnable_XilObjBypassingRunnable_m_pad_radarObjPort_par_out_local.TChangeableMemPool._._._m_arrayPool._0_._elem._m_objectInformation._2_._m_perObjectType._m_prob1StatUnknownN "" VALUE 0xB0057373 __UByte_Value 0 NO_COMPU_METHOD 0 255 ECU_ADDRESS_EXTENSION 0x1 BYTE_ORDER MSB_LAST /end CHARACTERISTIC
/begin CHARACTERISTIC _g_PL_AD_fw_Radar_1R1V_rpc_XilObjBypassingRunnable_XilObjBypassingRunnable_m_pad_radarObjPort_par_out_local.TChangeableMemPool._._._m_arrayPool._0_._elem._m_objectInformation._2_._m_perObjectType._m_prob1StationaryN "" VALUE 0xB005736C __UByte_Value 0 NO_COMPU_METHOD 0 255 ECU_ADDRESS_EXTENSION 0x1 BYTE_ORDER MSB_LAST /end CHARACTERISTIC
/begin CHARACTERISTIC _g_PL_AD_fw_Radar_1R1V_rpc_XilObjBypassingRunnable_XilObjBypassingRunnable_m_pad_radarObjPort_par_out_local.TChangeableMemPool._._._m_arrayPool._0_._elem._m_objectInformation._2_._m_perObjectType._m_prob1TruckN "" VALUE 0xB0057375 __UByte_Value 0 NO_COMPU_METHOD 0 255 ECU_ADDRESS_EXTENSION 0x1 BYTE_ORDER MSB_LAST /end CHARACTERISTIC
/begin CHARACTERISTIC _g_PL_AD_fw_Radar_1R1V_rpc_XilObjBypassingRunnable_XilObjBypassingRunnable_m_pad_radarObjPort_par_out_local.TChangeableMemPool._._._m_arrayPool._0_._elem._m_objectInformation._2_._m_perObjectType._m_prob1TwoWheelerN "" VALUE 0xB005736F __UByte_Value 0 NO_COMPU_METHOD 0 255 ECU_ADDRESS_EXTENSION 0x1 BYTE_ORDER MSB_LAST /end CHARACTERISTIC
/begin CHARACTERISTIC _g_PL_AD_fw_Radar_1R1V_rpc_XilObjBypassingRunnable_XilObjBypassingRunnable_m_pad_radarObjPort_par_out_local.TChangeableMemPool._._._m_arrayPool._0_._elem._m_objectInformation._2_._m_perObjectType._m_prob1UnknownN "" VALUE 0xB005736A __UByte_Value 0 NO_COMPU_METHOD 0 255 ECU_ADDRESS_EXTENSION 0x1 BYTE_ORDER MSB_LAST /end CHARACTERISTIC
/begin CHARACTERISTIC _g_PL_AD_fw_Radar_1R1V_rpc_XilObjBypassingRunnable_XilObjBypassingRunnable_m_pad_radarObjPort_par_out_local.TChangeableMemPool._._._m_arrayPool._0_._elem._m_objectInformation._2_._m_prob1HasBeenObservedMovingN "" VALUE 0xB00573B1 __UByte_Value 0 NO_COMPU_METHOD 0 255 ECU_ADDRESS_EXTENSION 0x1 BYTE_ORDER MSB_LAST /end CHARACTERISTIC
/begin CHARACTERISTIC _g_PL_AD_fw_Radar_1R1V_rpc_XilObjBypassingRunnable_XilObjBypassingRunnable_m_pad_radarObjPort_par_out_local.TChangeableMemPool._._._m_arrayPool._0_._elem._m_objectInformation._2_._m_prob1MovingN "" VALUE 0xB00573B0 __UByte_Value 0 NO_COMPU_METHOD 0 255 ECU_ADDRESS_EXTENSION 0x1 BYTE_ORDER MSB_LAST /end CHARACTERISTIC
/begin CHARACTERISTIC _g_PL_AD_fw_Radar_1R1V_rpc_XilObjBypassingRunnable_XilObjBypassingRunnable_m_pad_radarObjPort_par_out_local.TChangeableMemPool._._._m_arrayPool._0_._elem._m_objectInformation._2_._m_varAxN "" VALUE 0xB005738C __SLong_Value 0 NO_COMPU_METHOD -2147483648 2147483647 ECU_ADDRESS_EXTENSION 0x1 BYTE_ORDER MSB_LAST /end CHARACTERISTIC
/begin CHARACTERISTIC _g_PL_AD_fw_Radar_1R1V_rpc_XilObjBypassingRunnable_XilObjBypassingRunnable_m_pad_radarObjPort_par_out_local.TChangeableMemPool._._._m_arrayPool._0_._elem._m_objectInformation._2_._m_varAyN "" VALUE 0xB0057390 __SLong_Value 0 NO_COMPU_METHOD -2147483648 2147483647 ECU_ADDRESS_EXTENSION 0x1 BYTE_ORDER MSB_LAST /end CHARACTERISTIC
/begin CHARACTERISTIC _g_PL_AD_fw_Radar_1R1V_rpc_XilObjBypassingRunnable_XilObjBypassingRunnable_m_pad_radarObjPort_par_out_local.TChangeableMemPool._._._m_arrayPool._0_._elem._m_objectInformation._2_._m_varDxN "" VALUE 0xB005737C __SLong_Value 0 NO_COMPU_METHOD -2147483648 2147483647 ECU_ADDRESS_EXTENSION 0x1 BYTE_ORDER MSB_LAST /end CHARACTERISTIC
/begin CHARACTERISTIC _g_PL_AD_fw_Radar_1R1V_rpc_XilObjBypassingRunnable_XilObjBypassingRunnable_m_pad_radarObjPort_par_out_local.TChangeableMemPool._._._m_arrayPool._0_._elem._m_objectInformation._2_._m_varDyN "" VALUE 0xB0057380 __SLong_Value 0 NO_COMPU_METHOD -2147483648 2147483647 ECU_ADDRESS_EXTENSION 0x1 BYTE_ORDER MSB_LAST /end CHARACTERISTIC
/begin CHARACTERISTIC _g_PL_AD_fw_Radar_1R1V_rpc_XilObjBypassingRunnable_XilObjBypassingRunnable_m_pad_radarObjPort_par_out_local.TChangeableMemPool._._._m_arrayPool._0_._elem._m_objectInformation._2_._m_varVxN "" VALUE 0xB0057384 __SLong_Value 0 NO_COMPU_METHOD -2147483648 2147483647 ECU_ADDRESS_EXTENSION 0x1 BYTE_ORDER MSB_LAST /end CHARACTERISTIC
/begin CHARACTERISTIC _g_PL_AD_fw_Radar_1R1V_rpc_XilObjBypassingRunnable_XilObjBypassingRunnable_m_pad_radarObjPort_par_out_local.TChangeableMemPool._._._m_arrayPool._0_._elem._m_objectInformation._2_._m_varVyN "" VALUE 0xB0057388 __SLong_Value 0 NO_COMPU_METHOD -2147483648 2147483647 ECU_ADDRESS_EXTENSION 0x1 BYTE_ORDER MSB_LAST /end CHARACTERISTIC
/begin CHARACTERISTIC _g_PL_AD_fw_Radar_1R1V_rpc_XilObjBypassingRunnable_XilObjBypassingRunnable_m_pad_radarObjPort_par_out_local.TChangeableMemPool._._._m_arrayPool._0_._elem._m_objectInformation._2_._m_vxN "" VALUE 0xB005739A __SWord_Value 0 NO_COMPU_METHOD -32768 32767 ECU_ADDRESS_EXTENSION 0x1 BYTE_ORDER MSB_LAST /end CHARACTERISTIC
/begin CHARACTERISTIC _g_PL_AD_fw_Radar_1R1V_rpc_XilObjBypassingRunnable_XilObjBypassingRunnable_m_pad_radarObjPort_par_out_local.TChangeableMemPool._._._m_arrayPool._0_._elem._m_objectInformation._2_._m_vyN "" VALUE 0xB005739C __SWord_Value 0 NO_COMPU_METHOD -32768 32767 ECU_ADDRESS_EXTENSION 0x1 BYTE_ORDER MSB_LAST /end CHARACTERISTIC
/begin CHARACTERISTIC _g_PL_AD_fw_Radar_1R1V_rpc_XilObjBypassingRunnable_XilObjBypassingRunnable_m_pad_radarObjPort_par_out_local.TChangeableMemPool._._._m_arrayPool._0_._elem._m_objectInformation._2_._m_wExistProbN "" VALUE 0xB00573AE __UWord_Value 0 NO_COMPU_METHOD 0 65535 ECU_ADDRESS_EXTENSION 0x1 BYTE_ORDER MSB_LAST /end CHARACTERISTIC
/begin CHARACTERISTIC _g_PL_AD_fw_Radar_1R1V_rpc_XilObjBypassingRunnable_XilObjBypassingRunnable_m_pad_radarObjPort_par_out_local.TChangeableMemPool._._._m_arrayPool._0_._elem._m_objectInformation._3_._Valid_b "" VALUE 0xB0057403 __UByte_Value 0 NO_COMPU_METHOD 0 255 ECU_ADDRESS_EXTENSION 0x1 BYTE_ORDER MSB_LAST /end CHARACTERISTIC
/begin CHARACTERISTIC _g_PL_AD_fw_Radar_1R1V_rpc_XilObjBypassingRunnable_XilObjBypassingRunnable_m_pad_radarObjPort_par_out_local.TChangeableMemPool._._._m_arrayPool._0_._elem._m_objectInformation._3_._m_HandleN "" VALUE 0xB0057402 __UByte_Value 0 NO_COMPU_METHOD 0 255 ECU_ADDRESS_EXTENSION 0x1 BYTE_ORDER MSB_LAST /end CHARACTERISTIC
/begin CHARACTERISTIC _g_PL_AD_fw_Radar_1R1V_rpc_XilObjBypassingRunnable_XilObjBypassingRunnable_m_pad_radarObjPort_par_out_local.TChangeableMemPool._._._m_arrayPool._0_._elem._m_objectInformation._3_._m_alpPiVarYawAngleN "" VALUE 0xB00573F8 __UWord_Value 0 NO_COMPU_METHOD 0 65535 ECU_ADDRESS_EXTENSION 0x1 BYTE_ORDER MSB_LAST /end CHARACTERISTIC
/begin CHARACTERISTIC _g_PL_AD_fw_Radar_1R1V_rpc_XilObjBypassingRunnable_XilObjBypassingRunnable_m_pad_radarObjPort_par_out_local.TChangeableMemPool._._._m_arrayPool._0_._elem._m_objectInformation._3_._m_alpPiYawAngleN "" VALUE 0xB00573F2 __SWord_Value 0 NO_COMPU_METHOD -32768 32767 ECU_ADDRESS_EXTENSION 0x1 BYTE_ORDER MSB_LAST /end CHARACTERISTIC
/begin CHARACTERISTIC _g_PL_AD_fw_Radar_1R1V_rpc_XilObjBypassingRunnable_XilObjBypassingRunnable_m_pad_radarObjPort_par_out_local.TChangeableMemPool._._._m_arrayPool._0_._elem._m_objectInformation._3_._m_axN "" VALUE 0xB00573EE __SWord_Value 0 NO_COMPU_METHOD -32768 32767 ECU_ADDRESS_EXTENSION 0x1 BYTE_ORDER MSB_LAST /end CHARACTERISTIC
/begin CHARACTERISTIC _g_PL_AD_fw_Radar_1R1V_rpc_XilObjBypassingRunnable_XilObjBypassingRunnable_m_pad_radarObjPort_par_out_local.TChangeableMemPool._._._m_arrayPool._0_._elem._m_objectInformation._3_._m_ayN "" VALUE 0xB00573F0 __SWord_Value 0 NO_COMPU_METHOD -32768 32767 ECU_ADDRESS_EXTENSION 0x1 BYTE_ORDER MSB_LAST /end CHARACTERISTIC
/begin CHARACTERISTIC _g_PL_AD_fw_Radar_1R1V_rpc_XilObjBypassingRunnable_XilObjBypassingRunnable_m_pad_radarObjPort_par_out_local.TChangeableMemPool._._._m_arrayPool._0_._elem._m_objectInformation._3_._m_dLengthN "" VALUE 0xB00573F6 __SWord_Value 0 NO_COMPU_METHOD -32768 32767 ECU_ADDRESS_EXTENSION 0x1 BYTE_ORDER MSB_LAST /end CHARACTERISTIC
/begin CHARACTERISTIC _g_PL_AD_fw_Radar_1R1V_rpc_XilObjBypassingRunnable_XilObjBypassingRunnable_m_pad_radarObjPort_par_out_local.TChangeableMemPool._._._m_arrayPool._0_._elem._m_objectInformation._3_._m_dVarLengthN "" VALUE 0xB00573FC __UWord_Value 0 NO_COMPU_METHOD 0 65535 ECU_ADDRESS_EXTENSION 0x1 BYTE_ORDER MSB_LAST /end CHARACTERISTIC
/begin CHARACTERISTIC _g_PL_AD_fw_Radar_1R1V_rpc_XilObjBypassingRunnable_XilObjBypassingRunnable_m_pad_radarObjPort_par_out_local.TChangeableMemPool._._._m_arrayPool._0_._elem._m_objectInformation._3_._m_dVarWidthN "" VALUE 0xB00573FA __UWord_Value 0 NO_COMPU_METHOD 0 65535 ECU_ADDRESS_EXTENSION 0x1 BYTE_ORDER MSB_LAST /end CHARACTERISTIC
/begin CHARACTERISTIC _g_PL_AD_fw_Radar_1R1V_rpc_XilObjBypassingRunnable_XilObjBypassingRunnable_m_pad_radarObjPort_par_out_local.TChangeableMemPool._._._m_arrayPool._0_._elem._m_objectInformation._3_._m_dWidthN "" VALUE 0xB00573F4 __SWord_Value 0 NO_COMPU_METHOD -32768 32767 ECU_ADDRESS_EXTENSION 0x1 BYTE_ORDER MSB_LAST /end CHARACTERISTIC
/begin CHARACTERISTIC _g_PL_AD_fw_Radar_1R1V_rpc_XilObjBypassingRunnable_XilObjBypassingRunnable_m_pad_radarObjPort_par_out_local.TChangeableMemPool._._._m_arrayPool._0_._elem._m_objectInformation._3_._m_dxN "" VALUE 0xB00573E4 __SWord_Value 0 NO_COMPU_METHOD -32768 32767 ECU_ADDRESS_EXTENSION 0x1 BYTE_ORDER MSB_LAST /end CHARACTERISTIC
/begin CHARACTERISTIC _g_PL_AD_fw_Radar_1R1V_rpc_XilObjBypassingRunnable_XilObjBypassingRunnable_m_pad_radarObjPort_par_out_local.TChangeableMemPool._._._m_arrayPool._0_._elem._m_objectInformation._3_._m_dyN "" VALUE 0xB00573E6 __SWord_Value 0 NO_COMPU_METHOD -32768 32767 ECU_ADDRESS_EXTENSION 0x1 BYTE_ORDER MSB_LAST /end CHARACTERISTIC
/begin CHARACTERISTIC _g_PL_AD_fw_Radar_1R1V_rpc_XilObjBypassingRunnable_XilObjBypassingRunnable_m_pad_radarObjPort_par_out_local.TChangeableMemPool._._._m_arrayPool._0_._elem._m_objectInformation._3_._m_dzN "" VALUE 0xB00573E8 __SWord_Value 0 NO_COMPU_METHOD -32768 32767 ECU_ADDRESS_EXTENSION 0x1 BYTE_ORDER MSB_LAST /end CHARACTERISTIC
/begin CHARACTERISTIC _g_PL_AD_fw_Radar_1R1V_rpc_XilObjBypassingRunnable_XilObjBypassingRunnable_m_pad_radarObjPort_par_out_local.TChangeableMemPool._._._m_arrayPool._0_._elem._m_objectInformation._3_._m_isObjectAsil "" VALUE 0xB0057404 __UByte_Value 0 NO_COMPU_METHOD 0 255 ECU_ADDRESS_EXTENSION 0x1 BYTE_ORDER MSB_LAST /end CHARACTERISTIC
/begin CHARACTERISTIC _g_PL_AD_fw_Radar_1R1V_rpc_XilObjBypassingRunnable_XilObjBypassingRunnable_m_pad_radarObjPort_par_out_local.TChangeableMemPool._._._m_arrayPool._0_._elem._m_objectInformation._3_._m_perObjectType._m_prob1FourPlusWheelerN "" VALUE 0xB00573BE __UByte_Value 0 NO_COMPU_METHOD 0 255 ECU_ADDRESS_EXTENSION 0x1 BYTE_ORDER MSB_LAST /end CHARACTERISTIC
/begin CHARACTERISTIC _g_PL_AD_fw_Radar_1R1V_rpc_XilObjBypassingRunnable_XilObjBypassingRunnable_m_pad_radarObjPort_par_out_local.TChangeableMemPool._._._m_arrayPool._0_._elem._m_objectInformation._3_._m_perObjectType._m_prob1FourWheelUnknownN "" VALUE 0xB00573C6 __UByte_Value 0 NO_COMPU_METHOD 0 255 ECU_ADDRESS_EXTENSION 0x1 BYTE_ORDER MSB_LAST /end CHARACTERISTIC
/begin CHARACTERISTIC _g_PL_AD_fw_Radar_1R1V_rpc_XilObjBypassingRunnable_XilObjBypassingRunnable_m_pad_radarObjPort_par_out_local.TChangeableMemPool._._._m_arrayPool._0_._elem._m_objectInformation._3_._m_perObjectType._m_prob1MobileN "" VALUE 0xB00573BB __UByte_Value 0 NO_COMPU_METHOD 0 255 ECU_ADDRESS_EXTENSION 0x1 BYTE_ORDER MSB_LAST /end CHARACTERISTIC
/begin CHARACTERISTIC _g_PL_AD_fw_Radar_1R1V_rpc_XilObjBypassingRunnable_XilObjBypassingRunnable_m_pad_radarObjPort_par_out_local.TChangeableMemPool._._._m_arrayPool._0_._elem._m_objectInformation._3_._m_perObjectType._m_prob1MovUnknownN "" VALUE 0xB00573C1 __UByte_Value 0 NO_COMPU_METHOD 0 255 ECU_ADDRESS_EXTENSION 0x1 BYTE_ORDER MSB_LAST /end CHARACTERISTIC
/begin CHARACTERISTIC _g_PL_AD_fw_Radar_1R1V_rpc_XilObjBypassingRunnable_XilObjBypassingRunnable_m_pad_radarObjPort_par_out_local.TChangeableMemPool._._._m_arrayPool._0_._elem._m_objectInformation._3_._m_perObjectType._m_prob1NonObstacleN "" VALUE 0xB00573B9 __UByte_Value 0 NO_COMPU_METHOD 0 255 ECU_ADDRESS_EXTENSION 0x1 BYTE_ORDER MSB_LAST /end CHARACTERISTIC
/begin CHARACTERISTIC _g_PL_AD_fw_Radar_1R1V_rpc_XilObjBypassingRunnable_XilObjBypassingRunnable_m_pad_radarObjPort_par_out_local.TChangeableMemPool._._._m_arrayPool._0_._elem._m_objectInformation._3_._m_perObjectType._m_prob1ObstUnknownN "" VALUE 0xB00573BD __UByte_Value 0 NO_COMPU_METHOD 0 255 ECU_ADDRESS_EXTENSION 0x1 BYTE_ORDER MSB_LAST /end CHARACTERISTIC
/begin CHARACTERISTIC _g_PL_AD_fw_Radar_1R1V_rpc_XilObjBypassingRunnable_XilObjBypassingRunnable_m_pad_radarObjPort_par_out_local.TChangeableMemPool._._._m_arrayPool._0_._elem._m_objectInformation._3_._m_perObjectType._m_prob1ObstacleN "" VALUE 0xB00573B8 __UByte_Value 0 NO_COMPU_METHOD 0 255 ECU_ADDRESS_EXTENSION 0x1 BYTE_ORDER MSB_LAST /end CHARACTERISTIC
/begin CHARACTERISTIC _g_PL_AD_fw_Radar_1R1V_rpc_XilObjBypassingRunnable_XilObjBypassingRunnable_m_pad_radarObjPort_par_out_local.TChangeableMemPool._._._m_arrayPool._0_._elem._m_objectInformation._3_._m_perObjectType._m_prob1PassengerCarN "" VALUE 0xB00573C4 __UByte_Value 0 NO_COMPU_METHOD 0 255 ECU_ADDRESS_EXTENSION 0x1 BYTE_ORDER MSB_LAST /end CHARACTERISTIC
/begin CHARACTERISTIC _g_PL_AD_fw_Radar_1R1V_rpc_XilObjBypassingRunnable_XilObjBypassingRunnable_m_pad_radarObjPort_par_out_local.TChangeableMemPool._._._m_arrayPool._0_._elem._m_objectInformation._3_._m_perObjectType._m_prob1PedestrianN "" VALUE 0xB00573C0 __UByte_Value 0 NO_COMPU_METHOD 0 255 ECU_ADDRESS_EXTENSION 0x1 BYTE_ORDER MSB_LAST /end CHARACTERISTIC
/begin CHARACTERISTIC _g_PL_AD_fw_Radar_1R1V_rpc_XilObjBypassingRunnable_XilObjBypassingRunnable_m_pad_radarObjPort_par_out_local.TChangeableMemPool._._._m_arrayPool._0_._elem._m_objectInformation._3_._m_perObjectType._m_prob1RoadsideBarrierN "" VALUE 0xB00573C2 __UByte_Value 0 NO_COMPU_METHOD 0 255 ECU_ADDRESS_EXTENSION 0x1 BYTE_ORDER MSB_LAST /end CHARACTERISTIC
/begin CHARACTERISTIC _g_PL_AD_fw_Radar_1R1V_rpc_XilObjBypassingRunnable_XilObjBypassingRunnable_m_pad_radarObjPort_par_out_local.TChangeableMemPool._._._m_arrayPool._0_._elem._m_objectInformation._3_._m_perObjectType._m_prob1StatUnknownN "" VALUE 0xB00573C3 __UByte_Value 0 NO_COMPU_METHOD 0 255 ECU_ADDRESS_EXTENSION 0x1 BYTE_ORDER MSB_LAST /end CHARACTERISTIC
/begin CHARACTERISTIC _g_PL_AD_fw_Radar_1R1V_rpc_XilObjBypassingRunnable_XilObjBypassingRunnable_m_pad_radarObjPort_par_out_local.TChangeableMemPool._._._m_arrayPool._0_._elem._m_objectInformation._3_._m_perObjectType._m_prob1StationaryN "" VALUE 0xB00573BC __UByte_Value 0 NO_COMPU_METHOD 0 255 ECU_ADDRESS_EXTENSION 0x1 BYTE_ORDER MSB_LAST /end CHARACTERISTIC
/begin CHARACTERISTIC _g_PL_AD_fw_Radar_1R1V_rpc_XilObjBypassingRunnable_XilObjBypassingRunnable_m_pad_radarObjPort_par_out_local.TChangeableMemPool._._._m_arrayPool._0_._elem._m_objectInformation._3_._m_perObjectType._m_prob1TruckN "" VALUE 0xB00573C5 __UByte_Value 0 NO_COMPU_METHOD 0 255 ECU_ADDRESS_EXTENSION 0x1 BYTE_ORDER MSB_LAST /end CHARACTERISTIC
/begin CHARACTERISTIC _g_PL_AD_fw_Radar_1R1V_rpc_XilObjBypassingRunnable_XilObjBypassingRunnable_m_pad_radarObjPort_par_out_local.TChangeableMemPool._._._m_arrayPool._0_._elem._m_objectInformation._3_._m_perObjectType._m_prob1TwoWheelerN "" VALUE 0xB00573BF __UByte_Value 0 NO_COMPU_METHOD 0 255 ECU_ADDRESS_EXTENSION 0x1 BYTE_ORDER MSB_LAST /end CHARACTERISTIC
/begin CHARACTERISTIC _g_PL_AD_fw_Radar_1R1V_rpc_XilObjBypassingRunnable_XilObjBypassingRunnable_m_pad_radarObjPort_par_out_local.TChangeableMemPool._._._m_arrayPool._0_._elem._m_objectInformation._3_._m_perObjectType._m_prob1UnknownN "" VALUE 0xB00573BA __UByte_Value 0 NO_COMPU_METHOD 0 255 ECU_ADDRESS_EXTENSION 0x1 BYTE_ORDER MSB_LAST /end CHARACTERISTIC
/begin CHARACTERISTIC _g_PL_AD_fw_Radar_1R1V_rpc_XilObjBypassingRunnable_XilObjBypassingRunnable_m_pad_radarObjPort_par_out_local.TChangeableMemPool._._._m_arrayPool._0_._elem._m_objectInformation._3_._m_prob1HasBeenObservedMovingN "" VALUE 0xB0057401 __UByte_Value 0 NO_COMPU_METHOD 0 255 ECU_ADDRESS_EXTENSION 0x1 BYTE_ORDER MSB_LAST /end CHARACTERISTIC
/begin CHARACTERISTIC _g_PL_AD_fw_Radar_1R1V_rpc_XilObjBypassingRunnable_XilObjBypassingRunnable_m_pad_radarObjPort_par_out_local.TChangeableMemPool._._._m_arrayPool._0_._elem._m_objectInformation._3_._m_prob1MovingN "" VALUE 0xB0057400 __UByte_Value 0 NO_COMPU_METHOD 0 255 ECU_ADDRESS_EXTENSION 0x1 BYTE_ORDER MSB_LAST /end CHARACTERISTIC
/begin CHARACTERISTIC _g_PL_AD_fw_Radar_1R1V_rpc_XilObjBypassingRunnable_XilObjBypassingRunnable_m_pad_radarObjPort_par_out_local.TChangeableMemPool._._._m_arrayPool._0_._elem._m_objectInformation._3_._m_varAxN "" VALUE 0xB00573DC __SLong_Value 0 NO_COMPU_METHOD -2147483648 2147483647 ECU_ADDRESS_EXTENSION 0x1 BYTE_ORDER MSB_LAST /end CHARACTERISTIC
/begin CHARACTERISTIC _g_PL_AD_fw_Radar_1R1V_rpc_XilObjBypassingRunnable_XilObjBypassingRunnable_m_pad_radarObjPort_par_out_local.TChangeableMemPool._._._m_arrayPool._0_._elem._m_objectInformation._3_._m_varAyN "" VALUE 0xB00573E0 __SLong_Value 0 NO_COMPU_METHOD -2147483648 2147483647 ECU_ADDRESS_EXTENSION 0x1 BYTE_ORDER MSB_LAST /end CHARACTERISTIC
/begin CHARACTERISTIC _g_PL_AD_fw_Radar_1R1V_rpc_XilObjBypassingRunnable_XilObjBypassingRunnable_m_pad_radarObjPort_par_out_local.TChangeableMemPool._._._m_arrayPool._0_._elem._m_objectInformation._3_._m_varDxN "" VALUE 0xB00573CC __SLong_Value 0 NO_COMPU_METHOD -2147483648 2147483647 ECU_ADDRESS_EXTENSION 0x1 BYTE_ORDER MSB_LAST /end CHARACTERISTIC
/begin CHARACTERISTIC _g_PL_AD_fw_Radar_1R1V_rpc_XilObjBypassingRunnable_XilObjBypassingRunnable_m_pad_radarObjPort_par_out_local.TChangeableMemPool._._._m_arrayPool._0_._elem._m_objectInformation._3_._m_varDyN "" VALUE 0xB00573D0 __SLong_Value 0 NO_COMPU_METHOD -2147483648 2147483647 ECU_ADDRESS_EXTENSION 0x1 BYTE_ORDER MSB_LAST /end CHARACTERISTIC
/begin CHARACTERISTIC _g_PL_AD_fw_Radar_1R1V_rpc_XilObjBypassingRunnable_XilObjBypassingRunnable_m_pad_radarObjPort_par_out_local.TChangeableMemPool._._._m_arrayPool._0_._elem._m_objectInformation._3_._m_varVxN "" VALUE 0xB00573D4 __SLong_Value 0 NO_COMPU_METHOD -2147483648 2147483647 ECU_ADDRESS_EXTENSION 0x1 BYTE_ORDER MSB_LAST /end CHARACTERISTIC
/begin CHARACTERISTIC _g_PL_AD_fw_Radar_1R1V_rpc_XilObjBypassingRunnable_XilObjBypassingRunnable_m_pad_radarObjPort_par_out_local.TChangeableMemPool._._._m_arrayPool._0_._elem._m_objectInformation._3_._m_varVyN "" VALUE 0xB00573D8 __SLong_Value 0 NO_COMPU_METHOD -2147483648 2147483647 ECU_ADDRESS_EXTENSION 0x1 BYTE_ORDER MSB_LAST /end CHARACTERISTIC
/begin CHARACTERISTIC _g_PL_AD_fw_Radar_1R1V_rpc_XilObjBypassingRunnable_XilObjBypassingRunnable_m_pad_radarObjPort_par_out_local.TChangeableMemPool._._._m_arrayPool._0_._elem._m_objectInformation._3_._m_vxN "" VALUE 0xB00573EA __SWord_Value 0 NO_COMPU_METHOD -32768 32767 ECU_ADDRESS_EXTENSION 0x1 BYTE_ORDER MSB_LAST /end CHARACTERISTIC
/begin CHARACTERISTIC _g_PL_AD_fw_Radar_1R1V_rpc_XilObjBypassingRunnable_XilObjBypassingRunnable_m_pad_radarObjPort_par_out_local.TChangeableMemPool._._._m_arrayPool._0_._elem._m_objectInformation._3_._m_vyN "" VALUE 0xB00573EC __SWord_Value 0 NO_COMPU_METHOD -32768 32767 ECU_ADDRESS_EXTENSION 0x1 BYTE_ORDER MSB_LAST /end CHARACTERISTIC
/begin CHARACTERISTIC _g_PL_AD_fw_Radar_1R1V_rpc_XilObjBypassingRunnable_XilObjBypassingRunnable_m_pad_radarObjPort_par_out_local.TChangeableMemPool._._._m_arrayPool._0_._elem._m_objectInformation._3_._m_wExistProbN "" VALUE 0xB00573FE __UWord_Value 0 NO_COMPU_METHOD 0 65535 ECU_ADDRESS_EXTENSION 0x1 BYTE_ORDER MSB_LAST /end CHARACTERISTIC
/begin CHARACTERISTIC _g_PL_AD_fw_Radar_1R1V_rpc_XilObjBypassingRunnable_XilObjBypassingRunnable_m_pad_radarObjPort_par_out_local.TChangeableMemPool._._._m_arrayPool._0_._elem._m_objectInformation._4_._Valid_b "" VALUE 0xB0057453 __UByte_Value 0 NO_COMPU_METHOD 0 255 ECU_ADDRESS_EXTENSION 0x1 BYTE_ORDER MSB_LAST /end CHARACTERISTIC
/begin CHARACTERISTIC _g_PL_AD_fw_Radar_1R1V_rpc_XilObjBypassingRunnable_XilObjBypassingRunnable_m_pad_radarObjPort_par_out_local.TChangeableMemPool._._._m_arrayPool._0_._elem._m_objectInformation._4_._m_HandleN "" VALUE 0xB0057452 __UByte_Value 0 NO_COMPU_METHOD 0 255 ECU_ADDRESS_EXTENSION 0x1 BYTE_ORDER MSB_LAST /end CHARACTERISTIC
/begin CHARACTERISTIC _g_PL_AD_fw_Radar_1R1V_rpc_XilObjBypassingRunnable_XilObjBypassingRunnable_m_pad_radarObjPort_par_out_local.TChangeableMemPool._._._m_arrayPool._0_._elem._m_objectInformation._4_._m_alpPiVarYawAngleN "" VALUE 0xB0057448 __UWord_Value 0 NO_COMPU_METHOD 0 65535 ECU_ADDRESS_EXTENSION 0x1 BYTE_ORDER MSB_LAST /end CHARACTERISTIC
/begin CHARACTERISTIC _g_PL_AD_fw_Radar_1R1V_rpc_XilObjBypassingRunnable_XilObjBypassingRunnable_m_pad_radarObjPort_par_out_local.TChangeableMemPool._._._m_arrayPool._0_._elem._m_objectInformation._4_._m_alpPiYawAngleN "" VALUE 0xB0057442 __SWord_Value 0 NO_COMPU_METHOD -32768 32767 ECU_ADDRESS_EXTENSION 0x1 BYTE_ORDER MSB_LAST /end CHARACTERISTIC
/begin CHARACTERISTIC _g_PL_AD_fw_Radar_1R1V_rpc_XilObjBypassingRunnable_XilObjBypassingRunnable_m_pad_radarObjPort_par_out_local.TChangeableMemPool._._._m_arrayPool._0_._elem._m_objectInformation._4_._m_axN "" VALUE 0xB005743E __SWord_Value 0 NO_COMPU_METHOD -32768 32767 ECU_ADDRESS_EXTENSION 0x1 BYTE_ORDER MSB_LAST /end CHARACTERISTIC
/begin CHARACTERISTIC _g_PL_AD_fw_Radar_1R1V_rpc_XilObjBypassingRunnable_XilObjBypassingRunnable_m_pad_radarObjPort_par_out_local.TChangeableMemPool._._._m_arrayPool._0_._elem._m_objectInformation._4_._m_ayN "" VALUE 0xB0057440 __SWord_Value 0 NO_COMPU_METHOD -32768 32767 ECU_ADDRESS_EXTENSION 0x1 BYTE_ORDER MSB_LAST /end CHARACTERISTIC
/begin CHARACTERISTIC _g_PL_AD_fw_Radar_1R1V_rpc_XilObjBypassingRunnable_XilObjBypassingRunnable_m_pad_radarObjPort_par_out_local.TChangeableMemPool._._._m_arrayPool._0_._elem._m_objectInformation._4_._m_dLengthN "" VALUE 0xB0057446 __SWord_Value 0 NO_COMPU_METHOD -32768 32767 ECU_ADDRESS_EXTENSION 0x1 BYTE_ORDER MSB_LAST /end CHARACTERISTIC
/begin CHARACTERISTIC _g_PL_AD_fw_Radar_1R1V_rpc_XilObjBypassingRunnable_XilObjBypassingRunnable_m_pad_radarObjPort_par_out_local.TChangeableMemPool._._._m_arrayPool._0_._elem._m_objectInformation._4_._m_dVarLengthN "" VALUE 0xB005744C __UWord_Value 0 NO_COMPU_METHOD 0 65535 ECU_ADDRESS_EXTENSION 0x1 BYTE_ORDER MSB_LAST /end CHARACTERISTIC
/begin CHARACTERISTIC _g_PL_AD_fw_Radar_1R1V_rpc_XilObjBypassingRunnable_XilObjBypassingRunnable_m_pad_radarObjPort_par_out_local.TChangeableMemPool._._._m_arrayPool._0_._elem._m_objectInformation._4_._m_dVarWidthN "" VALUE 0xB005744A __UWord_Value 0 NO_COMPU_METHOD 0 65535 ECU_ADDRESS_EXTENSION 0x1 BYTE_ORDER MSB_LAST /end CHARACTERISTIC
/begin CHARACTERISTIC _g_PL_AD_fw_Radar_1R1V_rpc_XilObjBypassingRunnable_XilObjBypassingRunnable_m_pad_radarObjPort_par_out_local.TChangeableMemPool._._._m_arrayPool._0_._elem._m_objectInformation._4_._m_dWidthN "" VALUE 0xB0057444 __SWord_Value 0 NO_COMPU_METHOD -32768 32767 ECU_ADDRESS_EXTENSION 0x1 BYTE_ORDER MSB_LAST /end CHARACTERISTIC
/begin CHARACTERISTIC _g_PL_AD_fw_Radar_1R1V_rpc_XilObjBypassingRunnable_XilObjBypassingRunnable_m_pad_radarObjPort_par_out_local.TChangeableMemPool._._._m_arrayPool._0_._elem._m_objectInformation._4_._m_dxN "" VALUE 0xB0057434 __SWord_Value 0 NO_COMPU_METHOD -32768 32767 ECU_ADDRESS_EXTENSION 0x1 BYTE_ORDER MSB_LAST /end CHARACTERISTIC
/begin CHARACTERISTIC _g_PL_AD_fw_Radar_1R1V_rpc_XilObjBypassingRunnable_XilObjBypassingRunnable_m_pad_radarObjPort_par_out_local.TChangeableMemPool._._._m_arrayPool._0_._elem._m_objectInformation._4_._m_dyN "" VALUE 0xB0057436 __SWord_Value 0 NO_COMPU_METHOD -32768 32767 ECU_ADDRESS_EXTENSION 0x1 BYTE_ORDER MSB_LAST /end CHARACTERISTIC
/begin CHARACTERISTIC _g_PL_AD_fw_Radar_1R1V_rpc_XilObjBypassingRunnable_XilObjBypassingRunnable_m_pad_radarObjPort_par_out_local.TChangeableMemPool._._._m_arrayPool._0_._elem._m_objectInformation._4_._m_dzN "" VALUE 0xB0057438 __SWord_Value 0 NO_COMPU_METHOD -32768 32767 ECU_ADDRESS_EXTENSION 0x1 BYTE_ORDER MSB_LAST /end CHARACTERISTIC
/begin CHARACTERISTIC _g_PL_AD_fw_Radar_1R1V_rpc_XilObjBypassingRunnable_XilObjBypassingRunnable_m_pad_radarObjPort_par_out_local.TChangeableMemPool._._._m_arrayPool._0_._elem._m_objectInformation._4_._m_isObjectAsil "" VALUE 0xB0057454 __UByte_Value 0 NO_COMPU_METHOD 0 255 ECU_ADDRESS_EXTENSION 0x1 BYTE_ORDER MSB_LAST /end CHARACTERISTIC
/begin CHARACTERISTIC _g_PL_AD_fw_Radar_1R1V_rpc_XilObjBypassingRunnable_XilObjBypassingRunnable_m_pad_radarObjPort_par_out_local.TChangeableMemPool._._._m_arrayPool._0_._elem._m_objectInformation._4_._m_perObjectType._m_prob1FourPlusWheelerN "" VALUE 0xB005740E __UByte_Value 0 NO_COMPU_METHOD 0 255 ECU_ADDRESS_EXTENSION 0x1 BYTE_ORDER MSB_LAST /end CHARACTERISTIC
/begin CHARACTERISTIC _g_PL_AD_fw_Radar_1R1V_rpc_XilObjBypassingRunnable_XilObjBypassingRunnable_m_pad_radarObjPort_par_out_local.TChangeableMemPool._._._m_arrayPool._0_._elem._m_objectInformation._4_._m_perObjectType._m_prob1FourWheelUnknownN "" VALUE 0xB0057416 __UByte_Value 0 NO_COMPU_METHOD 0 255 ECU_ADDRESS_EXTENSION 0x1 BYTE_ORDER MSB_LAST /end CHARACTERISTIC
/begin CHARACTERISTIC _g_PL_AD_fw_Radar_1R1V_rpc_XilObjBypassingRunnable_XilObjBypassingRunnable_m_pad_radarObjPort_par_out_local.TChangeableMemPool._._._m_arrayPool._0_._elem._m_objectInformation._4_._m_perObjectType._m_prob1MobileN "" VALUE 0xB005740B __UByte_Value 0 NO_COMPU_METHOD 0 255 ECU_ADDRESS_EXTENSION 0x1 BYTE_ORDER MSB_LAST /end CHARACTERISTIC
/begin CHARACTERISTIC _g_PL_AD_fw_Radar_1R1V_rpc_XilObjBypassingRunnable_XilObjBypassingRunnable_m_pad_radarObjPort_par_out_local.TChangeableMemPool._._._m_arrayPool._0_._elem._m_objectInformation._4_._m_perObjectType._m_prob1MovUnknownN "" VALUE 0xB0057411 __UByte_Value 0 NO_COMPU_METHOD 0 255 ECU_ADDRESS_EXTENSION 0x1 BYTE_ORDER MSB_LAST /end CHARACTERISTIC
/begin CHARACTERISTIC _g_PL_AD_fw_Radar_1R1V_rpc_XilObjBypassingRunnable_XilObjBypassingRunnable_m_pad_radarObjPort_par_out_local.TChangeableMemPool._._._m_arrayPool._0_._elem._m_objectInformation._4_._m_perObjectType._m_prob1NonObstacleN "" VALUE 0xB0057409 __UByte_Value 0 NO_COMPU_METHOD 0 255 ECU_ADDRESS_EXTENSION 0x1 BYTE_ORDER MSB_LAST /end CHARACTERISTIC
/begin CHARACTERISTIC _g_PL_AD_fw_Radar_1R1V_rpc_XilObjBypassingRunnable_XilObjBypassingRunnable_m_pad_radarObjPort_par_out_local.TChangeableMemPool._._._m_arrayPool._0_._elem._m_objectInformation._4_._m_perObjectType._m_prob1ObstUnknownN "" VALUE 0xB005740D __UByte_Value 0 NO_COMPU_METHOD 0 255 ECU_ADDRESS_EXTENSION 0x1 BYTE_ORDER MSB_LAST /end CHARACTERISTIC
/begin CHARACTERISTIC _g_PL_AD_fw_Radar_1R1V_rpc_XilObjBypassingRunnable_XilObjBypassingRunnable_m_pad_radarObjPort_par_out_local.TChangeableMemPool._._._m_arrayPool._0_._elem._m_objectInformation._4_._m_perObjectType._m_prob1ObstacleN "" VALUE 0xB0057408 __UByte_Value 0 NO_COMPU_METHOD 0 255 ECU_ADDRESS_EXTENSION 0x1 BYTE_ORDER MSB_LAST /end CHARACTERISTIC
/begin CHARACTERISTIC _g_PL_AD_fw_Radar_1R1V_rpc_XilObjBypassingRunnable_XilObjBypassingRunnable_m_pad_radarObjPort_par_out_local.TChangeableMemPool._._._m_arrayPool._0_._elem._m_objectInformation._4_._m_perObjectType._m_prob1PassengerCarN "" VALUE 0xB0057414 __UByte_Value 0 NO_COMPU_METHOD 0 255 ECU_ADDRESS_EXTENSION 0x1 BYTE_ORDER MSB_LAST /end CHARACTERISTIC
/begin CHARACTERISTIC _g_PL_AD_fw_Radar_1R1V_rpc_XilObjBypassingRunnable_XilObjBypassingRunnable_m_pad_radarObjPort_par_out_local.TChangeableMemPool._._._m_arrayPool._0_._elem._m_objectInformation._4_._m_perObjectType._m_prob1PedestrianN "" VALUE 0xB0057410 __UByte_Value 0 NO_COMPU_METHOD 0 255 ECU_ADDRESS_EXTENSION 0x1 BYTE_ORDER MSB_LAST /end CHARACTERISTIC
/begin CHARACTERISTIC _g_PL_AD_fw_Radar_1R1V_rpc_XilObjBypassingRunnable_XilObjBypassingRunnable_m_pad_radarObjPort_par_out_local.TChangeableMemPool._._._m_arrayPool._0_._elem._m_objectInformation._4_._m_perObjectType._m_prob1RoadsideBarrierN "" VALUE 0xB0057412 __UByte_Value 0 NO_COMPU_METHOD 0 255 ECU_ADDRESS_EXTENSION 0x1 BYTE_ORDER MSB_LAST /end CHARACTERISTIC
/begin CHARACTERISTIC _g_PL_AD_fw_Radar_1R1V_rpc_XilObjBypassingRunnable_XilObjBypassingRunnable_m_pad_radarObjPort_par_out_local.TChangeableMemPool._._._m_arrayPool._0_._elem._m_objectInformation._4_._m_perObjectType._m_prob1StatUnknownN "" VALUE 0xB0057413 __UByte_Value 0 NO_COMPU_METHOD 0 255 ECU_ADDRESS_EXTENSION 0x1 BYTE_ORDER MSB_LAST /end CHARACTERISTIC
/begin CHARACTERISTIC _g_PL_AD_fw_Radar_1R1V_rpc_XilObjBypassingRunnable_XilObjBypassingRunnable_m_pad_radarObjPort_par_out_local.TChangeableMemPool._._._m_arrayPool._0_._elem._m_objectInformation._4_._m_perObjectType._m_prob1StationaryN "" VALUE 0xB005740C __UByte_Value 0 NO_COMPU_METHOD 0 255 ECU_ADDRESS_EXTENSION 0x1 BYTE_ORDER MSB_LAST /end CHARACTERISTIC
/begin CHARACTERISTIC _g_PL_AD_fw_Radar_1R1V_rpc_XilObjBypassingRunnable_XilObjBypassingRunnable_m_pad_radarObjPort_par_out_local.TChangeableMemPool._._._m_arrayPool._0_._elem._m_objectInformation._4_._m_perObjectType._m_prob1TruckN "" VALUE 0xB0057415 __UByte_Value 0 NO_COMPU_METHOD 0 255 ECU_ADDRESS_EXTENSION 0x1 BYTE_ORDER MSB_LAST /end CHARACTERISTIC
/begin CHARACTERISTIC _g_PL_AD_fw_Radar_1R1V_rpc_XilObjBypassingRunnable_XilObjBypassingRunnable_m_pad_radarObjPort_par_out_local.TChangeableMemPool._._._m_arrayPool._0_._elem._m_objectInformation._4_._m_perObjectType._m_prob1TwoWheelerN "" VALUE 0xB005740F __UByte_Value 0 NO_COMPU_METHOD 0 255 ECU_ADDRESS_EXTENSION 0x1 BYTE_ORDER MSB_LAST /end CHARACTERISTIC
/begin CHARACTERISTIC _g_PL_AD_fw_Radar_1R1V_rpc_XilObjBypassingRunnable_XilObjBypassingRunnable_m_pad_radarObjPort_par_out_local.TChangeableMemPool._._._m_arrayPool._0_._elem._m_objectInformation._4_._m_perObjectType._m_prob1UnknownN "" VALUE 0xB005740A __UByte_Value 0 NO_COMPU_METHOD 0 255 ECU_ADDRESS_EXTENSION 0x1 BYTE_ORDER MSB_LAST /end CHARACTERISTIC
/begin CHARACTERISTIC _g_PL_AD_fw_Radar_1R1V_rpc_XilObjBypassingRunnable_XilObjBypassingRunnable_m_pad_radarObjPort_par_out_local.TChangeableMemPool._._._m_arrayPool._0_._elem._m_objectInformation._4_._m_prob1HasBeenObservedMovingN "" VALUE 0xB0057451 __UByte_Value 0 NO_COMPU_METHOD 0 255 ECU_ADDRESS_EXTENSION 0x1 BYTE_ORDER MSB_LAST /end CHARACTERISTIC
/begin CHARACTERISTIC _g_PL_AD_fw_Radar_1R1V_rpc_XilObjBypassingRunnable_XilObjBypassingRunnable_m_pad_radarObjPort_par_out_local.TChangeableMemPool._._._m_arrayPool._0_._elem._m_objectInformation._4_._m_prob1MovingN "" VALUE 0xB0057450 __UByte_Value 0 NO_COMPU_METHOD 0 255 ECU_ADDRESS_EXTENSION 0x1 BYTE_ORDER MSB_LAST /end CHARACTERISTIC
/begin CHARACTERISTIC _g_PL_AD_fw_Radar_1R1V_rpc_XilObjBypassingRunnable_XilObjBypassingRunnable_m_pad_radarObjPort_par_out_local.TChangeableMemPool._._._m_arrayPool._0_._elem._m_objectInformation._4_._m_varAxN "" VALUE 0xB005742C __SLong_Value 0 NO_COMPU_METHOD -2147483648 2147483647 ECU_ADDRESS_EXTENSION 0x1 BYTE_ORDER MSB_LAST /end CHARACTERISTIC
/begin CHARACTERISTIC _g_PL_AD_fw_Radar_1R1V_rpc_XilObjBypassingRunnable_XilObjBypassingRunnable_m_pad_radarObjPort_par_out_local.TChangeableMemPool._._._m_arrayPool._0_._elem._m_objectInformation._4_._m_varAyN "" VALUE 0xB0057430 __SLong_Value 0 NO_COMPU_METHOD -2147483648 2147483647 ECU_ADDRESS_EXTENSION 0x1 BYTE_ORDER MSB_LAST /end CHARACTERISTIC
/begin CHARACTERISTIC _g_PL_AD_fw_Radar_1R1V_rpc_XilObjBypassingRunnable_XilObjBypassingRunnable_m_pad_radarObjPort_par_out_local.TChangeableMemPool._._._m_arrayPool._0_._elem._m_objectInformation._4_._m_varDxN "" VALUE 0xB005741C __SLong_Value 0 NO_COMPU_METHOD -2147483648 2147483647 ECU_ADDRESS_EXTENSION 0x1 BYTE_ORDER MSB_LAST /end CHARACTERISTIC
/begin CHARACTERISTIC _g_PL_AD_fw_Radar_1R1V_rpc_XilObjBypassingRunnable_XilObjBypassingRunnable_m_pad_radarObjPort_par_out_local.TChangeableMemPool._._._m_arrayPool._0_._elem._m_objectInformation._4_._m_varDyN "" VALUE 0xB0057420 __SLong_Value 0 NO_COMPU_METHOD -2147483648 2147483647 ECU_ADDRESS_EXTENSION 0x1 BYTE_ORDER MSB_LAST /end CHARACTERISTIC
/begin CHARACTERISTIC _g_PL_AD_fw_Radar_1R1V_rpc_XilObjBypassingRunnable_XilObjBypassingRunnable_m_pad_radarObjPort_par_out_local.TChangeableMemPool._._._m_arrayPool._0_._elem._m_objectInformation._4_._m_varVxN "" VALUE 0xB0057424 __SLong_Value 0 NO_COMPU_METHOD -2147483648 2147483647 ECU_ADDRESS_EXTENSION 0x1 BYTE_ORDER MSB_LAST /end CHARACTERISTIC
/begin CHARACTERISTIC _g_PL_AD_fw_Radar_1R1V_rpc_XilObjBypassingRunnable_XilObjBypassingRunnable_m_pad_radarObjPort_par_out_local.TChangeableMemPool._._._m_arrayPool._0_._elem._m_objectInformation._4_._m_varVyN "" VALUE 0xB0057428 __SLong_Value 0 NO_COMPU_METHOD -2147483648 2147483647 ECU_ADDRESS_EXTENSION 0x1 BYTE_ORDER MSB_LAST /end CHARACTERISTIC
/begin CHARACTERISTIC _g_PL_AD_fw_Radar_1R1V_rpc_XilObjBypassingRunnable_XilObjBypassingRunnable_m_pad_radarObjPort_par_out_local.TChangeableMemPool._._._m_arrayPool._0_._elem._m_objectInformation._4_._m_vxN "" VALUE 0xB005743A __SWord_Value 0 NO_COMPU_METHOD -32768 32767 ECU_ADDRESS_EXTENSION 0x1 BYTE_ORDER MSB_LAST /end CHARACTERISTIC
/begin CHARACTERISTIC _g_PL_AD_fw_Radar_1R1V_rpc_XilObjBypassingRunnable_XilObjBypassingRunnable_m_pad_radarObjPort_par_out_local.TChangeableMemPool._._._m_arrayPool._0_._elem._m_objectInformation._4_._m_vyN "" VALUE 0xB005743C __SWord_Value 0 NO_COMPU_METHOD -32768 32767 ECU_ADDRESS_EXTENSION 0x1 BYTE_ORDER MSB_LAST /end CHARACTERISTIC
/begin CHARACTERISTIC _g_PL_AD_fw_Radar_1R1V_rpc_XilObjBypassingRunnable_XilObjBypassingRunnable_m_pad_radarObjPort_par_out_local.TChangeableMemPool._._._m_arrayPool._0_._elem._m_objectInformation._4_._m_wExistProbN "" VALUE 0xB005744E __UWord_Value 0 NO_COMPU_METHOD 0 65535 ECU_ADDRESS_EXTENSION 0x1 BYTE_ORDER MSB_LAST /end CHARACTERISTIC
/begin CHARACTERISTIC _g_PL_AD_fw_Radar_1R1V_rpc_XilObjBypassingRunnable_XilObjBypassingRunnable_m_pad_radarObjPort_par_out_local.TChangeableMemPool._._._m_arrayPool._0_._elem._m_objectInformation._5_._Valid_b "" VALUE 0xB00574A3 __UByte_Value 0 NO_COMPU_METHOD 0 255 ECU_ADDRESS_EXTENSION 0x1 BYTE_ORDER MSB_LAST /end CHARACTERISTIC
/begin CHARACTERISTIC _g_PL_AD_fw_Radar_1R1V_rpc_XilObjBypassingRunnable_XilObjBypassingRunnable_m_pad_radarObjPort_par_out_local.TChangeableMemPool._._._m_arrayPool._0_._elem._m_objectInformation._5_._m_HandleN "" VALUE 0xB00574A2 __UByte_Value 0 NO_COMPU_METHOD 0 255 ECU_ADDRESS_EXTENSION 0x1 BYTE_ORDER MSB_LAST /end CHARACTERISTIC
/begin CHARACTERISTIC _g_PL_AD_fw_Radar_1R1V_rpc_XilObjBypassingRunnable_XilObjBypassingRunnable_m_pad_radarObjPort_par_out_local.TChangeableMemPool._._._m_arrayPool._0_._elem._m_objectInformation._5_._m_alpPiVarYawAngleN "" VALUE 0xB0057498 __UWord_Value 0 NO_COMPU_METHOD 0 65535 ECU_ADDRESS_EXTENSION 0x1 BYTE_ORDER MSB_LAST /end CHARACTERISTIC
/begin CHARACTERISTIC _g_PL_AD_fw_Radar_1R1V_rpc_XilObjBypassingRunnable_XilObjBypassingRunnable_m_pad_radarObjPort_par_out_local.TChangeableMemPool._._._m_arrayPool._0_._elem._m_objectInformation._5_._m_alpPiYawAngleN "" VALUE 0xB0057492 __SWord_Value 0 NO_COMPU_METHOD -32768 32767 ECU_ADDRESS_EXTENSION 0x1 BYTE_ORDER MSB_LAST /end CHARACTERISTIC
/begin CHARACTERISTIC _g_PL_AD_fw_Radar_1R1V_rpc_XilObjBypassingRunnable_XilObjBypassingRunnable_m_pad_radarObjPort_par_out_local.TChangeableMemPool._._._m_arrayPool._0_._elem._m_objectInformation._5_._m_axN "" VALUE 0xB005748E __SWord_Value 0 NO_COMPU_METHOD -32768 32767 ECU_ADDRESS_EXTENSION 0x1 BYTE_ORDER MSB_LAST /end CHARACTERISTIC
/begin CHARACTERISTIC _g_PL_AD_fw_Radar_1R1V_rpc_XilObjBypassingRunnable_XilObjBypassingRunnable_m_pad_radarObjPort_par_out_local.TChangeableMemPool._._._m_arrayPool._0_._elem._m_objectInformation._5_._m_ayN "" VALUE 0xB0057490 __SWord_Value 0 NO_COMPU_METHOD -32768 32767 ECU_ADDRESS_EXTENSION 0x1 BYTE_ORDER MSB_LAST /end CHARACTERISTIC
/begin CHARACTERISTIC _g_PL_AD_fw_Radar_1R1V_rpc_XilObjBypassingRunnable_XilObjBypassingRunnable_m_pad_radarObjPort_par_out_local.TChangeableMemPool._._._m_arrayPool._0_._elem._m_objectInformation._5_._m_dLengthN "" VALUE 0xB0057496 __SWord_Value 0 NO_COMPU_METHOD -32768 32767 ECU_ADDRESS_EXTENSION 0x1 BYTE_ORDER MSB_LAST /end CHARACTERISTIC
/begin CHARACTERISTIC _g_PL_AD_fw_Radar_1R1V_rpc_XilObjBypassingRunnable_XilObjBypassingRunnable_m_pad_radarObjPort_par_out_local.TChangeableMemPool._._._m_arrayPool._0_._elem._m_objectInformation._5_._m_dVarLengthN "" VALUE 0xB005749C __UWord_Value 0 NO_COMPU_METHOD 0 65535 ECU_ADDRESS_EXTENSION 0x1 BYTE_ORDER MSB_LAST /end CHARACTERISTIC
/begin CHARACTERISTIC _g_PL_AD_fw_Radar_1R1V_rpc_XilObjBypassingRunnable_XilObjBypassingRunnable_m_pad_radarObjPort_par_out_local.TChangeableMemPool._._._m_arrayPool._0_._elem._m_objectInformation._5_._m_dVarWidthN "" VALUE 0xB005749A __UWord_Value 0 NO_COMPU_METHOD 0 65535 ECU_ADDRESS_EXTENSION 0x1 BYTE_ORDER MSB_LAST /end CHARACTERISTIC
/begin CHARACTERISTIC _g_PL_AD_fw_Radar_1R1V_rpc_XilObjBypassingRunnable_XilObjBypassingRunnable_m_pad_radarObjPort_par_out_local.TChangeableMemPool._._._m_arrayPool._0_._elem._m_objectInformation._5_._m_dWidthN "" VALUE 0xB0057494 __SWord_Value 0 NO_COMPU_METHOD -32768 32767 ECU_ADDRESS_EXTENSION 0x1 BYTE_ORDER MSB_LAST /end CHARACTERISTIC
/begin CHARACTERISTIC _g_PL_AD_fw_Radar_1R1V_rpc_XilObjBypassingRunnable_XilObjBypassingRunnable_m_pad_radarObjPort_par_out_local.TChangeableMemPool._._._m_arrayPool._0_._elem._m_objectInformation._5_._m_dxN "" VALUE 0xB0057484 __SWord_Value 0 NO_COMPU_METHOD -32768 32767 ECU_ADDRESS_EXTENSION 0x1 BYTE_ORDER MSB_LAST /end CHARACTERISTIC
/begin CHARACTERISTIC _g_PL_AD_fw_Radar_1R1V_rpc_XilObjBypassingRunnable_XilObjBypassingRunnable_m_pad_radarObjPort_par_out_local.TChangeableMemPool._._._m_arrayPool._0_._elem._m_objectInformation._5_._m_dyN "" VALUE 0xB0057486 __SWord_Value 0 NO_COMPU_METHOD -32768 32767 ECU_ADDRESS_EXTENSION 0x1 BYTE_ORDER MSB_LAST /end CHARACTERISTIC
/begin CHARACTERISTIC _g_PL_AD_fw_Radar_1R1V_rpc_XilObjBypassingRunnable_XilObjBypassingRunnable_m_pad_radarObjPort_par_out_local.TChangeableMemPool._._._m_arrayPool._0_._elem._m_objectInformation._5_._m_dzN "" VALUE 0xB0057488 __SWord_Value 0 NO_COMPU_METHOD -32768 32767 ECU_ADDRESS_EXTENSION 0x1 BYTE_ORDER MSB_LAST /end CHARACTERISTIC
/begin CHARACTERISTIC _g_PL_AD_fw_Radar_1R1V_rpc_XilObjBypassingRunnable_XilObjBypassingRunnable_m_pad_radarObjPort_par_out_local.TChangeableMemPool._._._m_arrayPool._0_._elem._m_objectInformation._5_._m_isObjectAsil "" VALUE 0xB00574A4 __UByte_Value 0 NO_COMPU_METHOD 0 255 ECU_ADDRESS_EXTENSION 0x1 BYTE_ORDER MSB_LAST /end CHARACTERISTIC
/begin CHARACTERISTIC _g_PL_AD_fw_Radar_1R1V_rpc_XilObjBypassingRunnable_XilObjBypassingRunnable_m_pad_radarObjPort_par_out_local.TChangeableMemPool._._._m_arrayPool._0_._elem._m_objectInformation._5_._m_perObjectType._m_prob1FourPlusWheelerN "" VALUE 0xB005745E __UByte_Value 0 NO_COMPU_METHOD 0 255 ECU_ADDRESS_EXTENSION 0x1 BYTE_ORDER MSB_LAST /end CHARACTERISTIC
/begin CHARACTERISTIC _g_PL_AD_fw_Radar_1R1V_rpc_XilObjBypassingRunnable_XilObjBypassingRunnable_m_pad_radarObjPort_par_out_local.TChangeableMemPool._._._m_arrayPool._0_._elem._m_objectInformation._5_._m_perObjectType._m_prob1FourWheelUnknownN "" VALUE 0xB0057466 __UByte_Value 0 NO_COMPU_METHOD 0 255 ECU_ADDRESS_EXTENSION 0x1 BYTE_ORDER MSB_LAST /end CHARACTERISTIC
/begin CHARACTERISTIC _g_PL_AD_fw_Radar_1R1V_rpc_XilObjBypassingRunnable_XilObjBypassingRunnable_m_pad_radarObjPort_par_out_local.TChangeableMemPool._._._m_arrayPool._0_._elem._m_objectInformation._5_._m_perObjectType._m_prob1MobileN "" VALUE 0xB005745B __UByte_Value 0 NO_COMPU_METHOD 0 255 ECU_ADDRESS_EXTENSION 0x1 BYTE_ORDER MSB_LAST /end CHARACTERISTIC
/begin CHARACTERISTIC _g_PL_AD_fw_Radar_1R1V_rpc_XilObjBypassingRunnable_XilObjBypassingRunnable_m_pad_radarObjPort_par_out_local.TChangeableMemPool._._._m_arrayPool._0_._elem._m_objectInformation._5_._m_perObjectType._m_prob1MovUnknownN "" VALUE 0xB0057461 __UByte_Value 0 NO_COMPU_METHOD 0 255 ECU_ADDRESS_EXTENSION 0x1 BYTE_ORDER MSB_LAST /end CHARACTERISTIC
/begin CHARACTERISTIC _g_PL_AD_fw_Radar_1R1V_rpc_XilObjBypassingRunnable_XilObjBypassingRunnable_m_pad_radarObjPort_par_out_local.TChangeableMemPool._._._m_arrayPool._0_._elem._m_objectInformation._5_._m_perObjectType._m_prob1NonObstacleN "" VALUE 0xB0057459 __UByte_Value 0 NO_COMPU_METHOD 0 255 ECU_ADDRESS_EXTENSION 0x1 BYTE_ORDER MSB_LAST /end CHARACTERISTIC
/begin CHARACTERISTIC _g_PL_AD_fw_Radar_1R1V_rpc_XilObjBypassingRunnable_XilObjBypassingRunnable_m_pad_radarObjPort_par_out_local.TChangeableMemPool._._._m_arrayPool._0_._elem._m_objectInformation._5_._m_perObjectType._m_prob1ObstUnknownN "" VALUE 0xB005745D __UByte_Value 0 NO_COMPU_METHOD 0 255 ECU_ADDRESS_EXTENSION 0x1 BYTE_ORDER MSB_LAST /end CHARACTERISTIC
/begin CHARACTERISTIC _g_PL_AD_fw_Radar_1R1V_rpc_XilObjBypassingRunnable_XilObjBypassingRunnable_m_pad_radarObjPort_par_out_local.TChangeableMemPool._._._m_arrayPool._0_._elem._m_objectInformation._5_._m_perObjectType._m_prob1ObstacleN "" VALUE 0xB0057458 __UByte_Value 0 NO_COMPU_METHOD 0 255 ECU_ADDRESS_EXTENSION 0x1 BYTE_ORDER MSB_LAST /end CHARACTERISTIC
/begin CHARACTERISTIC _g_PL_AD_fw_Radar_1R1V_rpc_XilObjBypassingRunnable_XilObjBypassingRunnable_m_pad_radarObjPort_par_out_local.TChangeableMemPool._._._m_arrayPool._0_._elem._m_objectInformation._5_._m_perObjectType._m_prob1PassengerCarN "" VALUE 0xB0057464 __UByte_Value 0 NO_COMPU_METHOD 0 255 ECU_ADDRESS_EXTENSION 0x1 BYTE_ORDER MSB_LAST /end CHARACTERISTIC
/begin CHARACTERISTIC _g_PL_AD_fw_Radar_1R1V_rpc_XilObjBypassingRunnable_XilObjBypassingRunnable_m_pad_radarObjPort_par_out_local.TChangeableMemPool._._._m_arrayPool._0_._elem._m_objectInformation._5_._m_perObjectType._m_prob1PedestrianN "" VALUE 0xB0057460 __UByte_Value 0 NO_COMPU_METHOD 0 255 ECU_ADDRESS_EXTENSION 0x1 BYTE_ORDER MSB_LAST /end CHARACTERISTIC
/begin CHARACTERISTIC _g_PL_AD_fw_Radar_1R1V_rpc_XilObjBypassingRunnable_XilObjBypassingRunnable_m_pad_radarObjPort_par_out_local.TChangeableMemPool._._._m_arrayPool._0_._elem._m_objectInformation._5_._m_perObjectType._m_prob1RoadsideBarrierN "" VALUE 0xB0057462 __UByte_Value 0 NO_COMPU_METHOD 0 255 ECU_ADDRESS_EXTENSION 0x1 BYTE_ORDER MSB_LAST /end CHARACTERISTIC
/begin CHARACTERISTIC _g_PL_AD_fw_Radar_1R1V_rpc_XilObjBypassingRunnable_XilObjBypassingRunnable_m_pad_radarObjPort_par_out_local.TChangeableMemPool._._._m_arrayPool._0_._elem._m_objectInformation._5_._m_perObjectType._m_prob1StatUnknownN "" VALUE 0xB0057463 __UByte_Value 0 NO_COMPU_METHOD 0 255 ECU_ADDRESS_EXTENSION 0x1 BYTE_ORDER MSB_LAST /end CHARACTERISTIC
/begin CHARACTERISTIC _g_PL_AD_fw_Radar_1R1V_rpc_XilObjBypassingRunnable_XilObjBypassingRunnable_m_pad_radarObjPort_par_out_local.TChangeableMemPool._._._m_arrayPool._0_._elem._m_objectInformation._5_._m_perObjectType._m_prob1StationaryN "" VALUE 0xB005745C __UByte_Value 0 NO_COMPU_METHOD 0 255 ECU_ADDRESS_EXTENSION 0x1 BYTE_ORDER MSB_LAST /end CHARACTERISTIC
/begin CHARACTERISTIC _g_PL_AD_fw_Radar_1R1V_rpc_XilObjBypassingRunnable_XilObjBypassingRunnable_m_pad_radarObjPort_par_out_local.TChangeableMemPool._._._m_arrayPool._0_._elem._m_objectInformation._5_._m_perObjectType._m_prob1TruckN "" VALUE 0xB0057465 __UByte_Value 0 NO_COMPU_METHOD 0 255 ECU_ADDRESS_EXTENSION 0x1 BYTE_ORDER MSB_LAST /end CHARACTERISTIC
/begin CHARACTERISTIC _g_PL_AD_fw_Radar_1R1V_rpc_XilObjBypassingRunnable_XilObjBypassingRunnable_m_pad_radarObjPort_par_out_local.TChangeableMemPool._._._m_arrayPool._0_._elem._m_objectInformation._5_._m_perObjectType._m_prob1TwoWheelerN "" VALUE 0xB005745F __UByte_Value 0 NO_COMPU_METHOD 0 255 ECU_ADDRESS_EXTENSION 0x1 BYTE_ORDER MSB_LAST /end CHARACTERISTIC
/begin CHARACTERISTIC _g_PL_AD_fw_Radar_1R1V_rpc_XilObjBypassingRunnable_XilObjBypassingRunnable_m_pad_radarObjPort_par_out_local.TChangeableMemPool._._._m_arrayPool._0_._elem._m_objectInformation._5_._m_perObjectType._m_prob1UnknownN "" VALUE 0xB005745A __UByte_Value 0 NO_COMPU_METHOD 0 255 ECU_ADDRESS_EXTENSION 0x1 BYTE_ORDER MSB_LAST /end CHARACTERISTIC
/begin CHARACTERISTIC _g_PL_AD_fw_Radar_1R1V_rpc_XilObjBypassingRunnable_XilObjBypassingRunnable_m_pad_radarObjPort_par_out_local.TChangeableMemPool._._._m_arrayPool._0_._elem._m_objectInformation._5_._m_prob1HasBeenObservedMovingN "" VALUE 0xB00574A1 __UByte_Value 0 NO_COMPU_METHOD 0 255 ECU_ADDRESS_EXTENSION 0x1 BYTE_ORDER MSB_LAST /end CHARACTERISTIC
/begin CHARACTERISTIC _g_PL_AD_fw_Radar_1R1V_rpc_XilObjBypassingRunnable_XilObjBypassingRunnable_m_pad_radarObjPort_par_out_local.TChangeableMemPool._._._m_arrayPool._0_._elem._m_objectInformation._5_._m_prob1MovingN "" VALUE 0xB00574A0 __UByte_Value 0 NO_COMPU_METHOD 0 255 ECU_ADDRESS_EXTENSION 0x1 BYTE_ORDER MSB_LAST /end CHARACTERISTIC
/begin CHARACTERISTIC _g_PL_AD_fw_Radar_1R1V_rpc_XilObjBypassingRunnable_XilObjBypassingRunnable_m_pad_radarObjPort_par_out_local.TChangeableMemPool._._._m_arrayPool._0_._elem._m_objectInformation._5_._m_varAxN "" VALUE 0xB005747C __SLong_Value 0 NO_COMPU_METHOD -2147483648 2147483647 ECU_ADDRESS_EXTENSION 0x1 BYTE_ORDER MSB_LAST /end CHARACTERISTIC
/begin CHARACTERISTIC _g_PL_AD_fw_Radar_1R1V_rpc_XilObjBypassingRunnable_XilObjBypassingRunnable_m_pad_radarObjPort_par_out_local.TChangeableMemPool._._._m_arrayPool._0_._elem._m_objectInformation._5_._m_varAyN "" VALUE 0xB0057480 __SLong_Value 0 NO_COMPU_METHOD -2147483648 2147483647 ECU_ADDRESS_EXTENSION 0x1 BYTE_ORDER MSB_LAST /end CHARACTERISTIC
/begin CHARACTERISTIC _g_PL_AD_fw_Radar_1R1V_rpc_XilObjBypassingRunnable_XilObjBypassingRunnable_m_pad_radarObjPort_par_out_local.TChangeableMemPool._._._m_arrayPool._0_._elem._m_objectInformation._5_._m_varDxN "" VALUE 0xB005746C __SLong_Value 0 NO_COMPU_METHOD -2147483648 2147483647 ECU_ADDRESS_EXTENSION 0x1 BYTE_ORDER MSB_LAST /end CHARACTERISTIC
/begin CHARACTERISTIC _g_PL_AD_fw_Radar_1R1V_rpc_XilObjBypassingRunnable_XilObjBypassingRunnable_m_pad_radarObjPort_par_out_local.TChangeableMemPool._._._m_arrayPool._0_._elem._m_objectInformation._5_._m_varDyN "" VALUE 0xB0057470 __SLong_Value 0 NO_COMPU_METHOD -2147483648 2147483647 ECU_ADDRESS_EXTENSION 0x1 BYTE_ORDER MSB_LAST /end CHARACTERISTIC
/begin CHARACTERISTIC _g_PL_AD_fw_Radar_1R1V_rpc_XilObjBypassingRunnable_XilObjBypassingRunnable_m_pad_radarObjPort_par_out_local.TChangeableMemPool._._._m_arrayPool._0_._elem._m_objectInformation._5_._m_varVxN "" VALUE 0xB0057474 __SLong_Value 0 NO_COMPU_METHOD -2147483648 2147483647 ECU_ADDRESS_EXTENSION 0x1 BYTE_ORDER MSB_LAST /end CHARACTERISTIC
/begin CHARACTERISTIC _g_PL_AD_fw_Radar_1R1V_rpc_XilObjBypassingRunnable_XilObjBypassingRunnable_m_pad_radarObjPort_par_out_local.TChangeableMemPool._._._m_arrayPool._0_._elem._m_objectInformation._5_._m_varVyN "" VALUE 0xB0057478 __SLong_Value 0 NO_COMPU_METHOD -2147483648 2147483647 ECU_ADDRESS_EXTENSION 0x1 BYTE_ORDER MSB_LAST /end CHARACTERISTIC
/begin CHARACTERISTIC _g_PL_AD_fw_Radar_1R1V_rpc_XilObjBypassingRunnable_XilObjBypassingRunnable_m_pad_radarObjPort_par_out_local.TChangeableMemPool._._._m_arrayPool._0_._elem._m_objectInformation._5_._m_vxN "" VALUE 0xB005748A __SWord_Value 0 NO_COMPU_METHOD -32768 32767 ECU_ADDRESS_EXTENSION 0x1 BYTE_ORDER MSB_LAST /end CHARACTERISTIC
/begin CHARACTERISTIC _g_PL_AD_fw_Radar_1R1V_rpc_XilObjBypassingRunnable_XilObjBypassingRunnable_m_pad_radarObjPort_par_out_local.TChangeableMemPool._._._m_arrayPool._0_._elem._m_objectInformation._5_._m_vyN "" VALUE 0xB005748C __SWord_Value 0 NO_COMPU_METHOD -32768 32767 ECU_ADDRESS_EXTENSION 0x1 BYTE_ORDER MSB_LAST /end CHARACTERISTIC
/begin CHARACTERISTIC _g_PL_AD_fw_Radar_1R1V_rpc_XilObjBypassingRunnable_XilObjBypassingRunnable_m_pad_radarObjPort_par_out_local.TChangeableMemPool._._._m_arrayPool._0_._elem._m_objectInformation._5_._m_wExistProbN "" VALUE 0xB005749E __UWord_Value 0 NO_COMPU_METHOD 0 65535 ECU_ADDRESS_EXTENSION 0x1 BYTE_ORDER MSB_LAST /end CHARACTERISTIC
/begin CHARACTERISTIC _g_PL_AD_fw_Radar_1R1V_rpc_XilObjBypassingRunnable_XilObjBypassingRunnable_m_pad_radarObjPort_par_out_local.TChangeableMemPool._._._m_arrayPool._0_._elem._m_objectInformation._6_._Valid_b "" VALUE 0xB00574F3 __UByte_Value 0 NO_COMPU_METHOD 0 255 ECU_ADDRESS_EXTENSION 0x1 BYTE_ORDER MSB_LAST /end CHARACTERISTIC
/begin CHARACTERISTIC _g_PL_AD_fw_Radar_1R1V_rpc_XilObjBypassingRunnable_XilObjBypassingRunnable_m_pad_radarObjPort_par_out_local.TChangeableMemPool._._._m_arrayPool._0_._elem._m_objectInformation._6_._m_HandleN "" VALUE 0xB00574F2 __UByte_Value 0 NO_COMPU_METHOD 0 255 ECU_ADDRESS_EXTENSION 0x1 BYTE_ORDER MSB_LAST /end CHARACTERISTIC
/begin CHARACTERISTIC _g_PL_AD_fw_Radar_1R1V_rpc_XilObjBypassingRunnable_XilObjBypassingRunnable_m_pad_radarObjPort_par_out_local.TChangeableMemPool._._._m_arrayPool._0_._elem._m_objectInformation._6_._m_alpPiVarYawAngleN "" VALUE 0xB00574E8 __UWord_Value 0 NO_COMPU_METHOD 0 65535 ECU_ADDRESS_EXTENSION 0x1 BYTE_ORDER MSB_LAST /end CHARACTERISTIC
/begin CHARACTERISTIC _g_PL_AD_fw_Radar_1R1V_rpc_XilObjBypassingRunnable_XilObjBypassingRunnable_m_pad_radarObjPort_par_out_local.TChangeableMemPool._._._m_arrayPool._0_._elem._m_objectInformation._6_._m_alpPiYawAngleN "" VALUE 0xB00574E2 __SWord_Value 0 NO_COMPU_METHOD -32768 32767 ECU_ADDRESS_EXTENSION 0x1 BYTE_ORDER MSB_LAST /end CHARACTERISTIC
/begin CHARACTERISTIC _g_PL_AD_fw_Radar_1R1V_rpc_XilObjBypassingRunnable_XilObjBypassingRunnable_m_pad_radarObjPort_par_out_local.TChangeableMemPool._._._m_arrayPool._0_._elem._m_objectInformation._6_._m_axN "" VALUE 0xB00574DE __SWord_Value 0 NO_COMPU_METHOD -32768 32767 ECU_ADDRESS_EXTENSION 0x1 BYTE_ORDER MSB_LAST /end CHARACTERISTIC
/begin CHARACTERISTIC _g_PL_AD_fw_Radar_1R1V_rpc_XilObjBypassingRunnable_XilObjBypassingRunnable_m_pad_radarObjPort_par_out_local.TChangeableMemPool._._._m_arrayPool._0_._elem._m_objectInformation._6_._m_ayN "" VALUE 0xB00574E0 __SWord_Value 0 NO_COMPU_METHOD -32768 32767 ECU_ADDRESS_EXTENSION 0x1 BYTE_ORDER MSB_LAST /end CHARACTERISTIC
/begin CHARACTERISTIC _g_PL_AD_fw_Radar_1R1V_rpc_XilObjBypassingRunnable_XilObjBypassingRunnable_m_pad_radarObjPort_par_out_local.TChangeableMemPool._._._m_arrayPool._0_._elem._m_objectInformation._6_._m_dLengthN "" VALUE 0xB00574E6 __SWord_Value 0 NO_COMPU_METHOD -32768 32767 ECU_ADDRESS_EXTENSION 0x1 BYTE_ORDER MSB_LAST /end CHARACTERISTIC
/begin CHARACTERISTIC _g_PL_AD_fw_Radar_1R1V_rpc_XilObjBypassingRunnable_XilObjBypassingRunnable_m_pad_radarObjPort_par_out_local.TChangeableMemPool._._._m_arrayPool._0_._elem._m_objectInformation._6_._m_dVarLengthN "" VALUE 0xB00574EC __UWord_Value 0 NO_COMPU_METHOD 0 65535 ECU_ADDRESS_EXTENSION 0x1 BYTE_ORDER MSB_LAST /end CHARACTERISTIC
/begin CHARACTERISTIC _g_PL_AD_fw_Radar_1R1V_rpc_XilObjBypassingRunnable_XilObjBypassingRunnable_m_pad_radarObjPort_par_out_local.TChangeableMemPool._._._m_arrayPool._0_._elem._m_objectInformation._6_._m_dVarWidthN "" VALUE 0xB00574EA __UWord_Value 0 NO_COMPU_METHOD 0 65535 ECU_ADDRESS_EXTENSION 0x1 BYTE_ORDER MSB_LAST /end CHARACTERISTIC
/begin CHARACTERISTIC _g_PL_AD_fw_Radar_1R1V_rpc_XilObjBypassingRunnable_XilObjBypassingRunnable_m_pad_radarObjPort_par_out_local.TChangeableMemPool._._._m_arrayPool._0_._elem._m_objectInformation._6_._m_dWidthN "" VALUE 0xB00574E4 __SWord_Value 0 NO_COMPU_METHOD -32768 32767 ECU_ADDRESS_EXTENSION 0x1 BYTE_ORDER MSB_LAST /end CHARACTERISTIC
/begin CHARACTERISTIC _g_PL_AD_fw_Radar_1R1V_rpc_XilObjBypassingRunnable_XilObjBypassingRunnable_m_pad_radarObjPort_par_out_local.TChangeableMemPool._._._m_arrayPool._0_._elem._m_objectInformation._6_._m_dxN "" VALUE 0xB00574D4 __SWord_Value 0 NO_COMPU_METHOD -32768 32767 ECU_ADDRESS_EXTENSION 0x1 BYTE_ORDER MSB_LAST /end CHARACTERISTIC
/begin CHARACTERISTIC _g_PL_AD_fw_Radar_1R1V_rpc_XilObjBypassingRunnable_XilObjBypassingRunnable_m_pad_radarObjPort_par_out_local.TChangeableMemPool._._._m_arrayPool._0_._elem._m_objectInformation._6_._m_dyN "" VALUE 0xB00574D6 __SWord_Value 0 NO_COMPU_METHOD -32768 32767 ECU_ADDRESS_EXTENSION 0x1 BYTE_ORDER MSB_LAST /end CHARACTERISTIC
/begin CHARACTERISTIC _g_PL_AD_fw_Radar_1R1V_rpc_XilObjBypassingRunnable_XilObjBypassingRunnable_m_pad_radarObjPort_par_out_local.TChangeableMemPool._._._m_arrayPool._0_._elem._m_objectInformation._6_._m_dzN "" VALUE 0xB00574D8 __SWord_Value 0 NO_COMPU_METHOD -32768 32767 ECU_ADDRESS_EXTENSION 0x1 BYTE_ORDER MSB_LAST /end CHARACTERISTIC
/begin CHARACTERISTIC _g_PL_AD_fw_Radar_1R1V_rpc_XilObjBypassingRunnable_XilObjBypassingRunnable_m_pad_radarObjPort_par_out_local.TChangeableMemPool._._._m_arrayPool._0_._elem._m_objectInformation._6_._m_isObjectAsil "" VALUE 0xB00574F4 __UByte_Value 0 NO_COMPU_METHOD 0 255 ECU_ADDRESS_EXTENSION 0x1 BYTE_ORDER MSB_LAST /end CHARACTERISTIC
/begin CHARACTERISTIC _g_PL_AD_fw_Radar_1R1V_rpc_XilObjBypassingRunnable_XilObjBypassingRunnable_m_pad_radarObjPort_par_out_local.TChangeableMemPool._._._m_arrayPool._0_._elem._m_objectInformation._6_._m_perObjectType._m_prob1FourPlusWheelerN "" VALUE 0xB00574AE __UByte_Value 0 NO_COMPU_METHOD 0 255 ECU_ADDRESS_EXTENSION 0x1 BYTE_ORDER MSB_LAST /end CHARACTERISTIC
/begin CHARACTERISTIC _g_PL_AD_fw_Radar_1R1V_rpc_XilObjBypassingRunnable_XilObjBypassingRunnable_m_pad_radarObjPort_par_out_local.TChangeableMemPool._._._m_arrayPool._0_._elem._m_objectInformation._6_._m_perObjectType._m_prob1FourWheelUnknownN "" VALUE 0xB00574B6 __UByte_Value 0 NO_COMPU_METHOD 0 255 ECU_ADDRESS_EXTENSION 0x1 BYTE_ORDER MSB_LAST /end CHARACTERISTIC
/begin CHARACTERISTIC _g_PL_AD_fw_Radar_1R1V_rpc_XilObjBypassingRunnable_XilObjBypassingRunnable_m_pad_radarObjPort_par_out_local.TChangeableMemPool._._._m_arrayPool._0_._elem._m_objectInformation._6_._m_perObjectType._m_prob1MobileN "" VALUE 0xB00574AB __UByte_Value 0 NO_COMPU_METHOD 0 255 ECU_ADDRESS_EXTENSION 0x1 BYTE_ORDER MSB_LAST /end CHARACTERISTIC
/begin CHARACTERISTIC _g_PL_AD_fw_Radar_1R1V_rpc_XilObjBypassingRunnable_XilObjBypassingRunnable_m_pad_radarObjPort_par_out_local.TChangeableMemPool._._._m_arrayPool._0_._elem._m_objectInformation._6_._m_perObjectType._m_prob1MovUnknownN "" VALUE 0xB00574B1 __UByte_Value 0 NO_COMPU_METHOD 0 255 ECU_ADDRESS_EXTENSION 0x1 BYTE_ORDER MSB_LAST /end CHARACTERISTIC
/begin CHARACTERISTIC _g_PL_AD_fw_Radar_1R1V_rpc_XilObjBypassingRunnable_XilObjBypassingRunnable_m_pad_radarObjPort_par_out_local.TChangeableMemPool._._._m_arrayPool._0_._elem._m_objectInformation._6_._m_perObjectType._m_prob1NonObstacleN "" VALUE 0xB00574A9 __UByte_Value 0 NO_COMPU_METHOD 0 255 ECU_ADDRESS_EXTENSION 0x1 BYTE_ORDER MSB_LAST /end CHARACTERISTIC
/begin CHARACTERISTIC _g_PL_AD_fw_Radar_1R1V_rpc_XilObjBypassingRunnable_XilObjBypassingRunnable_m_pad_radarObjPort_par_out_local.TChangeableMemPool._._._m_arrayPool._0_._elem._m_objectInformation._6_._m_perObjectType._m_prob1ObstUnknownN "" VALUE 0xB00574AD __UByte_Value 0 NO_COMPU_METHOD 0 255 ECU_ADDRESS_EXTENSION 0x1 BYTE_ORDER MSB_LAST /end CHARACTERISTIC
/begin CHARACTERISTIC _g_PL_AD_fw_Radar_1R1V_rpc_XilObjBypassingRunnable_XilObjBypassingRunnable_m_pad_radarObjPort_par_out_local.TChangeableMemPool._._._m_arrayPool._0_._elem._m_objectInformation._6_._m_perObjectType._m_prob1ObstacleN "" VALUE 0xB00574A8 __UByte_Value 0 NO_COMPU_METHOD 0 255 ECU_ADDRESS_EXTENSION 0x1 BYTE_ORDER MSB_LAST /end CHARACTERISTIC
/begin CHARACTERISTIC _g_PL_AD_fw_Radar_1R1V_rpc_XilObjBypassingRunnable_XilObjBypassingRunnable_m_pad_radarObjPort_par_out_local.TChangeableMemPool._._._m_arrayPool._0_._elem._m_objectInformation._6_._m_perObjectType._m_prob1PassengerCarN "" VALUE 0xB00574B4 __UByte_Value 0 NO_COMPU_METHOD 0 255 ECU_ADDRESS_EXTENSION 0x1 BYTE_ORDER MSB_LAST /end CHARACTERISTIC
/begin CHARACTERISTIC _g_PL_AD_fw_Radar_1R1V_rpc_XilObjBypassingRunnable_XilObjBypassingRunnable_m_pad_radarObjPort_par_out_local.TChangeableMemPool._._._m_arrayPool._0_._elem._m_objectInformation._6_._m_perObjectType._m_prob1PedestrianN "" VALUE 0xB00574B0 __UByte_Value 0 NO_COMPU_METHOD 0 255 ECU_ADDRESS_EXTENSION 0x1 BYTE_ORDER MSB_LAST /end CHARACTERISTIC
/begin CHARACTERISTIC _g_PL_AD_fw_Radar_1R1V_rpc_XilObjBypassingRunnable_XilObjBypassingRunnable_m_pad_radarObjPort_par_out_local.TChangeableMemPool._._._m_arrayPool._0_._elem._m_objectInformation._6_._m_perObjectType._m_prob1RoadsideBarrierN "" VALUE 0xB00574B2 __UByte_Value 0 NO_COMPU_METHOD 0 255 ECU_ADDRESS_EXTENSION 0x1 BYTE_ORDER MSB_LAST /end CHARACTERISTIC
/begin CHARACTERISTIC _g_PL_AD_fw_Radar_1R1V_rpc_XilObjBypassingRunnable_XilObjBypassingRunnable_m_pad_radarObjPort_par_out_local.TChangeableMemPool._._._m_arrayPool._0_._elem._m_objectInformation._6_._m_perObjectType._m_prob1StatUnknownN "" VALUE 0xB00574B3 __UByte_Value 0 NO_COMPU_METHOD 0 255 ECU_ADDRESS_EXTENSION 0x1 BYTE_ORDER MSB_LAST /end CHARACTERISTIC
/begin CHARACTERISTIC _g_PL_AD_fw_Radar_1R1V_rpc_XilObjBypassingRunnable_XilObjBypassingRunnable_m_pad_radarObjPort_par_out_local.TChangeableMemPool._._._m_arrayPool._0_._elem._m_objectInformation._6_._m_perObjectType._m_prob1StationaryN "" VALUE 0xB00574AC __UByte_Value 0 NO_COMPU_METHOD 0 255 ECU_ADDRESS_EXTENSION 0x1 BYTE_ORDER MSB_LAST /end CHARACTERISTIC
/begin CHARACTERISTIC _g_PL_AD_fw_Radar_1R1V_rpc_XilObjBypassingRunnable_XilObjBypassingRunnable_m_pad_radarObjPort_par_out_local.TChangeableMemPool._._._m_arrayPool._0_._elem._m_objectInformation._6_._m_perObjectType._m_prob1TruckN "" VALUE 0xB00574B5 __UByte_Value 0 NO_COMPU_METHOD 0 255 ECU_ADDRESS_EXTENSION 0x1 BYTE_ORDER MSB_LAST /end CHARACTERISTIC
/begin COMPU_METHOD ObjectMotionDirection "enumeration table" TAB_VERB "%.0" "" COMPU_TAB_REF ObjectMotionDirection /end COMPU_METHOD
/begin COMPU_METHOD ObjectMovingState "enumeration table" TAB_VERB "%.0" "" COMPU_TAB_REF ObjectMovingState /end COMPU_METHOD
/begin COMPU_METHOD ObjectMovingState_Copy1 "enumeration table" TAB_VERB "%.0" "" COMPU_TAB_REF ObjectMovingState_Copy1 /end COMPU_METHOD
/begin COMPU_METHOD ObjectRadarSensorState "enumeration table" TAB_VERB "%.0" "" COMPU_TAB_REF ObjectRadarSensorState /end COMPU_METHOD
/begin COMPU_METHOD ObjectTrackingState "enumeration table" TAB_VERB "%.0" "" COMPU_TAB_REF ObjectTrackingState /end COMPU_METHOD
/begin COMPU_METHOD ObjectType "enumeration table" TAB_VERB "%.0" "" COMPU_TAB_REF ObjectType /end COMPU_METHOD
/begin COMPU_METHOD ObjectType_Copy1 "enumeration table" TAB_VERB "%.0" "" COMPU_TAB_REF ObjectType_Copy1 /end COMPU_METHOD
/begin COMPU_METHOD ObstacleBlockingSide "enumeration table" TAB_VERB "%.0" "" COMPU_TAB_REF ObstacleBlockingSide /end COMPU_METHOD
/begin COMPU_METHOD ObstacleSensorIndex "enumeration table" TAB_VERB "%.0" "" COMPU_TAB_REF ObstacleSensorIndex /end COMPU_METHOD
/begin COMPU_METHOD OcclusionState "enumeration table" TAB_VERB "%.0" "" COMPU_TAB_REF OcclusionState /end COMPU_METHOD
/begin COMPU_METHOD OosIds "enumeration table" TAB_VERB "%.0" "" COMPU_TAB_REF OosIds /end COMPU_METHOD
/begin COMPU_METHOD OoseqStrategy "enumeration table" TAB_VERB "%.0" "" COMPU_TAB_REF OoseqStrategy /end COMPU_METHOD
/begin COMPU_METHOD OoseqStrategy_Copy1 "enumeration table" TAB_VERB "%.0" "" COMPU_TAB_REF OoseqStrategy_Copy1 /end COMPU_METHOD
/begin COMPU_METHOD OrientationType "enumeration table" TAB_VERB "%.0" "" COMPU_TAB_REF OrientationType /end COMPU_METHOD
/begin COMPU_METHOD Os_ScheduleTableStatusType "enumeration table" TAB_VERB "%.0" "" COMPU_TAB_REF Os_ScheduleTableStatusType /end COMPU_METHOD
/begin COMPU_METHOD OverspeedOffsetUnit "enumeration table" TAB_VERB "%.0" "" COMPU_TAB_REF OverspeedOffsetUnit /end COMPU_METHOD
/begin COMPU_METHOD PER_ALGOS_MBF_TYPES "enumeration table" TAB_VERB "%.0" "" COMPU_TAB_REF PER_ALGOS_MBF_TYPES /end COMPU_METHOD
/begin COMPU_METHOD PER_ALGOS_MBF_TYPES_Copy1 "enumeration table" TAB_VERB "%.0" "" COMPU_TAB_REF PER_ALGOS_MBF_TYPES_Copy1 /end COMPU_METHOD
/begin COMPU_METHOD PER_ALGOS_MBF_TYPES_Copy99 "enumeration table" TAB_VERB "%.0" "" COMPU_TAB_REF PER_ALGOS_MBF_TYPES_Copy99 /end COMPU_METHOD
/begin COMPU_METHOD PER_ASIL_LEVELS "enumeration table" TAB_VERB "%.0" "" COMPU_TAB_REF PER_ASIL_LEVELS /end COMPU_METHOD
/begin COMPU_METHOD PER_PER_TYPES "enumeration table" TAB_VERB "%.0" "" COMPU_TAB_REF PER_PER_TYPES /end COMPU_METHOD
/begin COMPU_METHOD PER_RAW_FEATURES "enumeration table" TAB_VERB "%.0" "" COMPU_TAB_REF PER_RAW_FEATURES /end COMPU_METHOD
/begin COMPU_METHOD PER_REFERENCE_POINTS "enumeration table" TAB_VERB "%.0" "" COMPU_TAB_REF PER_REFERENCE_POINTS /end COMPU_METHOD
/begin COMPU_METHOD PER_REFERENCE_POINTS.OLD_Copy1 "enumeration table" TAB_VERB "%.0" "" COMPU_TAB_REF PER_REFERENCE_POINTS.OLD_1 /end COMPU_METHOD
/begin COMPU_METHOD PER_REFERENCE_POINTS_Copy1 "enumeration table" TAB_VERB "%.0" "" COMPU_TAB_REF PER_REFERENCE_POINTS_Copy1 /end COMPU_METHOD
/begin COMPU_METHOD PER_REFERENCE_POINTS_Copy2 "enumeration table" TAB_VERB "%.0" "" COMPU_TAB_REF PER_REFERENCE_POINTS_Copy2 /end COMPU_METHOD
/begin COMPU_METHOD PER_SENSOR_TYPES "enumeration table" TAB_VERB "%.0" "" COMPU_TAB_REF PER_SENSOR_TYPES /end COMPU_METHOD
/begin COMPU_METHOD PathStartStrategy "enumeration table" TAB_VERB "%.0" "" COMPU_TAB_REF PathStartStrategy /end COMPU_METHOD
/begin COMPU_METHOD PerVideoObjectTypes "enumeration table" TAB_VERB "%.0" "" COMPU_TAB_REF PerVideoObjectTypes /end COMPU_METHOD
/begin COMPU_METHOD PortStates "enumeration table" TAB_VERB "%.0" "" COMPU_TAB_REF PortStates /end COMPU_METHOD
/begin COMPU_METHOD Pre_NoCom_No_PN_Substates_Enum "enumeration table" TAB_VERB "%.0" "" COMPU_TAB_REF Pre_NoCom_No_PN_Substates_Enum /end COMPU_METHOD
/begin COMPU_METHOD PredictedStateOfMotion "enumeration table" TAB_VERB "%.0" "" COMPU_TAB_REF PredictedStateOfMotion /end COMPU_METHOD
/begin COMPU_METHOD Priority "enumeration table" TAB_VERB "%.0" "" COMPU_TAB_REF Priority /end COMPU_METHOD
/begin COMPU_METHOD ProfileWarnHaptic "enumeration table" TAB_VERB "%.0" "" COMPU_TAB_REF ProfileWarnHaptic /end COMPU_METHOD
/begin COMPU_METHOD PswRequestType "enumeration table" TAB_VERB "%.0" "" COMPU_TAB_REF PswRequestType /end COMPU_METHOD
/begin COMPU_METHOD RIF_STATUS "enumeration table" TAB_VERB "%.0" "" COMPU_TAB_REF RIF_STATUS /end COMPU_METHOD
/begin COMPU_METHOD RIF_STATUS.OLD_Copy1 "enumeration table" TAB_VERB "%.0" "" COMPU_TAB_REF RIF_STATUS.OLD_1 /end COMPU_METHOD
/begin COMPU_METHOD RIF_STATUS_Copy1 "enumeration table" TAB_VERB "%.0" "" COMPU_TAB_REF RIF_STATUS_Copy1 /end COMPU_METHOD
/begin COMPU_METHOD RPType.OLD_Copy1 "enumeration table" TAB_VERB "%.0" "" COMPU_TAB_REF RPType.OLD_1 /end COMPU_METHOD
/begin COMPU_METHOD RSB_Types "enumeration table" TAB_VERB "%.0" "" COMPU_TAB_REF RSB_Types /end COMPU_METHOD
/begin COMPU_METHOD RbvmiBrakeDiscTemperatureStatus "enumeration table" TAB_VERB "%.0" "" COMPU_TAB_REF RbvmiBrakeDiscTemperatureStatus /end COMPU_METHOD
/begin COMPU_METHOD RbvmiBrakeDiscTemperatureStatusAvailability "enumeration table" TAB_VERB "%.0" "" COMPU_TAB_REF RbvmiBrakeDiscTemperatureStatusAvailability /end COMPU_METHOD
/begin COMPU_METHOD ReactionPatternType "enumeration table" TAB_VERB "%.0" "" COMPU_TAB_REF ReactionPatternType /end COMPU_METHOD
/begin COMPU_METHOD Reason "enumeration table" TAB_VERB "%.0" "" COMPU_TAB_REF Reason /end COMPU_METHOD
/begin COMPU_METHOD ReceiverPortStates "enumeration table" TAB_VERB "%.0" "" COMPU_TAB_REF ReceiverPortStates /end COMPU_METHOD
/begin COMPU_METHOD ReferenceLineMotionGoal_v0 "enumeration table" TAB_VERB "%.0" "" COMPU_TAB_REF ReferenceLineMotionGoal_v0 /end COMPU_METHOD
/begin COMPU_METHOD RegulatingLane "enumeration table" TAB_VERB "%.0" "" COMPU_TAB_REF RegulatingLane /end COMPU_METHOD
/begin COMPU_METHOD RelationCalculationStrategy "enumeration table" TAB_VERB "%.0" "" COMPU_TAB_REF RelationCalculationStrategy /end COMPU_METHOD
/begin COMPU_METHOD RelativeLaneRelation "enumeration table" TAB_VERB "%.0" "" COMPU_TAB_REF RelativeLaneRelation /end COMPU_METHOD
/begin COMPU_METHOD RestrictionType "enumeration table" TAB_VERB "%.0" "" COMPU_TAB_REF RestrictionType /end COMPU_METHOD
/begin COMPU_METHOD RifNumChanType "enumeration table" TAB_VERB "%.0" "" COMPU_TAB_REF RifNumChanType /end COMPU_METHOD
/begin COMPU_METHOD RightOfWay "enumeration table" TAB_VERB "%.0" "" COMPU_TAB_REF RightOfWay /end COMPU_METHOD
/begin COMPU_METHOD RoadConditionStates "enumeration table" TAB_VERB "%.0" "" COMPU_TAB_REF RoadConditionStates /end COMPU_METHOD
/begin COMPU_METHOD RoadLineColor "enumeration table" TAB_VERB "%.0" "" COMPU_TAB_REF RoadLineColor /end COMPU_METHOD
/begin COMPU_METHOD RoadLineType "enumeration table" TAB_VERB "%.0" "" COMPU_TAB_REF RoadLineType /end COMPU_METHOD
/begin COMPU_METHOD RoadSignType "enumeration table" TAB_VERB "%.0" "" COMPU_TAB_REF RoadSignType /end COMPU_METHOD
/begin COMPU_METHOD RoadSignType.OLD_Copy1 "enumeration table" TAB_VERB "%.0" "" COMPU_TAB_REF RoadSignType.OLD_1 /end COMPU_METHOD
/begin COMPU_METHOD SC_USGuete "" LINEAR "%8.8" "" COEFFS_LINEAR 0.00390625 0 /end COMPU_METHOD
/begin COMPU_METHOD SC_USRadius "" LINEAR "%10.7" "" COEFFS_LINEAR 0.0078125 0 /end COMPU_METHOD
/begin COMPU_METHOD SC_US_w_Free "" LINEAR "%16.15" "" COEFFS_LINEAR 3.0517578125E-05 0 /end COMPU_METHOD
/begin COMPU_METHOD SC_dx "" LINEAR "%13.12" "" COEFFS_LINEAR 0.000244140625 0 /end COMPU_METHOD
/begin COMPU_METHOD SC_i16_Geschwindigkeit "" LINEAR "%11.8" "" COEFFS_LINEAR 0.00390625 0 /end COMPU_METHOD
/begin COMPU_METHOD SC_i16_Rotationsfaktor "" LINEAR "%15.14" "" COEFFS_LINEAR 6.103515625E-05 0 /end COMPU_METHOD
/begin COMPU_METHOD SLWFWarningMode "enumeration table" TAB_VERB "%.0" "" COMPU_TAB_REF SLWFWarningMode /end COMPU_METHOD
/begin COMPU_METHOD SPU_Status_t "enumeration table" TAB_VERB "%.0" "" COMPU_TAB_REF SPU_Status_t /end COMPU_METHOD
/begin COMPU_METHOD SPU_Status_t.OLD_Copy1 "enumeration table" TAB_VERB "%.0" "" COMPU_TAB_REF SPU_Status_t.OLD_1 /end COMPU_METHOD
/begin COMPU_METHOD SPU_Status_t.OLD_Copy2 "enumeration table" TAB_VERB "%.0" "" COMPU_TAB_REF SPU_Status_t.OLD_2 /end COMPU_METHOD
/begin COMPU_METHOD SPU_Status_t_Copy1 "enumeration table" TAB_VERB "%.0" "" COMPU_TAB_REF SPU_Status_t_Copy1 /end COMPU_METHOD
/begin COMPU_METHOD SPU_Status_t_Copy2 "enumeration table" TAB_VERB "%.0" "" COMPU_TAB_REF SPU_Status_t_Copy2 /end COMPU_METHOD
/begin COMPU_METHOD SPU_Status_t_Copy3 "enumeration table" TAB_VERB "%.0" "" COMPU_TAB_REF SPU_Status_t_Copy3 /end COMPU_METHOD
/begin COMPU_METHOD SSCState "enumeration table" TAB_VERB "%.0" "" COMPU_TAB_REF SSCState /end COMPU_METHOD
/begin COMPU_METHOD SensorConfirmationLevel "enumeration table" TAB_VERB "%.0" "" COMPU_TAB_REF SensorConfirmationLevel /end COMPU_METHOD
/begin COMPU_METHOD SeqIntDef "enumeration table" TAB_VERB "%.0" "" COMPU_TAB_REF SeqIntDef /end COMPU_METHOD
/begin COMPU_METHOD ServiceId "enumeration table" TAB_VERB "%.0" "" COMPU_TAB_REF ServiceId /end COMPU_METHOD
/begin COMPU_METHOD SetSpeedInteractionType "enumeration table" TAB_VERB "%.0" "" COMPU_TAB_REF SetSpeedInteractionType /end COMPU_METHOD
/begin COMPU_METHOD Side "enumeration table" TAB_VERB "%.0" "" COMPU_TAB_REF Side /end COMPU_METHOD
/begin COMPU_METHOD Side_Copy1 "enumeration table" TAB_VERB "%.0" "" COMPU_TAB_REF Side_Copy1 /end COMPU_METHOD
/begin COMPU_METHOD Side_Copy2 "enumeration table" TAB_VERB "%.0" "" COMPU_TAB_REF Side_Copy2 /end COMPU_METHOD
/begin COMPU_METHOD SmStateId "enumeration table" TAB_VERB "%.0" "" COMPU_TAB_REF SmStateId /end COMPU_METHOD
/begin COMPU_METHOD SmoothType4dSet "enumeration table" TAB_VERB "%.0" "" COMPU_TAB_REF SmoothType4dSet /end COMPU_METHOD
/begin COMPU_METHOD SpeedUpFunction "enumeration table" TAB_VERB "%.0" "" COMPU_TAB_REF SpeedUpFunction /end COMPU_METHOD
/begin COMPU_METHOD SscOosConfigurationType "enumeration table" TAB_VERB "%.0" "" COMPU_TAB_REF SscOosConfigurationType /end COMPU_METHOD
/begin COMPU_METHOD SscPhase "enumeration table" TAB_VERB "%.0" "" COMPU_TAB_REF SscPhase /end COMPU_METHOD
/begin COMPU_METHOD SscPhase.OLD_Copy1 "enumeration table" TAB_VERB "%.0" "" COMPU_TAB_REF SscPhase.OLD_1 /end COMPU_METHOD
/begin COMPU_METHOD StalinResult "enumeration table" TAB_VERB "%.0" "" COMPU_TAB_REF StalinResult /end COMPU_METHOD
/begin COMPU_METHOD StartLaneReaction "enumeration table" TAB_VERB "%.0" "" COMPU_TAB_REF StartLaneReaction /end COMPU_METHOD
/begin COMPU_METHOD StateMachineStates "enumeration table" TAB_VERB "%.0" "" COMPU_TAB_REF StateMachineStates /end COMPU_METHOD
/begin COMPU_METHOD StateMachineType "enumeration table" TAB_VERB "%.0" "" COMPU_TAB_REF StateMachineType /end COMPU_METHOD
/begin COMPU_METHOD StateMachineType_Copy1 "enumeration table" TAB_VERB "%.0" "" COMPU_TAB_REF StateMachineType_Copy1 /end COMPU_METHOD
/begin COMPU_METHOD StateMachine_Type "enumeration table" TAB_VERB "%.0" "" COMPU_TAB_REF StateMachine_Type /end COMPU_METHOD
/begin COMPU_METHOD Static2DMotionGoal "enumeration table" TAB_VERB "%.0" "" COMPU_TAB_REF Static2DMotionGoal /end COMPU_METHOD
/begin COMPU_METHOD Static2DMotionGoal_v0 "enumeration table" TAB_VERB "%.0" "" COMPU_TAB_REF Static2DMotionGoal_v0 /end COMPU_METHOD
/begin COMPU_METHOD StationaryHoldMode "enumeration table" TAB_VERB "%.0" "" COMPU_TAB_REF StationaryHoldMode /end COMPU_METHOD
/begin COMPU_METHOD Status "enumeration table" TAB_VERB "%.0" "" COMPU_TAB_REF Status /end COMPU_METHOD
/begin COMPU_METHOD StatusIndicator "enumeration table" TAB_VERB "%.0" "" COMPU_TAB_REF StatusIndicator /end COMPU_METHOD
/begin COMPU_METHOD SteeringWheelAssistState "enumeration table" TAB_VERB "%.0" "" COMPU_TAB_REF SteeringWheelAssistState /end COMPU_METHOD
/begin COMPU_METHOD SystemServiceIds "enumeration table" TAB_VERB "%.0" "" COMPU_TAB_REF SystemServiceIds /end COMPU_METHOD
/begin COMPU_METHOD SystemServiceResponseType "enumeration table" TAB_VERB "%.0" "" COMPU_TAB_REF SystemServiceResponseType /end COMPU_METHOD
/begin COMPU_METHOD SystemServiceState "enumeration table" TAB_VERB "%.0" "" COMPU_TAB_REF SystemServiceState /end COMPU_METHOD
/begin COMPU_METHOD Table_1 "enumeration table" TAB_VERB "%.0" "" COMPU_TAB_REF Table_1 /end COMPU_METHOD
/begin COMPU_METHOD Table_115 "enumeration table" TAB_VERB "%.0" "" COMPU_TAB_REF Table_115 /end COMPU_METHOD
/begin COMPU_METHOD Table_116 "enumeration table" TAB_VERB "%.0" "" COMPU_TAB_REF Table_116 /end COMPU_METHOD
/begin COMPU_METHOD Table_117 "enumeration table" TAB_VERB "%.0" "" COMPU_TAB_REF Table_117 /end COMPU_METHOD
/begin COMPU_METHOD Table_118 "enumeration table" TAB_VERB "%.0" "" COMPU_TAB_REF Table_118 /end COMPU_METHOD
/begin COMPU_METHOD Table_119 "enumeration table" TAB_VERB "%.0" "" COMPU_TAB_REF Table_119 /end COMPU_METHOD
/begin COMPU_METHOD Table_160 "enumeration table" TAB_VERB "%.0" "" COMPU_TAB_REF Table_160 /end COMPU_METHOD
/begin COMPU_METHOD Table_161 "enumeration table" TAB_VERB "%.0" "" COMPU_TAB_REF Table_161 /end COMPU_METHOD
/begin COMPU_METHOD Table_162 "enumeration table" TAB_VERB "%.0" "" COMPU_TAB_REF Table_162 /end COMPU_METHOD
/begin COMPU_METHOD Table_163 "enumeration table" TAB_VERB "%.0" "" COMPU_TAB_REF Table_163 /end COMPU_METHOD
/begin COMPU_METHOD Table_164 "enumeration table" TAB_VERB "%.0" "" COMPU_TAB_REF Table_164 /end COMPU_METHOD
/begin COMPU_METHOD Table_229 "enumeration table" TAB_VERB "%.0" "" COMPU_TAB_REF Table_229 /end COMPU_METHOD
/begin COMPU_METHOD Table_232 "enumeration table" TAB_VERB "%.0" "" COMPU_TAB_REF Table_232 /end COMPU_METHOD
/begin COMPU_METHOD Table_234 "enumeration table" TAB_VERB "%.0" "" COMPU_TAB_REF Table_234 /end COMPU_METHOD
/begin COMPU_METHOD Table_235 "enumeration table" TAB_VERB "%.0" "" COMPU_TAB_REF Table_235 /end COMPU_METHOD
/begin COMPU_METHOD Table_253 "enumeration table" TAB_VERB "%.0" "" COMPU_TAB_REF Table_253 /end COMPU_METHOD
/begin COMPU_METHOD Table_348 "enumeration table" TAB_VERB "%.0" "" COMPU_TAB_REF Table_348 /end COMPU_METHOD
/begin COMPU_METHOD Table_349 "enumeration table" TAB_VERB "%.0" "" COMPU_TAB_REF Table_349 /end COMPU_METHOD
/begin COMPU_METHOD Table_350 "enumeration table" TAB_VERB "%.0" "" COMPU_TAB_REF Table_350 /end COMPU_METHOD
/begin COMPU_METHOD Table_351 "enumeration table" TAB_VERB "%.0" "" COMPU_TAB_REF Table_351 /end COMPU_METHOD
/begin COMPU_METHOD Table_352 "enumeration table" TAB_VERB "%.0" "" COMPU_TAB_REF Table_352 /end COMPU_METHOD
/begin COMPU_METHOD Table_353 "enumeration table" TAB_VERB "%.0" "" COMPU_TAB_REF Table_353 /end COMPU_METHOD
/begin COMPU_METHOD Table_354 "enumeration table" TAB_VERB "%.0" "" COMPU_TAB_REF Table_354 /end COMPU_METHOD
/begin COMPU_METHOD Table_355 "enumeration table" TAB_VERB "%.0" "" COMPU_TAB_REF Table_355 /end COMPU_METHOD
/begin COMPU_METHOD Table_357 "enumeration table" TAB_VERB "%.0" "" COMPU_TAB_REF Table_357 /end COMPU_METHOD
/begin COMPU_METHOD Table_358 "enumeration table" TAB_VERB "%.0" "" COMPU_TAB_REF Table_358 /end COMPU_METHOD
/begin COMPU_METHOD Table_361 "enumeration table" TAB_VERB "%.0" "" COMPU_TAB_REF Table_361 /end COMPU_METHOD
/begin COMPU_METHOD Table_363 "enumeration table" TAB_VERB "%.0" "" COMPU_TAB_REF Table_363 /end COMPU_METHOD
/begin COMPU_METHOD Table_369 "enumeration table" TAB_VERB "%.0" "" COMPU_TAB_REF Table_369 /end COMPU_METHOD
/begin COMPU_METHOD Table_370 "enumeration table" TAB_VERB "%.0" "" COMPU_TAB_REF Table_370 /end COMPU_METHOD
/begin COMPU_METHOD Table_371 "enumeration table" TAB_VERB "%.0" "" COMPU_TAB_REF Table_371 /end COMPU_METHOD
/begin COMPU_METHOD Table_372 "enumeration table" TAB_VERB "%.0" "" COMPU_TAB_REF Table_372 /end COMPU_METHOD
/begin COMPU_METHOD Table_373 "enumeration table" TAB_VERB "%.0" "" COMPU_TAB_REF Table_373 /end COMPU_METHOD
/begin COMPU_METHOD Table_374 "enumeration table" TAB_VERB "%.0" "" COMPU_TAB_REF Table_374 /end COMPU_METHOD
/begin COMPU_METHOD Table_390 "enumeration table" TAB_VERB "%.0" "" COMPU_TAB_REF Table_390 /end COMPU_METHOD
/begin COMPU_METHOD Table_394 "enumeration table" TAB_VERB "%.0" "" COMPU_TAB_REF Table_394 /end COMPU_METHOD
/begin COMPU_METHOD Table_397 "enumeration table" TAB_VERB "%.0" "" COMPU_TAB_REF Table_397 /end COMPU_METHOD
/begin COMPU_METHOD Table_467 "enumeration table" TAB_VERB "%.0" "" COMPU_TAB_REF Table_467 /end COMPU_METHOD
/begin COMPU_METHOD Table_468 "enumeration table" TAB_VERB "%.0" "" COMPU_TAB_REF Table_468 /end COMPU_METHOD
/begin COMPU_METHOD Table_540 "enumeration table" TAB_VERB "%.0" "" COMPU_TAB_REF Table_540 /end COMPU_METHOD
/begin COMPU_METHOD Table_541 "enumeration table" TAB_VERB "%.0" "" COMPU_TAB_REF Table_541 /end COMPU_METHOD
/begin COMPU_METHOD Table_557 "enumeration table" TAB_VERB "%.0" "" COMPU_TAB_REF Table_557 /end COMPU_METHOD
/begin COMPU_METHOD Table_559 "enumeration table" TAB_VERB "%.0" "" COMPU_TAB_REF Table_559 /end COMPU_METHOD
/begin COMPU_METHOD Table_571 "enumeration table" TAB_VERB "%.0" "" COMPU_TAB_REF Table_571 /end COMPU_METHOD
/begin COMPU_METHOD Table_574 "enumeration table" TAB_VERB "%.0" "" COMPU_TAB_REF Table_574 /end COMPU_METHOD
/begin COMPU_METHOD Table_644 "enumeration table" TAB_VERB "%.0" "" COMPU_TAB_REF Table_644 /end COMPU_METHOD
/begin COMPU_METHOD Table_662 "enumeration table" TAB_VERB "%.0" "" COMPU_TAB_REF Table_662 /end COMPU_METHOD
/begin COMPU_METHOD Table_664 "enumeration table" TAB_VERB "%.0" "" COMPU_TAB_REF Table_664 /end COMPU_METHOD
/begin COMPU_METHOD Table_665 "enumeration table" TAB_VERB "%.0" "" COMPU_TAB_REF Table_665 /end COMPU_METHOD
/begin COMPU_METHOD Table_667 "enumeration table" TAB_VERB "%.0" "" COMPU_TAB_REF Table_667 /end COMPU_METHOD
/begin COMPU_METHOD Table_669 "enumeration table" TAB_VERB "%.0" "" COMPU_TAB_REF Table_669 /end COMPU_METHOD
/begin COMPU_METHOD Table_671 "enumeration table" TAB_VERB "%.0" "" COMPU_TAB_REF Table_671 /end COMPU_METHOD
/begin COMPU_METHOD Table_674 "enumeration table" TAB_VERB "%.0" "" COMPU_TAB_REF Table_674 /end COMPU_METHOD
/begin COMPU_METHOD Table_678 "enumeration table" TAB_VERB "%.0" "" COMPU_TAB_REF Table_678 /end COMPU_METHOD
/begin COMPU_METHOD Table_681 "enumeration table" TAB_VERB "%.0" "" COMPU_TAB_REF Table_681 /end COMPU_METHOD
/begin COMPU_METHOD Table_687 "enumeration table" TAB_VERB "%.0" "" COMPU_TAB_REF Table_687 /end COMPU_METHOD
/begin COMPU_METHOD Table_688 "enumeration table" TAB_VERB "%.0" "" COMPU_TAB_REF Table_688 /end COMPU_METHOD
/begin COMPU_METHOD Table_689 "enumeration table" TAB_VERB "%.0" "" COMPU_TAB_REF Table_689 /end COMPU_METHOD
/begin COMPU_METHOD Table_690 "enumeration table" TAB_VERB "%.0" "" COMPU_TAB_REF Table_690 /end COMPU_METHOD
/begin COMPU_METHOD Table_691 "enumeration table" TAB_VERB "%.0" "" COMPU_TAB_REF Table_691 /end COMPU_METHOD
/begin COMPU_METHOD Table_692 "enumeration table" TAB_VERB "%.0" "" COMPU_TAB_REF Table_692 /end COMPU_METHOD
/begin COMPU_METHOD Table_695 "enumeration table" TAB_VERB "%.0" "" COMPU_TAB_REF Table_695 /end COMPU_METHOD
/begin COMPU_METHOD Table_696 "enumeration table" TAB_VERB "%.0" "" COMPU_TAB_REF Table_696 /end COMPU_METHOD
/begin COMPU_METHOD Table_697 "enumeration table" TAB_VERB "%.0" "" COMPU_TAB_REF Table_697 /end COMPU_METHOD
/begin COMPU_METHOD Table_698 "enumeration table" TAB_VERB "%.0" "" COMPU_TAB_REF Table_698 /end COMPU_METHOD
/begin COMPU_METHOD Table_699 "enumeration table" TAB_VERB "%.0" "" COMPU_TAB_REF Table_699 /end COMPU_METHOD
/begin COMPU_METHOD Table_716 "enumeration table" TAB_VERB "%.0" "" COMPU_TAB_REF Table_716 /end COMPU_METHOD
/begin COMPU_METHOD Table_738 "enumeration table" TAB_VERB "%.0" "" COMPU_TAB_REF Table_738 /end COMPU_METHOD
/begin COMPU_METHOD Table_740 "enumeration table" TAB_VERB "%.0" "" COMPU_TAB_REF Table_740 /end COMPU_METHOD
/begin COMPU_METHOD Table_742 "enumeration table" TAB_VERB "%.0" "" COMPU_TAB_REF Table_742 /end COMPU_METHOD
/begin COMPU_METHOD Table_760 "enumeration table" TAB_VERB "%.0" "" COMPU_TAB_REF Table_760 /end COMPU_METHOD
/begin COMPU_METHOD Table_761 "enumeration table" TAB_VERB "%.0" "" COMPU_TAB_REF Table_761 /end COMPU_METHOD
/begin COMPU_METHOD Table_762 "enumeration table" TAB_VERB "%.0" "" COMPU_TAB_REF Table_762 /end COMPU_METHOD
/begin COMPU_METHOD Table_763 "enumeration table" TAB_VERB "%.0" "" COMPU_TAB_REF Table_763 /end COMPU_METHOD
/begin COMPU_METHOD Table_764 "enumeration table" TAB_VERB "%.0" "" COMPU_TAB_REF Table_764 /end COMPU_METHOD
/begin COMPU_METHOD Table_765 "enumeration table" TAB_VERB "%.0" "" COMPU_TAB_REF Table_765 /end COMPU_METHOD
/begin COMPU_METHOD Table_766 "enumeration table" TAB_VERB "%.0" "" COMPU_TAB_REF Table_766 /end COMPU_METHOD
/begin COMPU_METHOD Table_811 "enumeration table" TAB_VERB "%.0" "" COMPU_TAB_REF Table_811 /end COMPU_METHOD
/begin COMPU_METHOD Table_945 "enumeration table" TAB_VERB "%.0" "" COMPU_TAB_REF Table_945 /end COMPU_METHOD
/begin COMPU_METHOD Table_946 "enumeration table" TAB_VERB "%.0" "" COMPU_TAB_REF Table_946 /end COMPU_METHOD
/begin COMPU_METHOD Table_947 "enumeration table" TAB_VERB "%.0" "" COMPU_TAB_REF Table_947 /end COMPU_METHOD
/begin COMPU_METHOD Table_948 "enumeration table" TAB_VERB "%.0" "" COMPU_TAB_REF Table_948 /end COMPU_METHOD
/begin COMPU_METHOD Table_956 "enumeration table" TAB_VERB "%.0" "" COMPU_TAB_REF Table_956 /end COMPU_METHOD
/begin COMPU_METHOD TargetLaneReaction "enumeration table" TAB_VERB "%.0" "" COMPU_TAB_REF TargetLaneReaction /end COMPU_METHOD
/begin COMPU_METHOD TargetObjectLossType "enumeration table" TAB_VERB "%.0" "" COMPU_TAB_REF TargetObjectLossType /end COMPU_METHOD
/begin COMPU_METHOD TargetSelectionStrategy "enumeration table" TAB_VERB "%.0" "" COMPU_TAB_REF TargetSelectionStrategy /end COMPU_METHOD
/begin COMPU_METHOD Temperature.CONVERSION "@@@@RuleName created by CANape" LINEAR "%3.1" "°C" COEFFS_LINEAR 0.123040771484 -273.14999999999998 /end COMPU_METHOD
/begin COMPU_METHOD TimbaObjectIndex "enumeration table" TAB_VERB "%.0" "" COMPU_TAB_REF TimbaObjectIndex /end COMPU_METHOD
/begin COMPU_METHOD TimeValidity "enumeration table" TAB_VERB "%.0" "" COMPU_TAB_REF TimeValidity /end COMPU_METHOD
/begin COMPU_METHOD TrafficDirection "enumeration table" TAB_VERB "%.0" "" COMPU_TAB_REF TrafficDirection /end COMPU_METHOD
/begin COMPU_METHOD TrafficJamLevel "enumeration table" TAB_VERB "%.0" "" COMPU_TAB_REF TrafficJamLevel /end COMPU_METHOD
/begin COMPU_METHOD TrafficLightState "enumeration table" TAB_VERB "%.0" "" COMPU_TAB_REF TrafficLightState /end COMPU_METHOD
/begin COMPU_METHOD TrafficSignType "enumeration table" TAB_VERB "%.0" "" COMPU_TAB_REF TrafficSignType /end COMPU_METHOD
/begin COMPU_METHOD Type "enumeration table" TAB_VERB "%.0" "" COMPU_TAB_REF Type /end COMPU_METHOD
/begin COMPU_METHOD Type.OLD_Copy1 "enumeration table" TAB_VERB "%.0" "" COMPU_TAB_REF Type.OLD_1 /end COMPU_METHOD
/begin COMPU_METHOD Type.OLD_Copy2 "enumeration table" TAB_VERB "%.0" "" COMPU_TAB_REF Type.OLD_2 /end COMPU_METHOD
/begin COMPU_METHOD Type.OLD_Copy3 "enumeration table" TAB_VERB "%.0" "" COMPU_TAB_REF Type.OLD_3 /end COMPU_METHOD
/begin COMPU_METHOD Type.OLD_Copy4 "enumeration table" TAB_VERB "%.0" "" COMPU_TAB_REF Type.OLD_4 /end COMPU_METHOD
/begin COMPU_METHOD Type_Copy1 "enumeration table" TAB_VERB "%.0" "" COMPU_TAB_REF Type_Copy1 /end COMPU_METHOD
/begin COMPU_METHOD Type_Copy2 "enumeration table" TAB_VERB "%.0" "" COMPU_TAB_REF Type_Copy2 /end COMPU_METHOD
/begin COMPU_METHOD Type_Copy3 "enumeration table" TAB_VERB "%.0" "" COMPU_TAB_REF Type_Copy3 /end COMPU_METHOD
/begin COMPU_METHOD Unit "enumeration table" TAB_VERB "%.0" "" COMPU_TAB_REF Unit /end COMPU_METHOD
/begin COMPU_METHOD VOID_SCALING_a "Void scaling for unscaled variables" IDENTICAL "%1.0" "" /end COMPU_METHOD
/begin COMPU_METHOD VX1000.BM.mon.bmTemperature.CONVERSION "@@@@RuleName created by CANape" RAT_FUNC "%3.1" "°C" COEFFS 0 128 0 0 0 1 /end COMPU_METHOD
/begin COMPU_METHOD VX1000.sys.podTemp.CONVERSION.DIFF_UNIT "@@@@RuleName created by CANape" RAT_FUNC "%3.1" "°C" COEFFS 0 1 0 0 0 1 /end COMPU_METHOD
/begin COMPU_METHOD VX1000.sys.upTimeS.CONVERSION.DIFF_UNIT "@@@@RuleName created by CANape" RAT_FUNC "%3.1" "Seconds" COEFFS 0 1 0 0 0 1 /end COMPU_METHOD
/begin COMPU_METHOD VX14xx.mon.pod.temperature.CONVERSION "" IDENTICAL "%3.1" "" /end COMPU_METHOD
/begin COMPU_METHOD Value "enumeration table" TAB_VERB "%.0" "" COMPU_TAB_REF Value /end COMPU_METHOD
/begin COMPU_METHOD Value.OLD_Copy1 "enumeration table" TAB_VERB "%.0" "" COMPU_TAB_REF Value.OLD_1 /end COMPU_METHOD
/begin COMPU_METHOD Value.OLD_Copy2 "enumeration table" TAB_VERB "%.0" "" COMPU_TAB_REF Value.OLD_2 /end COMPU_METHOD
/begin COMPU_METHOD Value.OLD_Copy3 "enumeration table" TAB_VERB "%.0" "" COMPU_TAB_REF Value.OLD_3 /end COMPU_METHOD
/begin COMPU_METHOD Value.OLD_Copy4 "enumeration table" TAB_VERB "%.0" "" COMPU_TAB_REF Value.OLD_4 /end COMPU_METHOD
/begin COMPU_METHOD Value.OLD_Copy5 "enumeration table" TAB_VERB "%.0" "" COMPU_TAB_REF Value.OLD_5 /end COMPU_METHOD
/begin COMPU_METHOD Value.OLD_Copy6 "enumeration table" TAB_VERB "%.0" "" COMPU_TAB_REF Value.OLD_6 /end COMPU_METHOD
/begin COMPU_METHOD Value.OLD_Copy7 "enumeration table" TAB_VERB "%.0" "" COMPU_TAB_REF Value.OLD_7 /end COMPU_METHOD
/begin COMPU_METHOD Value.OLD_Copy8 "enumeration table" TAB_VERB "%.0" "" COMPU_TAB_REF Value.OLD_8 /end COMPU_METHOD
/begin COMPU_METHOD Value_Copy1 "enumeration table" TAB_VERB "%.0" "" COMPU_TAB_REF Value_Copy1 /end COMPU_METHOD
/begin COMPU_METHOD Value_Copy10 "enumeration table" TAB_VERB "%.0" "" COMPU_TAB_REF Value_Copy10 /end COMPU_METHOD
/begin COMPU_METHOD Value_Copy11 "enumeration table" TAB_VERB "%.0" "" COMPU_TAB_REF Value_Copy11 /end COMPU_METHOD
/begin COMPU_METHOD Value_Copy12 "enumeration table" TAB_VERB "%.0" "" COMPU_TAB_REF Value_Copy12 /end COMPU_METHOD
/begin COMPU_METHOD Value_Copy13 "enumeration table" TAB_VERB "%.0" "" COMPU_TAB_REF Value_Copy13 /end COMPU_METHOD
/begin COMPU_METHOD Value_Copy2 "enumeration table" TAB_VERB "%.0" "" COMPU_TAB_REF Value_Copy2 /end COMPU_METHOD
/begin COMPU_METHOD Value_Copy3 "enumeration table" TAB_VERB "%.0" "" COMPU_TAB_REF Value_Copy3 /end COMPU_METHOD
/begin COMPU_METHOD Value_Copy4 "enumeration table" TAB_VERB "%.0" "" COMPU_TAB_REF Value_Copy4 /end COMPU_METHOD
/begin COMPU_METHOD Value_Copy5 "enumeration table" TAB_VERB "%.0" "" COMPU_TAB_REF Value_Copy5 /end COMPU_METHOD
/begin COMPU_METHOD Value_Copy6 "enumeration table" TAB_VERB "%.0" "" COMPU_TAB_REF Value_Copy6 /end COMPU_METHOD
/begin COMPU_METHOD Value_Copy7 "enumeration table" TAB_VERB "%.0" "" COMPU_TAB_REF Value_Copy7 /end COMPU_METHOD
/begin COMPU_METHOD Value_Copy8 "enumeration table" TAB_VERB "%.0" "" COMPU_TAB_REF Value_Copy8 /end COMPU_METHOD
/begin COMPU_METHOD Value_Copy9 "enumeration table" TAB_VERB "%.0" "" COMPU_TAB_REF Value_Copy9 /end COMPU_METHOD
/begin COMPU_METHOD VehicleMovementDirection "enumeration table" TAB_VERB "%.0" "" COMPU_TAB_REF VehicleMovementDirection /end COMPU_METHOD
/begin COMPU_METHOD VehicleStandstillState "enumeration table" TAB_VERB "%.0" "" COMPU_TAB_REF VehicleStandstillState /end COMPU_METHOD
/begin COMPU_METHOD VertexType "enumeration table" TAB_VERB "%.0" "" COMPU_TAB_REF VertexType /end COMPU_METHOD
/begin COMPU_METHOD VideoCalibrationState "enumeration table" TAB_VERB "%.0" "" COMPU_TAB_REF VideoCalibrationState /end COMPU_METHOD
/begin COMPU_METHOD VideoLane "enumeration table" TAB_VERB "%.0" "" COMPU_TAB_REF VideoLane /end COMPU_METHOD
/begin COMPU_METHOD VideoSensorState "enumeration table" TAB_VERB "%.0" "" COMPU_TAB_REF VideoSensorState /end COMPU_METHOD
/begin COMPU_METHOD VideoStatusState "enumeration table" TAB_VERB "%.0" "" COMPU_TAB_REF VideoStatusState /end COMPU_METHOD
/begin COMPU_METHOD VlcAccRequestMainState "enumeration table" TAB_VERB "%.0" "" COMPU_TAB_REF VlcAccRequestMainState /end COMPU_METHOD
/begin COMPU_METHOD VlcShutDownRequest "enumeration table" TAB_VERB "%.0" "" COMPU_TAB_REF VlcShutDownRequest /end COMPU_METHOD
/begin COMPU_METHOD VmcAvailabilityStatus "enumeration table" TAB_VERB "%.0" "" COMPU_TAB_REF VmcAvailabilityStatus /end COMPU_METHOD
/begin COMPU_METHOD VmcMotionType "enumeration table" TAB_VERB "%.0" "" COMPU_TAB_REF VmcMotionType /end COMPU_METHOD
/begin COMPU_METHOD VmcStatusComfortLaneDriving "enumeration table" TAB_VERB "%.0" "" COMPU_TAB_REF VmcStatusComfortLaneDriving /end COMPU_METHOD
/begin COMPU_METHOD VoltageHigh_StateMachine_State "enumeration table" TAB_VERB "%.0" "" COMPU_TAB_REF VoltageHigh_StateMachine_State /end COMPU_METHOD
/begin COMPU_METHOD VoltageLow_StateMachine_State "enumeration table" TAB_VERB "%.0" "" COMPU_TAB_REF VoltageLow_StateMachine_State /end COMPU_METHOD
/begin COMPU_METHOD WiperStatus "enumeration table" TAB_VERB "%.0" "" COMPU_TAB_REF WiperStatus /end COMPU_METHOD
/begin COMPU_METHOD YAW_RATE_OFFSET_EXTERNAL_STATES "enumeration table" TAB_VERB "%.0" "" COMPU_TAB_REF YAW_RATE_OFFSET_EXTERNAL_STATES /end COMPU_METHOD
/begin COMPU_METHOD YAW_RATE_OFFSET_INDICATOR_STATES "enumeration table" TAB_VERB "%.0" "" COMPU_TAB_REF YAW_RATE_OFFSET_INDICATOR_STATES /end COMPU_METHOD
/begin COMPU_METHOD YawRateStabilizationAvailability "enumeration table" TAB_VERB "%.0" "" COMPU_TAB_REF YawRateStabilizationAvailability /end COMPU_METHOD
/begin COMPU_METHOD _Adc_ConfigAdcSwGroupCfg_ast._1_._AdcGroupConversionMode_en.CONVERSION "@@@@RuleName created by CANape" TAB_VERB "%.0" "" COMPU_TAB_REF _Adc_ConfigAdcSwGroupCfg_ast._1_._AdcGroupConversionMode_en.CONVERSION /end COMPU_METHOD
/begin COMPU_METHOD _Adc_ConfigAdcSwGroupCfg_ast._1_._AdcIntClockDiv_en.CONVERSION "@@@@RuleName created by CANape" TAB_VERB "%.0" "" COMPU_TAB_REF _Adc_ConfigAdcSwGroupCfg_ast._1_._AdcIntClockDiv_en.CONVERSION /end COMPU_METHOD
/begin COMPU_METHOD _Adc_Prv_GroupInfo_ast._1_._Status_en.CONVERSION "@@@@RuleName created by CANape" TAB_VERB "%.0" "" COMPU_TAB_REF _Adc_Prv_GroupInfo_ast._1_._Status_en.CONVERSION /end COMPU_METHOD
/begin COMPU_METHOD _CanIf_ControllerState._0_._ChannelMode.CONVERSION "@@@@RuleName created by CANape" TAB_VERB "%.0" "" COMPU_TAB_REF _CanIf_ControllerState._0_._ChannelMode.CONVERSION /end COMPU_METHOD
/begin COMPU_METHOD _CanIf_HrhConfig._9_._HrhInfo.CONVERSION "@@@@RuleName created by CANape" TAB_VERB "%.0" "" COMPU_TAB_REF _CanIf_HrhConfig._9_._HrhInfo.CONVERSION /end COMPU_METHOD
/begin COMPU_METHOD _CanIf_TxNotification._9_.CONVERSION "@@@@RuleName created by CANape" TAB_VERB "%.0" "" COMPU_TAB_REF _CanIf_TxNotification._9_.CONVERSION /end COMPU_METHOD
/begin COMPU_METHOD _CanIf_TxPduConfig._0_._TxUser.CONVERSION "enumeration table" TAB_VERB "%.0" "" COMPU_TAB_REF _CanIf_TxPduConfig._0_._TxUser.CONVERSION /end COMPU_METHOD
/begin COMPU_METHOD _CanIf_TxPduConfig._9_._TxUser.CONVERSION "@@@@RuleName created by CANape" TAB_VERB "%.0" "" COMPU_TAB_REF _CanIf_TxPduConfig._9_._TxUser.CONVERSION /end COMPU_METHOD
/begin COMPU_METHOD _CanSM_BOR_Controller_Stopped_state_en._0_.CONVERSION "@@@@RuleName created by CANape" TAB_VERB "%.0" "" COMPU_TAB_REF _CanSM_BOR_Controller_Stopped_state_en._0_.CONVERSION /end COMPU_METHOD
/begin COMPU_METHOD _CanSM_ControllerState_en._0_.CONVERSION "@@@@RuleName created by CANape" TAB_VERB "%.0" "" COMPU_TAB_REF _CanSM_ControllerState_en._0_.CONVERSION /end COMPU_METHOD
/begin COMPU_METHOD _CanSM_CurrNw_Mode_en._0_.CONVERSION "@@@@RuleName created by CANape" TAB_VERB "%.0" "" COMPU_TAB_REF _CanSM_CurrNw_Mode_en._0_.CONVERSION /end COMPU_METHOD
/begin COMPU_METHOD _CanSM_PreFullCom_Substates_en._0_.CONVERSION "@@@@RuleName created by CANape" TAB_VERB "%.0" "" COMPU_TAB_REF _CanSM_PreFullCom_Substates_en._0_.CONVERSION /end COMPU_METHOD
/begin COMPU_METHOD _CanSM_PreNoCom_Substates_en._0_.CONVERSION "@@@@RuleName created by CANape" TAB_VERB "%.0" "" COMPU_TAB_REF _CanSM_PreNoCom_Substates_en._0_.CONVERSION /end COMPU_METHOD
/begin COMPU_METHOD _CanSM_TimerConfig_ast._0_._stTimer.CONVERSION "@@@@RuleName created by CANape" TAB_VERB "%.0" "" COMPU_TAB_REF _CanSM_TimerConfig_ast._0_._stTimer.CONVERSION /end COMPU_METHOD
/begin COMPU_METHOD _CanSM_TxTimeoutexception_Substates_en._0_.CONVERSION "@@@@RuleName created by CANape" TAB_VERB "%.0" "" COMPU_TAB_REF _CanSM_TxTimeoutexception_Substates_en._0_.CONVERSION /end COMPU_METHOD
/begin COMPU_METHOD _CanSM_WakeUpValidation_Substates_en._0_.CONVERSION "@@@@RuleName created by CANape" TAB_VERB "%.0" "" COMPU_TAB_REF _CanSM_WakeUpValidation_Substates_en._0_.CONVERSION /end COMPU_METHOD
/begin COMPU_METHOD _CanSM_currBOR_State_en._0_.CONVERSION "@@@@RuleName created by CANape" TAB_VERB "%.0" "" COMPU_TAB_REF _CanSM_currBOR_State_en._0_.CONVERSION /end COMPU_METHOD
/begin COMPU_METHOD _CanTSyn_Master_Tx_a._0_._TxCrc.CONVERSION "enumeration table" TAB_VERB "%.0" "" COMPU_TAB_REF _CanTSyn_Master_Tx_a._0_._TxCrc.CONVERSION /end COMPU_METHOD
/begin COMPU_METHOD _CanTSyn_TxRam._0_._TxType.CONVERSION "enumeration table" TAB_VERB "%.0" "" COMPU_TAB_REF _CanTSyn_TxRam._0_._TxType.CONVERSION /end COMPU_METHOD
/begin COMPU_METHOD _CanTSyn_TxRam._0_._mode.CONVERSION "enumeration table" TAB_VERB "%.0" "" COMPU_TAB_REF _CanTSyn_TxRam._0_._mode.CONVERSION /end COMPU_METHOD
/begin COMPU_METHOD _ComM_ChanelList._0_._BusType_e.CONVERSION "@@@@RuleName created by CANape" TAB_VERB "%.0" "" COMPU_TAB_REF _ComM_ChanelList._0_._BusType_e.CONVERSION /end COMPU_METHOD
/begin COMPU_METHOD _ComM_ChanelList._0_._ComMNmVariant_e.CONVERSION "@@@@RuleName created by CANape" TAB_VERB "%.0" "" COMPU_TAB_REF _ComM_ChanelList._0_._ComMNmVariant_e.CONVERSION /end COMPU_METHOD
/begin COMPU_METHOD _ComM_ChannelStruct._0_._ChannelState_e.CONVERSION "@@@@RuleName created by CANape" TAB_VERB "%.0" "" COMPU_TAB_REF _ComM_ChannelStruct._0_._ChannelState_e.CONVERSION /end COMPU_METHOD
/begin COMPU_METHOD _ComM_GlobalStruct._ComM_InitStatus.CONVERSION "@@@@RuleName created by CANape" TAB_VERB "%.0" "" COMPU_TAB_REF _ComM_GlobalStruct._ComM_InitStatus.CONVERSION /end COMPU_METHOD
/begin COMPU_METHOD _Com_Uninit_Flag.CONVERSION "@@@@RuleName created by CANape" TAB_VERB "%.0" "" COMPU_TAB_REF _Com_Uninit_Flag.CONVERSION /end COMPU_METHOD
/begin COMPU_METHOD _Dcm_ActiveDiagnosticState_en.CONVERSION "@@@@RuleName created by CANape" TAB_VERB "%.0" "" COMPU_TAB_REF _Dcm_ActiveDiagnosticState_en.CONVERSION /end COMPU_METHOD
/begin COMPU_METHOD _Dcm_BootLoaderState_en.CONVERSION "@@@@RuleName created by CANape" TAB_VERB "%.0" "" COMPU_TAB_REF _Dcm_BootLoaderState_en.CONVERSION /end COMPU_METHOD
/begin COMPU_METHOD _Dcm_DsldGlobal_st._stDsdState_en.CONVERSION "@@@@RuleName created by CANape" TAB_VERB "%.0" "" COMPU_TAB_REF _Dcm_DsldGlobal_st._stDsdState_en.CONVERSION /end COMPU_METHOD
/begin COMPU_VTAB ObjectMotionDirection "enumeration table" TAB_VERB 4 0 "unspecified" 1 "parallel" 2 "oncoming" 3 "oncomingTurn" /end COMPU_VTAB
/begin COMPU_VTAB ObjectMovingState "enumeration table" TAB_VERB 4 0 "unknown" 1 "standing" 2 "moving" 3 "stopped" /end COMPU_VTAB
/begin COMPU_VTAB ObjectMovingState_Copy1 "enumeration table" TAB_VERB 6 0 "unknown" 1 "standing" 2 "moving" 3 "stopped" 4 "oncoming" 5 "stoppedOncoming" /end COMPU_VTAB
/begin COMPU_VTAB ObjectRadarSensorState "enumeration table" TAB_VERB 17 0 "sensorFullyOperational" 1 "hwMalfunction" 2 "dspIssues" 3 "communicationErrors" 4 "misalignment" 5 "sensorBlindnessDetected" 6 "sensorDisturbed" 7 "otherIssues" 8 "degradedByRequest" 9 "reserved1" 10 "reserved2" 11 "reserved3" 12 "reserved4" 13 "reserved5" 14 "reserved6" 15 "invalid" 255 "outOfRange" /end COMPU_VTAB
/begin COMPU_VTAB ObjectTrackingState "enumeration table" TAB_VERB 6 0 "undefined" 1 "newlyAppeared" 2 "tracked" 3 "replacedWithSimilar" 4 "replacedWithDifferent" 5 "newlyDisappeared" /end COMPU_VTAB
/begin COMPU_VTAB_RANGE ObjectType "" 3 0 0 "Car" 1 1 "Truck" 2 2 "Unknown" DEFAULT_VALUE "" /end COMPU_VTAB_RANGE
/begin COMPU_VTAB ObjectType_Copy1 "enumeration table" TAB_VERB 14 0 "Unknown" 1 "NonObstacle" 2 "UnknownObstacle" 3 "MobileObstacle" 4 "TwoWheelerUnknown" 5 "Pedestrian" 6 "FourWheelerUnknown" 7 "Truck" 8 "Car" 9 "Bicycle" 10 "Motorcycle" 11 "Bus" 12 "Trailer" 13 "RoadSafetyUnit" /end COMPU_VTAB
/begin COMPU_VTAB ObstacleBlockingSide "enumeration table" TAB_VERB 3 -1 "Right" 0 "Undefined" 1 "Left" /end COMPU_VTAB
/begin COMPU_VTAB ObstacleSensorIndex "enumeration table" TAB_VERB 19 0 "invalidObstacleSensorIndex" 1 "frontCenterLocationRadar" 2 "frontCenterVideo" 3 "fusedFrontObjectSensor" 3 "envModelSensor" 4 "frontLeftCornerObjectRadar" 5 "frontRightCornerObjectRadar" 6 "rearLeftCornerObjectRadar" 7 "rearRightCornerObjectRadar" 8 "trackedVideoObjectSensor" 9 "frontLeftCornerLocationRadar" 10 "frontRightCornerLocationRadar" 11 "rearLeftCornerLocationRadar" 12 "rearRightCornerLocationRadar" 13 "lidarSensor" 14 "frontCenterObjectRadar" 15 "customObstacleSensorIndex1" 16 "customObstacleSensorIndex2" 255 "maxValueInvalidObstacleSensorIndex" /end COMPU_VTAB
/begin COMPU_VTAB OcclusionState "enumeration table" TAB_VERB 3 0 "notOccluded" 1 "occluded" 2 "notChecked" /end COMPU_VTAB
/begin COMPU_VTAB_RANGE OosIds "" 3 0 0 "INSPEC" 1 1 "PER_PME_VELOCITY_SERVICE_OOS" 2 2 "PER_PME_YAW_RATE_SERVICE_OOS" DEFAULT_VALUE "" /end COMPU_VTAB_RANGE
/begin COMPU_VTAB_RANGE OoseqStrategy "" 6 0 0 "DISCARD" 1 1 "NEGLECT" 2 2 "WAIT" 3 3 "PREDICT_OBJECTLIST" 4 4 "PREDICT_MEASUREMENT" 5 5 "TWOSTEP" DEFAULT_VALUE "" /end COMPU_VTAB_RANGE
/begin COMPU_VTAB OoseqStrategy_Copy1 "enumeration table" TAB_VERB 5 0 "USE" 1 "REWRITE" 2 "DISCARD" 3 "IMPLAUSIBLE" 4 "PLAUSIBLE_QM" /end COMPU_VTAB
/begin COMPU_VTAB OrientationType "enumeration table" TAB_VERB 4 0 "unknown" 1 "left" 2 "right" 3 "center" /end COMPU_VTAB
/begin COMPU_VTAB_RANGE Os_ScheduleTableStatusType "" 5 0 0 "SCHEDULETABLE_STOPPED" 1 1 "SCHEDULETABLE_NEXT" 2 2 "SCHEDULETABLE_WAITING" 3 3 "SCHEDULETABLE_RUNNING" 4 4 "SCHEDULETABLE_RUNNING_AND_SYNCHRONOUS" DEFAULT_VALUE "" /end COMPU_VTAB_RANGE
/begin COMPU_VTAB OverspeedOffsetUnit "enumeration table" TAB_VERB 2 0 "offsetUnitKph" 1 "offsetUnitMph" /end COMPU_VTAB
/begin COMPU_VTAB_RANGE PER_ALGOS_MBF_TYPES "" 8 1 1 "TYPE_MBF_DEFAULT" 1 1 "TYPE_LKF_WNJ_CART" 3 3 "TYPE_LKF_LA_CART" 4 4 "TYPE_LKF_FH_CART" 5 5 "TYPE_EKF_WNJ_POL" 6 6 "TYPE_EKF_CT_POL" 7 7 "TYPE_EKF_LA_POL" 8 8 "TYPE_EKF_FH_POL" DEFAULT_VALUE "" /end COMPU_VTAB_RANGE
/begin COMPU_VTAB PER_ALGOS_MBF_TYPES_Copy1 "enumeration table" TAB_VERB 5 0 "TYPE_WNJ" 0 "TYPE_MBF_DEFAULT" 1 "TYPE_LA" 2 "TYPE_FH" 3 "TYPE_CT" /end COMPU_VTAB
/begin COMPU_VTAB PER_ALGOS_MBF_TYPES_Copy99 "enumeration table" TAB_VERB 8 1 "TYPE_LKF_WNJ_CART" 1 "TYPE_MBF_DEFAULT" 3 "TYPE_LKF_LA_CART" 4 "TYPE_LKF_FH_CART" 5 "TYPE_EKF_WNJ_POL" 6 "TYPE_EKF_CT_POL" 7 "TYPE_EKF_LA_POL" 8 "TYPE_EKF_FH_POL" /end COMPU_VTAB
/begin COMPU_VTAB_RANGE PER_ASIL_LEVELS "" 6 0 0 "ASIL_UNKNOWN" 1 1 "ASIL_QM" 2 2 "ASIL_A" 3 3 "ASIL_B" 4 4 "ASIL_C" 5 5 "ASIL_D" DEFAULT_VALUE "" /end COMPU_VTAB_RANGE
/begin COMPU_VTAB PER_PER_TYPES "enumeration table" TAB_VERB 6 1 "TYPE_DEP" 2 "TYPE_SEP" 3 "TYPE_REP" 5 "TYPE_ADEP" 6 "TYPE_ASEP" 7 "TYPE_AREP" /end COMPU_VTAB
/begin COMPU_VTAB_RANGE PER_RAW_FEATURES "" 6 0 0 "RAW_FEATURE_INVALID" 1 1 "RAW_FEATURE_LENGTH" 2 2 "RAW_FEATURE_WIDTH" 3 3 "RAW_FEATURE_RADIALDIST" 4 4 "RAW_FEATURE_RCS" 5 5 "RAW_FEATURE_ELEVATION" DEFAULT_VALUE "" /end COMPU_VTAB_RANGE
/begin COMPU_VTAB_RANGE PER_REFERENCE_POINTS "" 16 0 0 "REF_POS_FL" 1 1 "REF_POS_FC" 2 2 "REF_POS_FR" 3 3 "REF_POS_FWL" 4 4 "REF_POS_FWR" 5 5 "REF_POS_SML" 6 6 "REF_POS_SMR" 7 7 "REF_POS_RWL" 8 8 "REF_POS_RWR" 9 9 "REF_POS_RL" 10 10 "REF_POS_RC" 11 11 "REF_POS_RR" 12 12 "REF_POS_CENTER" 13 13 "REF_POS_RWC" 14 14 "REF_POS_FWC" 255 255 "REF_POS_INVALID" DEFAULT_VALUE "" /end COMPU_VTAB_RANGE
/begin COMPU_VTAB_RANGE PER_REFERENCE_POINTS.OLD_1 "" 14 0 0 "REF_POS_FL" 1 1 "REF_POS_FC" 2 2 "REF_POS_FR" 3 3 "REF_POS_FWL" 4 4 "REF_POS_FWR" 5 5 "REF_POS_SML" 6 6 "REF_POS_SMR" 7 7 "REF_POS_RWL" 8 8 "REF_POS_RWR" 9 9 "REF_POS_RL" 10 10 "REF_POS_RC" 11 11 "REF_POS_RR" 12 12 "REF_POS_CENTER" 255 255 "REF_POS_INVALID" DEFAULT_VALUE "" /end COMPU_VTAB_RANGE
/begin COMPU_VTAB PER_REFERENCE_POINTS_Copy1 "enumeration table" TAB_VERB 17 0 "REF_POS_FL" 1 "REF_POS_FC" 2 "REF_POS_FR" 3 "REF_POS_FWL" 4 "REF_POS_FWR" 5 "REF_POS_SML" 6 "REF_POS_SMR" 7 "REF_POS_RWL" 8 "REF_POS_RWR" 9 "REF_POS_RL" 10 "REF_POS_RC" 11 "REF_POS_RR" 12 "REF_POS_CENTER" 13 "REF_POS_RWC" 14 "REF_POS_FWC" 15 "REF_POS_ADAPTIVE" 255 "REF_POS_INVALID" /end COMPU_VTAB
/begin COMPU_VTAB PER_REFERENCE_POINTS_Copy2 "enumeration table" TAB_VERB 18 0 "REF_POS_FL" 1 "REF_POS_FC" 2 "REF_POS_FR" 3 "REF_POS_FWL" 4 "REF_POS_FWR" 5 "REF_POS_SML" 6 "REF_POS_SMR" 7 "REF_POS_RWL" 8 "REF_POS_RWR" 9 "REF_POS_RL" 10 "REF_POS_RC" 11 "REF_POS_RR" 12 "REF_POS_CENTER" 13 "REF_POS_RWC" 14 "REF_POS_FWC" 15 "REF_POS_INVALID" 16 "REF_POS_NLR" 17 "REF_POS_NFR" /end COMPU_VTAB
/begin COMPU_VTAB_RANGE PER_SENSOR_TYPES "" 8 0 0 "TYPE_PER" 1 1 "TYPE_RADAR" 2 2 "TYPE_VIDEO" 3 3 "TYPE_LIDAR" 4 4 "TYPE_ULTRASONIC" 5 5 "TYPE_MAP" 6 6 "TYPE_SIGN" 7 7 "TYPE_LANE" DEFAULT_VALUE "" /end COMPU_VTAB_RANGE
/begin COMPU_VTAB PathStartStrategy "enumeration table" TAB_VERB 4 0 "off" 1 "init" 2 "reinit" 3 "normal" /end COMPU_VTAB
/begin COMPU_VTAB PerVideoObjectTypes "enumeration table" TAB_VERB 24 0 "unknown" 1 "passableAbove" 2 "passableBelow" 3 "pedestrian" 4 "pedestrianGroup" 5 "bicycle" 6 "ptw" 7 "car" 8 "van" 9 "truck" 10 "barrier" 11 "animal" 12 "reflector" 13 "type13" 14 "type14" 15 "init" 16 "fourPlusWheeler" 17 "twowheeler" 18 "beacon" 19 "post" 20 "cone" 21 "rickshaw" 22 "carSide" 23 "truckSide" /end COMPU_VTAB
/begin COMPU_VTAB_RANGE PortStates "" 4 0 0 "PortStateUnknown" 1 1 "PortStateNoData" 2 2 "PortStateOldData" 3 3 "PortStateNewData" DEFAULT_VALUE "" /end COMPU_VTAB_RANGE
/begin COMPU_VTAB_RANGE Pre_NoCom_No_PN_Substates_Enum "" 9 0 0 "CANSM_NO_PN_DEFAULT" 1 1 "CANSM_NO_PN_S_CC_STOPPED" 2 2 "CANSM_NO_PN_S_CC_STOPPED_WAIT" 3 3 "CANSM_NO_PN_S_CC_SLEEP" 4 4 "CANSM_NO_PN_S_CC_SLEEP_WAIT" 5 5 "CANSM_NO_PN_S_TRCV_NORMAL" 6 6 "CANSM_NO_PN_S_TRCV_NORMAL_WAIT" 7 7 "CANSM_NO_PN_S_TRCV_STANDBY" 8 8 "CANSM_NO_PN_S_TRCV_STANDBY_WAIT" DEFAULT_VALUE "" /end COMPU_VTAB_RANGE
/begin COMPU_VTAB PredictedStateOfMotion "enumeration table" TAB_VERB 4 0 "unspecified" 1 "stationary" 2 "moving" 3 "stopped" /end COMPU_VTAB
/begin COMPU_VTAB Priority "enumeration table" TAB_VERB 4 0 "A" 1 "B" 2 "parallel" 3 "invalid" /end COMPU_VTAB
/begin COMPU_VTAB ProfileWarnHaptic "enumeration table" TAB_VERB 3 1 "low" 2 "medium" 3 "strong" /end COMPU_VTAB
/begin COMPU_VTAB_RANGE PswRequestType "" 3 0 0 "NO_WRITE" 1 1 "WRITE" 2 2 "FORCE_WRITE" DEFAULT_VALUE "" /end COMPU_VTAB_RANGE
/begin COMPU_VTAB_RANGE RIF_STATUS "" 11 0 0 "RIF_OK" 1 1 "RIF_CONF_ENABLE_TIMEOUT_ERR" 2 2 "RIF_CONF_DISABLE_TIMEOUT_ERR" 3 3 "RIF_CONF_RESET_TIMEOUT_ERR" 4 4 "RIF_DATA_CRC_ERR" 5 5 "RIF_DATA_COUNTER_ERR" 6 6 "RIF_DFU_LKSTP_ERR" 7 7 "RIF_REG_CRC_ERR" 8 8 "RIF_SFTY_CTRL_ERR" 9 9 "RIF_CAL_DESKEW_ERR" 10 10 "RIF_CAL_TIMEOUT_ERR" DEFAULT_VALUE "" /end COMPU_VTAB_RANGE
/begin COMPU_VTAB_RANGE RIF_STATUS.OLD_1 "" 8 0 0 "RIF_OK" 1 1 "RIF_CONF_ENABLE_TIMEOUT_ERR" 2 2 "RIF_CONF_DISABLE_TIMEOUT_ERR" 3 3 "RIF_CONF_RESET_TIMEOUT_ERR" 4 4 "RIF_DATA_CRC_ERR" 5 5 "RIF_DATA_COUNTER_ERR" 6 6 "RIF_CAL_DESKEW_ERR" 7 7 "RIF_CAL_TIMEOUT_ERR" DEFAULT_VALUE "" /end COMPU_VTAB_RANGE
/begin COMPU_VTAB RIF_STATUS_Copy1 "enumeration table" TAB_VERB 12 0 "RIF_OK" 1 "RIF_CONF_ENABLE_TIMEOUT_ERR" 2 "RIF_CONF_DISABLE_TIMEOUT_ERR" 3 "RIF_CONF_RESET_TIMEOUT_ERR" 4 "RIF_DATA_CRC_ERR" 5 "RIF_DATA_COUNTER_ERR" 6 "RIF_DFU_LKSTP_ERR" 7 "RIF_REG_CRC_ERR" 8 "RIF_SFTY_CTRL_ERR" 9 "RIF_CAL_DESKEW_ERR" 10 "RIF_CAL_TIMEOUT_ERR" 11 "RIF_HW_REGISTER_ERR" /end COMPU_VTAB
/begin COMPU_VTAB_RANGE RPType.OLD_1 "" 6 0 0 "RPT_UNDEFINED" 1 1 "RPT_ALD" 2 2 "RPT_ALC" 3 3 "RPT_AEB_M" 4 4 "RPT_TOR" 5 5 "RPT_HWA_ALD" DEFAULT_VALUE "" /end COMPU_VTAB_RANGE
/begin COMPU_VTAB RSB_Types "enumeration table" TAB_VERB 9 0 "RSB_TYPE_INVALID" 1 "RSB_TYPE_LEFT_ELEVATED" 2 "RSB_TYPE_RIGHT_ELEVATED" 3 "RSB_TYPE_LEFT_ROADEDGE" 4 "RSB_TYPE_RIGHT_ROADEDGE" 5 "RSB_TYPE_LEFT_ELEVATED_VIDEO" 6 "RSB_TYPE_LEFT_ELEVATED_RADAR" 7 "RSB_TYPE_RIGHT_ELEVATED_VIDEO" 8 "RSB_TYPE_RIGHT_ELEVATED_RADAR" /end COMPU_VTAB
/begin COMPU_VTAB RbvmiBrakeDiscTemperatureStatus "enumeration table" TAB_VERB 4 0 "level3" 1 "level2" 2 "level1" 3 "normal" /end COMPU_VTAB
/begin COMPU_VTAB RbvmiBrakeDiscTemperatureStatusAvailability "enumeration table" TAB_VERB 3 0 "notAvailable" 1 "failure" 2 "available" /end COMPU_VTAB
/begin COMPU_VTAB ReactionPatternType "enumeration table" TAB_VERB 7 0 "undefined" 1 "laneDriving" 2 "laneChange" 3 "emergencyAvoidance" 4 "immediateBrake" 5 "returnToLane" 6 "activeWarning" /end COMPU_VTAB
/begin COMPU_VTAB Reason "enumeration table" TAB_VERB 4 0 "Undefined" 1 "UrbanParking" 2 "Truck" 3 "Guardrail" /end COMPU_VTAB
/begin COMPU_VTAB_RANGE ReceiverPortStates "" 4 0 0 "Unkown" 1 1 "NoData" 2 2 "OldData" 3 3 "NewData" DEFAULT_VALUE "" /end COMPU_VTAB_RANGE
/begin COMPU_VTAB ReferenceLineMotionGoal_v0 "enumeration table" TAB_VERB 1 0 "follow" /end COMPU_VTAB
/begin COMPU_VTAB RegulatingLane "enumeration table" TAB_VERB 3 0 "invalid" 1 "startLane" 2 "targetLane" /end COMPU_VTAB
/begin COMPU_VTAB RelationCalculationStrategy "enumeration table" TAB_VERB 3 0 "discretePolyline" 1 "egoDrivingCorridor" 255 "Invalid" /end COMPU_VTAB
/begin COMPU_VTAB RelativeLaneRelation "enumeration table" TAB_VERB 4 0 "left" 1 "ego" 2 "right" 255 "unknown" /end COMPU_VTAB
/begin COMPU_VTAB RestrictionType "enumeration table" TAB_VERB 13 0 "unspecified" 1 "genericImageBasedObject" 2 "matchedGenericImageBasedObject" 3 "redTrafficLight" 4 "yellowTrafficLight" 5 "narrowingCorridor" 6 "deltaSpeed" 7 "stopSign" 8 "greenTrafficLight" 9 "yellowBlinkingTrafficLight" 10 "turnedOffTrafficLight" 11 "speedLimitSign" 12 "curvature" /end COMPU_VTAB
/begin COMPU_VTAB RifNumChanType "enumeration table" TAB_VERB 4 1 "Rif_NumChan_1" 2 "Rif_NumChan_2" 3 "Rif_NumChan_3" 4 "Rif_NumChan_4" /end COMPU_VTAB
/begin COMPU_VTAB RightOfWay "enumeration table" TAB_VERB 4 0 "drivingInHasPriority" 1 "drivingInHasToYield" 2 "unknownRightOfWay" 3 "notAvailable" /end COMPU_VTAB
/begin COMPU_VTAB RoadConditionStates "enumeration table" TAB_VERB 4 0 "Dry" 1 "Wet" 2 "Snowy" 3 "Invalid" /end COMPU_VTAB
/begin COMPU_VTAB RoadLineColor "enumeration table" TAB_VERB 5 0 "unknown" 1 "white" 2 "yellow" 3 "red" 4 "blue" /end COMPU_VTAB
/begin COMPU_VTAB RoadLineType "enumeration table" TAB_VERB 9 0 "virtualLine" 1 "unknown" 2 "dashed" 3 "solid" 4 "dashedExcept" 5 "solidExcept" 6 "roadEdge" 7 "constructionElement" 255 "invalidType" /end COMPU_VTAB
/begin COMPU_VTAB_RANGE RoadSignType "" 218 0 0 "UNKNOWN" 1 1 "SL5" 2 2 "SL10" 3 3 "SL15" 4 4 "SL20" 5 5 "SL25" 6 6 "SL30" 7 7 "SL35" 8 8 "SL40" 9 9 "SL45" 10 10 "SL50" 11 11 "SL55" 12 12 "SL60" 13 13 "SL65" 14 14 "SL70" 15 15 "SL75" 16 16 "SL80" 17 17 "SL85" 18 18 "SL90" 19 19 "SL95" 20 20 "SL100" 21 21 "SL105" 22 22 "SL110" 23 23 "SL115" 24 24 "SL120" 25 25 "SL125" 26 26 "SL130" 27 27 "SL135" 28 28 "SL140" 29 29 "SL145" 30 30 "SL150" 31 31 "SL155" 32 32 "SL160" 33 33 "OP" 34 34 "OL" 35 35 "ESL" 36 36 "EOP" 37 37 "EOL" 38 38 "EA" 77 77 "ADDCAR" 78 78 "ADDLORRY" 79 79 "ADDTRAILER" 80 80 "ADDCARAVAN" 81 81 "ADDBUS" 82 82 "ADDTRACTOR" 83 83 "ADDMCYCLE" 84 84 "ADDLORRYBUSTRAILER_DEPRECATED" 85 85 "ADDLORRYBUS_DEPRECATED" 86 86 "ADDHAZMAT" 87 87 "ADDTANK" 88 88 "ADDTRAM" 89 89 "ADDWET" 90 90 "ADDFOG" 91 91 "ADDRAIN" 92 92 "ADDSNOW" 93 93 "ADDTIME" 94 94 "ADDSECTION" 95 95 "ADDDISTANCE" 96 96 "ADDWEIGHT" 97 97 "ADDEXITL" 98 98 "ADDEXITR" 99 99 "ADDLANES" 100 100 "ADDRADAR" 101 101 "ADDRAPPEL" 102 102 "ADDPRIOTURN" 103 103 "ADDLORRY_EXCEPT" 104 104 "ADDTRACTOR_OVER" 105 105 "NOENTRY" 106 106 "NOALL" 107 107 "NOCAR" 108 108 "NOLORRY" 109 109 "NOHAZMAT" 110 110 "NOBIKE" 111 111 "NOPED" 112 112 "NOCARBIKE" 113 113 "NOTWOWAY" 114 114 "WEIGHT" 115 115 "HEIGHT" 116 116 "WIDTH" 117 117 "LENGTH" 118 118 "PRIOCROSS" 119 119 "GIVEWAY" 120 120 "PRIOCROSSYIELDTORIGHT" 121 121 "WARNDANGER" 122 122 "WARNCURVEL" 123 123 "WARNCURVER" 124 124 "WARNDCURVEL" 125 125 "WARNDCURVER" 126 126 "WARNTRAIN" 127 127 "WARNJAM" 128 128 "WARNANIMAL_DEPRECATED" 129 129 "WARNRWORKS" 130 130 "WARNSLOPED" 131 131 "WARNSLOPEU" 132 132 "PRIOSTREET" 133 133 "EPRIOSTREET" 134 134 "STOP" 135 135 "EXIT" 136 136 "ASL" 137 137 "EASL" 138 138 "MSL" 139 139 "EMSL" 140 140 "MLC" 141 141 "WBDIAGL" 142 142 "WBDIAGR" 143 143 "WBROUND" 144 144 "NOLTURN" 145 145 "NORTURN" 146 146 "NOUTURN" 147 147 "NOPARK" 148 148 "NOSTOP" 149 149 "SMOG" 150 150 "UMWELT" 151 151 "EUMWELT" 152 152 "DOUANE" 153 153 "LOGO_LIDL" 154 154 "LOGO_ESSO" 155 155 "LOGO_SHELL" 156 156 "LOGO_VW" 157 157 "PICT_HOTEL" 158 158 "PICT_PHONE" 159 159 "PICT_FOOD" 160 160 "LAMP" 161 161 "ADDTEXT" 162 162 "REJECTION" 163 163 "ADDSIGN" 164 164 "FWAY" 165 165 "EFWAY" 166 166 "HWAY" 167 167 "EHWAY" 168 168 "NORIDER" 169 169 "ADDRAINSNOW" 170 170 "ADDHUMP" 171 171 "WARNCONST" 172 172 "WARNCONSTL" 173 173 "WARNCONSTR" 174 174 "WARNPED" 175 175 "WARNKIDS" 176 176 "WARNBIKE" 177 177 "WARNSKID" 178 178 "ZEBRA" 179 179 "ONEWAYS" 180 180 "ONEWAYU" 184 184 "ADDLORRYTRAILER_DEPRECATED" 185 185 "SLOWDOWN" 186 186 "NOCARRIAGE" 187 187 "NOLORRYTRAILER" 188 188 "NOBUS" 189 189 "NOTRACTOR" 190 190 "LORRYDIST" 191 191 "CARDIST" 192 192 "WARNROUND" 193 193 "WARNWILDANIMAL" 194 194 "WARNCATTLE" 195 195 "WARNFROG" 196 196 "WARNBUS" 197 197 "WARNWIND" 198 198 "WARNSNOW" 199 199 "WARNPCROSS" 200 200 "WARNHUMP" 201 201 "WARNROCK" 202 202 "WARNLOWTREE" 203 203 "WARNGRAVEL" 204 204 "WARNTWOWAY" 205 205 "WARNLIGHTS" 206 206 "WARNPLANE" 207 207 "ADDCAMPER" 208 208 "ADDZONE" 209 209 "ADDCRASHRISK" 210 210 "ADDACCIDENT" 211 211 "ADDJAM" 212 212 "ADDSMOKE" 213 213 "ADDOILTRAIL" 214 214 "ADDGRAVEL" 215 215 "ADDDIRT" 216 216 "ADDRWORKSEXIT" 217 217 "ADDROADDAMAGE" 218 218 "ADDRWORKSENTRY" 219 219 "ADDLOWTREE" 220 220 "ADDRWORKSACCESS" 221 221 "ADDRUTS" 222 222 "ADDSOFTSHOULDERCAR" 223 223 "ADDSOFTSHOULDERLORRY" 270 270 "CALM" 271 271 "ECALM" 272 272 "TWN" 273 273 "ETWN" 274 274 "DEADEND" 275 275 "AXLEWEIGHT" 276 276 "WARNRIDER" 277 277 "WARNDRAWBRIDGE" 278 278 "WARNPIER" 279 279 "TRINATURE" 288 288 "WBBENTLEFT" 289 289 "WBBENTLEFTRIGHT" 290 290 "WBBENTRIGHT" 291 291 "WBDIAGLR" 292 292 "WBLEFT" 293 293 "WBRIGHT" 294 294 "WBUP" 295 295 "WBUPLEFT" 296 296 "WBUPRIGHT" 297 297 "ADDNOSTOPSHOULDER" 298 298 "ADDTOWING" 299 299 "ADDSCHOOL" 300 300 "ADDNIGHT" 301 301 "ADDEND" 302 302 "ADDBEGINS" 303 303 "ADDWITHIN" 304 304 "WBHAZWATER" 305 305 "NOHAZWATER" 306 306 "ADDDISTANCEBARS" 307 307 "ADDMINIMUM" 308 308 "ADDADVICE" 309 309 "SCHOOL" 310 310 "ESCHOOL" 311 311 "HAZMAT" 312 312 "COUNT" DEFAULT_VALUE "" /end COMPU_VTAB_RANGE
/begin COMPU_VTAB_RANGE RoadSignType.OLD_1 "" 313 0 0 "UNKNOWN" 1 1 "SL5" 2 2 "SL10" 3 3 "SL15" 4 4 "SL20" 5 5 "SL25" 6 6 "SL30" 7 7 "SL35" 8 8 "SL40" 9 9 "SL45" 10 10 "SL50" 11 11 "SL55" 12 12 "SL60" 13 13 "SL65" 14 14 "SL70" 15 15 "SL75" 16 16 "SL80" 17 17 "SL85" 18 18 "SL90" 19 19 "SL95" 20 20 "SL100" 21 21 "SL105" 22 22 "SL110" 23 23 "SL115" 24 24 "SL120" 25 25 "SL125" 26 26 "SL130" 27 27 "SL135" 28 28 "SL140" 29 29 "SL145" 30 30 "SL150" 31 31 "SL155" 32 32 "SL160" 33 33 "OP" 34 34 "OL" 35 35 "ESL" 36 36 "EOP" 37 37 "EOL" 38 38 "EA" 39 39 "VSL5" 40 40 "VSL10" 41 41 "VSL15" 42 42 "VSL20" 43 43 "VSL25" 44 44 "VSL30" 45 45 "VSL35" 46 46 "VSL40" 47 47 "VSL45" 48 48 "VSL50" 49 49 "VSL55" 50 50 "VSL60" 51 51 "VSL65" 52 52 "VSL70" 53 53 "VSL75" 54 54 "VSL80" 55 55 "VSL85" 56 56 "VSL90" 57 57 "VSL95" 58 58 "VSL100" 59 59 "VSL105" 60 60 "VSL110" 61 61 "VSL115" 62 62 "VSL120" 63 63 "VSL125" 64 64 "VSL130" 65 65 "VSL135" 66 66 "VSL140" 67 67 "VSL145" 68 68 "VSL150" 69 69 "VSL155" 70 70 "VSL160" 71 71 "VOP" 72 72 "VOL" 73 73 "VESL" 74 74 "VEOP" 75 75 "VEOL" 76 76 "VEA" 77 77 "ADDCAR" 78 78 "ADDLORRY" 79 79 "ADDTRAILER" 80 80 "ADDCARAVAN" 81 81 "ADDBUS" 82 82 "ADDTRACTOR" 83 83 "ADDMCYCLE" 84 84 "ADDLORRYBUSTRAILER_DEPRECATED" 85 85 "ADDLORRYBUS_DEPRECATED" 86 86 "ADDHAZMAT" 87 87 "ADDTANK" 88 88 "ADDTRAM" 89 89 "ADDWET" 90 90 "ADDFOG" 91 91 "ADDRAIN" 92 92 "ADDSNOW" 93 93 "ADDTIME" 94 94 "ADDSECTION" 95 95 "ADDDISTANCE" 96 96 "ADDWEIGHT" 97 97 "ADDEXITL" 98 98 "ADDEXITR" 99 99 "ADDLANES" 100 100 "ADDRADAR" 101 101 "ADDRAPPEL" 102 102 "ADDPRIOTURN" 103 103 "ADDLORRY_EXCEPT" 104 104 "ADDTRACTOR_OVER" 105 105 "NOENTRY" 106 106 "NOALL" 107 107 "NOCAR" 108 108 "NOLORRY" 109 109 "NOHAZMAT" 110 110 "NOBIKE" 111 111 "NOPED" 112 112 "NOCARBIKE" 113 113 "NOTWOWAY" 114 114 "WEIGHT" 115 115 "HEIGHT" 116 116 "WIDTH" 117 117 "LENGTH" 118 118 "PRIOCROSS" 119 119 "GIVEWAY" 120 120 "PRIOCROSSYIELDTORIGHT" 121 121 "WARNDANGER" 122 122 "WARNCURVEL" 123 123 "WARNCURVER" 124 124 "WARNDCURVEL" 125 125 "WARNDCURVER" 126 126 "WARNTRAIN" 127 127 "WARNJAM" 128 128 "WARNANIMAL_DEPRECATED" 129 129 "WARNRWORKS" 130 130 "WARNSLOPED" 131 131 "WARNSLOPEU" 132 132 "PRIOSTREET" 133 133 "EPRIOSTREET" 134 134 "STOP" 135 135 "EXIT" 136 136 "ASL" 137 137 "EASL" 138 138 "MSL" 139 139 "EMSL" 140 140 "MLC" 141 141 "WBDIAGL" 142 142 "WBDIAGR" 143 143 "WBROUND" 144 144 "NOLTURN" 145 145 "NORTURN" 146 146 "NOUTURN" 147 147 "NOPARK" 148 148 "NOSTOP" 149 149 "SMOG" 150 150 "UMWELT" 151 151 "EUMWELT" 152 152 "DOUANE" 153 153 "LOGO_LIDL" 154 154 "LOGO_ESSO" 155 155 "LOGO_SHELL" 156 156 "LOGO_VW" 157 157 "PICT_HOTEL" 158 158 "PICT_PHONE" 159 159 "PICT_FOOD" 160 160 "LAMP" 161 161 "ADDTEXT" 162 162 "REJECTION" 163 163 "ADDSIGN" 164 164 "FWAY" 165 165 "EFWAY" 166 166 "HWAY" 167 167 "EHWAY" 168 168 "NORIDER" 169 169 "ADDRAINSNOW" 170 170 "ADDHUMP" 171 171 "WARNCONST" 172 172 "WARNCONSTL" 173 173 "WARNCONSTR" 174 174 "WARNPED" 175 175 "WARNKIDS" 176 176 "WARNBIKE" 177 177 "WARNSKID" 178 178 "ZEBRA" 179 179 "ONEWAYS" 180 180 "ONEWAYU" 181 181 "VADDLORRYBUSTRAILER_DEPRECATED" 182 182 "VADDLORRYBUS_DEPRECATED" 183 183 "VADDLORRYTRAILER_DEPRECATED" 184 184 "ADDLORRYTRAILER_DEPRECATED" 185 185 "SLOWDOWN" 186 186 "NOCARRIAGE" 187 187 "NOLORRYTRAILER" 188 188 "NOBUS" 189 189 "NOTRACTOR" 190 190 "LORRYDIST" 191 191 "CARDIST" 192 192 "WARNROUND" 193 193 "WARNWILDANIMAL" 194 194 "WARNCATTLE" 195 195 "WARNFROG" 196 196 "WARNBUS" 197 197 "WARNWIND" 198 198 "WARNSNOW" 199 199 "WARNPCROSS" 200 200 "WARNHUMP" 201 201 "WARNROCK" 202 202 "WARNLOWTREE" 203 203 "WARNGRAVEL" 204 204 "WARNTWOWAY" 205 205 "WARNLIGHTS" 206 206 "WARNPLANE" 207 207 "ADDCAMPER" 208 208 "ADDZONE" 209 209 "ADDCRASHRISK" 210 210 "ADDACCIDENT" 211 211 "ADDJAM" 212 212 "ADDSMOKE" 213 213 "ADDOILTRAIL" 214 214 "ADDGRAVEL" 215 215 "ADDDIRT" 216 216 "ADDRWORKSEXIT" 217 217 "ADDROADDAMAGE" 218 218 "ADDRWORKSENTRY" 219 219 "ADDLOWTREE" 220 220 "ADDRWORKSACCESS" 221 221 "ADDRUTS" 222 222 "ADDSOFTSHOULDERCAR" 223 223 "ADDSOFTSHOULDERLORRY" 224 224 "VADDSIGN" 225 225 "VADDCAR" 226 226 "VADDLORRY" 227 227 "VADDTRAILER" 228 228 "VADDCARAVAN" 229 229 "VADDBUS" 230 230 "VADDWET" 231 231 "VADDFOG" 232 232 "VADDRAIN" 233 233 "VADDSNOW" 234 234 "VADDRAINSNOW" 235 235 "VADDTEXT" 236 236 "VADDSECTION" 237 237 "VADDDISTANCE" 238 238 "VADDWEIGHT" 239 239 "VNOENTRY" 240 240 "VNOALL" 241 241 "VNOCAR" 242 242 "VNOLORRY" 243 243 "VNOCARBIKE" 244 244 "VWEIGHT" 245 245 "VHEIGHT" 246 246 "VWIDTH" 247 247 "VLENGTH" 248 248 "VWARNDANGER" 249 249 "VWARNJAM" 250 250 "VWARNRWORKS" 251 251 "VWARNSKID" 252 252 "VASL" 253 253 "VEASL" 254 254 "VNOLORRYTRAILER" 255 255 "VNOBUS" 256 256 "VLORRYDIST" 257 257 "VCARDIST" 258 258 "VWARNSNOW" 259 259 "VWARNHUMP" 260 260 "VWARNGRAVEL" 261 261 "VADDZONE" 262 262 "VADDCRASHRISK" 263 263 "VADDACCIDENT" 264 264 "VADDJAM" 265 265 "VADDOILTRAIL" 266 266 "VADDGRAVEL" 267 267 "VADDDIRT" 268 268 "VADDROADDAMAGE" 269 269 "VADDRUTS" 270 270 "CALM" 271 271 "ECALM" 272 272 "TWN" 273 273 "ETWN" 274 274 "DEADEND" 275 275 "AXLEWEIGHT" 276 276 "WARNRIDER" 277 277 "WARNDRAWBRIDGE" 278 278 "WARNPIER" 279 279 "TRINATURE" 280 280 "VWARNCONST" 281 281 "VWARNCONSTL" 282 282 "VWARNCONSTR" 283 283 "VWARNCURVEL" 284 284 "VWARNCURVER" 285 285 "VWARNDCURVEL" 286 286 "VWARNDCURVER" 287 287 "VWARNLIGHTS" 288 288 "WBBENTLEFT" 289 289 "WBBENTLEFTRIGHT" 290 290 "WBBENTRIGHT" 291 291 "WBDIAGLR" 292 292 "WBLEFT" 293 293 "WBRIGHT" 294 294 "WBUP" 295 295 "WBUPLEFT" 296 296 "WBUPRIGHT" 297 297 "ADDNOSTOPSHOULDER" 298 298 "ADDTOWING" 299 299 "ADDSCHOOL" 300 300 "ADDNIGHT" 301 301 "ADDEND" 302 302 "ADDBEGINS" 303 303 "ADDWITHIN" 304 304 "WBHAZWATER" 305 305 "NOHAZWATER" 306 306 "ADDDISTANCEBARS" 307 307 "ADDMINIMUM" 308 308 "ADDADVICE" 309 309 "SCHOOL" 310 310 "ESCHOOL" 311 311 "HAZMAT" 312 312 "COUNT" DEFAULT_VALUE "" /end COMPU_VTAB_RANGE
/begin COMPU_VTAB SLWFWarningMode "enumeration table" TAB_VERB 5 0 "none" 1 "visualOnly" 2 "visualAcousticCascaded" 3 "visualHapticCascaded" 4 "hapticOnly" /end COMPU_VTAB
/begin COMPU_VTAB_RANGE SPU_Status_t "" 5 0 0 "SPU_STATUS_OK" 1 1 "SPU_STATUS_ERROR_INT_TIMEOUT" 2 2 "SPU_STATUS_ERROR_MON_STAT_REG" 3 3 "SPU_STATUS_ERROR_HW_INIT" 4 4 "SPU_STATUS_ERROR_SBST" DEFAULT_VALUE "" /end COMPU_VTAB_RANGE
/begin COMPU_VTAB_RANGE SPU_Status_t.OLD_1 "" 3 0 0 "SPU_STATUS_OK" 1 1 "SPU_STATUS_TIMEOUT" 2 2 "SPU_STATUS_INVALID_MON_REG" DEFAULT_VALUE "" /end COMPU_VTAB_RANGE
/begin COMPU_VTAB_RANGE SPU_Status_t.OLD_2 "" 4 0 0 "SPU_STATUS_OK" 1 1 "SPU_STATUS_ERROR_INT_TIMEOUT" 2 2 "SPU_STATUS_ERROR_MON_STAT_REG" 3 3 "SPU_STATUS_ERROR_HW_INIT" DEFAULT_VALUE "" /end COMPU_VTAB_RANGE
/begin COMPU_VTAB SPU_Status_t_Copy1 "enumeration table" TAB_VERB 9 0 "SPU_STATUS_OK" 1 "SPU_STATUS_ERROR_INT_TIMEOUT" 2 "SPU_STATUS_ERROR_MON_STAT_REG" 3 "SPU_STATUS_ERROR_HW_INIT" 4 "SPU_STATUS_ERROR_SBST" 5 "SPU_STATUS_ERROR_CONF_SLOT_REG_CRC" 6 "SPU_STATUS_ERROR_EMEM_INTERFACE" 7 "SPU_STATUS_ERROR_RIF_INTERFACE" 8 "SPU_STATUS_ERROR_EXEC_TIME" /end COMPU_VTAB
/begin COMPU_VTAB SPU_Status_t_Copy2 "enumeration table" TAB_VERB 12 0 "SPU_STATUS_OK" 1 "SPU_STATUS_ERROR_INT_TIMEOUT" 2 "SPU_STATUS_ERROR_MON_STAT_REG" 3 "SPU_STATUS_ERROR_HW_INIT" 4 "SPU_STATUS_ERROR_SBST" 5 "SPU_STATUS_ERROR_CONF_SLOT_REG_CRC" 6 "SPU_STATUS_ERROR_EMEM_INTERFACE" 7 "SPU_STATUS_ERROR_RIF_INTERFACE" 8 "SPU_STATUS_ERROR_EXEC_TIME" 9 "SPU_STATUS_ERROR_CTRL_FLOW_CRC" 10 "SPU_STATUS_ERROR_SM_CTRL_STAT" 11 "SPU_STATUS_ERROR_ERR_INT" /end COMPU_VTAB
/begin COMPU_VTAB SPU_Status_t_Copy3 "enumeration table" TAB_VERB 13 0 "enSpuStatusOk" 1 "enSpuStatusErrorIntTimeout" 2 "enSpuStatusErrorMonStatReg" 3 "enSpuStatusErrorHwInit" 4 "enSpuStatusErrorSbst" 5 "enSpuStatusErrorConfSlotRegCrc" 6 "enSpuStatusErrorEmemInterface" 7 "enSpuStatusErrorRifInterface" 8 "enSpuStatusErrorExecTime" 9 "enSpuStatusErrorCtrlFlowCrc" 10 "enSpuStatusErrorSmCtrlStat" 11 "enSpuStatusErrorErrInt" 12 "enSpuStatusErrorCmem" /end COMPU_VTAB
/begin COMPU_VTAB_RANGE SSCState "" 4 0 0 "SYS_INSPEC" 1 1 "SYS_OOSPEC" 2 2 "SYS_SAVE" 3 3 "SYS_STARTUP" DEFAULT_VALUE "" /end COMPU_VTAB_RANGE
/begin COMPU_VTAB SensorConfirmationLevel "enumeration table" TAB_VERB 5 0 "noConfirmation" 1 "unstableConfirmationLostInNearRange" 2 "unstableConfirmation" 3 "stableConfirmationLostInNearRange" 4 "stableConfirmation" /end COMPU_VTAB
/begin COMPU_VTAB SeqIntDef "enumeration table" TAB_VERB 8 0 "enSeqNoint" 0 "enInt0" 1 "enSeqIntSpuVar" 1 "enInt1" 2 "enSeqIntVarOnly" 2 "enInt2" 3 "enSeqIntSpuOnly" 3 "enInt3" /end COMPU_VTAB
/begin COMPU_VTAB ServiceId "enumeration table" TAB_VERB 23 0 "HV" 1 "ENV_MODEL" 2 "ENV_MODEL2" 3 "BC" 4 "BC2" 5 "BS" 6 "BS2" 7 "RPM_EXECUTION" 8 "LONG_TARGET" 9 "ACF" 10 "REF_LAT" 11 "TRP_LAT" 12 "TRC_LAT" 13 "STEERING_ANGLE" 14 "STEERING_TORQUE" 15 "MCAM_LONG" 16 "EXTERNAL" 17 "SSU" 18 "LONG_OUTPUTPROC" 19 "BA" 20 "LOCA" 21 "TOTAL_NUMBER" 65535 "NOT_DEFINED" /end COMPU_VTAB
/begin COMPU_VTAB SetSpeedInteractionType "enumeration table" TAB_VERB 4 0 "NoEvent" 1 "Increase" 2 "Decrease" 3 "SetToValue" /end COMPU_VTAB
/begin COMPU_VTAB_RANGE Side "" 3 0 0 "UNKNOWN" 1 1 "RIGHT" 2 2 "LEFT" DEFAULT_VALUE "" /end COMPU_VTAB_RANGE
/begin COMPU_VTAB Side_Copy1 "enumeration table" TAB_VERB 2 0 "left" 1 "right" /end COMPU_VTAB
/begin COMPU_VTAB Side_Copy2 "enumeration table" TAB_VERB 4 0 "Undefined" 1 "Left" 2 "Right" 3 "Both" /end COMPU_VTAB
/begin COMPU_VTAB SmStateId "enumeration table" TAB_VERB 6 0 "startup_ending" 1 "bad" 2 "badConnection" 3 "reinit" 4 "reinit_ending" 5 "normalOperation" /end COMPU_VTAB
/begin COMPU_VTAB SmoothType4dSet "enumeration table" TAB_VERB 2 0 "None" 1 "EsaNlaObj" /end COMPU_VTAB
/begin COMPU_VTAB SpeedUpFunction "enumeration table" TAB_VERB 9 0 "None" 1 "CutOut" 2 "Overtake" 3 "LaneChangeSupport" 4 "iBoost" 5 "LaneChangeLeft" 6 "LaneChangeRight" 7 "OtaLeft" 8 "OtaRight" /end COMPU_VTAB
/begin COMPU_VTAB_RANGE SscOosConfigurationType "" 2 0 0 "REVERSIBLE" 1 1 "IRREVERSIBLE" DEFAULT_VALUE "" /end COMPU_VTAB_RANGE
/begin COMPU_VTAB_RANGE SscPhase "" 4 0 0 "INSPEC_PHASE" 1 1 "OOS_PHASE" 2 2 "SAFE_PHASE" 3 3 "STARTUP_PHASE" DEFAULT_VALUE "" /end COMPU_VTAB_RANGE
/begin COMPU_VTAB_RANGE SscPhase.OLD_1 "" 4 0 0 "INSPEC_PHASE" 1 1 "OOS_PHASE" 2 2 "SAVE_PHASE" 3 3 "STARTUP_PHASE" DEFAULT_VALUE "" /end COMPU_VTAB_RANGE
/begin COMPU_VTAB StalinResult "enumeration table" TAB_VERB 4 0 "successful" 1 "dspStateNotOk" 2 "locationListEmpty" 3 "noValidLocation" /end COMPU_VTAB
/begin COMPU_VTAB StartLaneReaction "enumeration table" TAB_VERB 3 0 "None" 1 "Predictive" 2 "Confident" /end COMPU_VTAB
/begin COMPU_VTAB_RANGE StateMachineStates "" 8 0 0 "Init" 1 1 "Passive" 2 2 "ActiveControl" 3 3 "ActiveControlSwOffState" 4 4 "ActiveSuspend" 5 5 "DriverRequest" 6 6 "RevFailure" 7 7 "IrrevFailure" DEFAULT_VALUE "" /end COMPU_VTAB_RANGE
/begin COMPU_VTAB_RANGE StateMachineType "" 7 0 0 "Long" 1 1 "Pss" 2 2 "Aeb_M" 3 3 "Aeb_Ped" 4 4 "Fcw" 5 5 "Aeb_P" 6 6 "Fta" DEFAULT_VALUE "" /end COMPU_VTAB_RANGE
/begin COMPU_VTAB StateMachineType_Copy1 "enumeration table" TAB_VERB 8 0 "Longitudinal" 1 "SafetyFunctions" 2 "AebFullBrake" 3 "EmergencyBrakeAssist" 4 "AebPartialBrake" 5 "ForwardCollisionWarning" 6 "AebPedestrian" 7 "FarsideTurnAssist" /end COMPU_VTAB
/begin COMPU_VTAB_RANGE StateMachine_Type "" 7 0 0 "SM_Long" 1 1 "SM_Lat" 2 2 "SM_Lc" 3 3 "SM_Mes" 4 4 "SM_Pss" 5 5 "SM_Aeb_M" 6 6 "SM_Aeb_Ped" DEFAULT_VALUE "" /end COMPU_VTAB_RANGE
/begin COMPU_VTAB Static2DMotionGoal "enumeration table" TAB_VERB 5 0 "stayLaterallyWithinYellowStaticCorridor" 1 "stayInParallelWithYellowStaticCorridor" 2 "keepLeft" 3 "keepRight" 4 "follow" /end COMPU_VTAB
/begin COMPU_VTAB Static2DMotionGoal_v0 "enumeration table" TAB_VERB 4 0 "stayLaterallyWithinYellowStaticCorridor" 1 "stayInParallelWithYellowStaticCorridor" 2 "keepLeft" 3 "keepRight" /end COMPU_VTAB
/begin COMPU_VTAB StationaryHoldMode "enumeration table" TAB_VERB 3 0 "normal" 1 "secure" 2 "secure_lock" /end COMPU_VTAB
/begin COMPU_VTAB_RANGE Status "" 3 0 0 "INVALID" 1 1 "AVAILABLE" 2 2 "REGULATED_UPON" DEFAULT_VALUE "" /end COMPU_VTAB_RANGE
/begin COMPU_VTAB StatusIndicator "enumeration table" TAB_VERB 3 0 "noExtrapolation" 1 "extrapolation" 2 "invalid" /end COMPU_VTAB
/begin COMPU_VTAB_RANGE SteeringWheelAssistState "" 4 0 0 "EPS_OFF" 1 1 "EPS_READY" 2 2 "EPS_ACTIVE" 3 3 "EPS_RESERVED" DEFAULT_VALUE "" /end COMPU_VTAB_RANGE
/begin COMPU_VTAB_RANGE SystemServiceIds "" 3 0 0 "PER_PME_VELOCITY_SERVICE" 1 1 "PER_PME_YAW_RATE_SERVICE" 255 255 "NOT_DEFINED" DEFAULT_VALUE "" /end COMPU_VTAB_RANGE
/begin COMPU_VTAB_RANGE SystemServiceResponseType "" 6 0 0 "RESPONSE_TYPE_SUCCESSFUL" 1 1 "RESPONSE_TYPE_FAILED" 2 2 "RESPONSE_TYPE_NOT_POSSIBLE" 3 3 "RESPONSE_TYPE_PENDING" 4 4 "RESPONSE_TYPE_TIMEOUT" 5 5 "RESPONSE_TYPE_INVALID" DEFAULT_VALUE "" /end COMPU_VTAB_RANGE
/begin COMPU_VTAB_RANGE SystemServiceState "" 4 0 0 "INVALID_STATE" 1 1 "NOT_INITIALIZED_STATE" 2 2 "SHUTDOWN_STATE" 3 3 "SAFE_STATE" DEFAULT_VALUE "" /end COMPU_VTAB_RANGE
/begin COMPU_VTAB Table_1 "enumeration table" TAB_VERB 5 0 "RBMONREACT_REACTION_DEM_TXPIN_FSP_SWRST" 1 "RBMONREACT_REACTION_DEM_TXPIN_FSP" 2 "RBMONREACT_REACTION_DEM_TXPIN" 3 "RBMONREACT_REACTION_HW_DIRECTLY" 4 "RBMONREACT_REACTION_NO_REACTION" /end COMPU_VTAB
/begin COMPU_VTAB Table_115 "enumeration table" TAB_VERB 3 0 "RBADC_UNINIT" 1 "RBADC_RUN" 2 "RBADC_ERROR" /end COMPU_VTAB
/begin COMPU_VTAB Table_116 "enumeration table" TAB_VERB 8 0 "RBBIST_NOERROR" 1 "RBBIST_MBIST_SERR_E" 2 "RBBIST_MBIST_CERR_E" 4 "RBBIST_MBIST_UCERR_E" 8 "RBBIST_MBIST_MERR_E" 16 "RBBIST_MONBIST_SMUERR_E" 32 "RBBIST_MONBIST_PMSERR_E" 48 "RBBIST_MONBIST_SMUERR_AND_PMSERR_E" /end COMPU_VTAB
/begin COMPU_VTAB Table_117 "enumeration table" TAB_VERB 3 0 "RBBIST_NOTTESTED_E" 1 "RBBIST_PASSED_E" 2 "RBBIST_FAILED_E" /end COMPU_VTAB
/begin COMPU_VTAB Table_118 "enumeration table" TAB_VERB 3 0 "RBBIST_LBIST_PASSED_FAKE_E" 1 "RBBIST_LBIST_PASSED_UCB_E" 2 "RBBIST_LBIST_PASSED_HARDCODED_E" /end COMPU_VTAB
/begin COMPU_VTAB Table_119 "enumeration table" TAB_VERB 97 0 "RBBIST_MEMORY_CPU0DMEM_E" 1 "RBBIST_MEMORY_CPU0DTAG_E" 2 "RBBIST_MEMORY_CPU0PMEM_E" 3 "RBBIST_MEMORY_CPU0PTAG_E" 4 "RBBIST_MEMORY_CPU0DLMUSTBY_E" 5 "RBBIST_MEMORY_CPU1DMEM_E" 6 "RBBIST_MEMORY_CPU1DTAG_E" 7 "RBBIST_MEMORY_CPU1PMEM_E" 8 "RBBIST_MEMORY_CPU1PTAG_E" 9 "RBBIST_MEMORY_CPU1DLMUSTBY_E" 10 "RBBIST_MEMORY_CPU2DMEM_E" 11 "RBBIST_MEMORY_CPU2DTAG_E" 12 "RBBIST_MEMORY_CPU2PMEM_E" 13 "RBBIST_MEMORY_CPU2PTAG_E" 14 "RBBIST_MEMORY_CPU2DLMU_E" 15 "RBBIST_MEMORY_CPU3DMEM_E" 16 "RBBIST_MEMORY_CPU3DTAG_E" 17 "RBBIST_MEMORY_CPU3PMEM_E" 18 "RBBIST_MEMORY_CPU3PTAG_E" 19 "RBBIST_MEMORY_CPU3DLMU_E" 20 "RBBIST_MEMORY_CPU4DMEM_E" 21 "RBBIST_MEMORY_CPU4DTAG_E" 22 "RBBIST_MEMORY_CPU4PMEM_E" 23 "RBBIST_MEMORY_CPU4PTAG_E" 24 "RBBIST_MEMORY_CPU4DLMU_E" 25 "RBBIST_MEMORY_CPU5DMEM_E" 26 "RBBIST_MEMORY_CPU5DTAG_E" 27 "RBBIST_MEMORY_CPU5PMEM_E" 28 "RBBIST_MEMORY_CPU5PTAG_E" 29 "RBBIST_MEMORY_CPU5DLMU_E" 30 "RBBIST_MEMORY_LMU00_E" 31 "RBBIST_MEMORY_LMU10_E" 32 "RBBIST_MEMORY_LMU20_E" 33 "RBBIST_MEMORY_RESERVED0_E" 34 "RBBIST_MEMORY_CPU0DMEM1_E" 35 "RBBIST_MEMORY_CPU1DMEM1_E" 36 "RBBIST_MEMORY_RESERVED1_E" 37 "RBBIST_MEMORY_RESERVED2_E" 38 "RBBIST_MEMORY_DAM0_E" 39 "RBBIST_MEMORY_DAM1_E" 40 "RBBIST_MEMORY_FSIRAM_E" 41 "RBBIST_MEMORY_SADMA_E" 42 "RBBIST_MEMORY_RESERVED4_E" 43 "RBBIST_MEMORY_MCDS_E" 44 "RBBIST_MEMORY_EMEM0_E" 45 "RBBIST_MEMORY_EMEM1_E" 46 "RBBIST_MEMORY_EMEM2_E" 47 "RBBIST_MEMORY_EMEM3_E" 48 "RBBIST_MEMORY_EMEMXTM_E" 49 "RBBIST_MEMORY_SPUBUFFER0_E" 50 "RBBIST_MEMORY_SPUBUFFER1_E" 51 "RBBIST_MEMORY_SPUCONFIG0_E" 52 "RBBIST_MEMORY_SPUCONFIG1_E" 53 "RBBIST_MEMORY_GTMFIFO_E" 54 "RBBIST_MEMORY_GTMMCS0SLOW_E" 55 "RBBIST_MEMORY_GTMMCS0FAST_E" 56 "RBBIST_MEMORY_GTMMCS1SLOW_E" 57 "RBBIST_MEMORY_GTMMCS1FAST_E" 58 "RBBIST_MEMORY_GTMDPLL1A_E" 59 "RBBIST_MEMORY_GTMDPLL1BC_E" 60 "RBBIST_MEMORY_GTMDPLL2_E" 61 "RBBIST_MEMORY_RESERVED5_E" 62 "RBBIST_MEMORY_MCAN10_E" 63 "RBBIST_MEMORY_MCAN20_E" 64 "RBBIST_MEMORY_MCAN21_E" 65 "RBBIST_MEMORY_PSI5_E" 66 "RBBIST_MEMORY_ERAYOBF0_E" 67 "RBBIST_MEMORY_ERAYOBF1_E" 68 "RBBIST_MEMORY_ERAYTBFIBF0_E" 69 "RBBIST_MEMORY_ERAYTBFIBF1_E" 70 "RBBIST_MEMORY_ERAYMBF0_E" 71 "RBBIST_MEMORY_ERAYMBF1_E" 72 "RBBIST_MEMORY_RESERVED6_E" 73 "RBBIST_MEMORY_RESERVED7_E" 74 "RBBIST_MEMORY_RESERVED8_E" 75 "RBBIST_MEMORY_RESERVED9_E" 76 "RBBIST_MEMORY_RESERVED10_E" 77 "RBBIST_MEMORY_SCRXRAM_E" 78 "RBBIST_MEMORY_SCRRAMINT_E" 79 "RBBIST_MEMORY_RESERVED11_E" 80 "RBBIST_MEMORY_RESERVED12_E" 81 "RBBIST_MEMORY_RESERVED13_E" 82 "RBBIST_MEMORY_GIGETHRXRAM_E" 83 "RBBIST_MEMORY_GIGETHTXRAM_E" 84 "RBBIST_MEMORY_SDMMCRAM_E" 85 "RBBIST_MEMORY_HSPDMRAM_E" 86 "RBBIST_MEMORY_RESERVED14_E" 87 "RBBIST_MEMORY_RESERVED15_E" 88 "RBBIST_MEMORY_SPUFFT00_E" 89 "RBBIST_MEMORY_SPUFFT01_E" 90 "RBBIST_MEMORY_SPUFFT10_E" 91 "RBBIST_MEMORY_SPUFFT11_E" 92 "RBBIST_MEMORY_SPUFFT20_E" 93 "RBBIST_MEMORY_SPUFFT21_E" 94 "RBBIST_MEMORY_SPUFFT30_E" 95 "RBBIST_MEMORY_SPUFFT31_E" 96 "RBBIST_MEMORY_MAXSSH_E" /end COMPU_VTAB
/begin COMPU_VTAB Table_160 "enumeration table" TAB_VERB 2 0 "RBMPUSRIBUSCONFIG_PASS_E" 1 "RBMPUSRIBUSCONFIG_FAIL_E" /end COMPU_VTAB
/begin COMPU_VTAB Table_161 "enumeration table" TAB_VERB 3 1 "RBSBST_IDLE_E" 2 "RBSBST_READY_E" 3 "RBSBST_TEST_DONE_E" /end COMPU_VTAB
/begin COMPU_VTAB Table_162 "enumeration table" TAB_VERB 4 0 "RBSBST_PSPR_PATTERN_A_FAILED_E" 1 "RBSBST_PSPR_PATTERN_5_FAILED_E" 2 "RBSBST_DLMU_PATTERN_A_FAILED_E" 3 "RBSBST_DLMU_PATTERN_5_FAILED_E" /end COMPU_VTAB
/begin COMPU_VTAB Table_163 "enumeration table" TAB_VERB 3 0 "RBSFTMON_CORECLK_CLKMON_NOT_ENABLED_E" 1 "RBSFTMON_CORECLK_ALARMNOTSET_E" 2 "RBSFTMON_CORECLK_ALARMNOTCLEARED_E" /end COMPU_VTAB
/begin COMPU_VTAB Table_164 "enumeration table" TAB_VERB 5 0 "RBTIME_STM_MON_INIT" 1 "RBTIME_STM_MON_REINIT" 2 "RBTIME_STM_MON_RUN" 3 "RBTIME_STM_MON_REPORT_FAILED" 4 "RBTIME_STM_MON_FAILED" /end COMPU_VTAB
/begin COMPU_VTAB Table_229 "enumeration table" TAB_VERB 2 0 "ADC_UNINIT" 1 "ADC_INIT" /end COMPU_VTAB
/begin COMPU_VTAB Table_232 "enumeration table" TAB_VERB 7 0 "NvM_Prv_JobResult_Succeeded_e" 1 "NvM_Prv_JobResult_Pending_e" 2 "NvM_Prv_JobResult_Failed_e" 3 "NvM_Prv_JobResult_BlockInconsistent_e" 4 "NvM_Prv_JobResult_BlockInvalidated_e" 5 "NvM_Prv_JobResult_Skipped_e" 6 "NvM_Prv_JobResult_Succeeded_MemIfSkipped_e" /end COMPU_VTAB
/begin COMPU_VTAB Table_234 "enumeration table" TAB_VERB 18 0 "NvM_Prv_idJob_Idle_e" 1 "NvM_Prv_idJob_Read_e" 2 "NvM_Prv_idJob_Write_e" 3 "NvM_Prv_idJob_Erase_e" 4 "NvM_Prv_idJob_Restore_e" 5 "NvM_Prv_idJob_Maintain_e" 6 "NvM_Prv_idJob_Validate_e" 7 "NvM_Prv_idJob_Invalidate_e" 8 "NvM_Prv_idJob_ReadIdConfigForReadAll_e" 9 "NvM_Prv_idJob_InvalidateForFirstInitAll_e" 10 "NvM_Prv_idJob_RestoreForImplicitRecovery_e" 11 "NvM_Prv_idJob_InvalidateForRemoveNonResistant_e" 12 "NvM_Prv_idJob_RecalcRamBlkCrc_e" 13 "NvM_Prv_idJob_WriteAll_e" 14 "NvM_Prv_idJob_ReadAllExtPreparation_e" 15 "NvM_Prv_idJob_Suspend_e" 16 "NvM_Prv_idJob_Invalid_e" 17 "NvM_Prv_idJob_Count_e" /end COMPU_VTAB
/begin COMPU_VTAB Table_235 "enumeration table" TAB_VERB 42 0 "NvM_Prv_stJob_Idle_e" 1 "NvM_Prv_stJob_DoCrypto_e" 2 "NvM_Prv_stJob_DoMemIf_e" 3 "NvM_Prv_stJob_PollMemIf_e" 4 "NvM_Prv_stJob_DoCrc_e" 5 "NvM_Prv_stJob_Finished_e" 6 "NvM_Prv_stJobWrite_GetUserData_e" 7 "NvM_Prv_stJobWrite_RecalcUserDataCrc_e" 8 "NvM_Prv_stJobWrite_CalcNvBlkCrc_e" 9 "NvM_Prv_stJobWrite_AppendAdminData_e" 10 "NvM_Prv_stJobWrite_InitiateMemIf_e" 11 "NvM_Prv_stJobWrite_CryptoStartGenerationRandom_e" 12 "NvM_Prv_stJobWrite_CryptoPollGenerationRandom_e" 13 "NvM_Prv_stJobWrite_CryptoStartEncryption_e" 14 "NvM_Prv_stJobWrite_CryptoPollEncryption_e" 15 "NvM_Prv_stJobWrite_CryptoStartGenerationSignature_e" 16 "NvM_Prv_stJobWrite_CryptoPollGenerationSignature_e" 17 "NvM_Prv_stJobRead_Start_e" 18 "NvM_Prv_stJobRead_GetUserData_e" 19 "NvM_Prv_stJobRead_CrcCheck_e" 20 "NvM_Prv_stJobRead_InitiateMemIf_e" 21 "NvM_Prv_stJobRead_RecalcUserDataCrc_e" 22 "NvM_Prv_stJobRead_CalcNvBlkCrc_e" 23 "NvM_Prv_stJobRead_ExtractAdminData_e" 24 "NvM_Prv_stJobRead_SetUserData_e" 25 "NvM_Prv_stJobRead_StartImplicitRecovery_e" 26 "NvM_Prv_stJobRead_CryptoStartSignatureVerification_e" 27 "NvM_Prv_stJobRead_CryptoPollSignatureVerification_e" 28 "NvM_Prv_stJobRead_CryptoStartDecryption_e" 29 "NvM_Prv_stJobRead_CryptoPollDecryption_e" 30 "NvM_Prv_stJobRestore_Start_e" 31 "NvM_Prv_stJobRestore_CopyFromRom_e" 32 "NvM_Prv_stJobRestore_ExplicitSync_e" 33 "NvM_Prv_stJobRestore_InitCallback_e" 34 "NvM_Prv_stJobRestore_Crc_e" 35 "NvM_Prv_stJobRestore_StartWrite_e" 36 "NvM_Prv_stJobInvalidate_InitiateMemIf_e" 37 "NvM_Prv_stJobMaintain_InitiateMemIf_e" 38 "NvM_Prv_stJobValidate_Start_e" 39 "NvM_Prv_stRecalcRamBlkCrc_ExplicitSyncWriteToNvM_e" 40 "NvM_Prv_stRecalcRamBlkCrc_Do_e" 41 "NvM_Prv_stJob_Count_e" /end COMPU_VTAB
/begin COMPU_VTAB Table_253 "enumeration table" TAB_VERB 4 0 "NVM_PRV_ACTIVITY_NOT_INIT" 1 "NVM_PRV_ACTIVITY_IDLE" 2 "NVM_PRV_ACTIVITY_BUSY" 3 "NVM_PRV_ACTIVITY_RAM_BLOCK_CRC" /end COMPU_VTAB
/begin COMPU_VTAB Table_348 "enumeration table" TAB_VERB 2 0 "READ_START" 1 "READ_STATUS_CHECK" /end COMPU_VTAB
/begin COMPU_VTAB Table_349 "enumeration table" TAB_VERB 4 0 "READTRAPINFO_STATE_SIZE_CHECK_e" 1 "READTRAPINFO_STATE_TRAP_READ_e" 2 "READTRAPINFO_STATE_TRAP_CHECK_e" 3 "READTRAPINFO_STATE_FAILURE_e" /end COMPU_VTAB
/begin COMPU_VTAB Table_350 "enumeration table" TAB_VERB 2 0 "VIN_WRITE_START" 1 "VIN_WRITE_STATUS_CHECK" /end COMPU_VTAB
/begin COMPU_VTAB Table_351 "enumeration table" TAB_VERB 2 0 "F1A1_WRITE_START" 1 "F1A1_WRITE_STATUS_CHECK" /end COMPU_VTAB
/begin COMPU_VTAB Table_352 "enumeration table" TAB_VERB 2 0 "XCP_DISABLE_WRITE_START" 1 "XCP_DISABLE_WRITE_STATUS_CHECK" /end COMPU_VTAB
/begin COMPU_VTAB Table_353 "enumeration table" TAB_VERB 2 0 "NVM_WRITE_START" 1 "NVM_WRITE_STATUS_CHECK" /end COMPU_VTAB
/begin COMPU_VTAB Table_354 "enumeration table" TAB_VERB 10 0 "rbDia_LifeCycleManagementPreconitionSessionInit_e" 1 "rbDia_LifeCycleManagementPreconitionSessionCheckLifeCycle_e" 2 "rbDia_LifeCycleManagementPreconitionSessionCheckLifeCyclePending_e" 3 "rbDia_LifeCycleManagementPreconitionSessionCheckReadLcPowerOnCtr_e" 4 "rbDia_LifeCycleManagementPreconitionSessionCheckReadLcPowerOnCtrPending_e" 5 "rbDia_LifeCycleManagementPreconitionSessionClosedPending_e" 6 "rbDia_LifeCycleManagementPreconitionSessionClosed_e" 7 "rbDia_LifeCycleManagementPreconitionSessionError_e" 8 "rbDia_LifeCycleManagementPreconitionSessionSuccessful_e" 9 "rbDia_LifeCycleManagementPreconitionSessionFailed_e" /end COMPU_VTAB
/begin COMPU_VTAB Table_355 "enumeration table" TAB_VERB 16 0 "rbDia_CryptoAlgoSessionInit_e" 1 "rbDia_CryptoAlgoSessionFcPending_e" 2 "rbDia_CryptoAlgoSessionOpen_e" 3 "rbDia_CryptoAlgoSessionBusy_e" 4 "rbDia_CryptoAlgoSessionClosed_e" 5 "rbDia_CryptoAlgoSessionClosedPending_e" 6 "rbDia_CryptoAlgoSessionError_e" 7 "rbDia_CryptoAlgoSessionCheckLifeCycle_e" 8 "rbDia_CryptoAlgoSessionCheckLifeCyclePending_e" 9 "rbDia_CryptoAlgoSessionCheckReadLCPowerOnCtr_e" 10 "rbDia_CryptoAlgoSessionCheckReadLCPowerOnCtrPending_e" 11 "rbDia_CryptoAlgoSessionGetChallenge_e" 12 "rbDia_CryptoAlgoSessionVerifyResponse_e" 13 "rbDia_CryptoAlgoSessionVerifyResponsePending_e" 14 "rbDia_CryptoAlgoSessionTransferResponse_e" 15 "rbDia_CryptoAlgoSessionIdle_e" /end COMPU_VTAB
/begin COMPU_VTAB Table_357 "enumeration table" TAB_VERB 5 0 "RBECUEOL_STORE_CONFIG_IN_NVM" 1 "RBECUEOL_STORE_CONFIG_ERROR_IN_NVM" 2 "RBECUEOL_NO_VALID_CONFIG_FOUND" 3 "RBECUEOL_VALID_CONFIG_IN_NVM_FOUND" 4 "RBECUEOL_NR_OF_READ_CONFIG_RESULTS" /end COMPU_VTAB
/begin COMPU_VTAB Table_358 "enumeration table" TAB_VERB 3 0 "RBMPUSRIBUSCONFIG_CORE0_EN" 1 "RBMPUSRIBUSCONFIG_CORE1_EN" 2 "RBMPUSRIBUSCONFIG_CORE2_EN" /end COMPU_VTAB
/begin COMPU_VTAB Table_361 "enumeration table" TAB_VERB 4 0 "RBMPUSRIBUSCONFIG_EMEM0_EN" 1 "RBMPUSRIBUSCONFIG_EMEM1_EN" 2 "RBMPUSRIBUSCONFIG_EMEM2_EN" 3 "RBMPUSRIBUSCONFIG_EMEM3_EN" /end COMPU_VTAB
/begin COMPU_VTAB Table_363 "enumeration table" TAB_VERB 4 0 "rbSpi_HwUnitCfgMMICQspi3" 1 "rbSpi_HwUnitCfgCS520Qspi" 2 "rbSpi_HwUnitCfgCLKPLAUSQspi" 3 "rbSpi_HwUnitCfgMax" /end COMPU_VTAB
/begin COMPU_VTAB Table_369 "enumeration table" TAB_VERB 3 0 "RBMEMSTACK_SETECU_IDLE" 1 "RBMEMSTACK_SETECU_PENDING" 2 "RBMEMSTACK_SETECU_DONE" /end COMPU_VTAB
/begin COMPU_VTAB Table_370 "enumeration table" TAB_VERB 2 0 "RBHWCFGCHECK_NONLOCKSTEP_PASSED_E" 1 "RBHWCFGCHECK_NONLOCKSTEP_FAILED_E" /end COMPU_VTAB
/begin COMPU_VTAB Table_371 "enumeration table" TAB_VERB 6 0 "rbLifeCycle_Hsm_State_Invalid_e" 1 "rbLifeCycle_Hsm_State_InField1_e" 2 "rbLifeCycle_Hsm_State_InField2_e" 3 "rbLifeCycle_Hsm_State_PrivModeDev_e" 4 "rbLifeCycle_Hsm_State_Production_e" 15 "rbLifeCycle_Hsm_State_Not_Started_e" /end COMPU_VTAB
/begin COMPU_VTAB Table_372 "enumeration table" TAB_VERB 4 0 "RBSFTMON_CLOCKPLAUSIBILITY_FIRST_TX_E" 1 "RBSFTMON_CLOCKPLAUSIBILITY_MEASURE_SEND_E" 2 "RBSFTMON_CLOCKPLAUSIBILITY_WAITFORINT_E" 3 "RBSFTMON_CLOCKPLAUSIBILITY_IDLE_E" /end COMPU_VTAB
/begin COMPU_VTAB Table_373 "enumeration table" TAB_VERB 5 0 "RBSFTMON_CLOCKPLAUSIBILITY_NOERROR_E" 1 "RBSFTMON_CLOCKPLAUSIBILITY_MISSINGINTERROR_E" 2 "RBSFTMON_CLOCKPLAUSIBILITY_OUTOFRANGE_UPPERBOUND_E" 3 "RBSFTMON_CLOCKPLAUSIBILITY_OUTOFRANGE_LOWERBOUND_E" 4 "RBSFTMON_CLOCKPLAUSIBILITY_TRANSMITERROR_E" /end COMPU_VTAB
/begin COMPU_VTAB Table_374 "enumeration table" TAB_VERB 3 0 "RBTRUSTEDBOOT_JOB_DONE_E" 1 "RBTRUSTEDBOOT_JOB_RUNNING_E" 2 "RBTRUSTEDBOOT_JOB_TRIGGERREQUEST_E" /end COMPU_VTAB
/begin COMPU_VTAB Table_390 "enumeration table" TAB_VERB 5 -3 "ecy_hsm_TB_STATE_NO_UPDATE" -2 "ecy_hsm_TB_STATE_PENDING" -1 "ecy_hsm_TB_STATE_NOT_TESTED" 0 "ecy_hsm_TB_STATE_INVALID_E" 1 "ecy_hsm_TB_STATE_VALID_E" /end COMPU_VTAB
/begin COMPU_VTAB Table_394 "enumeration table" TAB_VERB 6 0 "RBTRUSTEDBOOT_SELECTBLOCKSTRUCTURE_E" 1 "RBTRUSTEDBOOT_OPENSESSION_E" 2 "RBTRUSTEDBOOT_CLOSESESSION_E" 3 "RBTRUSTEDBOOT_PULLJOBHANDLER_E" 4 "RBTRUSTEDBOOT_TRIGGERJOB_E" 5 "RBTRUSTEDBOOT_ERRORSTATE_E" /end COMPU_VTAB
/begin COMPU_VTAB Table_397 "enumeration table" TAB_VERB 5 0 "DSD_IDLE" 1 "DSD_VERIFY_DIAGNOSTIC_DATA" 2 "DSD_CALL_SERVICE" 3 "DSD_WAITFORTXCONF" 4 "DSD_SENDTXCONF_APPL" /end COMPU_VTAB
/begin COMPU_VTAB Table_467 "enumeration table" TAB_VERB 5 0 "DCM_SUPPORT_OK" 1 "DCM_SUPPORT_SESSION_VIOLATED" 2 "DCM_SUPPORT_SECURITY_VIOLATED" 3 "DCM_SUPPORT_CONDITION_VIOLATED" 4 "DCM_SUPPORT_CONDITION_PENDING" /end COMPU_VTAB
/begin COMPU_VTAB Table_468 "enumeration table" TAB_VERB 2 0 "Fee_Rb_DeviceName" 1 "Fee_Rb_Device_Max" /end COMPU_VTAB
/begin COMPU_VTAB Table_540 "enumeration table" TAB_VERB 8 0 "FEE_PRV_JOBTYPE_NONE_E" 1 "FEE_PRV_JOBTYPE_READ_E" 2 "FEE_PRV_JOBTYPE_WRITE_E" 3 "FEE_PRV_JOBTYPE_INVALIDATE_E" 4 "FEE_PRV_JOBTYPE_BLOCKMAINTENANCE_E" 5 "FEE_PRV_JOBTYPE_TRIGGERREORG_E" 6 "FEE_PRV_JOBTYPE_ENTER_STOP_MODE_E" 7 "FEE_PRV_JOBTYPE_MAX_E" /end COMPU_VTAB
/begin COMPU_VTAB Table_541 "enumeration table" TAB_VERB 4 0 "RBA_FEEFS2_PRV_BACKGROUND_IDLE_E" 1 "RBA_FEEFS2_PRV_BACKGROUND_ERASE_E" 2 "RBA_FEEFS2_PRV_BACKGROUND_SOFTREORG_E" 3 "RBA_FEEFS2_PRV_BACKGROUND_WRITEPERSISTENTDATA_E" /end COMPU_VTAB
/begin COMPU_VTAB Table_557 "enumeration table" TAB_VERB 4 0 "RBA_FEEFS2_PRV_FAT_FATWRITE_IDLE_E" 1 "RBA_FEEFS2_PRV_FAT_FATWRITE_INIT_E" 2 "RBA_FEEFS2_PRV_FAT_FATWRITE_WRITE_E" 3 "RBA_FEEFS2_PRV_FAT_FATWRITE_FINAL_E" /end COMPU_VTAB
/begin COMPU_VTAB Table_559 "enumeration table" TAB_VERB 5 0 "RBA_FEEFS2_PRV_FAT_FINALIZE_IDLE_E" 1 "RBA_FEEFS2_PRV_FAT_FINALIZE_INIT_E" 2 "RBA_FEEFS2_PRV_FAT_FINALIZE_BLANKCHECK_E" 3 "RBA_FEEFS2_PRV_FAT_FINALIZE_SHREDDER_E" 4 "RBA_FEEFS2_PRV_FAT_FINALIZE_FINAL_E" /end COMPU_VTAB
/begin COMPU_VTAB Table_571 "enumeration table" TAB_VERB 7 0 "RBA_FEEFS2_PRV_SECTOR_ERASE_IDLE_E" 1 "RBA_FEEFS2_PRV_SECTOR_ERASE_INIT_E" 2 "RBA_FEEFS2_PRV_SECTOR_ERASE_PROGRAMERASESTARTMKRSLOT_E" 3 "RBA_FEEFS2_PRV_SECTOR_ERASE_OVERPROGRAMMARKER_E" 4 "RBA_FEEFS2_PRV_SECTOR_ERASE_ERASING_E" 5 "RBA_FEEFS2_PRV_SECTOR_ERASE_SETSTATE_E" 6 "RBA_FEEFS2_PRV_SECTOR_ERASE_FINAL_E" /end COMPU_VTAB
/begin COMPU_VTAB Table_574 "enumeration table" TAB_VERB 4 0 "CANIF_CS_UNINIT" 1 "CANIF_CS_SLEEP" 2 "CANIF_CS_STARTED" 3 "CANIF_CS_STOPPED" /end COMPU_VTAB
/begin COMPU_VTAB Table_644 "enumeration table" TAB_VERB 2 0 "USE_ASYNCH_CLIENT_SERVER" 1 "USE_ASYNCH_FNC" /end COMPU_VTAB
/begin COMPU_VTAB Table_662 "enumeration table" TAB_VERB 6 0 "FEE_PRV_MEDIUM_WRITE_IDLE_E" 1 "FEE_PRV_MEDIUM_WRITE_BLANKCHECK_E" 2 "FEE_PRV_MEDIUM_WRITE_COPYDATA_E" 3 "FEE_PRV_MEDIUM_WRITE_PROGRAM_E" 4 "FEE_PRV_MEDIUM_WRITE_COMPARE_E" 5 "FEE_PRV_MEDIUM_WRITE_FINAL_E" /end COMPU_VTAB
/begin COMPU_VTAB Table_664 "enumeration table" TAB_VERB 4 0 "FEE_PRV_MEDIUM_COPY_IDLE_E" 1 "FEE_PRV_MEDIUM_COPY_READ_E" 2 "FEE_PRV_MEDIUM_COPY_WRITE_E" 3 "FEE_PRV_MEDIUM_COPY_FINAL_E" /end COMPU_VTAB
/begin COMPU_VTAB Table_665 "enumeration table" TAB_VERB 5 0 "FEE_PRV_MEDIUM_SEQ_WRITE_BLNKCHK_COPY_COMP_E" 1 "FEE_PRV_MEDIUM_SEQ_WRITE_BLNKCHK_COMP_E" 2 "FEE_PRV_MEDIUM_SEQ_WRITE_COPY_COMP_E" 3 "FEE_PRV_MEDIUM_SEQ_WRITE_COMP_E" 4 "FEE_PRV_MEDIUM_SEQ_WRITE_ONLY_E" /end COMPU_VTAB
/begin COMPU_VTAB Table_667 "enumeration table" TAB_VERB 4 0 "FEE_PRV_MEDIUM_COMPAREFLS2FLS_IDLE_E" 1 "FEE_PRV_MEDIUM_COMPAREFLS2FLS_READ_E" 2 "FEE_PRV_MEDIUM_COMPAREFLS2FLS_COMPARE_E" 3 "FEE_PRV_MEDIUM_COMPAREFLS2FLS_FINAL_E" /end COMPU_VTAB
/begin COMPU_VTAB Table_669 "enumeration table" TAB_VERB 5 0 "FEE_PRV_PROC_DRIVERSTATE_UNINIT_E" 1 "FEE_PRV_PROC_DRIVERSTATE_INIT_E" 2 "FEE_PRV_PROC_DRIVERSTATE_BACKGROUND_E" 3 "FEE_PRV_PROC_DRIVERSTATE_IDLE_E" 4 "FEE_PRV_PROC_DRIVERSTATE_EXT_JOB_E" /end COMPU_VTAB
/begin COMPU_VTAB Table_671 "enumeration table" TAB_VERB 3 0 "FEE_PRV_PROC_BACKGROUNDSTATE_DISABLED" 1 "FEE_PRV_PROC_BACKGROUNDSTATE_ENABLED_ACTIVE" 2 "FEE_PRV_PROC_BACKGROUNDSTATE_ENABLED_SLEEPING" /end COMPU_VTAB
/begin COMPU_VTAB Table_674 "enumeration table" TAB_VERB 4 0 "FEE_FS10" 1 "FEE_FS1X" 2 "FEE_FS2" 3 "FEE_FS3" /end COMPU_VTAB
/begin COMPU_VTAB Table_678 "enumeration table" TAB_VERB 5 0 "FLS_RB_UNINIT" 1 "FLS_RB_DEEP" 2 "FLS_RB_IDLE" 3 "FLS_RB_BUSY" 4 "FLS_RB_BUSY_INTERNAL" /end COMPU_VTAB
/begin COMPU_VTAB Table_681 "enumeration table" TAB_VERB 8 0 "FLS_RB_ST_SUSPEND_NONE_E" 1 "FLS_RB_ST_SUSPEND_REQUESTED_E" 2 "FLS_RB_ST_SUSPEND_DONE_E" 3 "FLS_RB_ST_SUSPEND_NOT_NECESSARY_E" 4 "FLS_RB_ST_RESUME_REQUESTED_E" 5 "FLS_RB_ST_RESUME_DONE_E" 16 "FLS_RB_ST_SUSPEND_ACC_EXEC_ORDERS_E" 17 "FLS_RB_ST_SUSPEND_DONE_EXEC_ORDERS_E" /end COMPU_VTAB
/begin COMPU_VTAB Table_687 "enumeration table" TAB_VERB 2 0 "Fls_Rb_FlsDevice" 1 "Fls_Rb_nrFlsDevice" /end COMPU_VTAB
/begin COMPU_VTAB Table_688 "enumeration table" TAB_VERB 4 0 "Fls_RB_FlsUser_Fls_Fee" 1 "Fls_Rb_nrFlsUser" 254 "Fls_Rb_idErrorAdr" 255 "Fls_Rb_idErrorLen" /end COMPU_VTAB
/begin COMPU_VTAB Table_689 "enumeration table" TAB_VERB 2 0 "NvM_STATE_IDLE" 1 "NvM_STATE_WRITE_IN_PROGRESS" /end COMPU_VTAB
/begin COMPU_VTAB Table_690 "enumeration table" TAB_VERB 4 0 "IDLE" 1 "DATA_UPDATE" 2 "TRANSMIT_DATA" 3 "TRANSMIT_IN_PROGRESS" /end COMPU_VTAB
/begin COMPU_VTAB Table_691 "enumeration table" TAB_VERB 4 0 "E2E_P01_DATAID_BOTH" 1 "E2E_P01_DATAID_ALT" 2 "E2E_P01_DATAID_LOW" 3 "E2E_P01_DATAID_NIBBLE" /end COMPU_VTAB
/begin COMPU_VTAB Table_692 "enumeration table" TAB_VERB 8 0 "E2E_P01STATUS_OK" 1 "E2E_P01STATUS_NONEWDATA" 2 "E2E_P01STATUS_WRONGCRC" 3 "E2E_P01STATUS_SYNC" 4 "E2E_P01STATUS_INITIAL" 5 "E2E_P01STATUS_REPEATED" 6 "E2E_P01STATUS_OKSOMELOST" 7 "E2E_P01STATUS_WRONGSEQUENCE" /end COMPU_VTAB
/begin COMPU_VTAB Table_695 "enumeration table" TAB_VERB 3 0 "rbNetCom_NotInit_e" 1 "rbNetCom_InitDone_e" 2 "rbNetCom_MultiInit_e" /end COMPU_VTAB
/begin COMPU_VTAB Table_696 "enumeration table" TAB_VERB 3 0 "rbNetScheduler_NotInit_e" 1 "rbNetScheduler_InitDone_e" 2 "rbNetScheduler_MultiInit_e" /end COMPU_VTAB
/begin COMPU_VTAB Table_697 "enumeration table" TAB_VERB 3 0 "rbNetXcp_NotInit_e" 1 "rbNetXcp_InitDone_e" 2 "rbNetXcp_MultiInit_e" /end COMPU_VTAB
/begin COMPU_VTAB Table_698 "enumeration table" TAB_VERB 6 0 "RBADCMON_SIMPLEUNDERTHRESHOLD_E" 1 "RBADCMON_SIMPLEOVERTHRESHOLD_E" 2 "RBADCMON_SIMPLEUNDEROVERTHRESHOLD_E" 3 "RBADCMON_HYSTERESISUNDERTHRESHOLD_E" 4 "RBADCMON_HYSTERESISOVERTHRESHOLD_E" 5 "RBADCMON_HYSTERESISUNDEROVERTHRESHOLD_E" /end COMPU_VTAB
/begin COMPU_VTAB Table_699 "enumeration table" TAB_VERB 10 0 "RBADCMON_ITEM_ADCVOLTAGEPLAUSI_E" 1 "RBADCMON_ITEM_VBATOVERVOLTAGE_E" 2 "RBADCMON_ITEM_VBATUNDERVOLTAGE_E" 3 "RBADCMON_ITEM_ADCTEMPERATUREPLAUSI_E" 4 "RBADCMON_ITEM_ECUTEMPERATURERANGE_E" 5 "RBADCMON_ITEM_ECUTEMPERATUREDEFECT_E" 6 "RBADCMON_ITEM_UCTEMPERATURERANGE_E" 7 "RBADCMON_ITEM_UCTEMPERATUREDEFECT_E" 8 "RBADCMON_ITEM_SYSTEMPERATUREPLAUSI_E" 9 "RBADCMON_ENDOFITEMS_E" /end COMPU_VTAB
/begin COMPU_VTAB Table_716 "enumeration table" TAB_VERB 5 0 "RBADCMON_STATUS_PASS_E" 1 "RBADCMON_STATUS_PREPASS_E" 2 "RBADCMON_STATUS_PREFAIL_E" 3 "RBADCMON_STATUS_FAIL_E" 4 "RBADCMON_STATUS_DEFAULT_E" /end COMPU_VTAB
/begin COMPU_VTAB Table_738 "enumeration table" TAB_VERB 10 0 "CANSM_BSM_S_NOCOM" 1 "CANSM_BSM_S_SILENTCOM" 2 "CANSM_BSM_S_FULLCOM" 3 "CANSM_BSM_S_NOT_INITIALIZED" 4 "CANSM_BSM_S_PRE_NOCOM" 5 "CANSM_BSM_WUVALIDATION" 6 "CANSM_BSM_S_PRE_FULLCOM" 7 "CANSM_BSM_S_SET_BAUDRATE" 8 "CANSM_BSM_S_SILENTCOM_BOR" 9 "CANSM_BSM_S_TX_TIMEOUT_EXCEPTION" /end COMPU_VTAB
/begin COMPU_VTAB Table_740 "enumeration table" TAB_VERB 7 0 "CANSM_BOR_IDLE" 1 "CANSM_S_BUS_OFF_CHECK" 2 "CANSM_S_NO_BUS_OFF" 3 "CANSM_S_BUS_OFF_RECOVERY_L1" 4 "CANSM_S_RESTART_CC" 5 "CANSM_S_RESTART_CC_WAIT" 6 "CANSM_S_BUS_OFF_RECOVERY_L2" /end COMPU_VTAB
/begin COMPU_VTAB Table_742 "enumeration table" TAB_VERB 4 0 "CANSM_CANTRCV_DEFAULT" 1 "CANSM_CANTRCV_NORMAL" 2 "CANSM_CANTRCV_SLEEP" 3 "CANSM_CANTRCV_STANDBY" /end COMPU_VTAB
/begin COMPU_VTAB Table_760 "enumeration table" TAB_VERB 11 0 "XCP_DAQ_STATE_NO_DAQ" 1 "XCP_DAQ_STATE_FREE_DAQ" 2 "XCP_DAQ_STATE_ALLOC_DAQ" 3 "XCP_DAQ_STATE_ALLOC_ODT" 4 "XCP_DAQ_STATE_ALLOC_ODT_ENTRY" 5 "XCP_DAQ_STATE_WRITE_DAQ" 6 "XCP_DAQ_STATE_PREPARE_START" 7 "XCP_DAQ_STATE_SHIFTING" 8 "XCP_DAQ_STATE_STOP_REQUESTED" 9 "XCP_DAQ_STATE_READY_TO_RUN" 10 "XCP_DAQ_STATE_RUNNING" /end COMPU_VTAB
/begin COMPU_VTAB Table_761 "enumeration table" TAB_VERB 24 0 "XCP_ERR_CMD_SYNCH" 16 "XCP_ERR_CMD_BUSY" 17 "XCP_ERR_DAQ_ACTIVE" 18 "XCP_ERR_PGM_ACTIVE" 32 "XCP_ERR_CMD_UNKNOWN" 33 "XCP_ERR_CMD_SYNTAX" 34 "XCP_ERR_OUT_OF_RANGE" 35 "XCP_ERR_WRITE_PROTECTED" 36 "XCP_ERR_ACCESS_DENIED" 37 "XCP_ERR_ACCESS_LOCKED" 38 "XCP_ERR_PAGE_NOT_VALID" 39 "XCP_ERR_MODE_NOT_VALID" 40 "XCP_ERR_SEGMENT_NOT_VALID" 41 "XCP_ERR_SEQUENCE" 42 "XCP_ERR_DAQ_CONFIG" 48 "XCP_ERR_MEMORY_OVERFLOW" 49 "XCP_ERR_GENERIC" 50 "XCP_ERR_VERIFY" 51 "XCP_ERR_RES_TEMP_NOT_ACCESS" 52 "XCP_ERR_SUBCMD_UNKNOWN" 252 "XCP_REPEAT_COMMAND" 253 "XCP_NO_ACCESS_HIDE" 254 "XCP_NO_RESPONSE" 255 "XCP_NO_ERROR" /end COMPU_VTAB
/begin COMPU_VTAB Table_762 "enumeration table" TAB_VERB 7 0 "XCP_BG_IDLE" 1 "XCP_BG_CHKSUM" 2 "XCP_BG_MEM_WRITE" 3 "XCP_BG_REPEAT_CMD" 4 "XCP_BG_DO_DISCONNECT" 5 "XCP_BG_CANCEL_REQ" 6 "XCP_BG_START_STOP_SYNC_DAQ" /end COMPU_VTAB
/begin COMPU_VTAB Table_763 "enumeration table" TAB_VERB 7 0 "DSP_RDTC_SFUNINIT" 1 "DSP_RDTC_SFINIT" 2 "DSP_RDTC_SFCALCNUMDTC" 3 "DSP_RDTC_GETFFSIZE" 4 "DSP_RDTC_UPDATEDISABLED" 5 "DSP_RDTC_GETDTCSTATUS" 6 "DSP_RDTC_SFFILLRESP" /end COMPU_VTAB
/begin COMPU_VTAB Table_764 "enumeration table" TAB_VERB 8 0 "DCM_RDTC_SUBFUNCTION_INITIAL" 1 "DCM_RDTC_SUBFUNCTION_STATUSOFDTC" 2 "DCM_RDTC_SUBFUNCTION_DISABLERECORDUPDATE" 3 "DCM_RDTC_SUBFUNCTION_SELECTRECORDSDATA" 4 "DCM_RDTC_SUBFUNCTION_GETRECORDSDATASIZE" 5 "DCM_RDTC_SUBFUNCTION_REPORTDTCRECORDS" 6 "DCM_RDTC_SUBFUNCTION_ENABLERECORDUPDATE" 7 "DCM_RDTC_SUBFUNCTION_REENABLERECORDUPDATE" /end COMPU_VTAB
/begin COMPU_VTAB Table_765 "enumeration table" TAB_VERB 4 0 "STANDARD_CAN" 1 "STANDARD_FD_CAN" 2 "EXTENDED_CAN" 3 "EXTENDED_FD_CAN" /end COMPU_VTAB
/begin COMPU_VTAB Table_766 "enumeration table" TAB_VERB 11 0 "CANIF_NO_UL" 1 "CAN_NM" 2 "CAN_TP" 3 "CAN_TSYN" 4 "J1939NM" 5 "J1939TP" 6 "PDUR" 7 "XCP" 8 "CDD" 9 "USER" 10 "MAX_USER_TYPE" /end COMPU_VTAB
/begin COMPU_VTAB Table_811 "enumeration table" TAB_VERB 3 0 "CANIF_PRV_FULL_E" 1 "CANIF_PRV_BASIC_RANGE_E" 2 "CANIF_PRV_BASIC_LIST_E" /end COMPU_VTAB
/begin COMPU_VTAB Table_945 "enumeration table" TAB_VERB 4 0 "CANTSYN_CRC_IGNORED" 1 "CANTSYN_CRC_NOT_VALIDATED" 2 "CANTSYN_CRC_OPTIONAL" 3 "CANTSYN_CRC_VALIDATED" /end COMPU_VTAB
/begin COMPU_VTAB Table_946 "enumeration table" TAB_VERB 3 0 "STBM_NVM_NO_STORAGE" 1 "STBM_NVM_STORAGE_AT_SHUTDOWN" 2 "STBM_NVM_NOT_CONFIGURED" /end COMPU_VTAB
/begin COMPU_VTAB Table_947 "enumeration table" TAB_VERB 3 0 "STBM_MASTER" 1 "STBM_SLAVE" 2 "STBM_GATEWAY" /end COMPU_VTAB
/begin COMPU_VTAB Table_948 "enumeration table" TAB_VERB 5 0 "OS" 1 "ETHTSYN" 2 "GPT" 3 "EXTERNAL_COUNTER" 4 "STBMLOCALTIMEHARDWARE_NOT_CONFIGURED" /end COMPU_VTAB
/begin COMPU_VTAB Table_956 "enumeration table" TAB_VERB 6 0 "E2E_P05STATUS_OK" 1 "E2E_P05STATUS_NONEWDATA" 7 "E2E_P05STATUS_ERROR" 8 "E2E_P05STATUS_REPEATED" 32 "E2E_P05STATUS_OKSOMELOST" 64 "E2E_P05STATUS_WRONGSEQUENCE" /end COMPU_VTAB
/begin COMPU_VTAB TargetLaneReaction "enumeration table" TAB_VERB 5 0 "None" 1 "LimitedToStartLane" 2 "Full" 3 "WsosPass" 4 "WsosFollow" /end COMPU_VTAB
/begin COMPU_VTAB TargetObjectLossType "enumeration table" TAB_VERB 4 0 "noLoss" 1 "lossInFollowUp" 2 "lossInStandStill" 3 "lossInCloseRange" /end COMPU_VTAB
/begin COMPU_VTAB TargetSelectionStrategy "enumeration table" TAB_VERB 6 0 "tiplLaneKeeping" 1 "imbaFollowPrecedingObject" 2 "tiplLaneChangeToTheLeft" 3 "tiplLaneChangeToTheRight" 4 "tiplLaneChangeLongLatLeft" 5 "tiplLaneChangeLongLatRight" /end COMPU_VTAB
/begin COMPU_VTAB TimbaObjectIndex "enumeration table" TAB_VERB 11 0 "targetObject" 1 "closestTipl" 2 "subClosestCentral" 3 "closestLeft" 4 "subClosestLeft" 5 "closestRight" 6 "subClosestRight" 7 "closestOncomingLeft" 8 "closestOncomingRight" 9 "closestImba" 10 "TimbaObjectIndex_MAX" /end COMPU_VTAB
/begin COMPU_VTAB TimeValidity "enumeration table" TAB_VERB 5 0 "Undefined" 1 "Valid" 2 "ReverseMoving" 3 "NegativeTime" 4 "InfinityTime" /end COMPU_VTAB
/begin COMPU_VTAB TrafficDirection "enumeration table" TAB_VERB 3 0 "undefined" 1 "left" 2 "right" /end COMPU_VTAB
/begin COMPU_VTAB TrafficJamLevel "enumeration table" TAB_VERB 5 0 "none" 1 "neutral" 2 "slowMoving" 3 "trafficJam" 4 "trafficJamHighway" /end COMPU_VTAB
/begin COMPU_VTAB TrafficLightState "enumeration table" TAB_VERB 7 0 "unknown" 1 "red" 2 "yellow" 3 "green" 4 "yellowAfterGreen" 5 "yellowBlinking" 6 "turnedOff" /end COMPU_VTAB
/begin COMPU_VTAB TrafficSignType "enumeration table" TAB_VERB 2 0 "unknown" 1 "stopSign" /end COMPU_VTAB
/begin COMPU_VTAB_RANGE Type "" 14 0 0 "UNDEFINED" 1 1 "LANE_DRIVING" 2 2 "FORWARD_COLLISION_WARNING" 3 3 "EMERGENCY_BRAKE" 4 4 "PARTIAL_BRAKE" 5 5 "IMMEDIATE_BRAKE" 6 6 "EMERGENCY_BRAKE_ASSIST" 20 20 "LANE_CHANGE_LEFT" 21 21 "LANE_CHANGE_RIGHT" 22 22 "LANE_DEPARTURE_WARNING" 23 23 "RETURN_TO_LANE" 24 24 "LANE_CHANGE_WARNING" 30 30 "REAR_CROSS_TRAFFIC_WARNING" 50 50 "TAKE_OVER_REQUEST" DEFAULT_VALUE "" /end COMPU_VTAB_RANGE
/begin COMPU_VTAB_RANGE Type.OLD_1 "" 7 0 0 "RPT_UNDEFINED" 1 1 "RPT_ALD" 2 2 "RPT_HWA_ALD" 3 3 "RPT_AEB_M" 20 20 "RPT_ALC_LEFT" 21 21 "RPT_ALC_RIGHT" 50 50 "RPT_TOR" DEFAULT_VALUE "" /end COMPU_VTAB_RANGE
/begin COMPU_VTAB_RANGE Type.OLD_2 "" 9 0 0 "UNDEFINED" 1 1 "LANE_DRIVING" 2 2 "FORWARD_COLLISION_WARNING" 3 3 "EMERGENCY_BRAKE" 20 20 "LANE_CHANGE_LEFT" 21 21 "LANE_CHANGE_RIGHT" 22 22 "LANE_DEPARTURE_WARNING" 23 23 "RETURN_TO_LANE" 50 50 "TAKE_OVER_REQUEST" DEFAULT_VALUE "" /end COMPU_VTAB_RANGE
/begin COMPU_VTAB_RANGE Type.OLD_3 "" 11 0 0 "UNDEFINED" 1 1 "LANE_DRIVING" 2 2 "FORWARD_COLLISION_WARNING" 3 3 "EMERGENCY_BRAKE" 4 4 "PARTIAL_BRAKE" 5 5 "IMMEDIATE_BRAKE" 20 20 "LANE_CHANGE_LEFT" 21 21 "LANE_CHANGE_RIGHT" 22 22 "LANE_DEPARTURE_WARNING" 23 23 "RETURN_TO_LANE" 50 50 "TAKE_OVER_REQUEST" DEFAULT_VALUE "" /end COMPU_VTAB_RANGE
/begin COMPU_VTAB_RANGE Type.OLD_4 "" 13 0 0 "UNDEFINED" 1 1 "LANE_DRIVING" 2 2 "FORWARD_COLLISION_WARNING" 3 3 "EMERGENCY_BRAKE" 4 4 "PARTIAL_BRAKE" 5 5 "IMMEDIATE_BRAKE" 20 20 "LANE_CHANGE_LEFT" 21 21 "LANE_CHANGE_RIGHT" 22 22 "LANE_DEPARTURE_WARNING" 23 23 "RETURN_TO_LANE" 24 24 "LANE_CHANGE_WARNING" 30 30 "REAR_CROSS_TRAFFIC_WARNING" 50 50 "TAKE_OVER_REQUEST" DEFAULT_VALUE "" /end COMPU_VTAB_RANGE
/begin COMPU_VTAB Type_Copy1 "enumeration table" TAB_VERB 6 1 "Ok" 1 "OK" 2 "Error" 2 "ERROR" 3 "Imprecise" 3 "IMPRECISE" /end COMPU_VTAB
/begin COMPU_VTAB Type_Copy2 "enumeration table" TAB_VERB 3 0 "invalid" 1 "partialReaction" 2 "fullReaction" /end COMPU_VTAB
/begin COMPU_VTAB Type_Copy3 "enumeration table" TAB_VERB 15 0 "Unknown" 1 "StopLine" 2 "ZebraCrossing" 3 "ArrowForward" 4 "ArrowLeft" 5 "ArrowRight" 6 "ArrowStraightLeft" 7 "ArrowStraightRight" 8 "ArrowTurningPointLeft" 9 "ArrowTurningPointRight" 10 "Arrow45DegLeft" 11 "Arrow45DegRight" 12 "VirtualStopArea" 13 "VirtualBrakingArea" 14 "VirtualStopSign" /end COMPU_VTAB
/begin COMPU_VTAB_RANGE Unit "" 3 0 0 "UNIT_UNKNOWN" 1 1 "UNIT_KMH" 2 2 "UNIT_MPH" DEFAULT_VALUE "" /end COMPU_VTAB_RANGE
/begin COMPU_VTAB_RANGE Value "" 3 0 0 "none" 1 1 "fast" 2 2 "soft" DEFAULT_VALUE "" /end COMPU_VTAB_RANGE
/begin COMPU_VTAB_RANGE Value.OLD_1 "" 2 0 0 "kmh" 1 1 "mph" DEFAULT_VALUE "" /end COMPU_VTAB_RANGE
/begin COMPU_VTAB_RANGE Value.OLD_2 "" 4 0 0 "eco" 1 1 "normal" 2 2 "comfortable" 3 3 "sport" DEFAULT_VALUE "" /end COMPU_VTAB_RANGE
/begin COMPU_VTAB_RANGE Value.OLD_3 "" 76 0 0 "TRT_INVALID" 100 100 "TRT_SPEED_LIMIT" 101 101 "TRT_SPEED_ADVICE" 102 102 "TRT_SPEED_MINIMUM" 200 200 "TRT_NO_PASSING" 300 300 "TRT_PAY_ATTENTION_DANGER" 301 301 "TRT_PAY_ATTENTION_CURVE_LEFT" 302 302 "TRT_PAY_ATTENTION_CURVE_RIGHT" 303 303 "TRT_PAY_ATTENTION_DOUBLE_CURVE_LEFT" 304 304 "TRT_PAY_ATTENTION_DOUBLE_CURVE_RIGHT" 305 305 "TRT_PAY_ATTENTION_TRAIN" 306 306 "TRT_PAY_ATTENTION_JAM" 307 307 "TRT_PAY_ATTENTION_ROAD_WORKS" 308 308 "TRT_PAY_ATTENTION_SLOPE_DOWN" 309 309 "TRT_PAY_ATTENTION_SLOPE_UP" 310 310 "TRT_PAY_ATTENTION_CONSTRICTION" 311 311 "TRT_PAY_ATTENTION_CONSTRICTION_LEFT" 312 312 "TRT_PAY_ATTENTION_CONSTRICTION_RIGHT" 313 313 "TRT_PAY_ATTENTION_PEDESTRIANS" 314 314 "TRT_PAY_ATTENTION_KIDS" 315 315 "TRT_PAY_ATTENTION_BIKES" 316 316 "TRT_PAY_ATTENTION_SKIDDING" 317 317 "TRT_PAY_ATTENTION_ROUNDABOUT" 318 318 "TRT_PAY_ATTENTION_WILD_ANIMAL" 319 319 "TRT_PAY_ATTENTION_CATTLE" 320 320 "TRT_PAY_ATTENTION_FROGS" 321 321 "TRT_PAY_ATTENTION_BUS" 322 322 "TRT_PAY_ATTENTION_WIND" 323 323 "TRT_PAY_ATTENTION_SNOW" 324 324 "TRT_PAY_ATTENTION_PEDESTRIAN_CROSSING" 325 325 "TRT_PAY_ATTENTION_HUMP" 326 326 "TRT_PAY_ATTENTION_ROCK" 327 327 "TRT_PAY_ATTENTION_LOW_TREE" 328 328 "TRT_PAY_ATTENTION_GRAVEL" 329 329 "TRT_PAY_ATTENTION_TWO_WAY" 330 330 "TRT_PAY_ATTENTION_LIGHTS" 331 331 "TRT_PAY_ATTENTION_PLANE" 332 332 "TRT_PAY_ATTENTION_RIDER" 333 333 "TRT_PAY_ATTENTION_DRAWBRIDGE" 334 334 "TRT_PAY_ATTENTION_PIER" 335 335 "TRT_PAY_ATTENTION_JUNCTION" 336 336 "TRT_PAY_ATTENTION_CRASH_RISK" 337 337 "TRT_PAY_ATTENTION_ACCIDENT" 338 338 "TRT_PAY_ATTENTION_SMOKE" 339 339 "TRT_PAY_ATTENTION_OIL_TRAIL" 340 340 "TRT_PAY_ATTENTION_DIRTY_ROAD" 341 341 "TRT_PAY_ATTENTION_ROAD_DAMAGE" 342 342 "TRT_PAY_ATTENTION_RUTS" 343 343 "TRT_PAY_ATTENTION_SOFT_SHOULDER" 344 344 "TRT_PAY_ATTENTION_CUSTOMS" 345 345 "TRT_PAY_ATTENTION_DEAD_END" 346 346 "TRT_PAY_ATTENTION_POLLUTION" 400 400 "TRT_NO_ENTRY" 401 401 "TRT_NO_ENTRY_ONE_WAY" 500 500 "TRT_RIGHT_OF_WAY" 501 501 "TRT_RIGHT_OF_WAY_NEXT_CROSSING" 502 502 "TRT_GIVE_RIGHT_OF_WAY_NEXT_CROSSING" 503 503 "TRT_YIELD_TO_RIGHT_NEXT_CROSSING" 504 504 "TRT_YIELD_TO_LEFT_NEXT_CROSSING" 505 505 "TRT_STOP_AND_YIELD" 600 600 "TRT_DIRECTION_ONLY_STRAIGHT" 601 601 "TRT_DIRECTION_ONLY_RIGHT" 602 602 "TRT_DIRECTION_ONLY_LEFT" 603 603 "TRT_DIRECTION_ONLY_STRAIGHT_OR_LEFT" 604 604 "TRT_DIRECTION_ONLY_STRAIGHT_OR_RIGHT" 605 605 "TRT_DIRECTION_ONLY_LEFT_OR_RIGHT" 606 606 "TRT_NO_UTURN" 700 700 "TRT_NO_PARKING" 701 701 "TRT_NO_STOPPING" 702 702 "TRT_NO_STOPPING_ON_SHOULDER" 800 800 "TRT_ORDER_KEEP_DISTANCE" 801 801 "TRT_ORDER_ZEBRA_CROSSING" 802 802 "TRT_ORDER_UMWELT_ZONE" 803 803 "TRT_ORDER_TURN_LIGHTS_ON" 804 804 "TRT_ORDER_TURN_LIGHTS_OFF" 805 805 "TRT_ORDER_ONE_WAY_STREET" DEFAULT_VALUE "" /end COMPU_VTAB_RANGE
/begin COMPU_VTAB_RANGE Value.OLD_4 "" 6 0 0 "CT_NONE" 1 1 "CT_ALL" 2 2 "CT_SPEED_LIMIT" 3 3 "CT_SPEED_ADVICE" 4 4 "CT_SPEED_MINIMUM" 5 5 "CT_NO_PASSING" DEFAULT_VALUE "" /end COMPU_VTAB_RANGE
/begin COMPU_VTAB_RANGE Value.OLD_5 "" 3 0 0 "normal" 1 1 "eco" 2 2 "dynamic" DEFAULT_VALUE "" /end COMPU_VTAB_RANGE
/begin COMPU_VTAB_RANGE Value.OLD_6 "" 3 0 0 "moving" 1 1 "standstillNotReliable" 3 3 "standstillReliable" DEFAULT_VALUE "" /end COMPU_VTAB_RANGE
/begin COMPU_VTAB_RANGE Value.OLD_7 "" 7 0 0 "undefined" 1 1 "laneDriving" 2 2 "laneChange" 3 3 "emergencyBrake" 4 4 "immediateBrake" 5 5 "returnToLane" 6 6 "activeWarning" DEFAULT_VALUE "" /end COMPU_VTAB_RANGE
/begin COMPU_VTAB_RANGE Value.OLD_8 "" 11 0 0 "undefined" 1 1 "laneDriving" 2 2 "forwardCollisionWarning" 3 3 "emergencyBrake" 4 4 "partialBrake" 5 5 "immediateBrake" 6 6 "emergencyBrakeAssist" 20 20 "laneChangeLeft" 21 21 "laneChangeRight" 22 22 "laneDepartureWarning" 23 23 "returnToLane" DEFAULT_VALUE "" /end COMPU_VTAB_RANGE
/begin COMPU_VTAB Value_Copy1 "enumeration table" TAB_VERB 13 0 "undefined" 1 "laneDriving" 2 "forwardCollisionWarning" 3 "emergencyBrake" 4 "partialBrake" 5 "immediateBrake" 6 "emergencyBrakeAssist" 20 "laneChangeLeft" 21 "laneChangeRight" 22 "laneDepartureWarning" 23 "returnToLane" 24 "laneChangeWarning" 30 "rearCrossTrafficWarning" /end COMPU_VTAB
/begin COMPU_VTAB Value_Copy10 "enumeration table" TAB_VERB 20 0 "undefined" 1 "laneDriving" 2 "forwardCollisionWarning" 3 "emergencyBrake" 4 "partialBrake" 5 "immediateBrake" 6 "emergencyBrakeAssist" 20 "laneChangeLeft" 21 "laneChangeRight" 22 "laneDepartureWarning" 23 "returnToLane" 24 "laneChangeWarningLeft" 25 "laneChangeWarningRight" 30 "rearCrossTrafficWarning" 31 "doorOpeningWarning" 32 "frontCrossTrafficInfo" 33 "preCrashRearWarning" 40 "frontSafetyDistanceInformation" 50 "emergencySteering" 60 "mois" /end COMPU_VTAB
/begin COMPU_VTAB Value_Copy11 "enumeration table" TAB_VERB 43 0 "defaultTrait" 1 "vulnerableRoadUser" 2 "farsideTurnLeft" 3 "farsideTurnRight" 4 "collisionMitigation" 5 "stopping" 6 "oncoming" 7 "pedestrian" 8 "laneMarking" 9 "horizontalEdge" 10 "verticalEdge" 11 "brakeJerk" 12 "limitedBrake" 13 "highSpeedBrake" 14 "defaultTrait2" 15 "defaultTrait3" 16 "blindSpotDetection" 17 "laneChangeAssist" 18 "blindSpotTrailerTow" 19 "rearCrossingTrafficLeft" 20 "rearCrossingTrafficRight" 21 "handsFree" 22 "overtaking" 23 "brakePrefill" 24 "steeringWheelVibration" 25 "acousticWarning" 26 "visualWarning" 27 "frontCrossingTraffic" 28 "emergencyBrakeAssist" 29 "brakeJerkVehicle" 30 "brakeJerkVulnerableRoadUser" 31 "preFillVehicle" 32 "preFillVulnerableRoadUser" 33 "customerTrait0" 34 "customerTrait1" 35 "customerTrait2" 36 "customerTrait3" 37 "customerTrait4" 38 "customerTrait5" 39 "customerTrait6" 40 "customerTrait7" 41 "customerTrait8" 42 "customerTrait9" /end COMPU_VTAB
/begin COMPU_VTAB Value_Copy12 "enumeration table" TAB_VERB 14 0 "laneKeeping0" 1 "laneKeeping1" 2 "laneKeeping2" 3 "laneChangeOutOfBoundsLeft0" 4 "laneChange0OutOfBoundsLeft" 5 "laneChange01" 6 "laneChange10" 7 "laneChange12" 8 "laneChange21" 9 "laneChange2OutOfBoundsRight" 10 "laneChangeOutOfBoundsRight2" 11 "outOfBoundsLeft" 12 "outOfBoundsRight" 13 "unknown" /end COMPU_VTAB
/begin COMPU_VTAB Value_Copy13 "enumeration table" TAB_VERB 4 0 "none" 1 "left" 2 "right" 3 "reset" /end COMPU_VTAB
/begin COMPU_VTAB Value_Copy2 "enumeration table" TAB_VERB 11 0 "defaultTrait" 1 "vulnerableRoadUser" 2 "farsideTurn" 3 "collisionMitigation" 4 "stopping" 5 "oncoming" 6 "laneMarking" 7 "horizontalEdge" 8 "verticalEdge" 9 "brakeJerk" 10 "mySpecialProductLineXyTrait" /end COMPU_VTAB
/begin COMPU_VTAB Value_Copy3 "enumeration table" TAB_VERB 4 0 "frontRight" 1 "frontLeft" 2 "rearRight" 3 "rearLeft" /end COMPU_VTAB
/begin COMPU_VTAB Value_Copy4 "enumeration table" TAB_VERB 3 0 "invalid" 1 "trafficParticipant" 2 "platoon" /end COMPU_VTAB
/begin COMPU_VTAB Value_Copy5 "enumeration table" TAB_VERB 9 0 "none" 1 "unknown" 2 "junction" 3 "cancelAllSign" 4 "cancelSpecificSign" 5 "newTrafficContext" 6 "newRule" 7 "explicitRange" 8 "other" /end COMPU_VTAB
/begin COMPU_VTAB Value_Copy6 "enumeration table" TAB_VERB 7 0 "chooseResumeSetOverPlusMinus" 1 "choosePlusMinusOverResumeSet" 2 "disableResumeSetPlusMinus" 3 "chooseTimeGapOverSetSpeed" 4 "chooseSetSpeedOverTimeGap" 5 "disableAllButMainSwitch" 6 "driverAcknowledge" /end COMPU_VTAB
/begin COMPU_VTAB Value_Copy7 "enumeration table" TAB_VERB 9 0 "rearLast" 1 "rear2" 2 "rear1" 3 "front1" 4 "front2" 5 "front3" 6 "front4" 7 "frontLast" 255 "invalid" /end COMPU_VTAB
/begin COMPU_VTAB Value_Copy8 "enumeration table" TAB_VERB 6 0 "none" 1 "warning" 2 "driverCorrecting" 3 "assisting" 4 "autonomous" 5 "information" /end COMPU_VTAB
/begin COMPU_VTAB Value_Copy9 "enumeration table" TAB_VERB 5 0 "undefined" 1 "tipl" 2 "imba" 3 "cfm" 4 "tixl" /end COMPU_VTAB
/begin COMPU_VTAB VehicleMovementDirection "enumeration table" TAB_VERB 3 0 "forward" 1 "backward" 2 "undefined" /end COMPU_VTAB
/begin COMPU_VTAB_RANGE VehicleStandstillState "" 3 0 0 "STANDSTILL_STATE_VEHICLE_MOVING" 1 1 "STANDSTILL_STATE_NOT_RELIABLE" 3 3 "STANDSTILL_STATE_RELIABLE" DEFAULT_VALUE "" /end COMPU_VTAB_RANGE
/begin COMPU_VTAB_RANGE VertexType "" 6 0 0 "VertexType_RightFront" 1 1 "VertexType_LeftFront" 2 2 "VertexType_RightRear" 3 3 "VertexType_LeftRear" 4 4 "VertexType_BlockedFront" 5 5 "VertexType_BlockedRear" DEFAULT_VALUE "" /end COMPU_VTAB_RANGE
/begin COMPU_VTAB VideoCalibrationState "enumeration table" TAB_VERB 9 0 "fullyCalibrated" 1 "notCalibrated" 2 "yawNotCalibrated" 3 "pitchNotCalibrated" 4 "rollNotCalibrated" 5 "reserved5" 6 "reserved6" 7 "reserved7" 255 "outOfRange" /end COMPU_VTAB
/begin COMPU_VTAB VideoLane "enumeration table" TAB_VERB 5 0 "init" 1 "leftLane" 2 "egoLane" 3 "rightLane" 255 "unknownLane" /end COMPU_VTAB
/begin COMPU_VTAB VideoSensorState "enumeration table" TAB_VERB 9 0 "off" 1 "on" 2 "reduced" 3 "hwError" 4 "swError" 5 "fidActive" 6 "reserved6" 7 "reserved7" 255 "outOfRange" /end COMPU_VTAB
/begin COMPU_VTAB VideoStatusState "enumeration table" TAB_VERB 11 0 "cameraOperational" 1 "cameraInitialization" 2 "cameraLimited" 3 "cameraTempBlind" 4 "cameraBlocked" 5 "cameraError" 6 "cameraCalibration" 7 "cameraDecalibrated" 8 "cameraShutdown" 9 "cameraSleep" 255 "outOfRange" /end COMPU_VTAB
/begin COMPU_VTAB_RANGE VlcAccRequestMainState "" 5 0 0 "VLC_REQUEST_MAINSTATE_OFF" 1 1 "VLC_REQUEST_MAINSTATE_ON" 2 2 "VLC_REQUEST_MAINSTATE_BRAKEONLY" 3 3 "VLC_REQUEST_MAINSTATE_STANDSTILL" 4 4 "VLC_REQUEST_MAINSTATE_SUSPEND" DEFAULT_VALUE "" /end COMPU_VTAB_RANGE
/begin COMPU_VTAB_RANGE VlcShutDownRequest "" 4 0 0 "VLC_REQUEST_SHUTDOWN_SOFT_OFF" 1 1 "VLC_REQUEST_SHUTDOWN_FAST_OFF" 2 2 "VLC_REQUEST_SHUTDOWN_IMMEDIATE_OFF" 3 3 "VLC_REQUEST_SHUTDOWN_STANDSTILL_OFF" DEFAULT_VALUE "" /end COMPU_VTAB_RANGE
/begin COMPU_VTAB_RANGE VmcAvailabilityStatus "" 3 0 0 "VMC_NOT_AVAILABLE" 1 1 "VMC_FAILURE_DETECTED" 2 2 "VMC_AVAILABLE" DEFAULT_VALUE "" /end COMPU_VTAB_RANGE
/begin COMPU_VTAB VmcMotionType "enumeration table" TAB_VERB 3 0 "none" 1 "comfort" 2 "emergency" /end COMPU_VTAB
/begin COMPU_VTAB_RANGE VmcStatusComfortLaneDriving "" 4 0 0 "VMC_PASSIVE" 1 1 "VMC_ACTIVE" 2 2 "VMC_ACTIVE_LONGITUDINAL_ONLY" 3 3 "VMC_ACTIVE_LATERAL_ONLY" DEFAULT_VALUE "" /end COMPU_VTAB_RANGE
/begin COMPU_VTAB VoltageHigh_StateMachine_State "enumeration table" TAB_VERB 5 0 "NO_OVERVOLTAGE_CONDITION" 1 "VOLTAGE_HIGH_DEBOUNCE" 2 "VOLTAGE_HIGH_NORMAL_DEBOUNCE" 3 "VOLTAGE_HIGH_NORMAL" 4 "VOLTAGE_HIGH_ABNORMAL" /end COMPU_VTAB
/begin COMPU_VTAB VoltageLow_StateMachine_State "enumeration table" TAB_VERB 5 0 "NO_UNDER_VOLTAGE_CONDITION" 1 "VOLTAGE_LOW_DEBOUNCE" 2 "VOLTAGE_LOW_NORMAL_DEBOUNCE" 3 "VOLTAGE_LOW_NORMAL" 4 "VOLTAGE_LOW_ABNORMAL" /end COMPU_VTAB
/begin COMPU_VTAB WiperStatus "enumeration table" TAB_VERB 4 0 "off" 1 "slow" 2 "medium" 3 "fast" /end COMPU_VTAB
/begin COMPU_VTAB YAW_RATE_OFFSET_EXTERNAL_STATES "enumeration table" TAB_VERB 2 0 "UNAVAILABLE" 1 "AVAILABLE" /end COMPU_VTAB
/begin COMPU_VTAB YAW_RATE_OFFSET_INDICATOR_STATES "enumeration table" TAB_VERB 6 0 "INITIAL" 1 "DEFAULT_PERSISTENT_DATA" 2 "LAST_IGNITION_PERSISTENT_DATA" 3 "CROSS_MODEL_ALIGNED" 4 "YAW_RATE_INPUT_NOT_AVAILABLE_LONG" 5 "STANDSTILL_ALIGNED" /end COMPU_VTAB
/begin COMPU_VTAB YawRateStabilizationAvailability "enumeration table" TAB_VERB 3 0 "notInitialized" 1 "fault" 2 "full" /end COMPU_VTAB
/begin COMPU_VTAB_RANGE _Adc_ConfigAdcSwGroupCfg_ast._1_._AdcGroupConversionMode_en.CONVERSION "@@@@RuleName created by CANape" 2 0 0 "ADC_CONV_MODE_ONESHOT" 1 1 "ADC_CONV_MODE_CONTINUOUS" DEFAULT_VALUE "" /end COMPU_VTAB_RANGE
/begin COMPU_VTAB_RANGE _Adc_ConfigAdcSwGroupCfg_ast._1_._AdcIntClockDiv_en.CONVERSION "@@@@RuleName created by CANape" 32 0 0 "FADCI_IS_AT_MAX_FREQ" 1 1 "FADCI_IS_FADC_BY_2" 2 2 "FADCI_IS_FADC_BY_3" 3 3 "FADCI_IS_FADC_BY_4" 4 4 "FADCI_IS_FADC_BY_5" 5 5 "FADCI_IS_FADC_BY_6" 6 6 "FADCI_IS_FADC_BY_7" 7 7 "FADCI_IS_FADC_BY_8" 8 8 "FADCI_IS_FADC_BY_9" 9 9 "FADCI_IS_FADC_BY_10" 10 10 "FADCI_IS_FADC_BY_11" 11 11 "FADCI_IS_FADC_BY_12" 12 12 "FADCI_IS_FADC_BY_13" 13 13 "FADCI_IS_FADC_BY_14" 14 14 "FADCI_IS_FADC_BY_15" 15 15 "FADCI_IS_FADC_BY_16" 16 16 "FADCI_IS_FADC_BY_17" 17 17 "FADCI_IS_FADC_BY_18" 18 18 "FADCI_IS_FADC_BY_19" 19 19 "FADCI_IS_FADC_BY_20" 20 20 "FADCI_IS_FADC_BY_21" 21 21 "FADCI_IS_FADC_BY_22" 22 22 "FADCI_IS_FADC_BY_23" 23 23 "FADCI_IS_FADC_BY_24" 24 24 "FADCI_IS_FADC_BY_25" 25 25 "FADCI_IS_FADC_BY_26" 26 26 "FADCI_IS_FADC_BY_27" 27 27 "FADCI_IS_FADC_BY_28" 28 28 "FADCI_IS_FADC_BY_29" 29 29 "FADCI_IS_FADC_BY_30" 30 30 "FADCI_IS_FADC_BY_31" 31 31 "FADCI_IS_FADC_BY_32" DEFAULT_VALUE "" /end COMPU_VTAB_RANGE
/begin COMPU_VTAB_RANGE _Adc_Prv_GroupInfo_ast._1_._Status_en.CONVERSION "@@@@RuleName created by CANape" 4 0 0 "ADC_IDLE" 1 1 "ADC_BUSY" 2 2 "ADC_COMPLETED" 3 3 "ADC_STREAM_COMPLETED" DEFAULT_VALUE "" /end COMPU_VTAB_RANGE
/begin COMPU_VTAB_RANGE _CanIf_ControllerState._0_._ChannelMode.CONVERSION "@@@@RuleName created by CANape" 6 0 0 "CANIF_GET_OFFLINE" 1 1 "CANIF_GET_RX_ONLINE" 2 2 "CANIF_GET_TX_ONLINE" 3 3 "CANIF_GET_ONLINE" 4 4 "CANIF_GET_OFFLINE_ACTIVE" 5 5 "CANIF_GET_OFFLINE_ACTIVE_RX_ONLINE" DEFAULT_VALUE "" /end COMPU_VTAB_RANGE
/begin COMPU_VTAB_RANGE _CanIf_HrhConfig._9_._HrhInfo.CONVERSION "@@@@RuleName created by CANape" 4 0 0 "CANIF_FULL" 1 1 "CANIF_BASIC_RANGE_SFON_SINTGT" 2 2 "CANIF_BASIC_RANGE_SFON_MULTGT" 3 3 "CANIF_BASIC_LIST_SFON" DEFAULT_VALUE "" /end COMPU_VTAB_RANGE
/begin COMPU_VTAB_RANGE _CanIf_TxNotification._9_.CONVERSION "@@@@RuleName created by CANape" 2 0 0 "CANIF_NO_NOTIFICATION" 1 1 "CANIF_TX_RX_NOTIFICATION" DEFAULT_VALUE "" /end COMPU_VTAB_RANGE
/begin COMPU_VTAB _CanIf_TxPduConfig._0_._TxUser.CONVERSION "enumeration table" TAB_VERB 9 0 "PDUR" 1 "CANNM" 2 "CANTP" 3 "CAN_TSYN" 4 "ECUM" 5 "CDD" 6 "XCP" 7 "J1939TP" 8 "USER" /end COMPU_VTAB
/begin COMPU_VTAB_RANGE _CanIf_TxPduConfig._9_._TxUser.CONVERSION "@@@@RuleName created by CANape" 8 0 0 "PDUR" 1 1 "CANNM" 2 2 "CANTP" 3 3 "ECUM" 4 4 "CDD" 5 5 "XCP" 6 6 "J1939TP" 7 7 "USER" DEFAULT_VALUE "" /end COMPU_VTAB_RANGE
/begin COMPU_VTAB_RANGE _CanSM_BOR_Controller_Stopped_state_en._0_.CONVERSION "@@@@RuleName created by CANape" 3 0 0 "CANSM_BOR_CONTROLLER_STOPPED_REQUEST" 1 1 "CANSM_BOR_CONTROLLER_STOPPED_WAIT" 2 2 "CANSM_BOR_CONTROLLER_STOPPED_REQUEST_COMPLETED" DEFAULT_VALUE "" /end COMPU_VTAB_RANGE
/begin COMPU_VTAB_RANGE _CanSM_ControllerState_en._0_.CONVERSION "@@@@RuleName created by CANape" 4 0 0 "CANSM_ControllerState_UNINIT" 1 1 "CANSM_ControllerState_STOPPED" 2 2 "CANSM_ControllerState_STARTED" 3 3 "CANSM_ControllerState_SLEEP" DEFAULT_VALUE "" /end COMPU_VTAB_RANGE
/begin COMPU_VTAB_RANGE _CanSM_CurrNw_Mode_en._0_.CONVERSION "@@@@RuleName created by CANape" 10 0 0 "CANSM_BSM_S_NOCOM" 1 1 "CANSM_BSM_S_SILENTCOM" 2 2 "CANSM_BSM_S_FULLCOM" 3 3 "CANSM_BSM_S_NOT_INITIALIZED" 4 4 "CANSM_BSM_S_PRE_NOCOM" 5 5 "CANSM_BSM_WUVALIDATION" 6 6 "CANSM_BSM_S_PRE_FULLCOM" 7 7 "CANSM_BSM_S_CHANGE_BAUDRATE" 8 8 "CANSM_BSM_S_SILENTCOM_BOR" 9 9 "CANSM_BSM_S_TX_TIMEOUT_EXCEPTION" DEFAULT_VALUE "" /end COMPU_VTAB_RANGE
/begin COMPU_VTAB_RANGE _CanSM_PreFullCom_Substates_en._0_.CONVERSION "@@@@RuleName created by CANape" 7 0 0 "CANSM_PRE_FULLCOM_DEFAULT" 1 1 "CANSM_PRE_FULLCOM_S_TRCV_NORMAL" 2 2 "CANSM_PRE_FULLCOM_S_TRCV_NORMAL_WAIT" 3 3 "CANSM_PRE_FULLCOM_S_CC_STOPPED" 4 4 "CANSM_PRE_FULLCOM_S_CC_STOPPED_WAIT" 5 5 "CANSM_PRE_FULLCOM_S_CC_STARTED" 6 6 "CANSM_PRE_FULLCOM_S_CC_STARTED_WAIT" DEFAULT_VALUE "" /end COMPU_VTAB_RANGE
/begin COMPU_VTAB_RANGE _CanSM_PreNoCom_Substates_en._0_.CONVERSION "@@@@RuleName created by CANape" 23 0 0 "CANSM_DEFAULT" 1 1 "CANSM_S_CC_STOPPED" 2 2 "CANSM_S_PN_CC_STOPPED" 3 3 "CANSM_S_CC_STOPPED_WAIT" 4 4 "CANSM_S_PN_CC_STOPPED_WAIT" 5 5 "CANSM_S_CC_SLEEP" 6 6 "CANSM_S_PN_CC_SLEEP" 7 7 "CANSM_S_CC_SLEEP_WAIT" 8 8 "CANSM_S_PN_CC_SLEEP_WAIT" 9 9 "CANSM_S_TRCV_NORMAL" 10 10 "CANSM_S_PN_TRCV_NORMAL" 11 11 "CANSM_S_TRCV_NORMAL_WAIT" 12 12 "CANSM_S_PN_TRCV_NORMAL_WAIT" 13 13 "CANSM_S_TRCV_STANDBY" 14 14 "CANSM_S_PN_TRCV_STANDBY" 15 15 "CANSM_S_TRCV_STANDBY_WAIT" 16 16 "CANSM_S_PN_TRCV_STANDBY_WAIT" 17 17 "CANSM_S_PN_CLEAR_WUF" 18 18 "CANSM_S_PN_CLEAR_WUF_WAIT" 19 19 "CANSM_S_CHECK_WFLAG_IN_CC_SLEEP" 20 20 "CANSM_S_CHECK_WFLAG_IN_CC_SLEEP_WAIT" 21 21 "CANSM_S_CHECK_WFLAG_IN_NOT_CC_SLEEP" 22 22 "CANSM_S_CHECK_WFLAG_IN_NOT_CC_SLEEP_WAIT" DEFAULT_VALUE "" /end COMPU_VTAB_RANGE
/begin COMPU_VTAB_RANGE _CanSM_TimerConfig_ast._0_._stTimer.CONVERSION "@@@@RuleName created by CANape" 4 1 1 "CANSM_TIMER_INIT" 2 2 "CANSM_TIMER_RUNNING" 3 3 "CANSM_TIMER_ELAPSED" 4 4 "CANSM_TIMER_CANCELLED" DEFAULT_VALUE "" /end COMPU_VTAB_RANGE
/begin COMPU_VTAB_RANGE _CanSM_TxTimeoutexception_Substates_en._0_.CONVERSION "@@@@RuleName created by CANape" 5 0 0 "CANSM_TxTimeoutException_DEFAULT" 1 1 "CANSM_TxTimeoutException_S_CC_STOPPED" 2 2 "CANSM_TxTimeoutException_S_CC_STOPPED_WAIT" 3 3 "CANSM_TxTimeoutException_S_CC_STARTED" 4 4 "CANSM_TxTimeoutException_S_CC_STARTED_WAIT" DEFAULT_VALUE "" /end COMPU_VTAB_RANGE
/begin COMPU_VTAB_RANGE _CanSM_WakeUpValidation_Substates_en._0_.CONVERSION "@@@@RuleName created by CANape" 7 0 0 "CANSM_WAKEUP_VALIDATION_DEFAULT" 1 1 "CANSM_WAKEUP_VALIDATION_S_TRCV_NORMAL" 2 2 "CANSM_WAKEUP_VALIDATION_S_TRCV_NORMAL_WAIT" 3 3 "CANSM_WAKEUP_VALIDATION_S_CC_STOPPED" 4 4 "CANSM_WAKEUP_VALIDATION_S_CC_STOPPED_WAIT" 5 5 "CANSM_WAKEUP_VALIDATION_S_CC_STARTED" 6 6 "CANSM_WAKEUP_VALIDATION_S_CC_STARTED_WAIT" DEFAULT_VALUE "" /end COMPU_VTAB_RANGE
/begin COMPU_VTAB_RANGE _CanSM_currBOR_State_en._0_.CONVERSION "@@@@RuleName created by CANape" 7 1 1 "CANSM_BOR_IDLE" 2 2 "CANSM_S_BUS_OFF_CHECK" 3 3 "CANSM_S_NO_BUS_OFF" 4 4 "CANSM_S_BUS_OFF_RECOVERY_L1" 5 5 "CANSM_S_RESTART_CC" 6 6 "CANSM_S_RESTART_CC_WAIT" 7 7 "CANSM_S_BUS_OFF_RECOVERY_L2" DEFAULT_VALUE "" /end COMPU_VTAB_RANGE
/begin COMPU_VTAB _CanTSyn_Master_Tx_a._0_._TxCrc.CONVERSION "enumeration table" TAB_VERB 2 0 "CANTSYN_CRC_NOT_SUPPORTED" 1 "CANTSYN_CRC_SUPPORTED" /end COMPU_VTAB
/begin COMPU_VTAB _CanTSyn_TxRam._0_._TxType.CONVERSION "enumeration table" TAB_VERB 3 0 "CANTSYN_TXPERIOD" 1 "CANTSYN_IMMEDIATE" 2 "CANTSYN_IMMEDIATE_TXPERIOD" /end COMPU_VTAB
/begin COMPU_VTAB _CanTSyn_TxRam._0_._mode.CONVERSION "enumeration table" TAB_VERB 2 0 "CANTSYN_TX_OFF" 1 "CANTSYN_TX_ON" /end COMPU_VTAB
/begin COMPU_VTAB_RANGE _ComM_ChanelList._0_._BusType_e.CONVERSION "@@@@RuleName created by CANape" 5 0 0 "COMM_BUS_TYPE_CAN" 1 1 "COMM_BUS_TYPE_ETH" 2 2 "COMM_BUS_TYPE_FR" 3 3 "COMM_BUS_TYPE_INTERNAL" 4 4 "COMM_BUS_TYPE_LIN" DEFAULT_VALUE "" /end COMPU_VTAB_RANGE
/begin COMPU_VTAB_RANGE _ComM_ChanelList._0_._ComMNmVariant_e.CONVERSION "@@@@RuleName created by CANape" 4 0 0 "FULL" 1 1 "LIGHT" 2 2 "NONE" 3 3 "PASSIVE" DEFAULT_VALUE "" /end COMPU_VTAB_RANGE
/begin COMPU_VTAB_RANGE _ComM_ChannelStruct._0_._ChannelState_e.CONVERSION "@@@@RuleName created by CANape" 5 0 0 "COMM_NO_COM_NO_PENDING_REQUEST" 1 1 "COMM_NO_COM_REQUEST_PENDING" 2 2 "COMM_FULL_COM_NETWORK_REQUESTED" 3 3 "COMM_FULL_COM_READY_SLEEP" 4 4 "COMM_SILENT_COM" DEFAULT_VALUE "" /end COMPU_VTAB_RANGE
/begin COMPU_VTAB_RANGE _ComM_GlobalStruct._ComM_InitStatus.CONVERSION "@@@@RuleName created by CANape" 2 0 0 "COMM_UNINIT" 1 1 "COMM_INIT" DEFAULT_VALUE "" /end COMPU_VTAB_RANGE
/begin COMPU_VTAB_RANGE _Com_Uninit_Flag.CONVERSION "@@@@RuleName created by CANape" 2 0 0 "COM_UNINIT" 1 1 "COM_INIT" DEFAULT_VALUE "" /end COMPU_VTAB_RANGE
/begin COMPU_VTAB_RANGE _Dcm_ActiveDiagnosticState_en.CONVERSION "@@@@RuleName created by CANape" 2 0 0 "DCM_COMM_ACTIVE" 1 1 "DCM_COMM_NOT_ACTIVE" DEFAULT_VALUE "" /end COMPU_VTAB_RANGE
/begin COMPU_VTAB_RANGE _Dcm_BootLoaderState_en.CONVERSION "@@@@RuleName created by CANape" 11 0 0 "DCM_BOOT_IDLE" 1 1 "DCM_BOOT_PROCESS_RESET" 2 2 "DCM_BOOT_SENDFORCEDRESPPEND" 3 3 "DCM_BOOT_WAIT" 4 4 "DCM_BOOT_STORE_WARMREQ" 5 5 "DCM_BOOT_STORE_WARMINIT" 6 6 "DCM_BOOT_STORE_WARMRESP" 7 7 "DCM_BOOT_ERROR" 8 8 "DCM_BOOT_WAIT_FOR_RESET" 9 9 "DCM_BOOT_PERFORM_RESET" 10 10 "DCM_BOOT_PREPARE_RESET" DEFAULT_VALUE "" /end COMPU_VTAB_RANGE
/begin COMPU_VTAB_RANGE _Dcm_DsldGlobal_st._stDsdState_en.CONVERSION "@@@@RuleName created by CANape" 5 0 0 "DSD_IDLE" 1 1 "DSD_VERIFY_DIAGNOSTIC_DATA" 2 2 "DSD_CALL_SERVICE" 3 3 "DSD_SEND" 4 4 "DSD_TX_CONFIRMATION" DEFAULT_VALUE "" /end COMPU_VTAB_RANGE
/begin RECORD_LAYOUT __SLong_Value FNC_VALUES 1 SLONG ROW_DIR DIRECT /end RECORD_LAYOUT
/begin RECORD_LAYOUT __SWord_Value FNC_VALUES 1 SWORD ROW_DIR DIRECT /end RECORD_LAYOUT
/begin RECORD_LAYOUT __UByte_Value FNC_VALUES 1 UBYTE ROW_DIR DIRECT /end RECORD_LAYOUT
/begin RECORD_LAYOUT __UWord_Value FNC_VALUES 1 UWORD ROW_DIR DIRECT /end RECORD_LAYOUT
/end MODULE
/end PROJECT
