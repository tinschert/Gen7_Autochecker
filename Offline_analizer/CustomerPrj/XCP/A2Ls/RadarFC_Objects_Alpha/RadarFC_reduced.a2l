ASAP2_VERSION 1 71
/begin PROJECT RADAR_GEN5 ""
/begin HEADER "" VERSION "TO_BE_FILLED" /end HEADER
/begin MODULE RADAR_GEN5 ""
/begin MOD_COMMON "" ALIGNMENT_BYTE 1 ALIGNMENT_WORD 2 ALIGNMENT_LONG 4 ALIGNMENT_FLOAT16_IEEE 2 ALIGNMENT_FLOAT32_IEEE 4 ALIGNMENT_FLOAT64_IEEE 4 ALIGNMENT_INT64 4 /end MOD_COMMON
/begin CHARACTERISTIC _g_PL_AD_fw_Radar_1R1V_rpc_XilObjBypassingRunnable_XilObjBypassingRunnable_m_pad_radarObjPort_par_out_local.TChangeableMemPool._._._m_arrayPool._0_._elem._m_objectInformation._6_._m_perObjectType._m_prob1TwoWheelerN "" VALUE 0xB00574AF __UByte_Value 0 NO_COMPU_METHOD 0 255 ECU_ADDRESS_EXTENSION 0x1 BYTE_ORDER MSB_LAST /end CHARACTERISTIC
/begin CHARACTERISTIC _g_PL_AD_fw_Radar_1R1V_rpc_XilObjBypassingRunnable_XilObjBypassingRunnable_m_pad_radarObjPort_par_out_local.TChangeableMemPool._._._m_arrayPool._0_._elem._m_objectInformation._6_._m_perObjectType._m_prob1UnknownN "" VALUE 0xB00574AA __UByte_Value 0 NO_COMPU_METHOD 0 255 ECU_ADDRESS_EXTENSION 0x1 BYTE_ORDER MSB_LAST /end CHARACTERISTIC
/begin CHARACTERISTIC _g_PL_AD_fw_Radar_1R1V_rpc_XilObjBypassingRunnable_XilObjBypassingRunnable_m_pad_radarObjPort_par_out_local.TChangeableMemPool._._._m_arrayPool._0_._elem._m_objectInformation._6_._m_prob1HasBeenObservedMovingN "" VALUE 0xB00574F1 __UByte_Value 0 NO_COMPU_METHOD 0 255 ECU_ADDRESS_EXTENSION 0x1 BYTE_ORDER MSB_LAST /end CHARACTERISTIC
/begin CHARACTERISTIC _g_PL_AD_fw_Radar_1R1V_rpc_XilObjBypassingRunnable_XilObjBypassingRunnable_m_pad_radarObjPort_par_out_local.TChangeableMemPool._._._m_arrayPool._0_._elem._m_objectInformation._6_._m_prob1MovingN "" VALUE 0xB00574F0 __UByte_Value 0 NO_COMPU_METHOD 0 255 ECU_ADDRESS_EXTENSION 0x1 BYTE_ORDER MSB_LAST /end CHARACTERISTIC
/begin CHARACTERISTIC _g_PL_AD_fw_Radar_1R1V_rpc_XilObjBypassingRunnable_XilObjBypassingRunnable_m_pad_radarObjPort_par_out_local.TChangeableMemPool._._._m_arrayPool._0_._elem._m_objectInformation._6_._m_varAxN "" VALUE 0xB00574CC __SLong_Value 0 NO_COMPU_METHOD -2147483648 2147483647 ECU_ADDRESS_EXTENSION 0x1 BYTE_ORDER MSB_LAST /end CHARACTERISTIC
/begin CHARACTERISTIC _g_PL_AD_fw_Radar_1R1V_rpc_XilObjBypassingRunnable_XilObjBypassingRunnable_m_pad_radarObjPort_par_out_local.TChangeableMemPool._._._m_arrayPool._0_._elem._m_objectInformation._6_._m_varAyN "" VALUE 0xB00574D0 __SLong_Value 0 NO_COMPU_METHOD -2147483648 2147483647 ECU_ADDRESS_EXTENSION 0x1 BYTE_ORDER MSB_LAST /end CHARACTERISTIC
/begin CHARACTERISTIC _g_PL_AD_fw_Radar_1R1V_rpc_XilObjBypassingRunnable_XilObjBypassingRunnable_m_pad_radarObjPort_par_out_local.TChangeableMemPool._._._m_arrayPool._0_._elem._m_objectInformation._6_._m_varDxN "" VALUE 0xB00574BC __SLong_Value 0 NO_COMPU_METHOD -2147483648 2147483647 ECU_ADDRESS_EXTENSION 0x1 BYTE_ORDER MSB_LAST /end CHARACTERISTIC
/begin CHARACTERISTIC _g_PL_AD_fw_Radar_1R1V_rpc_XilObjBypassingRunnable_XilObjBypassingRunnable_m_pad_radarObjPort_par_out_local.TChangeableMemPool._._._m_arrayPool._0_._elem._m_objectInformation._6_._m_varDyN "" VALUE 0xB00574C0 __SLong_Value 0 NO_COMPU_METHOD -2147483648 2147483647 ECU_ADDRESS_EXTENSION 0x1 BYTE_ORDER MSB_LAST /end CHARACTERISTIC
/begin CHARACTERISTIC _g_PL_AD_fw_Radar_1R1V_rpc_XilObjBypassingRunnable_XilObjBypassingRunnable_m_pad_radarObjPort_par_out_local.TChangeableMemPool._._._m_arrayPool._0_._elem._m_objectInformation._6_._m_varVxN "" VALUE 0xB00574C4 __SLong_Value 0 NO_COMPU_METHOD -2147483648 2147483647 ECU_ADDRESS_EXTENSION 0x1 BYTE_ORDER MSB_LAST /end CHARACTERISTIC
/begin CHARACTERISTIC _g_PL_AD_fw_Radar_1R1V_rpc_XilObjBypassingRunnable_XilObjBypassingRunnable_m_pad_radarObjPort_par_out_local.TChangeableMemPool._._._m_arrayPool._0_._elem._m_objectInformation._6_._m_varVyN "" VALUE 0xB00574C8 __SLong_Value 0 NO_COMPU_METHOD -2147483648 2147483647 ECU_ADDRESS_EXTENSION 0x1 BYTE_ORDER MSB_LAST /end CHARACTERISTIC
/begin CHARACTERISTIC _g_PL_AD_fw_Radar_1R1V_rpc_XilObjBypassingRunnable_XilObjBypassingRunnable_m_pad_radarObjPort_par_out_local.TChangeableMemPool._._._m_arrayPool._0_._elem._m_objectInformation._6_._m_vxN "" VALUE 0xB00574DA __SWord_Value 0 NO_COMPU_METHOD -32768 32767 ECU_ADDRESS_EXTENSION 0x1 BYTE_ORDER MSB_LAST /end CHARACTERISTIC
/begin CHARACTERISTIC _g_PL_AD_fw_Radar_1R1V_rpc_XilObjBypassingRunnable_XilObjBypassingRunnable_m_pad_radarObjPort_par_out_local.TChangeableMemPool._._._m_arrayPool._0_._elem._m_objectInformation._6_._m_vyN "" VALUE 0xB00574DC __SWord_Value 0 NO_COMPU_METHOD -32768 32767 ECU_ADDRESS_EXTENSION 0x1 BYTE_ORDER MSB_LAST /end CHARACTERISTIC
/begin CHARACTERISTIC _g_PL_AD_fw_Radar_1R1V_rpc_XilObjBypassingRunnable_XilObjBypassingRunnable_m_pad_radarObjPort_par_out_local.TChangeableMemPool._._._m_arrayPool._0_._elem._m_objectInformation._6_._m_wExistProbN "" VALUE 0xB00574EE __UWord_Value 0 NO_COMPU_METHOD 0 65535 ECU_ADDRESS_EXTENSION 0x1 BYTE_ORDER MSB_LAST /end CHARACTERISTIC
/begin CHARACTERISTIC _g_PL_AD_fw_Radar_1R1V_rpc_XilObjBypassingRunnable_XilObjBypassingRunnable_m_pad_radarObjPort_par_out_local.TChangeableMemPool._._._m_arrayPool._0_._elem._m_objectInformation._7_._Valid_b "" VALUE 0xB0057543 __UByte_Value 0 NO_COMPU_METHOD 0 255 ECU_ADDRESS_EXTENSION 0x1 BYTE_ORDER MSB_LAST /end CHARACTERISTIC
/begin CHARACTERISTIC _g_PL_AD_fw_Radar_1R1V_rpc_XilObjBypassingRunnable_XilObjBypassingRunnable_m_pad_radarObjPort_par_out_local.TChangeableMemPool._._._m_arrayPool._0_._elem._m_objectInformation._7_._m_HandleN "" VALUE 0xB0057542 __UByte_Value 0 NO_COMPU_METHOD 0 255 ECU_ADDRESS_EXTENSION 0x1 BYTE_ORDER MSB_LAST /end CHARACTERISTIC
/begin CHARACTERISTIC _g_PL_AD_fw_Radar_1R1V_rpc_XilObjBypassingRunnable_XilObjBypassingRunnable_m_pad_radarObjPort_par_out_local.TChangeableMemPool._._._m_arrayPool._0_._elem._m_objectInformation._7_._m_alpPiVarYawAngleN "" VALUE 0xB0057538 __UWord_Value 0 NO_COMPU_METHOD 0 65535 ECU_ADDRESS_EXTENSION 0x1 BYTE_ORDER MSB_LAST /end CHARACTERISTIC
/begin CHARACTERISTIC _g_PL_AD_fw_Radar_1R1V_rpc_XilObjBypassingRunnable_XilObjBypassingRunnable_m_pad_radarObjPort_par_out_local.TChangeableMemPool._._._m_arrayPool._0_._elem._m_objectInformation._7_._m_alpPiYawAngleN "" VALUE 0xB0057532 __SWord_Value 0 NO_COMPU_METHOD -32768 32767 ECU_ADDRESS_EXTENSION 0x1 BYTE_ORDER MSB_LAST /end CHARACTERISTIC
/begin CHARACTERISTIC _g_PL_AD_fw_Radar_1R1V_rpc_XilObjBypassingRunnable_XilObjBypassingRunnable_m_pad_radarObjPort_par_out_local.TChangeableMemPool._._._m_arrayPool._0_._elem._m_objectInformation._7_._m_axN "" VALUE 0xB005752E __SWord_Value 0 NO_COMPU_METHOD -32768 32767 ECU_ADDRESS_EXTENSION 0x1 BYTE_ORDER MSB_LAST /end CHARACTERISTIC
/begin CHARACTERISTIC _g_PL_AD_fw_Radar_1R1V_rpc_XilObjBypassingRunnable_XilObjBypassingRunnable_m_pad_radarObjPort_par_out_local.TChangeableMemPool._._._m_arrayPool._0_._elem._m_objectInformation._7_._m_ayN "" VALUE 0xB0057530 __SWord_Value 0 NO_COMPU_METHOD -32768 32767 ECU_ADDRESS_EXTENSION 0x1 BYTE_ORDER MSB_LAST /end CHARACTERISTIC
/begin CHARACTERISTIC _g_PL_AD_fw_Radar_1R1V_rpc_XilObjBypassingRunnable_XilObjBypassingRunnable_m_pad_radarObjPort_par_out_local.TChangeableMemPool._._._m_arrayPool._0_._elem._m_objectInformation._7_._m_dLengthN "" VALUE 0xB0057536 __SWord_Value 0 NO_COMPU_METHOD -32768 32767 ECU_ADDRESS_EXTENSION 0x1 BYTE_ORDER MSB_LAST /end CHARACTERISTIC
/begin CHARACTERISTIC _g_PL_AD_fw_Radar_1R1V_rpc_XilObjBypassingRunnable_XilObjBypassingRunnable_m_pad_radarObjPort_par_out_local.TChangeableMemPool._._._m_arrayPool._0_._elem._m_objectInformation._7_._m_dVarLengthN "" VALUE 0xB005753C __UWord_Value 0 NO_COMPU_METHOD 0 65535 ECU_ADDRESS_EXTENSION 0x1 BYTE_ORDER MSB_LAST /end CHARACTERISTIC
/begin CHARACTERISTIC _g_PL_AD_fw_Radar_1R1V_rpc_XilObjBypassingRunnable_XilObjBypassingRunnable_m_pad_radarObjPort_par_out_local.TChangeableMemPool._._._m_arrayPool._0_._elem._m_objectInformation._7_._m_dVarWidthN "" VALUE 0xB005753A __UWord_Value 0 NO_COMPU_METHOD 0 65535 ECU_ADDRESS_EXTENSION 0x1 BYTE_ORDER MSB_LAST /end CHARACTERISTIC
/begin CHARACTERISTIC _g_PL_AD_fw_Radar_1R1V_rpc_XilObjBypassingRunnable_XilObjBypassingRunnable_m_pad_radarObjPort_par_out_local.TChangeableMemPool._._._m_arrayPool._0_._elem._m_objectInformation._7_._m_dWidthN "" VALUE 0xB0057534 __SWord_Value 0 NO_COMPU_METHOD -32768 32767 ECU_ADDRESS_EXTENSION 0x1 BYTE_ORDER MSB_LAST /end CHARACTERISTIC
/begin CHARACTERISTIC _g_PL_AD_fw_Radar_1R1V_rpc_XilObjBypassingRunnable_XilObjBypassingRunnable_m_pad_radarObjPort_par_out_local.TChangeableMemPool._._._m_arrayPool._0_._elem._m_objectInformation._7_._m_dxN "" VALUE 0xB0057524 __SWord_Value 0 NO_COMPU_METHOD -32768 32767 ECU_ADDRESS_EXTENSION 0x1 BYTE_ORDER MSB_LAST /end CHARACTERISTIC
/begin CHARACTERISTIC _g_PL_AD_fw_Radar_1R1V_rpc_XilObjBypassingRunnable_XilObjBypassingRunnable_m_pad_radarObjPort_par_out_local.TChangeableMemPool._._._m_arrayPool._0_._elem._m_objectInformation._7_._m_dyN "" VALUE 0xB0057526 __SWord_Value 0 NO_COMPU_METHOD -32768 32767 ECU_ADDRESS_EXTENSION 0x1 BYTE_ORDER MSB_LAST /end CHARACTERISTIC
/begin CHARACTERISTIC _g_PL_AD_fw_Radar_1R1V_rpc_XilObjBypassingRunnable_XilObjBypassingRunnable_m_pad_radarObjPort_par_out_local.TChangeableMemPool._._._m_arrayPool._0_._elem._m_objectInformation._7_._m_dzN "" VALUE 0xB0057528 __SWord_Value 0 NO_COMPU_METHOD -32768 32767 ECU_ADDRESS_EXTENSION 0x1 BYTE_ORDER MSB_LAST /end CHARACTERISTIC
/begin CHARACTERISTIC _g_PL_AD_fw_Radar_1R1V_rpc_XilObjBypassingRunnable_XilObjBypassingRunnable_m_pad_radarObjPort_par_out_local.TChangeableMemPool._._._m_arrayPool._0_._elem._m_objectInformation._7_._m_isObjectAsil "" VALUE 0xB0057544 __UByte_Value 0 NO_COMPU_METHOD 0 255 ECU_ADDRESS_EXTENSION 0x1 BYTE_ORDER MSB_LAST /end CHARACTERISTIC
/begin CHARACTERISTIC _g_PL_AD_fw_Radar_1R1V_rpc_XilObjBypassingRunnable_XilObjBypassingRunnable_m_pad_radarObjPort_par_out_local.TChangeableMemPool._._._m_arrayPool._0_._elem._m_objectInformation._7_._m_perObjectType._m_prob1FourPlusWheelerN "" VALUE 0xB00574FE __UByte_Value 0 NO_COMPU_METHOD 0 255 ECU_ADDRESS_EXTENSION 0x1 BYTE_ORDER MSB_LAST /end CHARACTERISTIC
/begin CHARACTERISTIC _g_PL_AD_fw_Radar_1R1V_rpc_XilObjBypassingRunnable_XilObjBypassingRunnable_m_pad_radarObjPort_par_out_local.TChangeableMemPool._._._m_arrayPool._0_._elem._m_objectInformation._7_._m_perObjectType._m_prob1FourWheelUnknownN "" VALUE 0xB0057506 __UByte_Value 0 NO_COMPU_METHOD 0 255 ECU_ADDRESS_EXTENSION 0x1 BYTE_ORDER MSB_LAST /end CHARACTERISTIC
/begin CHARACTERISTIC _g_PL_AD_fw_Radar_1R1V_rpc_XilObjBypassingRunnable_XilObjBypassingRunnable_m_pad_radarObjPort_par_out_local.TChangeableMemPool._._._m_arrayPool._0_._elem._m_objectInformation._7_._m_perObjectType._m_prob1MobileN "" VALUE 0xB00574FB __UByte_Value 0 NO_COMPU_METHOD 0 255 ECU_ADDRESS_EXTENSION 0x1 BYTE_ORDER MSB_LAST /end CHARACTERISTIC
/begin CHARACTERISTIC _g_PL_AD_fw_Radar_1R1V_rpc_XilObjBypassingRunnable_XilObjBypassingRunnable_m_pad_radarObjPort_par_out_local.TChangeableMemPool._._._m_arrayPool._0_._elem._m_objectInformation._7_._m_perObjectType._m_prob1MovUnknownN "" VALUE 0xB0057501 __UByte_Value 0 NO_COMPU_METHOD 0 255 ECU_ADDRESS_EXTENSION 0x1 BYTE_ORDER MSB_LAST /end CHARACTERISTIC
/begin CHARACTERISTIC _g_PL_AD_fw_Radar_1R1V_rpc_XilObjBypassingRunnable_XilObjBypassingRunnable_m_pad_radarObjPort_par_out_local.TChangeableMemPool._._._m_arrayPool._0_._elem._m_objectInformation._7_._m_perObjectType._m_prob1NonObstacleN "" VALUE 0xB00574F9 __UByte_Value 0 NO_COMPU_METHOD 0 255 ECU_ADDRESS_EXTENSION 0x1 BYTE_ORDER MSB_LAST /end CHARACTERISTIC
/begin CHARACTERISTIC _g_PL_AD_fw_Radar_1R1V_rpc_XilObjBypassingRunnable_XilObjBypassingRunnable_m_pad_radarObjPort_par_out_local.TChangeableMemPool._._._m_arrayPool._0_._elem._m_objectInformation._7_._m_perObjectType._m_prob1ObstUnknownN "" VALUE 0xB00574FD __UByte_Value 0 NO_COMPU_METHOD 0 255 ECU_ADDRESS_EXTENSION 0x1 BYTE_ORDER MSB_LAST /end CHARACTERISTIC
/begin CHARACTERISTIC _g_PL_AD_fw_Radar_1R1V_rpc_XilObjBypassingRunnable_XilObjBypassingRunnable_m_pad_radarObjPort_par_out_local.TChangeableMemPool._._._m_arrayPool._0_._elem._m_objectInformation._7_._m_perObjectType._m_prob1ObstacleN "" VALUE 0xB00574F8 __UByte_Value 0 NO_COMPU_METHOD 0 255 ECU_ADDRESS_EXTENSION 0x1 BYTE_ORDER MSB_LAST /end CHARACTERISTIC
/begin CHARACTERISTIC _g_PL_AD_fw_Radar_1R1V_rpc_XilObjBypassingRunnable_XilObjBypassingRunnable_m_pad_radarObjPort_par_out_local.TChangeableMemPool._._._m_arrayPool._0_._elem._m_objectInformation._7_._m_perObjectType._m_prob1PassengerCarN "" VALUE 0xB0057504 __UByte_Value 0 NO_COMPU_METHOD 0 255 ECU_ADDRESS_EXTENSION 0x1 BYTE_ORDER MSB_LAST /end CHARACTERISTIC
/begin CHARACTERISTIC _g_PL_AD_fw_Radar_1R1V_rpc_XilObjBypassingRunnable_XilObjBypassingRunnable_m_pad_radarObjPort_par_out_local.TChangeableMemPool._._._m_arrayPool._0_._elem._m_objectInformation._7_._m_perObjectType._m_prob1PedestrianN "" VALUE 0xB0057500 __UByte_Value 0 NO_COMPU_METHOD 0 255 ECU_ADDRESS_EXTENSION 0x1 BYTE_ORDER MSB_LAST /end CHARACTERISTIC
/begin CHARACTERISTIC _g_PL_AD_fw_Radar_1R1V_rpc_XilObjBypassingRunnable_XilObjBypassingRunnable_m_pad_radarObjPort_par_out_local.TChangeableMemPool._._._m_arrayPool._0_._elem._m_objectInformation._7_._m_perObjectType._m_prob1RoadsideBarrierN "" VALUE 0xB0057502 __UByte_Value 0 NO_COMPU_METHOD 0 255 ECU_ADDRESS_EXTENSION 0x1 BYTE_ORDER MSB_LAST /end CHARACTERISTIC
/begin CHARACTERISTIC _g_PL_AD_fw_Radar_1R1V_rpc_XilObjBypassingRunnable_XilObjBypassingRunnable_m_pad_radarObjPort_par_out_local.TChangeableMemPool._._._m_arrayPool._0_._elem._m_objectInformation._7_._m_perObjectType._m_prob1StatUnknownN "" VALUE 0xB0057503 __UByte_Value 0 NO_COMPU_METHOD 0 255 ECU_ADDRESS_EXTENSION 0x1 BYTE_ORDER MSB_LAST /end CHARACTERISTIC
/begin CHARACTERISTIC _g_PL_AD_fw_Radar_1R1V_rpc_XilObjBypassingRunnable_XilObjBypassingRunnable_m_pad_radarObjPort_par_out_local.TChangeableMemPool._._._m_arrayPool._0_._elem._m_objectInformation._7_._m_perObjectType._m_prob1StationaryN "" VALUE 0xB00574FC __UByte_Value 0 NO_COMPU_METHOD 0 255 ECU_ADDRESS_EXTENSION 0x1 BYTE_ORDER MSB_LAST /end CHARACTERISTIC
/begin CHARACTERISTIC _g_PL_AD_fw_Radar_1R1V_rpc_XilObjBypassingRunnable_XilObjBypassingRunnable_m_pad_radarObjPort_par_out_local.TChangeableMemPool._._._m_arrayPool._0_._elem._m_objectInformation._7_._m_perObjectType._m_prob1TruckN "" VALUE 0xB0057505 __UByte_Value 0 NO_COMPU_METHOD 0 255 ECU_ADDRESS_EXTENSION 0x1 BYTE_ORDER MSB_LAST /end CHARACTERISTIC
/begin CHARACTERISTIC _g_PL_AD_fw_Radar_1R1V_rpc_XilObjBypassingRunnable_XilObjBypassingRunnable_m_pad_radarObjPort_par_out_local.TChangeableMemPool._._._m_arrayPool._0_._elem._m_objectInformation._7_._m_perObjectType._m_prob1TwoWheelerN "" VALUE 0xB00574FF __UByte_Value 0 NO_COMPU_METHOD 0 255 ECU_ADDRESS_EXTENSION 0x1 BYTE_ORDER MSB_LAST /end CHARACTERISTIC
/begin CHARACTERISTIC _g_PL_AD_fw_Radar_1R1V_rpc_XilObjBypassingRunnable_XilObjBypassingRunnable_m_pad_radarObjPort_par_out_local.TChangeableMemPool._._._m_arrayPool._0_._elem._m_objectInformation._7_._m_perObjectType._m_prob1UnknownN "" VALUE 0xB00574FA __UByte_Value 0 NO_COMPU_METHOD 0 255 ECU_ADDRESS_EXTENSION 0x1 BYTE_ORDER MSB_LAST /end CHARACTERISTIC
/begin CHARACTERISTIC _g_PL_AD_fw_Radar_1R1V_rpc_XilObjBypassingRunnable_XilObjBypassingRunnable_m_pad_radarObjPort_par_out_local.TChangeableMemPool._._._m_arrayPool._0_._elem._m_objectInformation._7_._m_prob1HasBeenObservedMovingN "" VALUE 0xB0057541 __UByte_Value 0 NO_COMPU_METHOD 0 255 ECU_ADDRESS_EXTENSION 0x1 BYTE_ORDER MSB_LAST /end CHARACTERISTIC
/begin CHARACTERISTIC _g_PL_AD_fw_Radar_1R1V_rpc_XilObjBypassingRunnable_XilObjBypassingRunnable_m_pad_radarObjPort_par_out_local.TChangeableMemPool._._._m_arrayPool._0_._elem._m_objectInformation._7_._m_prob1MovingN "" VALUE 0xB0057540 __UByte_Value 0 NO_COMPU_METHOD 0 255 ECU_ADDRESS_EXTENSION 0x1 BYTE_ORDER MSB_LAST /end CHARACTERISTIC
/begin CHARACTERISTIC _g_PL_AD_fw_Radar_1R1V_rpc_XilObjBypassingRunnable_XilObjBypassingRunnable_m_pad_radarObjPort_par_out_local.TChangeableMemPool._._._m_arrayPool._0_._elem._m_objectInformation._7_._m_varAxN "" VALUE 0xB005751C __SLong_Value 0 NO_COMPU_METHOD -2147483648 2147483647 ECU_ADDRESS_EXTENSION 0x1 BYTE_ORDER MSB_LAST /end CHARACTERISTIC
/begin CHARACTERISTIC _g_PL_AD_fw_Radar_1R1V_rpc_XilObjBypassingRunnable_XilObjBypassingRunnable_m_pad_radarObjPort_par_out_local.TChangeableMemPool._._._m_arrayPool._0_._elem._m_objectInformation._7_._m_varAyN "" VALUE 0xB0057520 __SLong_Value 0 NO_COMPU_METHOD -2147483648 2147483647 ECU_ADDRESS_EXTENSION 0x1 BYTE_ORDER MSB_LAST /end CHARACTERISTIC
/begin CHARACTERISTIC _g_PL_AD_fw_Radar_1R1V_rpc_XilObjBypassingRunnable_XilObjBypassingRunnable_m_pad_radarObjPort_par_out_local.TChangeableMemPool._._._m_arrayPool._0_._elem._m_objectInformation._7_._m_varDxN "" VALUE 0xB005750C __SLong_Value 0 NO_COMPU_METHOD -2147483648 2147483647 ECU_ADDRESS_EXTENSION 0x1 BYTE_ORDER MSB_LAST /end CHARACTERISTIC
/begin CHARACTERISTIC _g_PL_AD_fw_Radar_1R1V_rpc_XilObjBypassingRunnable_XilObjBypassingRunnable_m_pad_radarObjPort_par_out_local.TChangeableMemPool._._._m_arrayPool._0_._elem._m_objectInformation._7_._m_varDyN "" VALUE 0xB0057510 __SLong_Value 0 NO_COMPU_METHOD -2147483648 2147483647 ECU_ADDRESS_EXTENSION 0x1 BYTE_ORDER MSB_LAST /end CHARACTERISTIC
/begin CHARACTERISTIC _g_PL_AD_fw_Radar_1R1V_rpc_XilObjBypassingRunnable_XilObjBypassingRunnable_m_pad_radarObjPort_par_out_local.TChangeableMemPool._._._m_arrayPool._0_._elem._m_objectInformation._7_._m_varVxN "" VALUE 0xB0057514 __SLong_Value 0 NO_COMPU_METHOD -2147483648 2147483647 ECU_ADDRESS_EXTENSION 0x1 BYTE_ORDER MSB_LAST /end CHARACTERISTIC
/begin CHARACTERISTIC _g_PL_AD_fw_Radar_1R1V_rpc_XilObjBypassingRunnable_XilObjBypassingRunnable_m_pad_radarObjPort_par_out_local.TChangeableMemPool._._._m_arrayPool._0_._elem._m_objectInformation._7_._m_varVyN "" VALUE 0xB0057518 __SLong_Value 0 NO_COMPU_METHOD -2147483648 2147483647 ECU_ADDRESS_EXTENSION 0x1 BYTE_ORDER MSB_LAST /end CHARACTERISTIC
/begin CHARACTERISTIC _g_PL_AD_fw_Radar_1R1V_rpc_XilObjBypassingRunnable_XilObjBypassingRunnable_m_pad_radarObjPort_par_out_local.TChangeableMemPool._._._m_arrayPool._0_._elem._m_objectInformation._7_._m_vxN "" VALUE 0xB005752A __SWord_Value 0 NO_COMPU_METHOD -32768 32767 ECU_ADDRESS_EXTENSION 0x1 BYTE_ORDER MSB_LAST /end CHARACTERISTIC
/begin CHARACTERISTIC _g_PL_AD_fw_Radar_1R1V_rpc_XilObjBypassingRunnable_XilObjBypassingRunnable_m_pad_radarObjPort_par_out_local.TChangeableMemPool._._._m_arrayPool._0_._elem._m_objectInformation._7_._m_vyN "" VALUE 0xB005752C __SWord_Value 0 NO_COMPU_METHOD -32768 32767 ECU_ADDRESS_EXTENSION 0x1 BYTE_ORDER MSB_LAST /end CHARACTERISTIC
/begin CHARACTERISTIC _g_PL_AD_fw_Radar_1R1V_rpc_XilObjBypassingRunnable_XilObjBypassingRunnable_m_pad_radarObjPort_par_out_local.TChangeableMemPool._._._m_arrayPool._0_._elem._m_objectInformation._7_._m_wExistProbN "" VALUE 0xB005753E __UWord_Value 0 NO_COMPU_METHOD 0 65535 ECU_ADDRESS_EXTENSION 0x1 BYTE_ORDER MSB_LAST /end CHARACTERISTIC
/begin CHARACTERISTIC _g_PL_AD_fw_Radar_1R1V_rpc_XilObjBypassingRunnable_XilObjBypassingRunnable_m_pad_radarObjPort_par_out_local.TChangeableMemPool._._._m_arrayPool._0_._elem._m_objectInformation._8_._Valid_b "" VALUE 0xB0057593 __UByte_Value 0 NO_COMPU_METHOD 0 255 ECU_ADDRESS_EXTENSION 0x1 BYTE_ORDER MSB_LAST /end CHARACTERISTIC
/begin CHARACTERISTIC _g_PL_AD_fw_Radar_1R1V_rpc_XilObjBypassingRunnable_XilObjBypassingRunnable_m_pad_radarObjPort_par_out_local.TChangeableMemPool._._._m_arrayPool._0_._elem._m_objectInformation._8_._m_HandleN "" VALUE 0xB0057592 __UByte_Value 0 NO_COMPU_METHOD 0 255 ECU_ADDRESS_EXTENSION 0x1 BYTE_ORDER MSB_LAST /end CHARACTERISTIC
/begin CHARACTERISTIC _g_PL_AD_fw_Radar_1R1V_rpc_XilObjBypassingRunnable_XilObjBypassingRunnable_m_pad_radarObjPort_par_out_local.TChangeableMemPool._._._m_arrayPool._0_._elem._m_objectInformation._8_._m_alpPiVarYawAngleN "" VALUE 0xB0057588 __UWord_Value 0 NO_COMPU_METHOD 0 65535 ECU_ADDRESS_EXTENSION 0x1 BYTE_ORDER MSB_LAST /end CHARACTERISTIC
/begin CHARACTERISTIC _g_PL_AD_fw_Radar_1R1V_rpc_XilObjBypassingRunnable_XilObjBypassingRunnable_m_pad_radarObjPort_par_out_local.TChangeableMemPool._._._m_arrayPool._0_._elem._m_objectInformation._8_._m_alpPiYawAngleN "" VALUE 0xB0057582 __SWord_Value 0 NO_COMPU_METHOD -32768 32767 ECU_ADDRESS_EXTENSION 0x1 BYTE_ORDER MSB_LAST /end CHARACTERISTIC
/begin CHARACTERISTIC _g_PL_AD_fw_Radar_1R1V_rpc_XilObjBypassingRunnable_XilObjBypassingRunnable_m_pad_radarObjPort_par_out_local.TChangeableMemPool._._._m_arrayPool._0_._elem._m_objectInformation._8_._m_axN "" VALUE 0xB005757E __SWord_Value 0 NO_COMPU_METHOD -32768 32767 ECU_ADDRESS_EXTENSION 0x1 BYTE_ORDER MSB_LAST /end CHARACTERISTIC
/begin CHARACTERISTIC _g_PL_AD_fw_Radar_1R1V_rpc_XilObjBypassingRunnable_XilObjBypassingRunnable_m_pad_radarObjPort_par_out_local.TChangeableMemPool._._._m_arrayPool._0_._elem._m_objectInformation._8_._m_ayN "" VALUE 0xB0057580 __SWord_Value 0 NO_COMPU_METHOD -32768 32767 ECU_ADDRESS_EXTENSION 0x1 BYTE_ORDER MSB_LAST /end CHARACTERISTIC
/begin CHARACTERISTIC _g_PL_AD_fw_Radar_1R1V_rpc_XilObjBypassingRunnable_XilObjBypassingRunnable_m_pad_radarObjPort_par_out_local.TChangeableMemPool._._._m_arrayPool._0_._elem._m_objectInformation._8_._m_dLengthN "" VALUE 0xB0057586 __SWord_Value 0 NO_COMPU_METHOD -32768 32767 ECU_ADDRESS_EXTENSION 0x1 BYTE_ORDER MSB_LAST /end CHARACTERISTIC
/begin CHARACTERISTIC _g_PL_AD_fw_Radar_1R1V_rpc_XilObjBypassingRunnable_XilObjBypassingRunnable_m_pad_radarObjPort_par_out_local.TChangeableMemPool._._._m_arrayPool._0_._elem._m_objectInformation._8_._m_dVarLengthN "" VALUE 0xB005758C __UWord_Value 0 NO_COMPU_METHOD 0 65535 ECU_ADDRESS_EXTENSION 0x1 BYTE_ORDER MSB_LAST /end CHARACTERISTIC
/begin CHARACTERISTIC _g_PL_AD_fw_Radar_1R1V_rpc_XilObjBypassingRunnable_XilObjBypassingRunnable_m_pad_radarObjPort_par_out_local.TChangeableMemPool._._._m_arrayPool._0_._elem._m_objectInformation._8_._m_dVarWidthN "" VALUE 0xB005758A __UWord_Value 0 NO_COMPU_METHOD 0 65535 ECU_ADDRESS_EXTENSION 0x1 BYTE_ORDER MSB_LAST /end CHARACTERISTIC
/begin CHARACTERISTIC _g_PL_AD_fw_Radar_1R1V_rpc_XilObjBypassingRunnable_XilObjBypassingRunnable_m_pad_radarObjPort_par_out_local.TChangeableMemPool._._._m_arrayPool._0_._elem._m_objectInformation._8_._m_dWidthN "" VALUE 0xB0057584 __SWord_Value 0 NO_COMPU_METHOD -32768 32767 ECU_ADDRESS_EXTENSION 0x1 BYTE_ORDER MSB_LAST /end CHARACTERISTIC
/begin CHARACTERISTIC _g_PL_AD_fw_Radar_1R1V_rpc_XilObjBypassingRunnable_XilObjBypassingRunnable_m_pad_radarObjPort_par_out_local.TChangeableMemPool._._._m_arrayPool._0_._elem._m_objectInformation._8_._m_dxN "" VALUE 0xB0057574 __SWord_Value 0 NO_COMPU_METHOD -32768 32767 ECU_ADDRESS_EXTENSION 0x1 BYTE_ORDER MSB_LAST /end CHARACTERISTIC
/begin CHARACTERISTIC _g_PL_AD_fw_Radar_1R1V_rpc_XilObjBypassingRunnable_XilObjBypassingRunnable_m_pad_radarObjPort_par_out_local.TChangeableMemPool._._._m_arrayPool._0_._elem._m_objectInformation._8_._m_dyN "" VALUE 0xB0057576 __SWord_Value 0 NO_COMPU_METHOD -32768 32767 ECU_ADDRESS_EXTENSION 0x1 BYTE_ORDER MSB_LAST /end CHARACTERISTIC
/begin CHARACTERISTIC _g_PL_AD_fw_Radar_1R1V_rpc_XilObjBypassingRunnable_XilObjBypassingRunnable_m_pad_radarObjPort_par_out_local.TChangeableMemPool._._._m_arrayPool._0_._elem._m_objectInformation._8_._m_dzN "" VALUE 0xB0057578 __SWord_Value 0 NO_COMPU_METHOD -32768 32767 ECU_ADDRESS_EXTENSION 0x1 BYTE_ORDER MSB_LAST /end CHARACTERISTIC
/begin CHARACTERISTIC _g_PL_AD_fw_Radar_1R1V_rpc_XilObjBypassingRunnable_XilObjBypassingRunnable_m_pad_radarObjPort_par_out_local.TChangeableMemPool._._._m_arrayPool._0_._elem._m_objectInformation._8_._m_isObjectAsil "" VALUE 0xB0057594 __UByte_Value 0 NO_COMPU_METHOD 0 255 ECU_ADDRESS_EXTENSION 0x1 BYTE_ORDER MSB_LAST /end CHARACTERISTIC
/begin CHARACTERISTIC _g_PL_AD_fw_Radar_1R1V_rpc_XilObjBypassingRunnable_XilObjBypassingRunnable_m_pad_radarObjPort_par_out_local.TChangeableMemPool._._._m_arrayPool._0_._elem._m_objectInformation._8_._m_perObjectType._m_prob1FourPlusWheelerN "" VALUE 0xB005754E __UByte_Value 0 NO_COMPU_METHOD 0 255 ECU_ADDRESS_EXTENSION 0x1 BYTE_ORDER MSB_LAST /end CHARACTERISTIC
/begin CHARACTERISTIC _g_PL_AD_fw_Radar_1R1V_rpc_XilObjBypassingRunnable_XilObjBypassingRunnable_m_pad_radarObjPort_par_out_local.TChangeableMemPool._._._m_arrayPool._0_._elem._m_objectInformation._8_._m_perObjectType._m_prob1FourWheelUnknownN "" VALUE 0xB0057556 __UByte_Value 0 NO_COMPU_METHOD 0 255 ECU_ADDRESS_EXTENSION 0x1 BYTE_ORDER MSB_LAST /end CHARACTERISTIC
/begin CHARACTERISTIC _g_PL_AD_fw_Radar_1R1V_rpc_XilObjBypassingRunnable_XilObjBypassingRunnable_m_pad_radarObjPort_par_out_local.TChangeableMemPool._._._m_arrayPool._0_._elem._m_objectInformation._8_._m_perObjectType._m_prob1MobileN "" VALUE 0xB005754B __UByte_Value 0 NO_COMPU_METHOD 0 255 ECU_ADDRESS_EXTENSION 0x1 BYTE_ORDER MSB_LAST /end CHARACTERISTIC
/begin CHARACTERISTIC _g_PL_AD_fw_Radar_1R1V_rpc_XilObjBypassingRunnable_XilObjBypassingRunnable_m_pad_radarObjPort_par_out_local.TChangeableMemPool._._._m_arrayPool._0_._elem._m_objectInformation._8_._m_perObjectType._m_prob1MovUnknownN "" VALUE 0xB0057551 __UByte_Value 0 NO_COMPU_METHOD 0 255 ECU_ADDRESS_EXTENSION 0x1 BYTE_ORDER MSB_LAST /end CHARACTERISTIC
/begin CHARACTERISTIC _g_PL_AD_fw_Radar_1R1V_rpc_XilObjBypassingRunnable_XilObjBypassingRunnable_m_pad_radarObjPort_par_out_local.TChangeableMemPool._._._m_arrayPool._0_._elem._m_objectInformation._8_._m_perObjectType._m_prob1NonObstacleN "" VALUE 0xB0057549 __UByte_Value 0 NO_COMPU_METHOD 0 255 ECU_ADDRESS_EXTENSION 0x1 BYTE_ORDER MSB_LAST /end CHARACTERISTIC
/begin CHARACTERISTIC _g_PL_AD_fw_Radar_1R1V_rpc_XilObjBypassingRunnable_XilObjBypassingRunnable_m_pad_radarObjPort_par_out_local.TChangeableMemPool._._._m_arrayPool._0_._elem._m_objectInformation._8_._m_perObjectType._m_prob1ObstUnknownN "" VALUE 0xB005754D __UByte_Value 0 NO_COMPU_METHOD 0 255 ECU_ADDRESS_EXTENSION 0x1 BYTE_ORDER MSB_LAST /end CHARACTERISTIC
/begin CHARACTERISTIC _g_PL_AD_fw_Radar_1R1V_rpc_XilObjBypassingRunnable_XilObjBypassingRunnable_m_pad_radarObjPort_par_out_local.TChangeableMemPool._._._m_arrayPool._0_._elem._m_objectInformation._8_._m_perObjectType._m_prob1ObstacleN "" VALUE 0xB0057548 __UByte_Value 0 NO_COMPU_METHOD 0 255 ECU_ADDRESS_EXTENSION 0x1 BYTE_ORDER MSB_LAST /end CHARACTERISTIC
/begin CHARACTERISTIC _g_PL_AD_fw_Radar_1R1V_rpc_XilObjBypassingRunnable_XilObjBypassingRunnable_m_pad_radarObjPort_par_out_local.TChangeableMemPool._._._m_arrayPool._0_._elem._m_objectInformation._8_._m_perObjectType._m_prob1PassengerCarN "" VALUE 0xB0057554 __UByte_Value 0 NO_COMPU_METHOD 0 255 ECU_ADDRESS_EXTENSION 0x1 BYTE_ORDER MSB_LAST /end CHARACTERISTIC
/begin CHARACTERISTIC _g_PL_AD_fw_Radar_1R1V_rpc_XilObjBypassingRunnable_XilObjBypassingRunnable_m_pad_radarObjPort_par_out_local.TChangeableMemPool._._._m_arrayPool._0_._elem._m_objectInformation._8_._m_perObjectType._m_prob1PedestrianN "" VALUE 0xB0057550 __UByte_Value 0 NO_COMPU_METHOD 0 255 ECU_ADDRESS_EXTENSION 0x1 BYTE_ORDER MSB_LAST /end CHARACTERISTIC
/begin CHARACTERISTIC _g_PL_AD_fw_Radar_1R1V_rpc_XilObjBypassingRunnable_XilObjBypassingRunnable_m_pad_radarObjPort_par_out_local.TChangeableMemPool._._._m_arrayPool._0_._elem._m_objectInformation._8_._m_perObjectType._m_prob1RoadsideBarrierN "" VALUE 0xB0057552 __UByte_Value 0 NO_COMPU_METHOD 0 255 ECU_ADDRESS_EXTENSION 0x1 BYTE_ORDER MSB_LAST /end CHARACTERISTIC
/begin CHARACTERISTIC _g_PL_AD_fw_Radar_1R1V_rpc_XilObjBypassingRunnable_XilObjBypassingRunnable_m_pad_radarObjPort_par_out_local.TChangeableMemPool._._._m_arrayPool._0_._elem._m_objectInformation._8_._m_perObjectType._m_prob1StatUnknownN "" VALUE 0xB0057553 __UByte_Value 0 NO_COMPU_METHOD 0 255 ECU_ADDRESS_EXTENSION 0x1 BYTE_ORDER MSB_LAST /end CHARACTERISTIC
/begin CHARACTERISTIC _g_PL_AD_fw_Radar_1R1V_rpc_XilObjBypassingRunnable_XilObjBypassingRunnable_m_pad_radarObjPort_par_out_local.TChangeableMemPool._._._m_arrayPool._0_._elem._m_objectInformation._8_._m_perObjectType._m_prob1StationaryN "" VALUE 0xB005754C __UByte_Value 0 NO_COMPU_METHOD 0 255 ECU_ADDRESS_EXTENSION 0x1 BYTE_ORDER MSB_LAST /end CHARACTERISTIC
/begin CHARACTERISTIC _g_PL_AD_fw_Radar_1R1V_rpc_XilObjBypassingRunnable_XilObjBypassingRunnable_m_pad_radarObjPort_par_out_local.TChangeableMemPool._._._m_arrayPool._0_._elem._m_objectInformation._8_._m_perObjectType._m_prob1TruckN "" VALUE 0xB0057555 __UByte_Value 0 NO_COMPU_METHOD 0 255 ECU_ADDRESS_EXTENSION 0x1 BYTE_ORDER MSB_LAST /end CHARACTERISTIC
/begin CHARACTERISTIC _g_PL_AD_fw_Radar_1R1V_rpc_XilObjBypassingRunnable_XilObjBypassingRunnable_m_pad_radarObjPort_par_out_local.TChangeableMemPool._._._m_arrayPool._0_._elem._m_objectInformation._8_._m_perObjectType._m_prob1TwoWheelerN "" VALUE 0xB005754F __UByte_Value 0 NO_COMPU_METHOD 0 255 ECU_ADDRESS_EXTENSION 0x1 BYTE_ORDER MSB_LAST /end CHARACTERISTIC
/begin CHARACTERISTIC _g_PL_AD_fw_Radar_1R1V_rpc_XilObjBypassingRunnable_XilObjBypassingRunnable_m_pad_radarObjPort_par_out_local.TChangeableMemPool._._._m_arrayPool._0_._elem._m_objectInformation._8_._m_perObjectType._m_prob1UnknownN "" VALUE 0xB005754A __UByte_Value 0 NO_COMPU_METHOD 0 255 ECU_ADDRESS_EXTENSION 0x1 BYTE_ORDER MSB_LAST /end CHARACTERISTIC
/begin CHARACTERISTIC _g_PL_AD_fw_Radar_1R1V_rpc_XilObjBypassingRunnable_XilObjBypassingRunnable_m_pad_radarObjPort_par_out_local.TChangeableMemPool._._._m_arrayPool._0_._elem._m_objectInformation._8_._m_prob1HasBeenObservedMovingN "" VALUE 0xB0057591 __UByte_Value 0 NO_COMPU_METHOD 0 255 ECU_ADDRESS_EXTENSION 0x1 BYTE_ORDER MSB_LAST /end CHARACTERISTIC
/begin CHARACTERISTIC _g_PL_AD_fw_Radar_1R1V_rpc_XilObjBypassingRunnable_XilObjBypassingRunnable_m_pad_radarObjPort_par_out_local.TChangeableMemPool._._._m_arrayPool._0_._elem._m_objectInformation._8_._m_prob1MovingN "" VALUE 0xB0057590 __UByte_Value 0 NO_COMPU_METHOD 0 255 ECU_ADDRESS_EXTENSION 0x1 BYTE_ORDER MSB_LAST /end CHARACTERISTIC
/begin CHARACTERISTIC _g_PL_AD_fw_Radar_1R1V_rpc_XilObjBypassingRunnable_XilObjBypassingRunnable_m_pad_radarObjPort_par_out_local.TChangeableMemPool._._._m_arrayPool._0_._elem._m_objectInformation._8_._m_varAxN "" VALUE 0xB005756C __SLong_Value 0 NO_COMPU_METHOD -2147483648 2147483647 ECU_ADDRESS_EXTENSION 0x1 BYTE_ORDER MSB_LAST /end CHARACTERISTIC
/begin CHARACTERISTIC _g_PL_AD_fw_Radar_1R1V_rpc_XilObjBypassingRunnable_XilObjBypassingRunnable_m_pad_radarObjPort_par_out_local.TChangeableMemPool._._._m_arrayPool._0_._elem._m_objectInformation._8_._m_varAyN "" VALUE 0xB0057570 __SLong_Value 0 NO_COMPU_METHOD -2147483648 2147483647 ECU_ADDRESS_EXTENSION 0x1 BYTE_ORDER MSB_LAST /end CHARACTERISTIC
/begin CHARACTERISTIC _g_PL_AD_fw_Radar_1R1V_rpc_XilObjBypassingRunnable_XilObjBypassingRunnable_m_pad_radarObjPort_par_out_local.TChangeableMemPool._._._m_arrayPool._0_._elem._m_objectInformation._8_._m_varDxN "" VALUE 0xB005755C __SLong_Value 0 NO_COMPU_METHOD -2147483648 2147483647 ECU_ADDRESS_EXTENSION 0x1 BYTE_ORDER MSB_LAST /end CHARACTERISTIC
/begin CHARACTERISTIC _g_PL_AD_fw_Radar_1R1V_rpc_XilObjBypassingRunnable_XilObjBypassingRunnable_m_pad_radarObjPort_par_out_local.TChangeableMemPool._._._m_arrayPool._0_._elem._m_objectInformation._8_._m_varDyN "" VALUE 0xB0057560 __SLong_Value 0 NO_COMPU_METHOD -2147483648 2147483647 ECU_ADDRESS_EXTENSION 0x1 BYTE_ORDER MSB_LAST /end CHARACTERISTIC
/begin CHARACTERISTIC _g_PL_AD_fw_Radar_1R1V_rpc_XilObjBypassingRunnable_XilObjBypassingRunnable_m_pad_radarObjPort_par_out_local.TChangeableMemPool._._._m_arrayPool._0_._elem._m_objectInformation._8_._m_varVxN "" VALUE 0xB0057564 __SLong_Value 0 NO_COMPU_METHOD -2147483648 2147483647 ECU_ADDRESS_EXTENSION 0x1 BYTE_ORDER MSB_LAST /end CHARACTERISTIC
/begin CHARACTERISTIC _g_PL_AD_fw_Radar_1R1V_rpc_XilObjBypassingRunnable_XilObjBypassingRunnable_m_pad_radarObjPort_par_out_local.TChangeableMemPool._._._m_arrayPool._0_._elem._m_objectInformation._8_._m_varVyN "" VALUE 0xB0057568 __SLong_Value 0 NO_COMPU_METHOD -2147483648 2147483647 ECU_ADDRESS_EXTENSION 0x1 BYTE_ORDER MSB_LAST /end CHARACTERISTIC
/begin CHARACTERISTIC _g_PL_AD_fw_Radar_1R1V_rpc_XilObjBypassingRunnable_XilObjBypassingRunnable_m_pad_radarObjPort_par_out_local.TChangeableMemPool._._._m_arrayPool._0_._elem._m_objectInformation._8_._m_vxN "" VALUE 0xB005757A __SWord_Value 0 NO_COMPU_METHOD -32768 32767 ECU_ADDRESS_EXTENSION 0x1 BYTE_ORDER MSB_LAST /end CHARACTERISTIC
/begin CHARACTERISTIC _g_PL_AD_fw_Radar_1R1V_rpc_XilObjBypassingRunnable_XilObjBypassingRunnable_m_pad_radarObjPort_par_out_local.TChangeableMemPool._._._m_arrayPool._0_._elem._m_objectInformation._8_._m_vyN "" VALUE 0xB005757C __SWord_Value 0 NO_COMPU_METHOD -32768 32767 ECU_ADDRESS_EXTENSION 0x1 BYTE_ORDER MSB_LAST /end CHARACTERISTIC
/begin CHARACTERISTIC _g_PL_AD_fw_Radar_1R1V_rpc_XilObjBypassingRunnable_XilObjBypassingRunnable_m_pad_radarObjPort_par_out_local.TChangeableMemPool._._._m_arrayPool._0_._elem._m_objectInformation._8_._m_wExistProbN "" VALUE 0xB005758E __UWord_Value 0 NO_COMPU_METHOD 0 65535 ECU_ADDRESS_EXTENSION 0x1 BYTE_ORDER MSB_LAST /end CHARACTERISTIC
/begin CHARACTERISTIC _g_PL_AD_fw_Radar_1R1V_rpc_XilObjBypassingRunnable_XilObjBypassingRunnable_m_pad_radarObjPort_par_out_local.TChangeableMemPool._._._m_arrayPool._0_._elem._m_objectInformation._9_._Valid_b "" VALUE 0xB00575E3 __UByte_Value 0 NO_COMPU_METHOD 0 255 ECU_ADDRESS_EXTENSION 0x1 BYTE_ORDER MSB_LAST /end CHARACTERISTIC
/begin CHARACTERISTIC _g_PL_AD_fw_Radar_1R1V_rpc_XilObjBypassingRunnable_XilObjBypassingRunnable_m_pad_radarObjPort_par_out_local.TChangeableMemPool._._._m_arrayPool._0_._elem._m_objectInformation._9_._m_HandleN "" VALUE 0xB00575E2 __UByte_Value 0 NO_COMPU_METHOD 0 255 ECU_ADDRESS_EXTENSION 0x1 BYTE_ORDER MSB_LAST /end CHARACTERISTIC
/begin CHARACTERISTIC _g_PL_AD_fw_Radar_1R1V_rpc_XilObjBypassingRunnable_XilObjBypassingRunnable_m_pad_radarObjPort_par_out_local.TChangeableMemPool._._._m_arrayPool._0_._elem._m_objectInformation._9_._m_alpPiVarYawAngleN "" VALUE 0xB00575D8 __UWord_Value 0 NO_COMPU_METHOD 0 65535 ECU_ADDRESS_EXTENSION 0x1 BYTE_ORDER MSB_LAST /end CHARACTERISTIC
/begin CHARACTERISTIC _g_PL_AD_fw_Radar_1R1V_rpc_XilObjBypassingRunnable_XilObjBypassingRunnable_m_pad_radarObjPort_par_out_local.TChangeableMemPool._._._m_arrayPool._0_._elem._m_objectInformation._9_._m_alpPiYawAngleN "" VALUE 0xB00575D2 __SWord_Value 0 NO_COMPU_METHOD -32768 32767 ECU_ADDRESS_EXTENSION 0x1 BYTE_ORDER MSB_LAST /end CHARACTERISTIC
/begin CHARACTERISTIC _g_PL_AD_fw_Radar_1R1V_rpc_XilObjBypassingRunnable_XilObjBypassingRunnable_m_pad_radarObjPort_par_out_local.TChangeableMemPool._._._m_arrayPool._0_._elem._m_objectInformation._9_._m_axN "" VALUE 0xB00575CE __SWord_Value 0 NO_COMPU_METHOD -32768 32767 ECU_ADDRESS_EXTENSION 0x1 BYTE_ORDER MSB_LAST /end CHARACTERISTIC
/begin CHARACTERISTIC _g_PL_AD_fw_Radar_1R1V_rpc_XilObjBypassingRunnable_XilObjBypassingRunnable_m_pad_radarObjPort_par_out_local.TChangeableMemPool._._._m_arrayPool._0_._elem._m_objectInformation._9_._m_ayN "" VALUE 0xB00575D0 __SWord_Value 0 NO_COMPU_METHOD -32768 32767 ECU_ADDRESS_EXTENSION 0x1 BYTE_ORDER MSB_LAST /end CHARACTERISTIC
/begin CHARACTERISTIC _g_PL_AD_fw_Radar_1R1V_rpc_XilObjBypassingRunnable_XilObjBypassingRunnable_m_pad_radarObjPort_par_out_local.TChangeableMemPool._._._m_arrayPool._0_._elem._m_objectInformation._9_._m_dLengthN "" VALUE 0xB00575D6 __SWord_Value 0 NO_COMPU_METHOD -32768 32767 ECU_ADDRESS_EXTENSION 0x1 BYTE_ORDER MSB_LAST /end CHARACTERISTIC
/begin CHARACTERISTIC _g_PL_AD_fw_Radar_1R1V_rpc_XilObjBypassingRunnable_XilObjBypassingRunnable_m_pad_radarObjPort_par_out_local.TChangeableMemPool._._._m_arrayPool._0_._elem._m_objectInformation._9_._m_dVarLengthN "" VALUE 0xB00575DC __UWord_Value 0 NO_COMPU_METHOD 0 65535 ECU_ADDRESS_EXTENSION 0x1 BYTE_ORDER MSB_LAST /end CHARACTERISTIC
/begin CHARACTERISTIC _g_PL_AD_fw_Radar_1R1V_rpc_XilObjBypassingRunnable_XilObjBypassingRunnable_m_pad_radarObjPort_par_out_local.TChangeableMemPool._._._m_arrayPool._0_._elem._m_objectInformation._9_._m_dVarWidthN "" VALUE 0xB00575DA __UWord_Value 0 NO_COMPU_METHOD 0 65535 ECU_ADDRESS_EXTENSION 0x1 BYTE_ORDER MSB_LAST /end CHARACTERISTIC
/begin CHARACTERISTIC _g_PL_AD_fw_Radar_1R1V_rpc_XilObjBypassingRunnable_XilObjBypassingRunnable_m_pad_radarObjPort_par_out_local.TChangeableMemPool._._._m_arrayPool._0_._elem._m_objectInformation._9_._m_dWidthN "" VALUE 0xB00575D4 __SWord_Value 0 NO_COMPU_METHOD -32768 32767 ECU_ADDRESS_EXTENSION 0x1 BYTE_ORDER MSB_LAST /end CHARACTERISTIC
/begin CHARACTERISTIC _g_PL_AD_fw_Radar_1R1V_rpc_XilObjBypassingRunnable_XilObjBypassingRunnable_m_pad_radarObjPort_par_out_local.TChangeableMemPool._._._m_arrayPool._0_._elem._m_objectInformation._9_._m_dxN "" VALUE 0xB00575C4 __SWord_Value 0 NO_COMPU_METHOD -32768 32767 ECU_ADDRESS_EXTENSION 0x1 BYTE_ORDER MSB_LAST /end CHARACTERISTIC
/begin CHARACTERISTIC _g_PL_AD_fw_Radar_1R1V_rpc_XilObjBypassingRunnable_XilObjBypassingRunnable_m_pad_radarObjPort_par_out_local.TChangeableMemPool._._._m_arrayPool._0_._elem._m_objectInformation._9_._m_dyN "" VALUE 0xB00575C6 __SWord_Value 0 NO_COMPU_METHOD -32768 32767 ECU_ADDRESS_EXTENSION 0x1 BYTE_ORDER MSB_LAST /end CHARACTERISTIC
/begin CHARACTERISTIC _g_PL_AD_fw_Radar_1R1V_rpc_XilObjBypassingRunnable_XilObjBypassingRunnable_m_pad_radarObjPort_par_out_local.TChangeableMemPool._._._m_arrayPool._0_._elem._m_objectInformation._9_._m_dzN "" VALUE 0xB00575C8 __SWord_Value 0 NO_COMPU_METHOD -32768 32767 ECU_ADDRESS_EXTENSION 0x1 BYTE_ORDER MSB_LAST /end CHARACTERISTIC
/begin CHARACTERISTIC _g_PL_AD_fw_Radar_1R1V_rpc_XilObjBypassingRunnable_XilObjBypassingRunnable_m_pad_radarObjPort_par_out_local.TChangeableMemPool._._._m_arrayPool._0_._elem._m_objectInformation._9_._m_isObjectAsil "" VALUE 0xB00575E4 __UByte_Value 0 NO_COMPU_METHOD 0 255 ECU_ADDRESS_EXTENSION 0x1 BYTE_ORDER MSB_LAST /end CHARACTERISTIC
/begin CHARACTERISTIC _g_PL_AD_fw_Radar_1R1V_rpc_XilObjBypassingRunnable_XilObjBypassingRunnable_m_pad_radarObjPort_par_out_local.TChangeableMemPool._._._m_arrayPool._0_._elem._m_objectInformation._9_._m_perObjectType._m_prob1FourPlusWheelerN "" VALUE 0xB005759E __UByte_Value 0 NO_COMPU_METHOD 0 255 ECU_ADDRESS_EXTENSION 0x1 BYTE_ORDER MSB_LAST /end CHARACTERISTIC
/begin CHARACTERISTIC _g_PL_AD_fw_Radar_1R1V_rpc_XilObjBypassingRunnable_XilObjBypassingRunnable_m_pad_radarObjPort_par_out_local.TChangeableMemPool._._._m_arrayPool._0_._elem._m_objectInformation._9_._m_perObjectType._m_prob1FourWheelUnknownN "" VALUE 0xB00575A6 __UByte_Value 0 NO_COMPU_METHOD 0 255 ECU_ADDRESS_EXTENSION 0x1 BYTE_ORDER MSB_LAST /end CHARACTERISTIC
/begin CHARACTERISTIC _g_PL_AD_fw_Radar_1R1V_rpc_XilObjBypassingRunnable_XilObjBypassingRunnable_m_pad_radarObjPort_par_out_local.TChangeableMemPool._._._m_arrayPool._0_._elem._m_objectInformation._9_._m_perObjectType._m_prob1MobileN "" VALUE 0xB005759B __UByte_Value 0 NO_COMPU_METHOD 0 255 ECU_ADDRESS_EXTENSION 0x1 BYTE_ORDER MSB_LAST /end CHARACTERISTIC
/begin CHARACTERISTIC _g_PL_AD_fw_Radar_1R1V_rpc_XilObjBypassingRunnable_XilObjBypassingRunnable_m_pad_radarObjPort_par_out_local.TChangeableMemPool._._._m_arrayPool._0_._elem._m_objectInformation._9_._m_perObjectType._m_prob1MovUnknownN "" VALUE 0xB00575A1 __UByte_Value 0 NO_COMPU_METHOD 0 255 ECU_ADDRESS_EXTENSION 0x1 BYTE_ORDER MSB_LAST /end CHARACTERISTIC
/begin CHARACTERISTIC _g_PL_AD_fw_Radar_1R1V_rpc_XilObjBypassingRunnable_XilObjBypassingRunnable_m_pad_radarObjPort_par_out_local.TChangeableMemPool._._._m_arrayPool._0_._elem._m_objectInformation._9_._m_perObjectType._m_prob1NonObstacleN "" VALUE 0xB0057599 __UByte_Value 0 NO_COMPU_METHOD 0 255 ECU_ADDRESS_EXTENSION 0x1 BYTE_ORDER MSB_LAST /end CHARACTERISTIC
/begin CHARACTERISTIC _g_PL_AD_fw_Radar_1R1V_rpc_XilObjBypassingRunnable_XilObjBypassingRunnable_m_pad_radarObjPort_par_out_local.TChangeableMemPool._._._m_arrayPool._0_._elem._m_objectInformation._9_._m_perObjectType._m_prob1ObstUnknownN "" VALUE 0xB005759D __UByte_Value 0 NO_COMPU_METHOD 0 255 ECU_ADDRESS_EXTENSION 0x1 BYTE_ORDER MSB_LAST /end CHARACTERISTIC
/begin CHARACTERISTIC _g_PL_AD_fw_Radar_1R1V_rpc_XilObjBypassingRunnable_XilObjBypassingRunnable_m_pad_radarObjPort_par_out_local.TChangeableMemPool._._._m_arrayPool._0_._elem._m_objectInformation._9_._m_perObjectType._m_prob1ObstacleN "" VALUE 0xB0057598 __UByte_Value 0 NO_COMPU_METHOD 0 255 ECU_ADDRESS_EXTENSION 0x1 BYTE_ORDER MSB_LAST /end CHARACTERISTIC
/begin CHARACTERISTIC _g_PL_AD_fw_Radar_1R1V_rpc_XilObjBypassingRunnable_XilObjBypassingRunnable_m_pad_radarObjPort_par_out_local.TChangeableMemPool._._._m_arrayPool._0_._elem._m_objectInformation._9_._m_perObjectType._m_prob1PassengerCarN "" VALUE 0xB00575A4 __UByte_Value 0 NO_COMPU_METHOD 0 255 ECU_ADDRESS_EXTENSION 0x1 BYTE_ORDER MSB_LAST /end CHARACTERISTIC
/begin CHARACTERISTIC _g_PL_AD_fw_Radar_1R1V_rpc_XilObjBypassingRunnable_XilObjBypassingRunnable_m_pad_radarObjPort_par_out_local.TChangeableMemPool._._._m_arrayPool._0_._elem._m_objectInformation._9_._m_perObjectType._m_prob1PedestrianN "" VALUE 0xB00575A0 __UByte_Value 0 NO_COMPU_METHOD 0 255 ECU_ADDRESS_EXTENSION 0x1 BYTE_ORDER MSB_LAST /end CHARACTERISTIC
/begin CHARACTERISTIC _g_PL_AD_fw_Radar_1R1V_rpc_XilObjBypassingRunnable_XilObjBypassingRunnable_m_pad_radarObjPort_par_out_local.TChangeableMemPool._._._m_arrayPool._0_._elem._m_objectInformation._9_._m_perObjectType._m_prob1RoadsideBarrierN "" VALUE 0xB00575A2 __UByte_Value 0 NO_COMPU_METHOD 0 255 ECU_ADDRESS_EXTENSION 0x1 BYTE_ORDER MSB_LAST /end CHARACTERISTIC
/begin CHARACTERISTIC _g_PL_AD_fw_Radar_1R1V_rpc_XilObjBypassingRunnable_XilObjBypassingRunnable_m_pad_radarObjPort_par_out_local.TChangeableMemPool._._._m_arrayPool._0_._elem._m_objectInformation._9_._m_perObjectType._m_prob1StatUnknownN "" VALUE 0xB00575A3 __UByte_Value 0 NO_COMPU_METHOD 0 255 ECU_ADDRESS_EXTENSION 0x1 BYTE_ORDER MSB_LAST /end CHARACTERISTIC
/begin CHARACTERISTIC _g_PL_AD_fw_Radar_1R1V_rpc_XilObjBypassingRunnable_XilObjBypassingRunnable_m_pad_radarObjPort_par_out_local.TChangeableMemPool._._._m_arrayPool._0_._elem._m_objectInformation._9_._m_perObjectType._m_prob1StationaryN "" VALUE 0xB005759C __UByte_Value 0 NO_COMPU_METHOD 0 255 ECU_ADDRESS_EXTENSION 0x1 BYTE_ORDER MSB_LAST /end CHARACTERISTIC
/begin CHARACTERISTIC _g_PL_AD_fw_Radar_1R1V_rpc_XilObjBypassingRunnable_XilObjBypassingRunnable_m_pad_radarObjPort_par_out_local.TChangeableMemPool._._._m_arrayPool._0_._elem._m_objectInformation._9_._m_perObjectType._m_prob1TruckN "" VALUE 0xB00575A5 __UByte_Value 0 NO_COMPU_METHOD 0 255 ECU_ADDRESS_EXTENSION 0x1 BYTE_ORDER MSB_LAST /end CHARACTERISTIC
/begin CHARACTERISTIC _g_PL_AD_fw_Radar_1R1V_rpc_XilObjBypassingRunnable_XilObjBypassingRunnable_m_pad_radarObjPort_par_out_local.TChangeableMemPool._._._m_arrayPool._0_._elem._m_objectInformation._9_._m_perObjectType._m_prob1TwoWheelerN "" VALUE 0xB005759F __UByte_Value 0 NO_COMPU_METHOD 0 255 ECU_ADDRESS_EXTENSION 0x1 BYTE_ORDER MSB_LAST /end CHARACTERISTIC
/begin CHARACTERISTIC _g_PL_AD_fw_Radar_1R1V_rpc_XilObjBypassingRunnable_XilObjBypassingRunnable_m_pad_radarObjPort_par_out_local.TChangeableMemPool._._._m_arrayPool._0_._elem._m_objectInformation._9_._m_perObjectType._m_prob1UnknownN "" VALUE 0xB005759A __UByte_Value 0 NO_COMPU_METHOD 0 255 ECU_ADDRESS_EXTENSION 0x1 BYTE_ORDER MSB_LAST /end CHARACTERISTIC
/begin CHARACTERISTIC _g_PL_AD_fw_Radar_1R1V_rpc_XilObjBypassingRunnable_XilObjBypassingRunnable_m_pad_radarObjPort_par_out_local.TChangeableMemPool._._._m_arrayPool._0_._elem._m_objectInformation._9_._m_prob1HasBeenObservedMovingN "" VALUE 0xB00575E1 __UByte_Value 0 NO_COMPU_METHOD 0 255 ECU_ADDRESS_EXTENSION 0x1 BYTE_ORDER MSB_LAST /end CHARACTERISTIC
/begin CHARACTERISTIC _g_PL_AD_fw_Radar_1R1V_rpc_XilObjBypassingRunnable_XilObjBypassingRunnable_m_pad_radarObjPort_par_out_local.TChangeableMemPool._._._m_arrayPool._0_._elem._m_objectInformation._9_._m_prob1MovingN "" VALUE 0xB00575E0 __UByte_Value 0 NO_COMPU_METHOD 0 255 ECU_ADDRESS_EXTENSION 0x1 BYTE_ORDER MSB_LAST /end CHARACTERISTIC
/begin CHARACTERISTIC _g_PL_AD_fw_Radar_1R1V_rpc_XilObjBypassingRunnable_XilObjBypassingRunnable_m_pad_radarObjPort_par_out_local.TChangeableMemPool._._._m_arrayPool._0_._elem._m_objectInformation._9_._m_varAxN "" VALUE 0xB00575BC __SLong_Value 0 NO_COMPU_METHOD -2147483648 2147483647 ECU_ADDRESS_EXTENSION 0x1 BYTE_ORDER MSB_LAST /end CHARACTERISTIC
/begin CHARACTERISTIC _g_PL_AD_fw_Radar_1R1V_rpc_XilObjBypassingRunnable_XilObjBypassingRunnable_m_pad_radarObjPort_par_out_local.TChangeableMemPool._._._m_arrayPool._0_._elem._m_objectInformation._9_._m_varAyN "" VALUE 0xB00575C0 __SLong_Value 0 NO_COMPU_METHOD -2147483648 2147483647 ECU_ADDRESS_EXTENSION 0x1 BYTE_ORDER MSB_LAST /end CHARACTERISTIC
/begin CHARACTERISTIC _g_PL_AD_fw_Radar_1R1V_rpc_XilObjBypassingRunnable_XilObjBypassingRunnable_m_pad_radarObjPort_par_out_local.TChangeableMemPool._._._m_arrayPool._0_._elem._m_objectInformation._9_._m_varDxN "" VALUE 0xB00575AC __SLong_Value 0 NO_COMPU_METHOD -2147483648 2147483647 ECU_ADDRESS_EXTENSION 0x1 BYTE_ORDER MSB_LAST /end CHARACTERISTIC
/begin CHARACTERISTIC _g_PL_AD_fw_Radar_1R1V_rpc_XilObjBypassingRunnable_XilObjBypassingRunnable_m_pad_radarObjPort_par_out_local.TChangeableMemPool._._._m_arrayPool._0_._elem._m_objectInformation._9_._m_varDyN "" VALUE 0xB00575B0 __SLong_Value 0 NO_COMPU_METHOD -2147483648 2147483647 ECU_ADDRESS_EXTENSION 0x1 BYTE_ORDER MSB_LAST /end CHARACTERISTIC
/begin CHARACTERISTIC _g_PL_AD_fw_Radar_1R1V_rpc_XilObjBypassingRunnable_XilObjBypassingRunnable_m_pad_radarObjPort_par_out_local.TChangeableMemPool._._._m_arrayPool._0_._elem._m_objectInformation._9_._m_varVxN "" VALUE 0xB00575B4 __SLong_Value 0 NO_COMPU_METHOD -2147483648 2147483647 ECU_ADDRESS_EXTENSION 0x1 BYTE_ORDER MSB_LAST /end CHARACTERISTIC
/begin CHARACTERISTIC _g_PL_AD_fw_Radar_1R1V_rpc_XilObjBypassingRunnable_XilObjBypassingRunnable_m_pad_radarObjPort_par_out_local.TChangeableMemPool._._._m_arrayPool._0_._elem._m_objectInformation._9_._m_varVyN "" VALUE 0xB00575B8 __SLong_Value 0 NO_COMPU_METHOD -2147483648 2147483647 ECU_ADDRESS_EXTENSION 0x1 BYTE_ORDER MSB_LAST /end CHARACTERISTIC
/begin CHARACTERISTIC _g_PL_AD_fw_Radar_1R1V_rpc_XilObjBypassingRunnable_XilObjBypassingRunnable_m_pad_radarObjPort_par_out_local.TChangeableMemPool._._._m_arrayPool._0_._elem._m_objectInformation._9_._m_vxN "" VALUE 0xB00575CA __SWord_Value 0 NO_COMPU_METHOD -32768 32767 ECU_ADDRESS_EXTENSION 0x1 BYTE_ORDER MSB_LAST /end CHARACTERISTIC
/begin CHARACTERISTIC _g_PL_AD_fw_Radar_1R1V_rpc_XilObjBypassingRunnable_XilObjBypassingRunnable_m_pad_radarObjPort_par_out_local.TChangeableMemPool._._._m_arrayPool._0_._elem._m_objectInformation._9_._m_vyN "" VALUE 0xB00575CC __SWord_Value 0 NO_COMPU_METHOD -32768 32767 ECU_ADDRESS_EXTENSION 0x1 BYTE_ORDER MSB_LAST /end CHARACTERISTIC
/begin CHARACTERISTIC _g_PL_AD_fw_Radar_1R1V_rpc_XilObjBypassingRunnable_XilObjBypassingRunnable_m_pad_radarObjPort_par_out_local.TChangeableMemPool._._._m_arrayPool._0_._elem._m_objectInformation._9_._m_wExistProbN "" VALUE 0xB00575DE __UWord_Value 0 NO_COMPU_METHOD 0 65535 ECU_ADDRESS_EXTENSION 0x1 BYTE_ORDER MSB_LAST /end CHARACTERISTIC
/begin MEASUREMENT _g_PL_AD_fw_fal_rpc_apl_PER_PerSppEnvRunnable_PerSppEnvRunnable_m_CameraSensor_Events_out_local.m_sequenceNumber "" UWORD NO_COMPU_METHOD 0 0 0 65535 BYTE_ORDER MSB_LAST ECU_ADDRESS 0x5000A2F2 ECU_ADDRESS_EXTENSION 0x4 /end MEASUREMENT
/begin MEASUREMENT _g_PL_AD_fw_fal_rpc_apl_PER_PerSppEnvRunnable_PerSppEnvRunnable_m_FrontCornerRadar_Events_out_local.m_sequenceNumber "" UWORD NO_COMPU_METHOD 0 0 0 65535 BYTE_ORDER MSB_LAST ECU_ADDRESS 0x5000A31E ECU_ADDRESS_EXTENSION 0x4 /end MEASUREMENT
/begin MEASUREMENT _g_PL_AD_fw_fal_rpc_apl_PER_PerSppEnvRunnable_PerSppEnvRunnable_m_ensRObjFLSensorPort_out_local.m_sequenceNumber "" UWORD NO_COMPU_METHOD 0 0 0 65535 BYTE_ORDER MSB_LAST ECU_ADDRESS 0x7000E382 ECU_ADDRESS_EXTENSION 0x1 /end MEASUREMENT
/begin MEASUREMENT _g_PL_AD_fw_fal_rpc_apl_PER_PerSppEnvRunnable_PerSppEnvRunnable_m_ensRObjFRSensorPort_out_local.m_sequenceNumber "" UWORD NO_COMPU_METHOD 0 0 0 65535 BYTE_ORDER MSB_LAST ECU_ADDRESS 0x7000F2DE ECU_ADDRESS_EXTENSION 0x1 /end MEASUREMENT
/begin MEASUREMENT _g_PL_AD_fw_fal_rpc_apl_PER_PerSppEnvRunnable_PerSppEnvRunnable_m_ensVLanesPort_out_local.m_sequenceNumber "" UWORD NO_COMPU_METHOD 0 0 0 65535 BYTE_ORDER MSB_LAST ECU_ADDRESS 0xB0012AE2 ECU_ADDRESS_EXTENSION 0x2 /end MEASUREMENT
/begin MEASUREMENT _g_PL_AD_fw_fal_rpc_apl_PER_PerSppEnvRunnable_PerSppEnvRunnable_m_ensVObjFCSensorPort_out_local.m_sequenceNumber "" UWORD NO_COMPU_METHOD 0 0 0 65535 BYTE_ORDER MSB_LAST ECU_ADDRESS 0xB00208A2 ECU_ADDRESS_EXTENSION 0x4 /end MEASUREMENT
/begin MEASUREMENT _g_PL_AD_fw_fsi_fsi_apl_net_apl_g_netRunnable_m_NetRx_RadarFL_Private_CANFD_RFL_Status_SenderPort_local.m_sequenceNumber "" UWORD NO_COMPU_METHOD 0 0 0 65535 BYTE_ORDER MSB_LAST ECU_ADDRESS 0xB0056D76 ECU_ADDRESS_EXTENSION 0x1 /end MEASUREMENT
/begin MEASUREMENT _g_PL_AD_fw_fsi_fsi_apl_net_apl_g_netRunnable_m_NetRx_RadarFR_Private_CANFD_RFR_Status_SenderPort_local.m_sequenceNumber "" UWORD NO_COMPU_METHOD 0 0 0 65535 BYTE_ORDER MSB_LAST ECU_ADDRESS 0xB0056DDA ECU_ADDRESS_EXTENSION 0x1 /end MEASUREMENT
/begin MEASUREMENT _g_PL_AD_fw_fsi_fsi_apl_net_apl_g_netRunnable_m_NetRx_VideoPrivate_CANFD_VFC_Status_SenderPort_local.m_sequenceNumber "" UWORD NO_COMPU_METHOD 0 0 0 65535 BYTE_ORDER MSB_LAST ECU_ADDRESS 0x5000A36A ECU_ADDRESS_EXTENSION 0x4 /end MEASUREMENT
/begin MEASUREMENT _g_PL_AD_fw_fsi_fsi_apl_net_apl_g_netRunnable_rbDyNet_RFL_Obj_serializer_m_CNetRFL_OBJ_SenderPort_local.m_sequenceNumber "" UWORD NO_COMPU_METHOD 0 0 0 65535 BYTE_ORDER MSB_LAST ECU_ADDRESS 0xB009B0FE ECU_ADDRESS_EXTENSION 0x2 /end MEASUREMENT
/begin MEASUREMENT _g_PL_AD_fw_fsi_fsi_apl_net_apl_g_netRunnable_rbDyNet_RFR_Obj_serializer_m_CNetRFR_OBJ_SenderPort_local.m_sequenceNumber "" UWORD NO_COMPU_METHOD 0 0 0 65535 BYTE_ORDER MSB_LAST ECU_ADDRESS 0xB009C092 ECU_ADDRESS_EXTENSION 0x2 /end MEASUREMENT
/begin MEASUREMENT _g_PL_AD_fw_fsi_fsi_apl_net_apl_g_netRunnable_rbDyNet_VFC_Obj_serializer_m_CNetVFC_Obj_SenderPort_local.m_sequenceNumber "" UWORD NO_COMPU_METHOD 0 0 0 65535 BYTE_ORDER MSB_LAST ECU_ADDRESS 0xB00114AA ECU_ADDRESS_EXTENSION 0x2 /end MEASUREMENT
/begin MEASUREMENT _g_PL_AD_fw_fsi_fsi_apl_net_apl_g_netRunnable_rbDyNet_VFC_Road_serializer_m_CNetVFC_Road_SenderPort_local.m_sequenceNumber "" UWORD NO_COMPU_METHOD 0 0 0 65535 BYTE_ORDER MSB_LAST ECU_ADDRESS 0x60017B4A ECU_ADDRESS_EXTENSION 0x2 /end MEASUREMENT
/begin CHARACTERISTIC _g_prm_resource_ram_apl._m_clusters._m_FctParam_AebCommon._m_current._m_classA._m_aebEncodingBypass "" VALUE 0x70019511 __UByte_Value 0 NO_COMPU_METHOD 0 255 ECU_ADDRESS_EXTENSION 0x1 BYTE_ORDER MSB_LAST /end CHARACTERISTIC
/begin CHARACTERISTIC _g_prm_resource_ram_apl._m_clusters._m_FctParam_AebCommon._m_current._m_classA._m_aebHMISwitchBypass "" VALUE 0x70019512 __UByte_Value 0 NO_COMPU_METHOD 0 255 ECU_ADDRESS_EXTENSION 0x1 BYTE_ORDER MSB_LAST /end CHARACTERISTIC
/begin CHARACTERISTIC _g_prm_resource_ram_apl._m_clusters._m_FctParam_AebCommon._m_current._m_classA._m_fcwHMISwitchBypass "" VALUE 0x70019514 __UByte_Value 0 NO_COMPU_METHOD 0 255 ECU_ADDRESS_EXTENSION 0x1 BYTE_ORDER MSB_LAST /end CHARACTERISTIC
/begin CHARACTERISTIC _g_prm_resource_ram_apl._m_clusters._m_FctParam_AebCommon._m_trigger._m_update "" VALUE 0x70019440 __UByte_Value 0 NO_COMPU_METHOD 0 255 ECU_ADDRESS_EXTENSION 0x1 BYTE_ORDER MSB_LAST /end CHARACTERISTIC
/begin COMPU_METHOD _Dcm_DsldGlobal_st._stResponseType_en.CONVERSION "@@@@RuleName created by CANape" TAB_VERB "%.0" "" COMPU_TAB_REF _Dcm_DsldGlobal_st._stResponseType_en.CONVERSION /end COMPU_METHOD
/begin COMPU_METHOD _Dcm_DsldTransmit_st._stDslNextState_en.CONVERSION "@@@@RuleName created by CANape" TAB_VERB "%.0" "" COMPU_TAB_REF _Dcm_DsldTransmit_st._stDslNextState_en.CONVERSION /end COMPU_METHOD
/begin COMPU_METHOD _Dcm_DspDataInfo_st._0_._usePort.CONVERSION "enumeration table" TAB_VERB "%.0" "" COMPU_TAB_REF _Dcm_DspDataInfo_st._0_._usePort.CONVERSION /end COMPU_METHOD
/begin COMPU_METHOD _Dcm_DspEcuResetType_cast._0_._resetForBoot.CONVERSION "@@@@RuleName created by CANape" TAB_VERB "%.0" "" COMPU_TAB_REF _Dcm_DspEcuResetType_cast._0_._resetForBoot.CONVERSION /end COMPU_METHOD
/begin COMPU_METHOD _Dcm_DspRDTCState_en.CONVERSION "@@@@RuleName created by CANape" TAB_VERB "%.0" "" COMPU_TAB_REF _Dcm_DspRDTCState_en.CONVERSION /end COMPU_METHOD
/begin COMPU_METHOD _Dcm_DspRDTCSubFunc_en.CONVERSION "@@@@RuleName created by CANape" TAB_VERB "%.0" "" COMPU_TAB_REF _Dcm_DspRDTCSubFunc_en.CONVERSION /end COMPU_METHOD
/begin COMPU_METHOD _Dcm_Dsp_Session._3_._sessionForBoot.CONVERSION "@@@@RuleName created by CANape" TAB_VERB "%.0" "" COMPU_TAB_REF _Dcm_Dsp_Session._3_._sessionForBoot.CONVERSION /end COMPU_METHOD
/begin COMPU_METHOD _Dcm_GetDataState_en.CONVERSION "@@@@RuleName created by CANape" TAB_VERB "%.0" "" COMPU_TAB_REF _Dcm_GetDataState_en.CONVERSION /end COMPU_METHOD
/begin COMPU_METHOD _Dcm_RoutineStatus_aen._2_.CONVERSION "@@@@RuleName created by CANape" TAB_VERB "%.0" "" COMPU_TAB_REF _Dcm_RoutineStatus_aen._2_.CONVERSION /end COMPU_METHOD
/begin COMPU_METHOD _Dcm_StLenCalc_en.CONVERSION "@@@@RuleName created by CANape" TAB_VERB "%.0" "" COMPU_TAB_REF _Dcm_StLenCalc_en.CONVERSION /end COMPU_METHOD
/begin COMPU_METHOD _Dcm_active_commode_e._0_._ComMState.CONVERSION "@@@@RuleName created by CANape" TAB_VERB "%.0" "" COMPU_TAB_REF _Dcm_active_commode_e._0_._ComMState.CONVERSION /end COMPU_METHOD
/begin COMPU_METHOD _Dcm_stDsc_en.CONVERSION "@@@@RuleName created by CANape" TAB_VERB "%.0" "" COMPU_TAB_REF _Dcm_stDsc_en.CONVERSION /end COMPU_METHOD
/begin COMPU_METHOD _Dcm_stDspRCState_en.CONVERSION "@@@@RuleName created by CANape" TAB_VERB "%.0" "" COMPU_TAB_REF _Dcm_stDspRCState_en.CONVERSION /end COMPU_METHOD
/begin COMPU_METHOD _Dcm_stDspStateWDBI_en.CONVERSION "@@@@RuleName created by CANape" TAB_VERB "%.0" "" COMPU_TAB_REF _Dcm_stDspStateWDBI_en.CONVERSION /end COMPU_METHOD
/begin COMPU_METHOD _Dcm_stEcuResetState_en.CONVERSION "@@@@RuleName created by CANape" TAB_VERB "%.0" "" COMPU_TAB_REF _Dcm_stEcuResetState_en.CONVERSION /end COMPU_METHOD
/begin COMPU_METHOD _Dcm_stRdbi_en.CONVERSION "@@@@RuleName created by CANape" TAB_VERB "%.0" "" COMPU_TAB_REF _Dcm_stRdbi_en.CONVERSION /end COMPU_METHOD
/begin COMPU_METHOD _EcuSh_RequestedState_N.CONVERSION "@@@@RuleName created by CANape" TAB_VERB "%.0" "" COMPU_TAB_REF _EcuSh_RequestedState_N.CONVERSION /end COMPU_METHOD
/begin COMPU_METHOD _Fee_Prv_DriverState_en.CONVERSION "enumeration table" TAB_VERB "%.0" "" COMPU_TAB_REF _Fee_Prv_DriverState_en.CONVERSION /end COMPU_METHOD
/begin COMPU_METHOD _Fee_Prv_MediumLoad_st._state_en.CONVERSION "@@@@RuleName created by CANape" TAB_VERB "%.0" "" COMPU_TAB_REF _Fee_Prv_MediumLoad_st._state_en.CONVERSION /end COMPU_METHOD
/begin COMPU_METHOD _Fee_Prv_MediumWrite_st._state_en.CONVERSION "@@@@RuleName created by CANape" TAB_VERB "%.0" "" COMPU_TAB_REF _Fee_Prv_MediumWrite_st._state_en.CONVERSION /end COMPU_METHOD
/begin COMPU_METHOD _Fee_Prv_Order_st._firstInitMigrationResult_aen._9_.CONVERSION "@@@@RuleName created by CANape" TAB_VERB "%.0" "" COMPU_TAB_REF _Fee_Prv_Order_st._firstInitMigrationResult_aen._9_.CONVERSION /end COMPU_METHOD
/begin COMPU_METHOD _Fee_Prv_Order_st._jobs_ast._2_._type_en.CONVERSION "@@@@RuleName created by CANape" TAB_VERB "%.0" "" COMPU_TAB_REF _Fee_Prv_Order_st._jobs_ast._2_._type_en.CONVERSION /end COMPU_METHOD
/begin COMPU_METHOD _Fee_stMain.CONVERSION "@@@@RuleName created by CANape" TAB_VERB "%.0" "" COMPU_TAB_REF _Fee_stMain.CONVERSION /end COMPU_METHOD
/begin COMPU_METHOD _Fls_Mode.CONVERSION "@@@@RuleName created by CANape" TAB_VERB "%.0" "" COMPU_TAB_REF _Fls_Mode.CONVERSION /end COMPU_METHOD
/begin COMPU_METHOD _Fls_Rb_Order_st._1_._OrderType_en.CONVERSION "@@@@RuleName created by CANape" TAB_VERB "%.0" "" COMPU_TAB_REF _Fls_Rb_Order_st._1_._OrderType_en.CONVERSION /end COMPU_METHOD
/begin COMPU_METHOD _Fls_Rb_stSuspend_en.CONVERSION "@@@@RuleName created by CANape" TAB_VERB "%.0" "" COMPU_TAB_REF _Fls_Rb_stSuspend_en.CONVERSION /end COMPU_METHOD
/begin COMPU_METHOD _Fls_stMain.CONVERSION "@@@@RuleName created by CANape" TAB_VERB "%.0" "" COMPU_TAB_REF _Fls_stMain.CONVERSION /end COMPU_METHOD
/begin COMPU_METHOD _IpduM_TxRamData._0_._TxState.CONVERSION "@@@@RuleName created by CANape" TAB_VERB "%.0" "" COMPU_TAB_REF _IpduM_TxRamData._0_._TxState.CONVERSION /end COMPU_METHOD
/begin COMPU_METHOD _IpduM_Uninit_Flag.CONVERSION "@@@@RuleName created by CANape" TAB_VERB "%.0" "" COMPU_TAB_REF _IpduM_Uninit_Flag.CONVERSION /end COMPU_METHOD
/begin COMPU_METHOD _NvM_Prv_AuxMigrationResult.CONVERSION "@@@@RuleName created by CANape" TAB_VERB "%.0" "" COMPU_TAB_REF _NvM_Prv_AuxMigrationResult.CONVERSION /end COMPU_METHOD
/begin COMPU_METHOD _NvM_Prv_BlockDescriptors_acst._9_._BlockManagementType_en.CONVERSION "@@@@RuleName created by CANape" TAB_VERB "%.0" "" COMPU_TAB_REF _NvM_Prv_BlockDescriptors_acst._9_._BlockManagementType_en.CONVERSION /end COMPU_METHOD
/begin COMPU_METHOD _NvM_Prv_Main_st._Activity_rAMwM_en.CONVERSION "@@@@RuleName created by CANape" TAB_VERB "%.0" "" COMPU_TAB_REF _NvM_Prv_Main_st._Activity_rAMwM_en.CONVERSION /end COMPU_METHOD
/begin COMPU_METHOD _NvM_Prv_Main_st._idActiveJob_rMwM_en.CONVERSION "@@@@RuleName created by CANape" TAB_VERB "%.0" "" COMPU_TAB_REF _NvM_Prv_Main_st._idActiveJob_rMwM_en.CONVERSION /end COMPU_METHOD
/begin COMPU_METHOD _NvM_Prv_Main_st._stActiveJobResult_rMwM_en.CONVERSION "@@@@RuleName created by CANape" TAB_VERB "%.0" "" COMPU_TAB_REF _NvM_Prv_Main_st._stActiveJobResult_rMwM_en.CONVERSION /end COMPU_METHOD
/begin COMPU_METHOD _Os_StackLog_st._Reason.CONVERSION "@@@@RuleName created by CANape" TAB_VERB "%.0" "" COMPU_TAB_REF _Os_StackLog_st._Reason.CONVERSION /end COMPU_METHOD
/begin COMPU_METHOD _Os_const_spinlocks._4_._extra_lock.CONVERSION "@@@@RuleName created by CANape" TAB_VERB "%.0" "" COMPU_TAB_REF _Os_const_spinlocks._4_._extra_lock.CONVERSION /end COMPU_METHOD
/begin COMPU_METHOD _Os_dyn_appstate._3_.CONVERSION "@@@@RuleName created by CANape" TAB_VERB "%.0" "" COMPU_TAB_REF _Os_dyn_appstate._3_.CONVERSION /end COMPU_METHOD
/begin COMPU_METHOD _PduR_State.CONVERSION "@@@@RuleName created by CANape" TAB_VERB "%.0" "" COMPU_TAB_REF _PduR_State.CONVERSION /end COMPU_METHOD
/begin COMPU_METHOD _Port_Detailled_Cfg._0_._iocr.CONVERSION "enumeration table" TAB_VERB "%.0" "" COMPU_TAB_REF _Port_Detailled_Cfg._0_._iocr.CONVERSION /end COMPU_METHOD
/begin COMPU_METHOD _StbM_Cfg_LocalTimeClockArray_ast._0_._StbMLocalTimeHardware_e.CONVERSION "enumeration table" TAB_VERB "%.0" "" COMPU_TAB_REF _StbM_Cfg_LocalTimeClockArray_ast._0_._StbMLocalTimeHardware_e.CONVERSION /end COMPU_METHOD
/begin COMPU_METHOD _StbM_Cfg_SynchronizedTimeBaseArray_ast._0_._StbMState_e.CONVERSION "enumeration table" TAB_VERB "%.0" "" COMPU_TAB_REF _StbM_Cfg_SynchronizedTimeBaseArray_ast._0_._StbMState_e.CONVERSION /end COMPU_METHOD
/begin COMPU_METHOD _StbM_Cfg_SynchronizedTimeBaseArray_ast._0_._StoreTimebaseNonVolatile_e.CONVERSION "enumeration table" TAB_VERB "%.0" "" COMPU_TAB_REF _StbM_Cfg_SynchronizedTimeBaseArray_ast._0_._StoreTimebaseNonVolatile_e.CONVERSION /end COMPU_METHOD
/begin COMPU_METHOD _Xcp_Cleared._0_._BgActivityState.CONVERSION "@@@@RuleName created by CANape" TAB_VERB "%.0" "" COMPU_TAB_REF _Xcp_Cleared._0_._BgActivityState.CONVERSION /end COMPU_METHOD
/begin COMPU_METHOD _Xcp_NoInit._0_._DaqConfig._DaqState_en.CONVERSION "@@@@RuleName created by CANape" TAB_VERB "%.0" "" COMPU_TAB_REF _Xcp_NoInit._0_._DaqConfig._DaqState_en.CONVERSION /end COMPU_METHOD
/begin COMPU_METHOD _Xcp_NoInit._0_._Session._XcpState_en.CONVERSION "enumeration table" TAB_VERB "%.0" "" COMPU_TAB_REF _Xcp_NoInit._0_._Session._XcpState_en.CONVERSION /end COMPU_METHOD
/begin COMPU_METHOD _Xcp_PlCfgConst._DaqRamCfg._0_._RamSectionType_en.CONVERSION "@@@@RuleName created by CANape" TAB_VERB "%.0" "" COMPU_TAB_REF _Xcp_PlCfgConst._DaqRamCfg._0_._RamSectionType_en.CONVERSION /end COMPU_METHOD
/begin COMPU_METHOD _Xcp_PlCfgConst._TlCfg._0_._Consistency_en.CONVERSION "enumeration table" TAB_VERB "%.0" "" COMPU_TAB_REF _Xcp_PlCfgConst._TlCfg._0_._Consistency_en.CONVERSION /end COMPU_METHOD
/begin COMPU_METHOD _Xcp_PlCfgConst._TlCfg._0_._IdFieldType_en.CONVERSION "@@@@RuleName created by CANape" TAB_VERB "%.0" "" COMPU_TAB_REF _Xcp_PlCfgConst._TlCfg._0_._IdFieldType_en.CONVERSION /end COMPU_METHOD
/begin COMPU_METHOD _Xcp_PlCfgConst._TlCfg._0_._OdtOptimizationType_en.CONVERSION "@@@@RuleName created by CANape" TAB_VERB "%.0" "" COMPU_TAB_REF _Xcp_PlCfgConst._TlCfg._0_._OdtOptimizationType_en.CONVERSION /end COMPU_METHOD
/begin COMPU_METHOD _Xcp_PlCfgConst._TlCfg._0_._OverloadType_en.CONVERSION "@@@@RuleName created by CANape" TAB_VERB "%.0" "" COMPU_TAB_REF _Xcp_PlCfgConst._TlCfg._0_._OverloadType_en.CONVERSION /end COMPU_METHOD
/begin COMPU_METHOD _Xcp_PlCfgConst._TlCfg._0_._TimestampType_en.CONVERSION "@@@@RuleName created by CANape" TAB_VERB "%.0" "" COMPU_TAB_REF _Xcp_PlCfgConst._TlCfg._0_._TimestampType_en.CONVERSION /end COMPU_METHOD
/begin COMPU_METHOD _bistmgr_DebugInfoAndStatus_st._lBist_en.CONVERSION "enumeration table" TAB_VERB "%.0" "" COMPU_TAB_REF _bistmgr_DebugInfoAndStatus_st._lBist_en.CONVERSION /end COMPU_METHOD
/begin COMPU_METHOD _bistmgr_DebugInfoAndStatus_st._mBist_en.CONVERSION "enumeration table" TAB_VERB "%.0" "" COMPU_TAB_REF _bistmgr_DebugInfoAndStatus_st._mBist_en.CONVERSION /end COMPU_METHOD
/begin COMPU_METHOD _bistmgr_DebugInfoAndStatus_st._monBist_en.CONVERSION "enumeration table" TAB_VERB "%.0" "" COMPU_TAB_REF _bistmgr_DebugInfoAndStatus_st._monBist_en.CONVERSION /end COMPU_METHOD
/begin COMPU_METHOD _bistmgr_State_en.CONVERSION "enumeration table" TAB_VERB "%.0" "" COMPU_TAB_REF _bistmgr_State_en.CONVERSION /end COMPU_METHOD
/begin COMPU_METHOD _g_1R1VApl_FCT_fsm_fsm._m_stateMachineController._m_accControlUnit._m_inputElementConfiguration._m_mainSwitch._m_currentAction.CONVERSION "@@@@RuleName created by CANape" TAB_VERB "%.0" "" COMPU_TAB_REF _g_1R1VApl_FCT_fsm_fsm._m_stateMachineController._m_accControlUnit._m_inputElementConfiguration._m_mainSwitch._m_currentAction.CONVERSION /end COMPU_METHOD
/begin COMPU_METHOD _g_1R1VApl_FCT_fsm_fsm._m_stateMachineController._m_accControlUnit._m_inputElementConfiguration._m_timeGapButton._m_currentAction.CONVERSION "@@@@RuleName created by CANape" TAB_VERB "%.0" "" COMPU_TAB_REF _g_1R1VApl_FCT_fsm_fsm._m_stateMachineController._m_accControlUnit._m_inputElementConfiguration._m_timeGapButton._m_currentAction.CONVERSION /end COMPU_METHOD
/begin COMPU_METHOD _g_1R1VApl_FCT_fsm_fsm._m_stateMachineController._m_accControlUnit._m_inputElementConfiguration._m_timeGapButton._m_previousSignal.CONVERSION "@@@@RuleName created by CANape" TAB_VERB "%.0" "" COMPU_TAB_REF _g_1R1VApl_FCT_fsm_fsm._m_stateMachineController._m_accControlUnit._m_inputElementConfiguration._m_timeGapButton._m_previousSignal.CONVERSION /end COMPU_METHOD
/begin COMPU_METHOD _g_1R1VApl_FCT_fsm_fsm._m_stateMachineController._m_accControlUnit._m_overloadResolver._m_resolutionStrategy.CONVERSION "@@@@RuleName created by CANape" TAB_VERB "%.0" "" COMPU_TAB_REF _g_1R1VApl_FCT_fsm_fsm._m_stateMachineController._m_accControlUnit._m_overloadResolver._m_resolutionStrategy.CONVERSION /end COMPU_METHOD
/begin COMPU_METHOD _g_1R1VApl_FCT_fsm_fsm._m_stateMachineController._m_accControlUnit._m_setspeedController._m_currentSpeedUnit.CONVERSION "@@@@RuleName created by CANape" TAB_VERB "%.0" "" COMPU_TAB_REF _g_1R1VApl_FCT_fsm_fsm._m_stateMachineController._m_accControlUnit._m_setspeedController._m_currentSpeedUnit.CONVERSION /end COMPU_METHOD
/begin COMPU_METHOD _g_1R1VApl_FCT_fsm_fsm._m_stateMachineController._m_accControlUnit._m_timeGapLevelController._m_behaviour.CONVERSION "@@@@RuleName created by CANape" TAB_VERB "%.0" "" COMPU_TAB_REF _g_1R1VApl_FCT_fsm_fsm._m_stateMachineController._m_accControlUnit._m_timeGapLevelController._m_behaviour.CONVERSION /end COMPU_METHOD
/begin COMPU_METHOD _g_1R1VApl_FCT_fsm_fsm._m_stateMachineController._m_functionalInputProcessor._m_daCoreStateNotificationCalculator._m_DaCoreState.CONVERSION "@@@@RuleName created by CANape" TAB_VERB "%.0" "" COMPU_TAB_REF _g_1R1VApl_FCT_fsm_fsm._m_stateMachineController._m_functionalInputProcessor._m_daCoreStateNotificationCalculator._m_DaCoreState.CONVERSION /end COMPU_METHOD
/begin COMPU_METHOD _g_1R1VApl_FCT_fsm_fsm._m_stateMachineController._m_longSmBehaviorList._m_memory._m_values._4_.CONVERSION "@@@@RuleName created by CANape" TAB_VERB "%.0" "" COMPU_TAB_REF _g_1R1VApl_FCT_fsm_fsm._m_stateMachineController._m_longSmBehaviorList._m_memory._m_values._4_.CONVERSION /end COMPU_METHOD
/begin COMPU_METHOD _g_1R1VApl_FCT_fsm_fsm._m_stateMachineController._m_longStateMachine.StateMachine._._m_stateMachineType.CONVERSION "@@@@RuleName created by CANape" TAB_VERB "%.0" "" COMPU_TAB_REF _g_1R1VApl_FCT_fsm_fsm._m_stateMachineController._m_longStateMachine.StateMachine._._m_stateMachineType.CONVERSION /end COMPU_METHOD
/begin COMPU_METHOD _g_1R1VApl_FCT_fsm_fsm_m_requestedBehaviorsTipl_local.TMemPool._._._m_pool._m_values._0_._elem._m_dynamicParameters._m_setSpeedConfiguration.CONVERSION "@@@@RuleName created by CANape" TAB_VERB "%.0" "" COMPU_TAB_REF _g_1R1VApl_FCT_fsm_fsm_m_requestedBehaviorsTipl_local.TMemPool._._._m_pool._m_values._0_._elem._m_dynamicParameters._m_setSpeedConfiguration.CONVERSION /end COMPU_METHOD
/begin COMPU_METHOD _g_DACore_RPM_CRPMExecution_CRPMExecution_m_portActiveWarnings_local.TMemPool._._._m_pool._m_values._0_._elem._m_activeWarnings._m_memory._m_values._2_._m_type.CONVERSION "@@@@RuleName created by CANape" TAB_VERB "%.0" "" COMPU_TAB_REF _g_DACore_RPM_CRPMExecution_CRPMExecution_m_portActiveWarnings_local.TMemPool._._._m_pool._m_values._0_._elem._m_activeWarnings._m_memory._m_values._2_._m_type.CONVERSION /end COMPU_METHOD
/begin COMPU_METHOD _g_DACore_SIT_RunnableBehaviorStrategyTIPL_RunnableBehaviorStrategyTIPL._m_behaviorStrategyTIPL._m_currentWorldModel._m_tiplObjects._m_value._9_.SitPredictedObject._._m_objectType.CONVERSION "@@@@RuleName created by CANape" TAB_VERB "%.0" "" COMPU_TAB_REF _g_DACore_SIT_RunnableBehaviorStrategyTIPL_RunnableBehaviorStrategyTIPL._m_behaviorStrategyTIPL._m_currentWorldModel._m_tiplObjects._m_value._9_.SitPredictedObject._._m_objectType.CONVERSION /end COMPU_METHOD
/begin COMPU_METHOD _g_DACore_SIT_RunnableBehaviorStrategyTIPL_RunnableBehaviorStrategyTIPL_m_environmentDataTipl_out_local.TMemPool._._._m_pool._m_values._0_._elem._m_egoData._m_vehicleStandStill.CONVERSION "@@@@RuleName created by CANape" TAB_VERB "%.0" "" COMPU_TAB_REF _g_DACore_SIT_RunnableBehaviorStrategyTIPL_RunnableBehaviorStrategyTIPL_m_environmentDataTipl_out_local.TMemPool._._._m_pool._m_values._0_._elem._m_egoData._m_vehicleStandStill.CONVERSION /end COMPU_METHOD
/begin COMPU_METHOD _g_DACore_SIT_RunnableBehaviorStrategyTIPL_RunnableBehaviorStrategyTIPL_m_environmentDataTipl_out_local.TMemPool._._._m_pool._m_values._0_._elem._m_predictedObjects._m_value._9_._m_driveByCorridor._m_objectBorderRelationRight._laneBorderId.CONVERSION "@@@@RuleName created by CANape" TAB_VERB "%.0" "" COMPU_TAB_REF _g_DACore_SIT_RunnableBehaviorStrategyTIPL_RunnableBehaviorStrategyTIPL_m_environmentDataTipl_out_local.TMemPool._._._m_pool._m_values._0_._elem._m_predictedObjects._m_value._9_._m_driveByCorridor._m_objectBorderRelationRight._laneBorderId.CONVERSION /end COMPU_METHOD
/begin COMPU_METHOD _g_DACore_SIT_RunnableBehaviorStrategyTIPL_RunnableBehaviorStrategyTIPL_m_environmentDataTipl_out_local.TMemPool._._._m_pool._m_values._0_._elem._m_predictedObjects._m_value._9_._m_drivingTaskInformation._m_drivingTask.CONVERSION "@@@@RuleName created by CANape" TAB_VERB "%.0" "" COMPU_TAB_REF _g_DACore_SIT_RunnableBehaviorStrategyTIPL_RunnableBehaviorStrategyTIPL_m_environmentDataTipl_out_local.TMemPool._._._m_pool._m_values._0_._elem._m_predictedObjects._m_value._9_._m_drivingTaskInformation._m_drivingTask.CONVERSION /end COMPU_METHOD
/begin COMPU_METHOD _g_DACore_SIT_RunnableBehaviorStrategyTIPL_RunnableBehaviorStrategyTIPL_m_environmentDataTipl_out_local.TMemPool._._._m_pool._m_values._0_._elem._m_predictedObjects._m_value._9_._m_drivingTaskInformation._m_targetLaneIndex.CONVERSION "@@@@RuleName created by CANape" TAB_VERB "%.0" "" COMPU_TAB_REF _g_DACore_SIT_RunnableBehaviorStrategyTIPL_RunnableBehaviorStrategyTIPL_m_environmentDataTipl_out_local.TMemPool._._._m_pool._m_values._0_._elem._m_predictedObjects._m_value._9_._m_drivingTaskInformation._m_targetLaneIndex.CONVERSION /end COMPU_METHOD
/begin COMPU_METHOD _g_DACore_SIT_RunnableDmi_RunnableDmi._m_hostVehicleLaneInteractionManager._m_drivingTaskRecognition._m_observables._m_directionIndicator.CONVERSION "@@@@RuleName created by CANape" TAB_VERB "%.0" "" COMPU_TAB_REF _g_DACore_SIT_RunnableDmi_RunnableDmi._m_hostVehicleLaneInteractionManager._m_drivingTaskRecognition._m_observables._m_directionIndicator.CONVERSION /end COMPU_METHOD
/begin COMPU_METHOD _g_DACore_SIT_RunnableImbaFollowPrecedingObject_RunnableImbaFollowPrecedingObject._m_behaviorFollowPrecedingObjectWithLateralControl._m_lockOnTargetBehaviorSelector.Behavior2ImitateDecider._._m_selectedBehavior2Imitate._m_relations._m_value._2_._m_relatableElementIdentifiers._m_value._1_._m_typeId.CONVERSION "@@@@RuleName created by CANape" TAB_VERB "%.0" "" COMPU_TAB_REF _g_DACore_SIT_RunnableImbaFollowPrecedingObject_RunnableImbaFollowPrecedingObject._m_behaviorFollowPrecedingObjectWithLateralControl._m_lockOnTargetBehaviorSelector.Behavior2ImitateDecider._._m_selectedBehavior2Imitate._m_relations._m_value._2_._m_relatableElementIdentifiers._m_value._1_._m_typeId.CONVERSION /end COMPU_METHOD
/begin COMPU_METHOD _g_DACore_SIT_RunnableLmfAndOlr_RunnableLmfAndOlr._m_LmfAndOlr._m_drivingDirection._m_drivingDirectionData._m_value._2_._m_drivingDirection.CONVERSION "@@@@RuleName created by CANape" TAB_VERB "%.0" "" COMPU_TAB_REF _g_DACore_SIT_RunnableLmfAndOlr_RunnableLmfAndOlr._m_LmfAndOlr._m_drivingDirection._m_drivingDirectionData._m_value._2_._m_drivingDirection.CONVERSION /end COMPU_METHOD
/begin COMPU_METHOD _g_DACore_SIT_RunnableTiplTurnCoDriver_RunnableTiplTurnCoDriver_m_evaluatedBehaviors_out_local.TMemPool._._._m_pool._m_values._0_._elem._m_evalBehaviorList._m_value._0_._m_rpCalcResultList._m_value._0_._m_reactionPatterns._m_value._0_._m_behaviorSpecification._m_systemCapability.CONVERSION "@@@@RuleName created by CANape" TAB_VERB "%.0" "" COMPU_TAB_REF _g_DACore_SIT_RunnableTiplTurnCoDriver_RunnableTiplTurnCoDriver_m_evaluatedBehaviors_out_local.TMemPool._._._m_pool._m_values._0_._elem._m_evalBehaviorList._m_value._0_._m_rpCalcResultList._m_value._0_._m_reactionPatterns._m_value._0_._m_behaviorSpecification._m_systemCapability.CONVERSION /end COMPU_METHOD
/begin COMPU_METHOD _g_DACore_SIT_RunnableTiplTurnCoDriver_RunnableTiplTurnCoDriver_m_evaluatedBehaviors_out_local.TMemPool._._._m_pool._m_values._0_._elem._m_evalBehaviorList._m_value._0_._m_rpCalcResultList._m_value._0_._m_reactionPatterns._m_value._0_._m_corridor._m_dynamicRedBorders._m_memory._m_values._3_._m_vertexType.CONVERSION "@@@@RuleName created by CANape" TAB_VERB "%.0" "" COMPU_TAB_REF _g_DACore_SIT_RunnableTiplTurnCoDriver_RunnableTiplTurnCoDriver_m_evaluatedBehaviors_out_local.TMemPool._._._m_pool._m_values._0_._elem._m_evalBehaviorList._m_value._0_._m_rpCalcResultList._m_value._0_._m_reactionPatterns._m_value._0_._m_corridor._m_dynamicRedBorders._m_memory._m_values._3_._m_vertexType.CONVERSION /end COMPU_METHOD
/begin COMPU_METHOD _g_DACore_SIT_RunnableTiplTurnCoDriver_RunnableTiplTurnCoDriver_m_evaluatedBehaviors_out_local.TMemPool._._._m_pool._m_values._0_._elem._m_evalBehaviorList._m_value._0_._m_rpCalcResultList._m_value._0_._m_reactionPatterns._m_value._0_._m_corridor._m_guidanceConfiguration._m_drivingModeLongitudinal.CONVERSION "@@@@RuleName created by CANape" TAB_VERB "%.0" "" COMPU_TAB_REF _g_DACore_SIT_RunnableTiplTurnCoDriver_RunnableTiplTurnCoDriver_m_evaluatedBehaviors_out_local.TMemPool._._._m_pool._m_values._0_._elem._m_evalBehaviorList._m_value._0_._m_rpCalcResultList._m_value._0_._m_reactionPatterns._m_value._0_._m_corridor._m_guidanceConfiguration._m_drivingModeLongitudinal.CONVERSION /end COMPU_METHOD
/begin COMPU_METHOD _g_DACore_SIT_RunnableTiplTurnCoDriver_RunnableTiplTurnCoDriver_m_evaluatedBehaviors_out_local.TMemPool._._._m_pool._m_values._0_._elem._m_evalBehaviorList._m_value._0_._m_rpCalcResultList._m_value._0_._m_reactionPatterns._m_value._0_._m_corridor._m_guidanceConfiguration._m_longitudinalMotionType.CONVERSION "@@@@RuleName created by CANape" TAB_VERB "%.0" "" COMPU_TAB_REF _g_DACore_SIT_RunnableTiplTurnCoDriver_RunnableTiplTurnCoDriver_m_evaluatedBehaviors_out_local.TMemPool._._._m_pool._m_values._0_._elem._m_evalBehaviorList._m_value._0_._m_rpCalcResultList._m_value._0_._m_reactionPatterns._m_value._0_._m_corridor._m_guidanceConfiguration._m_longitudinalMotionType.CONVERSION /end COMPU_METHOD
/begin COMPU_METHOD _g_DACore_SIT_RunnableTiplTurnCoDriver_RunnableTiplTurnCoDriver_m_evaluatedBehaviors_out_local.TMemPool._._._m_pool._m_values._0_._elem._m_evalBehaviorList._m_value._0_._m_rpCalcResultList._m_value._0_._m_reactionPatterns._m_value._0_._m_corridor._m_guidanceConfiguration._m_speedLimiter.CONVERSION "@@@@RuleName created by CANape" TAB_VERB "%.0" "" COMPU_TAB_REF _g_DACore_SIT_RunnableTiplTurnCoDriver_RunnableTiplTurnCoDriver_m_evaluatedBehaviors_out_local.TMemPool._._._m_pool._m_values._0_._elem._m_evalBehaviorList._m_value._0_._m_rpCalcResultList._m_value._0_._m_reactionPatterns._m_value._0_._m_corridor._m_guidanceConfiguration._m_speedLimiter.CONVERSION /end COMPU_METHOD
/begin COMPU_METHOD _g_DACore_SIT_RunnableTiplTurnCoDriver_RunnableTiplTurnCoDriver_m_evaluatedBehaviors_out_local.TMemPool._._._m_pool._m_values._0_._elem._m_evalBehaviorList._m_value._0_._m_rpCalcResultList._m_value._0_._m_reactionPatterns._m_value._0_._m_corridor._m_guidanceConfiguration._m_stationaryHoldMode.CONVERSION "@@@@RuleName created by CANape" TAB_VERB "%.0" "" COMPU_TAB_REF _g_DACore_SIT_RunnableTiplTurnCoDriver_RunnableTiplTurnCoDriver_m_evaluatedBehaviors_out_local.TMemPool._._._m_pool._m_values._0_._elem._m_evalBehaviorList._m_value._0_._m_rpCalcResultList._m_value._0_._m_reactionPatterns._m_value._0_._m_corridor._m_guidanceConfiguration._m_stationaryHoldMode.CONVERSION /end COMPU_METHOD
/begin COMPU_METHOD _g_DACore_SIT_RunnableTiplTurnCoDriver_RunnableTiplTurnCoDriver_m_evaluatedBehaviors_out_local.TMemPool._._._m_pool._m_values._0_._elem._m_evalBehaviorList._m_value._0_._m_rpCalcResultList._m_value._0_._m_reactionPatterns._m_value._0_._m_degreeOfAssistanceLongitudinal.CONVERSION "@@@@RuleName created by CANape" TAB_VERB "%.0" "" COMPU_TAB_REF _g_DACore_SIT_RunnableTiplTurnCoDriver_RunnableTiplTurnCoDriver_m_evaluatedBehaviors_out_local.TMemPool._._._m_pool._m_values._0_._elem._m_evalBehaviorList._m_value._0_._m_rpCalcResultList._m_value._0_._m_reactionPatterns._m_value._0_._m_degreeOfAssistanceLongitudinal.CONVERSION /end COMPU_METHOD
/begin COMPU_METHOD _g_DACore_SIT_RunnableTiplTurnCoDriver_RunnableTiplTurnCoDriver_m_evaluatedBehaviors_out_local.TMemPool._._._m_pool._m_values._0_._elem._m_evalBehaviorList._m_value._0_._m_rpCalcResultList._m_value._0_._m_reactionPatterns._m_value._0_._m_reactionPatternType.CONVERSION "@@@@RuleName created by CANape" TAB_VERB "%.0" "" COMPU_TAB_REF _g_DACore_SIT_RunnableTiplTurnCoDriver_RunnableTiplTurnCoDriver_m_evaluatedBehaviors_out_local.TMemPool._._._m_pool._m_values._0_._elem._m_evalBehaviorList._m_value._0_._m_rpCalcResultList._m_value._0_._m_reactionPatterns._m_value._0_._m_reactionPatternType.CONVERSION /end COMPU_METHOD
/begin COMPU_METHOD _g_DACore_SIT_RunnableTiplTurnCoDriver_RunnableTiplTurnCoDriver_m_introspection_out_local.TMemPool._._._m_pool._m_values._0_._elem._m_relevantBehaviorAttributes._m_value._0_._m_behaviorRestrictions._m_value._3_._m_restrictionType.CONVERSION "@@@@RuleName created by CANape" TAB_VERB "%.0" "" COMPU_TAB_REF _g_DACore_SIT_RunnableTiplTurnCoDriver_RunnableTiplTurnCoDriver_m_introspection_out_local.TMemPool._._._m_pool._m_values._0_._elem._m_relevantBehaviorAttributes._m_value._0_._m_behaviorRestrictions._m_value._3_._m_restrictionType.CONVERSION /end COMPU_METHOD
/begin COMPU_METHOD _g_DACore_SIT_RunnableTrafficRules_RunnableTrafficRules._m_controllerTrafficContextAnnotatedLanes._m_tcalContainer._m_trafficContexts.TList._._m_nodeAlloc._m_memPool._m_storage._m_vals._v1._7_._m_value._m_class.CONVERSION "@@@@RuleName created by CANape" TAB_VERB "%.0" "" COMPU_TAB_REF _g_DACore_SIT_RunnableTrafficRules_RunnableTrafficRules._m_controllerTrafficContextAnnotatedLanes._m_tcalContainer._m_trafficContexts.TList._._m_nodeAlloc._m_memPool._m_storage._m_vals._v1._7_._m_value._m_class.CONVERSION /end COMPU_METHOD
/begin COMPU_METHOD _g_DACore_SIT_RunnableTrafficRules_RunnableTrafficRules._m_controllerTrafficRules._m_ruleContainer._m_rules.TList._._m_nodeAlloc._m_memPool._m_storage._m_vals._v1._9_._m_value.TrafficRule._._m_ruleClass.CONVERSION "@@@@RuleName created by CANape" TAB_VERB "%.0" "" COMPU_TAB_REF _g_DACore_SIT_RunnableTrafficRules_RunnableTrafficRules._m_controllerTrafficRules._m_ruleContainer._m_rules.TList._._m_nodeAlloc._m_memPool._m_storage._m_vals._v1._9_._m_value.TrafficRule._._m_ruleClass.CONVERSION /end COMPU_METHOD
/begin COMPU_METHOD _g_DACore_SIT_RunnableTrafficRules_RunnableTrafficRules._m_controllerTrafficRules._m_ruleContainer._m_rules.TList._._m_nodeAlloc._m_memPool._m_storage._m_vals._v1._9_._m_value.TrafficRule._._m_type.CONVERSION "@@@@RuleName created by CANape" TAB_VERB "%.0" "" COMPU_TAB_REF _g_DACore_SIT_RunnableTrafficRules_RunnableTrafficRules._m_controllerTrafficRules._m_ruleContainer._m_rules.TList._._m_nodeAlloc._m_memPool._m_storage._m_vals._v1._9_._m_value.TrafficRule._._m_type.CONVERSION /end COMPU_METHOD
/begin COMPU_METHOD _g_DACore_SIT_RunnableTrafficRules_RunnableTrafficRules._m_controllerTrafficRules._m_ruleContainer._m_rules.TList._._m_nodeAlloc._m_memPool._m_storage._m_vals._v1._9_._m_value._m_cancelationType.CONVERSION "@@@@RuleName created by CANape" TAB_VERB "%.0" "" COMPU_TAB_REF _g_DACore_SIT_RunnableTrafficRules_RunnableTrafficRules._m_controllerTrafficRules._m_ruleContainer._m_rules.TList._._m_nodeAlloc._m_memPool._m_storage._m_vals._v1._9_._m_value._m_cancelationType.CONVERSION /end COMPU_METHOD
/begin COMPU_METHOD _g_triggerC1Runnable.TExtensionSystemTime._._m_systemTime._m_status.CONVERSION "@@@@RuleName created by CANape" TAB_VERB "%.0" "" COMPU_TAB_REF _g_triggerC1Runnable.TExtensionSystemTime._._m_systemTime._m_status.CONVERSION /end COMPU_METHOD
/begin COMPU_METHOD _mbist_MTURegisters_cast._0_._MBISTSEL_e.CONVERSION "enumeration table" TAB_VERB "%.0" "" COMPU_TAB_REF _mbist_MTURegisters_cast._0_._MBISTSEL_e.CONVERSION /end COMPU_METHOD
/begin COMPU_METHOD _mon_config_cast._0_._depmonitem_en.CONVERSION "enumeration table" TAB_VERB "%.0" "" COMPU_TAB_REF _mon_config_cast._0_._depmonitem_en.CONVERSION /end COMPU_METHOD
/begin COMPU_METHOD _mon_config_cast._0_._type_en.CONVERSION "@@@@RuleName created by CANape" TAB_VERB "%.0" "" COMPU_TAB_REF _mon_config_cast._0_._type_en.CONVERSION /end COMPU_METHOD
/begin COMPU_METHOD _mon_filteredstatus_aen._0_.CONVERSION "enumeration table" TAB_VERB "%.0" "" COMPU_TAB_REF _mon_filteredstatus_aen._0_.CONVERSION /end COMPU_METHOD
/begin COMPU_METHOD _mon_status_aen._0_.CONVERSION "@@@@RuleName created by CANape" TAB_VERB "%.0" "" COMPU_TAB_REF _mon_status_aen._0_.CONVERSION /end COMPU_METHOD
/begin COMPU_METHOD _rbInterruptHandler_DebugInfoSample_st._UnintendedInterruptIndex_en.CONVERSION "enumeration table" TAB_VERB "%.0" "" COMPU_TAB_REF _rbInterruptHandler_DebugInfoSample_st._UnintendedInterruptIndex_en.CONVERSION /end COMPU_METHOD
/begin COMPU_METHOD _rbInterruptHandler_StoreDebugInfoState_en.CONVERSION "enumeration table" TAB_VERB "%.0" "" COMPU_TAB_REF _rbInterruptHandler_StoreDebugInfoState_en.CONVERSION /end COMPU_METHOD
/begin COMPU_METHOD _rbModeMgr_ActiveSystemMode_en.CONVERSION "enumeration table" TAB_VERB "%.0" "" COMPU_TAB_REF _rbModeMgr_ActiveSystemMode_en.CONVERSION /end COMPU_METHOD
/begin COMPU_METHOD _rbResetHandler_ResetState_en.CONVERSION "enumeration table" TAB_VERB "%.0" "" COMPU_TAB_REF _rbResetHandler_ResetState_en.CONVERSION /end COMPU_METHOD
/begin COMPU_METHOD _rbResetHandler_ResetType_en.CONVERSION "enumeration table" TAB_VERB "%.0" "" COMPU_TAB_REF _rbResetHandler_ResetType_en.CONVERSION /end COMPU_METHOD
/begin COMPU_METHOD _rbSftMon_CoreClkMainState_en.CONVERSION "enumeration table" TAB_VERB "%.0" "" COMPU_TAB_REF _rbSftMon_CoreClkMainState_en.CONVERSION /end COMPU_METHOD
/begin COMPU_METHOD _rbSftMon_CoreClkTestStatus_en.CONVERSION "enumeration table" TAB_VERB "%.0" "" COMPU_TAB_REF _rbSftMon_CoreClkTestStatus_en.CONVERSION /end COMPU_METHOD
/begin COMPU_METHOD _rbSftMon_CoreVoltageMainState_en.CONVERSION "enumeration table" TAB_VERB "%.0" "" COMPU_TAB_REF _rbSftMon_CoreVoltageMainState_en.CONVERSION /end COMPU_METHOD
/begin COMPU_METHOD _rbSftMon_StackStatus_aen._0_.CONVERSION "enumeration table" TAB_VERB "%.0" "" COMPU_TAB_REF _rbSftMon_StackStatus_aen._0_.CONVERSION /end COMPU_METHOD
/begin COMPU_METHOD _rbSftMon_coreClkRunningIndex_en.CONVERSION "enumeration table" TAB_VERB "%.0" "" COMPU_TAB_REF _rbSftMon_coreClkRunningIndex_en.CONVERSION /end COMPU_METHOD
/begin COMPU_METHOD _rbSftMon_coreClkTest_st._0_._SubState_en.CONVERSION "enumeration table" TAB_VERB "%.0" "" COMPU_TAB_REF _rbSftMon_coreClkTest_st._0_._SubState_en.CONVERSION /end COMPU_METHOD
/begin COMPU_METHOD _rb_Sbst_CustSlice_en.CONVERSION "enumeration table" TAB_VERB "%.0" "" COMPU_TAB_REF _rb_Sbst_CustSlice_en.CONVERSION /end COMPU_METHOD
/begin COMPU_METHOD _rba_Can_Status_ast._9_._NodeStatus_st._Can_IPType_en.CONVERSION "@@@@RuleName created by CANape" TAB_VERB "%.0" "" COMPU_TAB_REF _rba_Can_Status_ast._9_._NodeStatus_st._Can_IPType_en.CONVERSION /end COMPU_METHOD
/begin COMPU_METHOD _rba_Can_Status_ast._9_._RequestedState_en.CONVERSION "@@@@RuleName created by CANape" TAB_VERB "%.0" "" COMPU_TAB_REF _rba_Can_Status_ast._9_._RequestedState_en.CONVERSION /end COMPU_METHOD
/begin COMPU_METHOD _rba_Dma_Driver_ast._9_._chStatus_en.CONVERSION "@@@@RuleName created by CANape" TAB_VERB "%.0" "" COMPU_TAB_REF _rba_Dma_Driver_ast._9_._chStatus_en.CONVERSION /end COMPU_METHOD
/begin COMPU_METHOD _rba_Emm_Cfg_IndivRTCfg_acst._0_._rba_Emm_Cfg_RTId_en.CONVERSION "@@@@RuleName created by CANape" TAB_VERB "%.0" "" COMPU_TAB_REF _rba_Emm_Cfg_IndivRTCfg_acst._0_._rba_Emm_Cfg_RTId_en.CONVERSION /end COMPU_METHOD
/begin COMPU_METHOD _rba_FeeFs2_Prv_AllocBackground_st._state_en.CONVERSION "@@@@RuleName created by CANape" TAB_VERB "%.0" "" COMPU_TAB_REF _rba_FeeFs2_Prv_AllocBackground_st._state_en.CONVERSION /end COMPU_METHOD
/begin COMPU_METHOD _rba_FeeFs2_Prv_AllocErase_st._state_en.CONVERSION "@@@@RuleName created by CANape" TAB_VERB "%.0" "" COMPU_TAB_REF _rba_FeeFs2_Prv_AllocErase_st._state_en.CONVERSION /end COMPU_METHOD
/begin COMPU_METHOD _rba_FeeFs2_Prv_AllocMallocDat_st._state_en.CONVERSION "@@@@RuleName created by CANape" TAB_VERB "%.0" "" COMPU_TAB_REF _rba_FeeFs2_Prv_AllocMallocDat_st._state_en.CONVERSION /end COMPU_METHOD
/begin COMPU_METHOD _rba_FeeFs2_Prv_AllocMallocFat_st._state_en.CONVERSION "@@@@RuleName created by CANape" TAB_VERB "%.0" "" COMPU_TAB_REF _rba_FeeFs2_Prv_AllocMallocFat_st._state_en.CONVERSION /end COMPU_METHOD
/begin COMPU_METHOD _rba_FeeFs2_Prv_DatCopy_st._state_en.CONVERSION "enumeration table" TAB_VERB "%.0" "" COMPU_TAB_REF _rba_FeeFs2_Prv_DatCopy_st._state_en.CONVERSION /end COMPU_METHOD
/begin COMPU_METHOD _rba_FeeFs2_Prv_DatCopy_st._state_en.CONVERSION0 "@@@@RuleName created by CANape" TAB_VERB "%.0" "" COMPU_TAB_REF _rba_FeeFs2_Prv_DatCopy_st._state_en.CONVERSION0 /end COMPU_METHOD
/begin COMPU_METHOD _rba_FeeFs2_Prv_DatUnlinkSector_st._state_en.CONVERSION "enumeration table" TAB_VERB "%.0" "" COMPU_TAB_REF _rba_FeeFs2_Prv_DatUnlinkSector_st._state_en.CONVERSION /end COMPU_METHOD
/begin COMPU_METHOD _rba_FeeFs2_Prv_DatUnlinkSector_st._state_en.CONVERSION0 "@@@@RuleName created by CANape" TAB_VERB "%.0" "" COMPU_TAB_REF _rba_FeeFs2_Prv_DatUnlinkSector_st._state_en.CONVERSION0 /end COMPU_METHOD
/begin COMPU_METHOD _rba_FeeFs2_Prv_DatWrap_st._func_en.CONVERSION "enumeration table" TAB_VERB "%.0" "" COMPU_TAB_REF _rba_FeeFs2_Prv_DatWrap_st._func_en.CONVERSION /end COMPU_METHOD
/begin COMPU_METHOD _rba_FeeFs2_Prv_DatWrap_st._func_en.CONVERSION0 "@@@@RuleName created by CANape" TAB_VERB "%.0" "" COMPU_TAB_REF _rba_FeeFs2_Prv_DatWrap_st._func_en.CONVERSION0 /end COMPU_METHOD
/begin COMPU_METHOD _rba_FeeFs2_Prv_DatWrap_st._state_en.CONVERSION "enumeration table" TAB_VERB "%.0" "" COMPU_TAB_REF _rba_FeeFs2_Prv_DatWrap_st._state_en.CONVERSION /end COMPU_METHOD
/begin COMPU_METHOD _rba_FeeFs2_Prv_DatWrap_st._state_en.CONVERSION0 "@@@@RuleName created by CANape" TAB_VERB "%.0" "" COMPU_TAB_REF _rba_FeeFs2_Prv_DatWrap_st._state_en.CONVERSION0 /end COMPU_METHOD
/begin COMPU_METHOD _rba_FeeFs2_Prv_DatWrite_st._state_en.CONVERSION "enumeration table" TAB_VERB "%.0" "" COMPU_TAB_REF _rba_FeeFs2_Prv_DatWrite_st._state_en.CONVERSION /end COMPU_METHOD
/begin COMPU_METHOD _rba_FeeFs2_Prv_DatWrite_st._state_en.CONVERSION0 "@@@@RuleName created by CANape" TAB_VERB "%.0" "" COMPU_TAB_REF _rba_FeeFs2_Prv_DatWrite_st._state_en.CONVERSION0 /end COMPU_METHOD
/begin COMPU_METHOD _rba_FeeFs2_Prv_FatCacheBuild_st._state_en.CONVERSION "enumeration table" TAB_VERB "%.0" "" COMPU_TAB_REF _rba_FeeFs2_Prv_FatCacheBuild_st._state_en.CONVERSION /end COMPU_METHOD
/begin COMPU_METHOD _rba_FeeFs2_Prv_FatCacheBuild_st._state_en.CONVERSION0 "@@@@RuleName created by CANape" TAB_VERB "%.0" "" COMPU_TAB_REF _rba_FeeFs2_Prv_FatCacheBuild_st._state_en.CONVERSION0 /end COMPU_METHOD
/begin COMPU_METHOD _rba_FeeFs2_Prv_FatCache_st._mode_en.CONVERSION "enumeration table" TAB_VERB "%.0" "" COMPU_TAB_REF _rba_FeeFs2_Prv_FatCache_st._mode_en.CONVERSION /end COMPU_METHOD
/begin COMPU_METHOD _rba_FeeFs2_Prv_FatCache_st._mode_en.CONVERSION0 "@@@@RuleName created by CANape" TAB_VERB "%.0" "" COMPU_TAB_REF _rba_FeeFs2_Prv_FatCache_st._mode_en.CONVERSION0 /end COMPU_METHOD
/begin COMPU_METHOD _rba_FeeFs2_Prv_FatEntry2Fls_st._state_en.CONVERSION "enumeration table" TAB_VERB "%.0" "" COMPU_TAB_REF _rba_FeeFs2_Prv_FatEntry2Fls_st._state_en.CONVERSION /end COMPU_METHOD
/begin COMPU_METHOD _rba_FeeFs2_Prv_FatEntry2Fls_st._state_en.CONVERSION0 "@@@@RuleName created by CANape" TAB_VERB "%.0" "" COMPU_TAB_REF _rba_FeeFs2_Prv_FatEntry2Fls_st._state_en.CONVERSION0 /end COMPU_METHOD
/begin COMPU_METHOD _rba_FeeFs2_Prv_FatFinalize_st._state_en.CONVERSION "enumeration table" TAB_VERB "%.0" "" COMPU_TAB_REF _rba_FeeFs2_Prv_FatFinalize_st._state_en.CONVERSION /end COMPU_METHOD
/begin COMPU_METHOD _rba_FeeFs2_Prv_FatFinalize_st._state_en.CONVERSION0 "@@@@RuleName created by CANape" TAB_VERB "%.0" "" COMPU_TAB_REF _rba_FeeFs2_Prv_FatFinalize_st._state_en.CONVERSION0 /end COMPU_METHOD
/begin COMPU_METHOD _rba_FeeFs2_Prv_FatGetLatestByAdr_st._state_en.CONVERSION "enumeration table" TAB_VERB "%.0" "" COMPU_TAB_REF _rba_FeeFs2_Prv_FatGetLatestByAdr_st._state_en.CONVERSION /end COMPU_METHOD
/begin COMPU_METHOD _rba_FeeFs2_Prv_FatGetLatestByAdr_st._state_en.CONVERSION0 "@@@@RuleName created by CANape" TAB_VERB "%.0" "" COMPU_TAB_REF _rba_FeeFs2_Prv_FatGetLatestByAdr_st._state_en.CONVERSION0 /end COMPU_METHOD
/begin COMPU_METHOD _rba_FeeFs2_Prv_FatGetLatestById_st._state_en.CONVERSION "enumeration table" TAB_VERB "%.0" "" COMPU_TAB_REF _rba_FeeFs2_Prv_FatGetLatestById_st._state_en.CONVERSION /end COMPU_METHOD
/begin COMPU_METHOD _rba_FeeFs2_Prv_FatGetLatestById_st._state_en.CONVERSION0 "@@@@RuleName created by CANape" TAB_VERB "%.0" "" COMPU_TAB_REF _rba_FeeFs2_Prv_FatGetLatestById_st._state_en.CONVERSION0 /end COMPU_METHOD
/begin COMPU_METHOD _rba_FeeFs2_Prv_FatMigrate_st._state_en.CONVERSION "enumeration table" TAB_VERB "%.0" "" COMPU_TAB_REF _rba_FeeFs2_Prv_FatMigrate_st._state_en.CONVERSION /end COMPU_METHOD
/begin COMPU_METHOD _rba_FeeFs2_Prv_FatMigrate_st._state_en.CONVERSION0 "@@@@RuleName created by CANape" TAB_VERB "%.0" "" COMPU_TAB_REF _rba_FeeFs2_Prv_FatMigrate_st._state_en.CONVERSION0 /end COMPU_METHOD
/begin COMPU_METHOD _rba_FeeFs2_Prv_FatWrite_st._state_en.CONVERSION "enumeration table" TAB_VERB "%.0" "" COMPU_TAB_REF _rba_FeeFs2_Prv_FatWrite_st._state_en.CONVERSION /end COMPU_METHOD
/begin COMPU_METHOD _rba_FeeFs2_Prv_FatWrite_st._state_en.CONVERSION0 "@@@@RuleName created by CANape" TAB_VERB "%.0" "" COMPU_TAB_REF _rba_FeeFs2_Prv_FatWrite_st._state_en.CONVERSION0 /end COMPU_METHOD
/begin COMPU_METHOD _rba_FeeFs2_Prv_InvalidateBlock_st._state_en.CONVERSION "@@@@RuleName created by CANape" TAB_VERB "%.0" "" COMPU_TAB_REF _rba_FeeFs2_Prv_InvalidateBlock_st._state_en.CONVERSION /end COMPU_METHOD
/begin COMPU_METHOD _rba_FeeFs2_Prv_Read_st._state_en.CONVERSION "@@@@RuleName created by CANape" TAB_VERB "%.0" "" COMPU_TAB_REF _rba_FeeFs2_Prv_Read_st._state_en.CONVERSION /end COMPU_METHOD
/begin COMPU_METHOD _rba_FeeFs2_Prv_SectorErase_st._formerWorkingState_en.CONVERSION "@@@@RuleName created by CANape" TAB_VERB "%.0" "" COMPU_TAB_REF _rba_FeeFs2_Prv_SectorErase_st._formerWorkingState_en.CONVERSION /end COMPU_METHOD
/begin COMPU_METHOD _rba_FeeFs2_Prv_SectorErase_st._state_en.CONVERSION "enumeration table" TAB_VERB "%.0" "" COMPU_TAB_REF _rba_FeeFs2_Prv_SectorErase_st._state_en.CONVERSION /end COMPU_METHOD
/begin COMPU_METHOD _rba_FeeFs2_Prv_SectorErase_st._state_en.CONVERSION0 "@@@@RuleName created by CANape" TAB_VERB "%.0" "" COMPU_TAB_REF _rba_FeeFs2_Prv_SectorErase_st._state_en.CONVERSION0 /end COMPU_METHOD
/begin COMPU_METHOD _rba_FeeFs2_Prv_SectorSetState_st._newSectorState_en.CONVERSION "@@@@RuleName created by CANape" TAB_VERB "%.0" "" COMPU_TAB_REF _rba_FeeFs2_Prv_SectorSetState_st._newSectorState_en.CONVERSION /end COMPU_METHOD
/begin COMPU_METHOD _rba_FeeFs2_Prv_SectorSetState_st._state_en.CONVERSION "enumeration table" TAB_VERB "%.0" "" COMPU_TAB_REF _rba_FeeFs2_Prv_SectorSetState_st._state_en.CONVERSION /end COMPU_METHOD
/begin COMPU_METHOD _rba_FeeFs2_Prv_SectorSetState_st._state_en.CONVERSION0 "@@@@RuleName created by CANape" TAB_VERB "%.0" "" COMPU_TAB_REF _rba_FeeFs2_Prv_SectorSetState_st._state_en.CONVERSION0 /end COMPU_METHOD
/begin COMPU_METHOD _rba_FeeFs2_Prv_SectorSetWlDfc_st._state_en.CONVERSION "enumeration table" TAB_VERB "%.0" "" COMPU_TAB_REF _rba_FeeFs2_Prv_SectorSetWlDfc_st._state_en.CONVERSION /end COMPU_METHOD
/begin COMPU_METHOD _rba_FeeFs2_Prv_SectorSetWlDfc_st._state_en.CONVERSION0 "@@@@RuleName created by CANape" TAB_VERB "%.0" "" COMPU_TAB_REF _rba_FeeFs2_Prv_SectorSetWlDfc_st._state_en.CONVERSION0 /end COMPU_METHOD
/begin COMPU_METHOD _rba_FeeFs2_Prv_SectorWriteMarker_st._state_en.CONVERSION "enumeration table" TAB_VERB "%.0" "" COMPU_TAB_REF _rba_FeeFs2_Prv_SectorWriteMarker_st._state_en.CONVERSION /end COMPU_METHOD
/begin COMPU_METHOD _rba_FeeFs2_Prv_SectorWriteMarker_st._state_en.CONVERSION0 "@@@@RuleName created by CANape" TAB_VERB "%.0" "" COMPU_TAB_REF _rba_FeeFs2_Prv_SectorWriteMarker_st._state_en.CONVERSION0 /end COMPU_METHOD
/begin COMPU_METHOD _rba_FeeFs2_Prv_Write_st._state_en.CONVERSION "@@@@RuleName created by CANape" TAB_VERB "%.0" "" COMPU_TAB_REF _rba_FeeFs2_Prv_Write_st._state_en.CONVERSION /end COMPU_METHOD
/begin COMPU_METHOD _rba_QueuedSpi_HwUnitCfg_0._0_._DmaConfigRx._TfrReqTyp_en.CONVERSION "enumeration table" TAB_VERB "%.0" "" COMPU_TAB_REF _rba_QueuedSpi_HwUnitCfg_0._0_._DmaConfigRx._TfrReqTyp_en.CONVERSION /end COMPU_METHOD
/begin COMPU_METHOD _rba_QueuedSpi_HwUnit_cast._0_._DmaConfigTx1_st._LinkedListTyp_en.CONVERSION "enumeration table" TAB_VERB "%.0" "" COMPU_TAB_REF _rba_QueuedSpi_HwUnit_cast._0_._DmaConfigTx1_st._LinkedListTyp_en.CONVERSION /end COMPU_METHOD
/begin COMPU_METHOD _rba_QueuedSpi_HwUnit_cast._0_._stAsyncMode_en.CONVERSION "enumeration table" TAB_VERB "%.0" "" COMPU_TAB_REF _rba_QueuedSpi_HwUnit_cast._0_._stAsyncMode_en.CONVERSION /end COMPU_METHOD
/begin COMPU_METHOD _rba_QueuedSpi_HwUnit_cast._0_._stHwUnit_en.CONVERSION "enumeration table" TAB_VERB "%.0" "" COMPU_TAB_REF _rba_QueuedSpi_HwUnit_cast._0_._stHwUnit_en.CONVERSION /end COMPU_METHOD
/begin COMPU_METHOD _rba_QueuedSpi_HwUnit_cast._5_._DmaConfigTx2_st._ChDataWidth_en.CONVERSION "@@@@RuleName created by CANape" TAB_VERB "%.0" "" COMPU_TAB_REF _rba_QueuedSpi_HwUnit_cast._5_._DmaConfigTx2_st._ChDataWidth_en.CONVERSION /end COMPU_METHOD
/begin COMPU_METHOD _rba_QueuedSpi_HwUnit_cast._5_._DmaConfigTx2_st._IntTrigTyp_en.CONVERSION "@@@@RuleName created by CANape" TAB_VERB "%.0" "" COMPU_TAB_REF _rba_QueuedSpi_HwUnit_cast._5_._DmaConfigTx2_st._IntTrigTyp_en.CONVERSION /end COMPU_METHOD
/begin COMPU_METHOD _rba_QueuedSpi_HwUnit_cast._5_._DmaConfigTx2_st._MovesPerTfr_en.CONVERSION "@@@@RuleName created by CANape" TAB_VERB "%.0" "" COMPU_TAB_REF _rba_QueuedSpi_HwUnit_cast._5_._DmaConfigTx2_st._MovesPerTfr_en.CONVERSION /end COMPU_METHOD
/begin COMPU_METHOD _rba_QueuedSpi_HwUnit_cast._5_._DmaConfigTx2_st._SrcAddrModifier_en.CONVERSION "@@@@RuleName created by CANape" TAB_VERB "%.0" "" COMPU_TAB_REF _rba_QueuedSpi_HwUnit_cast._5_._DmaConfigTx2_st._SrcAddrModifier_en.CONVERSION /end COMPU_METHOD
/begin COMPU_METHOD _rba_QueuedSpi_HwUnit_cast._5_._DmaConfigTx2_st._TfrReqTyp_en.CONVERSION "@@@@RuleName created by CANape" TAB_VERB "%.0" "" COMPU_TAB_REF _rba_QueuedSpi_HwUnit_cast._5_._DmaConfigTx2_st._TfrReqTyp_en.CONVERSION /end COMPU_METHOD
/begin COMPU_METHOD _rba_QueuedSpi_HwUnit_cast._5_._stAsyncMode_en.CONVERSION "@@@@RuleName created by CANape" TAB_VERB "%.0" "" COMPU_TAB_REF _rba_QueuedSpi_HwUnit_cast._5_._stAsyncMode_en.CONVERSION /end COMPU_METHOD
/begin COMPU_METHOD _rba_QueuedSpi_HwUnit_cast._5_._stHwUnit_en.CONVERSION "@@@@RuleName created by CANape" TAB_VERB "%.0" "" COMPU_TAB_REF _rba_QueuedSpi_HwUnit_cast._5_._stHwUnit_en.CONVERSION /end COMPU_METHOD
/begin COMPU_METHOD _rbsftmon_CoreClockInitializationState_en.CONVERSION "enumeration table" TAB_VERB "%.0" "" COMPU_TAB_REF _rbsftmon_CoreClockInitializationState_en.CONVERSION /end COMPU_METHOD
/begin COMPU_METHOD _stLLDRet_st._stRet_en.CONVERSION "@@@@RuleName created by CANape" TAB_VERB "%.0" "" COMPU_TAB_REF _stLLDRet_st._stRet_en.CONVERSION /end COMPU_METHOD
/begin COMPU_METHOD _syslog_dataLog._FreezeTrigger.CONVERSION "enumeration table" TAB_VERB "%.0" "" COMPU_TAB_REF _syslog_dataLog._FreezeTrigger.CONVERSION /end COMPU_METHOD
/begin COMPU_METHOD _syslog_dataLog._LastResetReason.CONVERSION "@@@@RuleName created by CANape" TAB_VERB "%.0" "" COMPU_TAB_REF _syslog_dataLog._LastResetReason.CONVERSION /end COMPU_METHOD
/begin COMPU_METHOD _warningArray._m_value._3_.CONVERSION "@@@@RuleName created by CANape" TAB_VERB "%.0" "" COMPU_TAB_REF _warningArray._m_value._3_.CONVERSION /end COMPU_METHOD
/begin COMPU_METHOD calibRotState "enumeration table" TAB_VERB "%.0" "" COMPU_TAB_REF calibRotState /end COMPU_METHOD
/begin COMPU_METHOD d_builtin_type_print "enumeration table" TAB_VERB "%.0" "" COMPU_TAB_REF d_builtin_type_print /end COMPU_METHOD
/begin COMPU_METHOD driverHandsOnSteeringWheelCapacitive "enumeration table" TAB_VERB "%.0" "" COMPU_TAB_REF driverHandsOnSteeringWheelCapacitive /end COMPU_METHOD
/begin COMPU_METHOD driverHandsOnSteeringWheelTorque "enumeration table" TAB_VERB "%.0" "" COMPU_TAB_REF driverHandsOnSteeringWheelTorque /end COMPU_METHOD
/begin COMPU_METHOD driverIntendedSteeringDirection "enumeration table" TAB_VERB "%.0" "" COMPU_TAB_REF driverIntendedSteeringDirection /end COMPU_METHOD
/begin COMPU_METHOD drivingGearSelection "enumeration table" TAB_VERB "%.0" "" COMPU_TAB_REF drivingGearSelection /end COMPU_METHOD
/begin COMPU_METHOD dxToleranz_Scaling "" LINEAR "%11.9" "" COEFFS_LINEAR 0.001953125 0 /end COMPU_METHOD
/begin COMPU_METHOD eErrorId "enumeration table" TAB_VERB "%.0" "" COMPU_TAB_REF eErrorId /end COMPU_METHOD
/begin COMPU_METHOD eErrorId.OLD_Copy1 "enumeration table" TAB_VERB "%.0" "" COMPU_TAB_REF eErrorId.OLD_1 /end COMPU_METHOD
/begin COMPU_METHOD eUnitInCommand "enumeration table" TAB_VERB "%.0" "" COMPU_TAB_REF eUnitInCommand /end COMPU_METHOD
/begin COMPU_METHOD ecy_hsm_Csai_KeyIdTag "enumeration table" TAB_VERB "%.0" "" COMPU_TAB_REF ecy_hsm_Csai_KeyIdTag /end COMPU_METHOD
/begin COMPU_METHOD messagePriority "enumeration table" TAB_VERB "%.0" "" COMPU_TAB_REF messagePriority /end COMPU_METHOD
/begin COMPU_METHOD messageType "enumeration table" TAB_VERB "%.0" "" COMPU_TAB_REF messageType /end COMPU_METHOD
/begin COMPU_METHOD rbCS520_ExtClkType_en "enumeration table" TAB_VERB "%.0" "" COMPU_TAB_REF rbCS520_ExtClkType_en /end COMPU_METHOD
/begin COMPU_METHOD rbEcuEOL_DriveTestMode_en "enumeration table" TAB_VERB "%.0" "" COMPU_TAB_REF rbEcuEOL_DriveTestMode_en /end COMPU_METHOD
/begin COMPU_METHOD rbEcuEOL_DriveTestResults_en "enumeration table" TAB_VERB "%.0" "" COMPU_TAB_REF rbEcuEOL_DriveTestResults_en /end COMPU_METHOD
/begin COMPU_METHOD rbHsmPrepare_AccessState_en "enumeration table" TAB_VERB "%.0" "" COMPU_TAB_REF rbHsmPrepare_AccessState_en /end COMPU_METHOD
/begin COMPU_METHOD rbMcu_LastResetType_en "enumeration table" TAB_VERB "%.0" "" COMPU_TAB_REF rbMcu_LastResetType_en /end COMPU_METHOD
/begin COMPU_METHOD rbMonReact_EventState "enumeration table" TAB_VERB "%.0" "" COMPU_TAB_REF rbMonReact_EventState /end COMPU_METHOD
/begin COMPU_METHOD rbMonReact_State_en "enumeration table" TAB_VERB "%.0" "" COMPU_TAB_REF rbMonReact_State_en /end COMPU_METHOD
/begin COMPU_METHOD rbNetCom_State_e "enumeration table" TAB_VERB "%.0" "" COMPU_TAB_REF rbNetCom_State_e /end COMPU_METHOD
/begin COMPU_METHOD rbNet_State_e "enumeration table" TAB_VERB "%.0" "" COMPU_TAB_REF rbNet_State_e /end COMPU_METHOD
/begin COMPU_METHOD rbPFlashIntegrity_CrcStatus_en "enumeration table" TAB_VERB "%.0" "" COMPU_TAB_REF rbPFlashIntegrity_CrcStatus_en /end COMPU_METHOD
/begin COMPU_METHOD rbPdm_EDevelopmentError "enumeration table" TAB_VERB "%.0" "" COMPU_TAB_REF rbPdm_EDevelopmentError /end COMPU_METHOD
/begin COMPU_METHOD rbPdm_EJobStatus "enumeration table" TAB_VERB "%.0" "" COMPU_TAB_REF rbPdm_EJobStatus /end COMPU_METHOD
/begin COMPU_METHOD rbPdm_ERequestType "enumeration table" TAB_VERB "%.0" "" COMPU_TAB_REF rbPdm_ERequestType /end COMPU_METHOD
/begin COMPU_METHOD rbSftMon_CoreClkList_en "enumeration table" TAB_VERB "%.0" "" COMPU_TAB_REF rbSftMon_CoreClkList_en /end COMPU_METHOD
/begin COMPU_METHOD rbSftMon_StackStatus_en "enumeration table" TAB_VERB "%.0" "" COMPU_TAB_REF rbSftMon_StackStatus_en /end COMPU_METHOD
/begin COMPU_METHOD rbSysEvM_EventState "enumeration table" TAB_VERB "%.0" "" COMPU_TAB_REF rbSysEvM_EventState /end COMPU_METHOD
/begin COMPU_METHOD rbSysLog_InvalidateStatus_en "enumeration table" TAB_VERB "%.0" "" COMPU_TAB_REF rbSysLog_InvalidateStatus_en /end COMPU_METHOD
/begin COMPU_METHOD rbSyslog_Invalidate_state_en "enumeration table" TAB_VERB "%.0" "" COMPU_TAB_REF rbSyslog_Invalidate_state_en /end COMPU_METHOD
/begin COMPU_METHOD rcy_hsm_Csai_JobPriorityTag "enumeration table" TAB_VERB "%.0" "" COMPU_TAB_REF rcy_hsm_Csai_JobPriorityTag /end COMPU_METHOD
/begin COMPU_METHOD rcy_hsm_Csai_SecAcc_NonceCtrl "enumeration table" TAB_VERB "%.0" "" COMPU_TAB_REF rcy_hsm_Csai_SecAcc_NonceCtrl /end COMPU_METHOD
/begin COMPU_METHOD validLineState "enumeration table" TAB_VERB "%.0" "" COMPU_TAB_REF validLineState /end COMPU_METHOD
/begin COMPU_VTAB_RANGE _Dcm_DsldGlobal_st._stResponseType_en.CONVERSION "@@@@RuleName created by CANape" 2 0 0 "DCM_DSLD_POS_RESPONSE" 1 1 "DCM_DSLD_NEG_RESPONSE" DEFAULT_VALUE "" /end COMPU_VTAB_RANGE
/begin COMPU_VTAB_RANGE _Dcm_DsldTransmit_st._stDslNextState_en.CONVERSION "@@@@RuleName created by CANape" 15 0 0 "DSL_READY_FOR_RECEPTION" 1 1 "DSL_ROETYPE1_RECIEVED" 2 2 "DSL_RECEIVING" 3 3 "DSL_STOP_PROTOCOL" 4 4 "DSL_STOP_PROTOCOL_RECEIVING" 5 5 "DSL_STOP_ROE" 6 6 "DSL_REQUEST_RECEIVED" 7 7 "DSL_WAIT_FOR_P2MAX" 8 8 "DSL_SEND_WAITPEND" 9 9 "DSL_SEND_GENERAL_REJECT" 10 10 "DSL_SEND_FINAL_RESPONSE" 11 11 "DSL_WAIT_FOR_CONFIRMATION" 12 12 "DSL_WAIT_FOR_DATA" 13 13 "DSL_DATA_READY" 14 14 "DSL_WAIT_PAGE_TXCONFIRM" DEFAULT_VALUE "" /end COMPU_VTAB_RANGE
/begin COMPU_VTAB_RANGE _Dcm_DspDataInfo_st._0_._usePort.CONVERSION "" 8 0 0 "USE_BLOCK_ID" 1 1 "USE_DATA_ASYNCH_CLIENT_SERVER" 2 2 "USE_DATA_SENDER_RECEIVER" 3 3 "USE_DATA_SENDER_RECEIVER_AS_SERVICE" 4 4 "USE_DATA_SYNCH_CLIENT_SERVER" 5 5 "USE_ECU_SIGNAL" 6 6 "USE_DATA_SYNCH_FNC" 7 7 "USE_DATA_ASYNCH_FNC" DEFAULT_VALUE "" /end COMPU_VTAB_RANGE
/begin COMPU_VTAB_RANGE _Dcm_DspEcuResetType_cast._0_._resetForBoot.CONVERSION "@@@@RuleName created by CANape" 4 0 0 "DCM_RESET_NO_BOOT" 1 1 "DCM_RESET_OEM_BOOT" 2 2 "DCM_RESET_SYS_BOOT" 3 3 "DCM_RESET_DRIVE_TO_DRIVE" DEFAULT_VALUE "" /end COMPU_VTAB_RANGE
/begin COMPU_VTAB_RANGE _Dcm_DspRDTCState_en.CONVERSION "@@@@RuleName created by CANape" 3 0 0 "DSP_RDTC_UNINIT" 1 1 "DSP_RDTC_INIT" 2 2 "DSP_RDTC_CALLSERVICE" DEFAULT_VALUE "" /end COMPU_VTAB_RANGE
/begin COMPU_VTAB_RANGE _Dcm_DspRDTCSubFunc_en.CONVERSION "@@@@RuleName created by CANape" 4 0 0 "DSP_RDTC_SFUNINIT" 1 1 "DSP_RDTC_SFINIT" 2 2 "DSP_RDTC_SFCALCNUMDTC" 3 3 "DSP_RDTC_SFFILLRESP" DEFAULT_VALUE "" /end COMPU_VTAB_RANGE
/begin COMPU_VTAB_RANGE _Dcm_Dsp_Session._3_._sessionForBoot.CONVERSION "@@@@RuleName created by CANape" 3 0 0 "DCM_NO_BOOT" 1 1 "DCM_OEM_BOOT" 2 2 "DCM_SYS_BOOT" DEFAULT_VALUE "" /end COMPU_VTAB_RANGE
/begin COMPU_VTAB_RANGE _Dcm_GetDataState_en.CONVERSION "@@@@RuleName created by CANape" 3 0 0 "DCM_GETDATA_STATUS_INIT" 1 1 "DCM_GETDATA_STATUS_GETLENGTH" 2 2 "DCM_GETDATA_STATUS_GETDATA" DEFAULT_VALUE "" /end COMPU_VTAB_RANGE
/begin COMPU_VTAB_RANGE _Dcm_RoutineStatus_aen._2_.CONVERSION "@@@@RuleName created by CANape" 4 0 0 "DCM_ROUTINE_IDLE" 1 1 "DCM_ROUTINE_STOP" 2 2 "DCM_ROUTINE_STARTED" 3 3 "DCM_ROUTINE_STOP_PENDING" DEFAULT_VALUE "" /end COMPU_VTAB_RANGE
/begin COMPU_VTAB_RANGE _Dcm_StLenCalc_en.CONVERSION "@@@@RuleName created by CANape" 4 0 0 "DCM_LENCALC_STATUS_INIT" 1 1 "DCM_LENCALC_STATUS_GETINDEX" 2 2 "DCM_LENCALC_STATUS_GETLENGTH" 3 3 "DCM_LENCALC_STATUS_GETSUPPORT" DEFAULT_VALUE "" /end COMPU_VTAB_RANGE
/begin COMPU_VTAB_RANGE _Dcm_active_commode_e._0_._ComMState.CONVERSION "@@@@RuleName created by CANape" 3 0 0 "DCM_DSLD_NO_COM_MODE" 1 1 "DCM_DSLD_SILENT_COM_MODE" 2 2 "DCM_DSLD_FULL_COM_MODE" DEFAULT_VALUE "" /end COMPU_VTAB_RANGE
/begin COMPU_VTAB_RANGE _Dcm_stDsc_en.CONVERSION "@@@@RuleName created by CANape" 5 1 1 "DCM_DSP_DSC_INIT" 2 2 "DCM_DSP_DSC_WAIT" 3 3 "DCM_DSP_DSC_CHECK_PERMISSION" 4 4 "DCM_DSP_DSC_SEND_RESP" 5 5 "DCM_DSP_DSC_ERROR" DEFAULT_VALUE "" /end COMPU_VTAB_RANGE
/begin COMPU_VTAB_RANGE _Dcm_stDspRCState_en.CONVERSION "@@@@RuleName created by CANape" 3 1 1 "DCM_RC_IDLE" 2 2 "DCM_RC_PENDING" 3 3 "DCM_RC_CANCEL" DEFAULT_VALUE "" /end COMPU_VTAB_RANGE
/begin COMPU_VTAB_RANGE _Dcm_stDspStateWDBI_en.CONVERSION "@@@@RuleName created by CANape" 4 0 0 "DCM_DSP_WDBI_IDLE" 1 1 "DCM_DSP_WDBI_VALDATALEN" 2 2 "DCM_DSP_WDBI_CHECKACCESS" 3 3 "DCM_DSP_WDBI_WRITEDATAREC" DEFAULT_VALUE "" /end COMPU_VTAB_RANGE
/begin COMPU_VTAB_RANGE _Dcm_stEcuResetState_en.CONVERSION "@@@@RuleName created by CANape" 5 1 1 "DCM_ECURESET_IDLE" 2 2 "DCM_ECURESET_REQPERMISSION" 3 3 "DCM_ECURESET_WAIT" 4 4 "DCM_ECURESET_SENDRESPONSE" 5 5 "DCM_ECURESET_ERROR" DEFAULT_VALUE "" /end COMPU_VTAB_RANGE
/begin COMPU_VTAB_RANGE _Dcm_stRdbi_en.CONVERSION "@@@@RuleName created by CANape" 7 0 0 "DCM_RDBI_IDLE" 1 1 "DCM_RDBI_NEG_RESP" 2 2 "DCM_RDBI_PROCESS_NEW_DID" 3 3 "DCM_RDBI_CHECK_READACCESS" 4 4 "DCM_RDBI_CHECK_CONDITIONS" 5 5 "DCM_RDBI_GET_LENGTH" 6 6 "DCM_RDBI_GET_DATA" DEFAULT_VALUE "" /end COMPU_VTAB_RANGE
/begin COMPU_VTAB_RANGE _EcuSh_RequestedState_N.CONVERSION "@@@@RuleName created by CANape" 6 0 0 "EcuSh_StateNone_N" 1 1 "EcuSh_StateInit_N" 2 2 "EcuSh_StateStartup_N" 3 3 "EcuSh_StateRun_N" 4 4 "EcuSh_StatePostrun_N" 5 5 "EcuSh_StateShutdown_N" DEFAULT_VALUE "" /end COMPU_VTAB_RANGE
/begin COMPU_VTAB_RANGE _Fee_Prv_DriverState_en.CONVERSION "" 8 0 0 "FEE_PRV_DRIVERSTATE_UNINIT_E" 1 1 "FEE_PRV_DRIVERSTATE_INIT_E" 2 2 "FEE_PRV_DRIVERSTATE_BACKGROUND_E" 3 3 "FEE_PRV_DRIVERSTATE_IDLE_E" 4 4 "FEE_PRV_DRIVERSTATE_READ_E" 5 5 "FEE_PRV_DRIVERSTATE_WRITE_E" 6 6 "FEE_PRV_DRIVERSTATE_INVALIDATEBLOCK_E" 7 7 "FEE_PRV_DRIVERSTATE_BLOCKMAINTENANCE_E" DEFAULT_VALUE "" /end COMPU_VTAB_RANGE
/begin COMPU_VTAB_RANGE _Fee_Prv_MediumLoad_st._state_en.CONVERSION "@@@@RuleName created by CANape" 2 0 0 "FEE_PRV_LOAD_IDLE_E" 1 1 "FEE_PRV_LOAD_BUSY_E" DEFAULT_VALUE "" /end COMPU_VTAB_RANGE
/begin COMPU_VTAB_RANGE _Fee_Prv_MediumWrite_st._state_en.CONVERSION "@@@@RuleName created by CANape" 5 0 0 "FEE_PRV_MEDIUM_WRITE_IDLE_E" 1 1 "FEE_PRV_MEDIUM_WRITE_BLANKCHECK_E" 2 2 "FEE_PRV_MEDIUM_WRITE_PROGRAM_E" 3 3 "FEE_PRV_MEDIUM_WRITE_COMPARE_E" 4 4 "FEE_PRV_MEDIUM_WRITE_FINAL_E" DEFAULT_VALUE "" /end COMPU_VTAB_RANGE
/begin COMPU_VTAB_RANGE _Fee_Prv_Order_st._firstInitMigrationResult_aen._9_.CONVERSION "@@@@RuleName created by CANape" 6 0 0 "MEMIF_RB_MIGRATION_RESULT_INIT_E" 1 1 "MEMIF_RB_MIGRATION_RESULT_NOT_NECESSARY_E" 2 2 "MEMIF_RB_MIGRATION_RESULT_TO_SMALLER_SIZE_E" 3 3 "MEMIF_RB_MIGRATION_RESULT_TO_BIGGER_SIZE_E" 4 4 "MEMIF_RB_MIGRATION_RESULT_NOT_DONE_E" 5 5 "MEMIF_RB_MIGRATION_RESULT_DEACTIVATED_E" DEFAULT_VALUE "" /end COMPU_VTAB_RANGE
/begin COMPU_VTAB_RANGE _Fee_Prv_Order_st._jobs_ast._2_._type_en.CONVERSION "@@@@RuleName created by CANape" 5 0 0 "FEE_PRV_ORDERTYPE_NONE_E" 1 1 "FEE_PRV_ORDERTYPE_READ_E" 2 2 "FEE_PRV_ORDERTYPE_WRITE_E" 3 3 "FEE_PRV_ORDERTYPE_INVALIDATE_E" 4 4 "FEE_PRV_ORDERTYPE_BLOCKMAINTENANCE_E" DEFAULT_VALUE "" /end COMPU_VTAB_RANGE
/begin COMPU_VTAB_RANGE _Fee_stMain.CONVERSION "@@@@RuleName created by CANape" 2 0 0 "FEE_POLLING_MODE_E" 1 1 "FEE_NORMAL_MODE_E" DEFAULT_VALUE "" /end COMPU_VTAB_RANGE
/begin COMPU_VTAB_RANGE _Fls_Mode.CONVERSION "@@@@RuleName created by CANape" 2 0 0 "MEMIF_MODE_SLOW" 1 1 "MEMIF_MODE_FAST" DEFAULT_VALUE "" /end COMPU_VTAB_RANGE
/begin COMPU_VTAB_RANGE _Fls_Rb_Order_st._1_._OrderType_en.CONVERSION "@@@@RuleName created by CANape" 6 0 0 "FLS_RB_NO_ORDER_E" 1 1 "FLS_RB_READ_ORDER_E" 2 2 "FLS_RB_WRITE_ORDER_E" 3 3 "FLS_RB_ERASE_ORDER_E" 4 4 "FLS_RB_COMPARE_ORDER_E" 5 5 "FLS_RB_BLANK_CHECK_ORDER_E" DEFAULT_VALUE "" /end COMPU_VTAB_RANGE
/begin COMPU_VTAB_RANGE _Fls_Rb_stSuspend_en.CONVERSION "@@@@RuleName created by CANape" 6 0 0 "FLS_RB_ST_SUSPEND_IDLE_E" 1 1 "FLS_RB_ST_SUSPEND_REQUESTED_E" 2 2 "FLS_RB_ST_SUSPEND_DONE_E" 3 3 "FLS_RB_ST_SUSPEND_NOT_NECESSARY_E" 4 4 "FLS_RB_ST_SUSPEND_ACC_AND_EXEC_ORDERS_E" 5 5 "FLS_RB_ST_RESUME_REQUESTED_E" DEFAULT_VALUE "" /end COMPU_VTAB_RANGE
/begin COMPU_VTAB_RANGE _Fls_stMain.CONVERSION "@@@@RuleName created by CANape" 4 0 0 "MEMIF_UNINIT" 1 1 "MEMIF_IDLE" 2 2 "MEMIF_BUSY" 3 3 "MEMIF_BUSY_INTERNAL" DEFAULT_VALUE "" /end COMPU_VTAB_RANGE
/begin COMPU_VTAB_RANGE _IpduM_TxRamData._0_._TxState.CONVERSION "@@@@RuleName created by CANape" 2 0 0 "IPDUM_TX_READY" 1 1 "IPDUM_TX_REQUESTED" DEFAULT_VALUE "" /end COMPU_VTAB_RANGE
/begin COMPU_VTAB_RANGE _IpduM_Uninit_Flag.CONVERSION "@@@@RuleName created by CANape" 2 0 0 "IPDUM_UNINIT" 1 1 "IPDUM_INIT" DEFAULT_VALUE "" /end COMPU_VTAB_RANGE
/begin COMPU_VTAB_RANGE _NvM_Prv_AuxMigrationResult.CONVERSION "@@@@RuleName created by CANape" 6 0 0 "NVM_RB_MIGRATION_RESULT_INIT_E" 1 1 "NVM_RB_MIGRATION_RESULT_NOT_NECESSARY_E" 2 2 "NVM_RB_MIGRATION_RESULT_TO_SMALLER_SIZE_E" 3 3 "NVM_RB_MIGRATION_RESULT_TO_BIGGER_SIZE_E" 4 4 "NVM_RB_MIGRATION_RESULT_NOT_DONE_E" 5 5 "NVM_RB_MIGRATION_RESULT_DEACTIVATED_E" DEFAULT_VALUE "" /end COMPU_VTAB_RANGE
/begin COMPU_VTAB_RANGE _NvM_Prv_BlockDescriptors_acst._9_._BlockManagementType_en.CONVERSION "@@@@RuleName created by CANape" 3 0 0 "NVM_BLOCK_NATIVE" 1 1 "NVM_BLOCK_REDUNDANT" 2 2 "NVM_BLOCK_DATASET" DEFAULT_VALUE "" /end COMPU_VTAB_RANGE
/begin COMPU_VTAB_RANGE _NvM_Prv_Main_st._Activity_rAMwM_en.CONVERSION "@@@@RuleName created by CANape" 6 0 0 "NVM_PRV_ACTIVITY_NOT_INIT" 1 1 "NVM_PRV_ACTIVITY_IDLE" 2 2 "NVM_PRV_ACTIVITY_ARBITRATE" 3 3 "NVM_PRV_ACTIVITY_JOB_START" 4 4 "NVM_PRV_ACTIVITY_POLL_RESULT" 5 5 "NVM_PRV_ACTIVITY_RESULT_EVAL" DEFAULT_VALUE "" /end COMPU_VTAB_RANGE
/begin COMPU_VTAB_RANGE _NvM_Prv_Main_st._idActiveJob_rMwM_en.CONVERSION "@@@@RuleName created by CANape" 8 0 0 "NVM_PRV_JOB_ID_IDLE" 1 1 "NVM_PRV_JOB_ID_READ" 2 2 "NVM_PRV_JOB_ID_WRITE" 3 3 "NVM_PRV_JOB_ID_INVALIDATE" 4 4 "NVM_PRV_JOB_ID_ERASE" 5 5 "NVM_PRV_JOB_ID_RESTORE" 6 6 "NVM_PRV_JOB_ID_MAINTAIN" 7 7 "NVM_PRV_JOB_ID_VALIDATE" DEFAULT_VALUE "" /end COMPU_VTAB_RANGE
/begin COMPU_VTAB_RANGE _NvM_Prv_Main_st._stActiveJobResult_rMwM_en.CONVERSION "@@@@RuleName created by CANape" 6 0 0 "MEMIF_JOB_OK" 1 1 "MEMIF_JOB_FAILED" 2 2 "MEMIF_JOB_PENDING" 3 3 "MEMIF_JOB_CANCELED" 4 4 "MEMIF_BLOCK_INCONSISTENT" 5 5 "MEMIF_BLOCK_INVALID" DEFAULT_VALUE "" /end COMPU_VTAB_RANGE
/begin COMPU_VTAB_RANGE _Os_StackLog_st._Reason.CONVERSION "@@@@RuleName created by CANape" 4 0 0 "OS_BUDGET" 1 1 "OS_ECC_START" 2 2 "OS_ECC_RESUME" 3 3 "OS_ECC_WAIT" DEFAULT_VALUE "" /end COMPU_VTAB_RANGE
/begin COMPU_VTAB_RANGE _Os_const_spinlocks._4_._extra_lock.CONVERSION "@@@@RuleName created by CANape" 4 0 0 "OS_LOCK_NOTHING" 1 1 "OS_LOCK_ALL" 2 2 "OS_LOCK_OS" 3 3 "OS_LOCK_TASKS" DEFAULT_VALUE "" /end COMPU_VTAB_RANGE
/begin COMPU_VTAB_RANGE _Os_dyn_appstate._3_.CONVERSION "@@@@RuleName created by CANape" 3 0 0 "APPLICATION_ACCESSIBLE" 1 1 "APPLICATION_RESTARTING" 2 2 "APPLICATION_TERMINATED" DEFAULT_VALUE "" /end COMPU_VTAB_RANGE
/begin COMPU_VTAB_RANGE _PduR_State.CONVERSION "@@@@RuleName created by CANape" 3 0 0 "PDUR_UNINIT" 1 1 "PDUR_REDUCED" 2 2 "PDUR_ONLINE" DEFAULT_VALUE "" /end COMPU_VTAB_RANGE
/begin COMPU_VTAB_RANGE _Port_Detailled_Cfg._0_._iocr.CONVERSION "" 20 0 0 "PORT_PIN_INPUT_NODEVICE" 1 1 "PORT_PIN_INPUT_PULLDOWN" 2 2 "PORT_PIN_INPUT_PULLUP" 16 16 "PORT_PIN_OUTPUT_GPIO_PUSHPULL" 17 17 "PORT_PIN_OUTPUT_ALTOUT1_PUSHPULL" 18 18 "PORT_PIN_OUTPUT_ALTOUT2_PUSHPULL" 19 19 "PORT_PIN_OUTPUT_ALTOUT3_PUSHPULL" 20 20 "PORT_PIN_OUTPUT_ALTOUT4_PUSHPULL" 21 21 "PORT_PIN_OUTPUT_ALTOUT5_PUSHPULL" 22 22 "PORT_PIN_OUTPUT_ALTOUT6_PUSHPULL" 23 23 "PORT_PIN_OUTPUT_ALTOUT7_PUSHPULL" 24 24 "PORT_PIN_OUTPUT_GPIO_OPENDRAIN" 25 25 "PORT_PIN_OUTPUT_ALTOUT1_OPENDRAIN" 26 26 "PORT_PIN_OUTPUT_ALTOUT2_OPENDRAIN" 27 27 "PORT_PIN_OUTPUT_ALTOUT3_OPENDRAIN" 28 28 "PORT_PIN_OUTPUT_ALTOUT4_OPENDRAIN" 29 29 "PORT_PIN_OUTPUT_ALTOUT5_OPENDRAIN" 30 30 "PORT_PIN_OUTPUT_ALTOUT6_OPENDRAIN" 31 31 "PORT_PIN_OUTPUT_ALTOUT7_OPENDRAIN" 32 32 "PORT_PIN_MODE_MAX" DEFAULT_VALUE "" /end COMPU_VTAB_RANGE
/begin COMPU_VTAB _StbM_Cfg_LocalTimeClockArray_ast._0_._StbMLocalTimeHardware_e.CONVERSION "enumeration table" TAB_VERB 4 0 "OS" 1 "ETHTSYN" 2 "GPT" 3 "STBMLOCALTIMEHARDWARE_NOT_CONFIGURED" /end COMPU_VTAB
/begin COMPU_VTAB _StbM_Cfg_SynchronizedTimeBaseArray_ast._0_._StbMState_e.CONVERSION "enumeration table" TAB_VERB 3 0 "MASTER" 1 "SLAVE" 2 "GATEWAY" /end COMPU_VTAB
/begin COMPU_VTAB _StbM_Cfg_SynchronizedTimeBaseArray_ast._0_._StoreTimebaseNonVolatile_e.CONVERSION "enumeration table" TAB_VERB 3 0 "NO_STORAGE" 1 "STORAGE_AT_SHUTDOWN" 2 "NVM_NOT_CONFIGURED" /end COMPU_VTAB
/begin COMPU_VTAB_RANGE _Xcp_Cleared._0_._BgActivityState.CONVERSION "@@@@RuleName created by CANape" 4 0 0 "XCP_BG_IDLE" 1 1 "XCP_BG_CHKSUM" 2 2 "XCP_BG_MEM_WRITE" 3 3 "XCP_BG_CANCEL_REQ" DEFAULT_VALUE "" /end COMPU_VTAB_RANGE
/begin COMPU_VTAB_RANGE _Xcp_NoInit._0_._DaqConfig._DaqState_en.CONVERSION "@@@@RuleName created by CANape" 10 0 0 "XCP_DAQ_STATE_NO_DAQ" 1 1 "XCP_DAQ_STATE_FREE_DAQ" 2 2 "XCP_DAQ_STATE_ALLOC_DAQ" 3 3 "XCP_DAQ_STATE_ALLOC_ODT" 4 4 "XCP_DAQ_STATE_ALLOC_ODT_ENTRY" 5 5 "XCP_DAQ_STATE_WRITE_DAQ" 6 6 "XCP_DAQ_STATE_PREPARE_START" 7 7 "XCP_DAQ_STATE_SHIFTING" 8 8 "XCP_DAQ_STATE_READY_TO_RUN" 9 9 "XCP_DAQ_STATE_RUNNING" DEFAULT_VALUE "" /end COMPU_VTAB_RANGE
/begin COMPU_VTAB_RANGE _Xcp_NoInit._0_._Session._XcpState_en.CONVERSION "" 5 0 0 "XCP_STATE_DISCONNECTED" 1 1 "XCP_STATE_DISCONNECTING" 2 2 "XCP_STATE_CONNECTED" 3 3 "XCP_STATE_RESUME" 240 240 "XCP_STATE_DISABLED" DEFAULT_VALUE "" /end COMPU_VTAB_RANGE
/begin COMPU_VTAB_RANGE _Xcp_PlCfgConst._DaqRamCfg._0_._RamSectionType_en.CONVERSION "@@@@RuleName created by CANape" 3 0 0 "XCP_RAMSECTION_INVALID" 1 1 "XCP_RAMSECTION_PD" 2 2 "XCP_RAMSECTION_ED" DEFAULT_VALUE "" /end COMPU_VTAB_RANGE
/begin COMPU_VTAB_RANGE _Xcp_PlCfgConst._TlCfg._0_._Consistency_en.CONVERSION "" 4 0 0 "XCP_CONSISTENCY_ODT" 1 1 "XCP_CONSISTENCY_DAQ" 2 2 "XCP_CONSISTENCY_EVENT" 3 3 "XCP_CONSISTENCY_NONE" DEFAULT_VALUE "" /end COMPU_VTAB_RANGE
/begin COMPU_VTAB_RANGE _Xcp_PlCfgConst._TlCfg._0_._IdFieldType_en.CONVERSION "@@@@RuleName created by CANape" 4 1 1 "XCP_IDENTIFICATION_FIELD_TYPE_ABSOLUTE" 2 2 "XCP_IDENTIFICATION_FIELD_TYPE_RELATIVE_BYTE" 3 3 "XCP_IDENTIFICATION_FIELD_TYPE_RELATIVE_WORD" 4 4 "XCP_IDENTIFICATION_FIELD_TYPE_RELATIVE_WORD_ALIGNED" DEFAULT_VALUE "" /end COMPU_VTAB_RANGE
/begin COMPU_VTAB_RANGE _Xcp_PlCfgConst._TlCfg._0_._OdtOptimizationType_en.CONVERSION "@@@@RuleName created by CANape" 6 0 0 "XCP_ODT_OPTIMIZATION_OM_DEFAULT" 1 1 "XCP_ODT_OPTIMIZATION_OM_ODT_TYPE_16" 2 2 "XCP_ODT_OPTIMIZATION_OM_ODT_TYPE_32" 3 3 "XCP_ODT_OPTIMIZATION_OM_ODT_TYPE_64" 4 4 "XCP_ODT_OPTIMIZATION_OM_ODT_TYPE_ALIGNMENT" 5 5 "XCP_ODT_OPTIMIZATION_OM_MAX_ENTRY_SIZE" DEFAULT_VALUE "" /end COMPU_VTAB_RANGE
/begin COMPU_VTAB_RANGE _Xcp_PlCfgConst._TlCfg._0_._OverloadType_en.CONVERSION "@@@@RuleName created by CANape" 3 0 0 "XCP_DAQ_NO_OVERLOAD_INDICATION" 1 1 "XCP_DAQ_OVERLOAD_INDICATION_PID" 2 2 "XCP_DAQ_OVERLOAD_INDICATION_EVENT" DEFAULT_VALUE "" /end COMPU_VTAB_RANGE
/begin COMPU_VTAB_RANGE _Xcp_PlCfgConst._TlCfg._0_._TimestampType_en.CONVERSION "@@@@RuleName created by CANape" 4 0 0 "XCP_TIMESTAMP_TYPE_NO_TIME_STAMP" 1 1 "XCP_TIMESTAMP_TYPE_ONE_BYTE" 2 2 "XCP_TIMESTAMP_TYPE_TWO_BYTE" 4 4 "XCP_TIMESTAMP_TYPE_FOUR_BYTE" DEFAULT_VALUE "" /end COMPU_VTAB_RANGE
/begin COMPU_VTAB _bistmgr_DebugInfoAndStatus_st._lBist_en.CONVERSION "enumeration table" TAB_VERB 3 0 "lbist_NotTested_e" 1 "lbist_Fail_e" 2 "lbist_Pass_e" /end COMPU_VTAB
/begin COMPU_VTAB _bistmgr_DebugInfoAndStatus_st._mBist_en.CONVERSION "enumeration table" TAB_VERB 3 0 "mbist_NotTested_e" 1 "mbist_Passed_e" 2 "mbist_Failed_e" /end COMPU_VTAB
/begin COMPU_VTAB _bistmgr_DebugInfoAndStatus_st._monBist_en.CONVERSION "enumeration table" TAB_VERB 3 0 "rbMonBist_NotTested_e" 1 "rbMonBist_Pass_e" 2 "rbMonBist_Fail_e" /end COMPU_VTAB
/begin COMPU_VTAB _bistmgr_State_en.CONVERSION "enumeration table" TAB_VERB 4 0 "BISTMGR_COLLECTSTATUS_E" 1 "BISTMGR_NVMWRITEREQ_E" 2 "BISTMGR_POLLNVMANDREPORTSTATUS_E" 3 "BISTMGR_IDLE_E" /end COMPU_VTAB
/begin COMPU_VTAB_RANGE _g_1R1VApl_FCT_fsm_fsm._m_stateMachineController._m_accControlUnit._m_inputElementConfiguration._m_mainSwitch._m_currentAction.CONVERSION "@@@@RuleName created by CANape" 2 0 0 "on" 1 1 "off" DEFAULT_VALUE "" /end COMPU_VTAB_RANGE
/begin COMPU_VTAB_RANGE _g_1R1VApl_FCT_fsm_fsm._m_stateMachineController._m_accControlUnit._m_inputElementConfiguration._m_timeGapButton._m_currentAction.CONVERSION "@@@@RuleName created by CANape" 3 0 0 "none" 1 1 "risingEdge" 2 2 "longPress" DEFAULT_VALUE "" /end COMPU_VTAB_RANGE
/begin COMPU_VTAB_RANGE _g_1R1VApl_FCT_fsm_fsm._m_stateMachineController._m_accControlUnit._m_inputElementConfiguration._m_timeGapButton._m_previousSignal.CONVERSION "@@@@RuleName created by CANape" 2 0 0 "inactive" 1 1 "active" DEFAULT_VALUE "" /end COMPU_VTAB_RANGE
/begin COMPU_VTAB_RANGE _g_1R1VApl_FCT_fsm_fsm._m_stateMachineController._m_accControlUnit._m_overloadResolver._m_resolutionStrategy.CONVERSION "@@@@RuleName created by CANape" 6 0 0 "chooseResumeSetOverPlusMinus" 1 1 "choosePlusMinusOverResumeSet" 2 2 "disableResumeSetPlusMinus" 3 3 "chooseTimeGapOverSetSpeed" 4 4 "chooseSetSpeedOverTimeGap" 5 5 "disableAllButMainSwitch" DEFAULT_VALUE "" /end COMPU_VTAB_RANGE
/begin COMPU_VTAB_RANGE _g_1R1VApl_FCT_fsm_fsm._m_stateMachineController._m_accControlUnit._m_setspeedController._m_currentSpeedUnit.CONVERSION "@@@@RuleName created by CANape" 2 0 0 "kmh" 1 1 "mph" DEFAULT_VALUE "" /end COMPU_VTAB_RANGE
/begin COMPU_VTAB_RANGE _g_1R1VApl_FCT_fsm_fsm._m_stateMachineController._m_accControlUnit._m_timeGapLevelController._m_behaviour.CONVERSION "@@@@RuleName created by CANape" 2 0 0 "loopAround" 1 1 "limitToRange" DEFAULT_VALUE "" /end COMPU_VTAB_RANGE
/begin COMPU_VTAB_RANGE _g_1R1VApl_FCT_fsm_fsm._m_stateMachineController._m_functionalInputProcessor._m_daCoreStateNotificationCalculator._m_DaCoreState.CONVERSION "@@@@RuleName created by CANape" 6 0 0 "DC_INVALID" 1 1 "DC_NOT_INITIALIZED" 2 2 "DC_STARTUP" 3 3 "DC_SAFE" 4 4 "DC_SHUTDOWN" 5 5 "DC_OOS" DEFAULT_VALUE "" /end COMPU_VTAB_RANGE
/begin COMPU_VTAB_RANGE _g_1R1VApl_FCT_fsm_fsm._m_stateMachineController._m_longSmBehaviorList._m_memory._m_values._4_.CONVERSION "@@@@RuleName created by CANape" 7 0 0 "AccTipl" 1 1 "AebFullBrakeTipl" 2 2 "FcwTipl" 3 3 "AebFullBrakeFm" 4 4 "AebPartialBrakeTipl" 5 5 "AccImba" 6 6 "FtaTipl" DEFAULT_VALUE "" /end COMPU_VTAB_RANGE
/begin COMPU_VTAB_RANGE _g_1R1VApl_FCT_fsm_fsm._m_stateMachineController._m_longStateMachine.StateMachine._._m_stateMachineType.CONVERSION "@@@@RuleName created by CANape" 7 0 0 "Longitudinal" 1 1 "SafetyFunctions" 2 2 "AebFullBrake" 3 3 "AebPartialBrake" 4 4 "ForwardCollisionWarning" 5 5 "AebPedestrian" 6 6 "FarsideTurnAssist" DEFAULT_VALUE "" /end COMPU_VTAB_RANGE
/begin COMPU_VTAB_RANGE _g_1R1VApl_FCT_fsm_fsm_m_requestedBehaviorsTipl_local.TMemPool._._._m_pool._m_values._0_._elem._m_dynamicParameters._m_setSpeedConfiguration.CONVERSION "@@@@RuleName created by CANape" 3 0 0 "off" 1 1 "cruiseControl" 2 2 "adaptiveCruiseControl" DEFAULT_VALUE "" /end COMPU_VTAB_RANGE
/begin COMPU_VTAB_RANGE _g_DACore_RPM_CRPMExecution_CRPMExecution_m_portActiveWarnings_local.TMemPool._._._m_pool._m_values._0_._elem._m_activeWarnings._m_memory._m_values._2_._m_type.CONVERSION "@@@@RuleName created by CANape" 5 0 0 "UNDEFINED" 1 1 "FORWARD_COLLISION_WARNING" 2 2 "LANE_DEPARTURE_WARNING" 3 3 "LANE_CHANGE_WARNING" 4 4 "REAR_CROSS_TRAFFIC_WARNING" DEFAULT_VALUE "" /end COMPU_VTAB_RANGE
/begin COMPU_VTAB_RANGE _g_DACore_SIT_RunnableBehaviorStrategyTIPL_RunnableBehaviorStrategyTIPL._m_behaviorStrategyTIPL._m_currentWorldModel._m_tiplObjects._m_value._9_.SitPredictedObject._._m_objectType.CONVERSION "@@@@RuleName created by CANape" 3 0 0 "OT_UNKNOWN" 1 1 "OT_VEHICLE" 2 2 "OT_VULNERABLE_ROAD_USER" DEFAULT_VALUE "" /end COMPU_VTAB_RANGE
/begin COMPU_VTAB_RANGE _g_DACore_SIT_RunnableBehaviorStrategyTIPL_RunnableBehaviorStrategyTIPL_m_environmentDataTipl_out_local.TMemPool._._._m_pool._m_values._0_._elem._m_egoData._m_vehicleStandStill.CONVERSION "@@@@RuleName created by CANape" 3 0 0 "moving" 1 1 "standstillNotReliable" 3 3 "standstillReliable" DEFAULT_VALUE "" /end COMPU_VTAB_RANGE
/begin COMPU_VTAB_RANGE _g_DACore_SIT_RunnableBehaviorStrategyTIPL_RunnableBehaviorStrategyTIPL_m_environmentDataTipl_out_local.TMemPool._._._m_pool._m_values._0_._elem._m_predictedObjects._m_value._9_._m_driveByCorridor._m_objectBorderRelationRight._laneBorderId.CONVERSION "@@@@RuleName created by CANape" 5 0 0 "borderLane0" 1 1 "borderLane01" 2 2 "borderLane12" 3 3 "borderLane2" 4 4 "borderLaneUnassigned" DEFAULT_VALUE "" /end COMPU_VTAB_RANGE
/begin COMPU_VTAB_RANGE _g_DACore_SIT_RunnableBehaviorStrategyTIPL_RunnableBehaviorStrategyTIPL_m_environmentDataTipl_out_local.TMemPool._._._m_pool._m_values._0_._elem._m_predictedObjects._m_value._9_._m_drivingTaskInformation._m_drivingTask.CONVERSION "@@@@RuleName created by CANape" 10 0 0 "laneKeeping0" 1 1 "laneKeeping1" 2 2 "laneKeeping2" 3 3 "laneChange01" 4 4 "laneChange10" 5 5 "laneChange12" 6 6 "laneChange21" 7 7 "outOfBoundsLeft" 8 8 "outOfBoundsRight" 9 9 "unknown" DEFAULT_VALUE "" /end COMPU_VTAB_RANGE
/begin COMPU_VTAB_RANGE _g_DACore_SIT_RunnableBehaviorStrategyTIPL_RunnableBehaviorStrategyTIPL_m_environmentDataTipl_out_local.TMemPool._._._m_pool._m_values._0_._elem._m_predictedObjects._m_value._9_._m_drivingTaskInformation._m_targetLaneIndex.CONVERSION "@@@@RuleName created by CANape" 4 0 0 "laneLeft" 1 1 "laneMiddle" 2 2 "laneRight" 255 255 "invalid" DEFAULT_VALUE "" /end COMPU_VTAB_RANGE
/begin COMPU_VTAB_RANGE _g_DACore_SIT_RunnableDmi_RunnableDmi._m_hostVehicleLaneInteractionManager._m_drivingTaskRecognition._m_observables._m_directionIndicator.CONVERSION "@@@@RuleName created by CANape" 3 0 0 "left" 1 1 "off" 2 2 "right" DEFAULT_VALUE "" /end COMPU_VTAB_RANGE
/begin COMPU_VTAB_RANGE _g_DACore_SIT_RunnableImbaFollowPrecedingObject_RunnableImbaFollowPrecedingObject._m_behaviorFollowPrecedingObjectWithLateralControl._m_lockOnTargetBehaviorSelector.Behavior2ImitateDecider._._m_selectedBehavior2Imitate._m_relations._m_value._2_._m_relatableElementIdentifiers._m_value._1_._m_typeId.CONVERSION "@@@@RuleName created by CANape" 5 0 0 "unknown" 1 1 "objectImba" 2 2 "egoVehicle" 3 3 "trajectory" 4 4 "polyline" DEFAULT_VALUE "" /end COMPU_VTAB_RANGE
/begin COMPU_VTAB_RANGE _g_DACore_SIT_RunnableLmfAndOlr_RunnableLmfAndOlr._m_LmfAndOlr._m_drivingDirection._m_drivingDirectionData._m_value._2_._m_drivingDirection.CONVERSION "@@@@RuleName created by CANape" 3 0 0 "unknown" 1 1 "synchronous" 2 2 "oncoming" DEFAULT_VALUE "" /end COMPU_VTAB_RANGE
/begin COMPU_VTAB_RANGE _g_DACore_SIT_RunnableTiplTurnCoDriver_RunnableTiplTurnCoDriver_m_evaluatedBehaviors_out_local.TMemPool._._._m_pool._m_values._0_._elem._m_evalBehaviorList._m_value._0_._m_rpCalcResultList._m_value._0_._m_reactionPatterns._m_value._0_._m_behaviorSpecification._m_systemCapability.CONVERSION "@@@@RuleName created by CANape" 11 0 0 "undefined" 1 1 "laneDriving" 2 2 "forwardCollisionWarning" 3 3 "emergencyBrake" 4 4 "partialBrake" 5 5 "immediateBrake" 6 6 "emergencyBrakeAssist" 20 20 "laneChangeLeft" 21 21 "laneChangeRight" 22 22 "laneDepartureWarning" 23 23 "returnToLane" DEFAULT_VALUE "" /end COMPU_VTAB_RANGE
/begin COMPU_VTAB_RANGE _g_DACore_SIT_RunnableTiplTurnCoDriver_RunnableTiplTurnCoDriver_m_evaluatedBehaviors_out_local.TMemPool._._._m_pool._m_values._0_._elem._m_evalBehaviorList._m_value._0_._m_rpCalcResultList._m_value._0_._m_reactionPatterns._m_value._0_._m_corridor._m_dynamicRedBorders._m_memory._m_values._3_._m_vertexType.CONVERSION "@@@@RuleName created by CANape" 6 0 0 "rightFront" 1 1 "leftFront" 2 2 "rightRear" 3 3 "leftRear" 4 4 "blockedFront" 5 5 "blockedRear" DEFAULT_VALUE "" /end COMPU_VTAB_RANGE
/begin COMPU_VTAB_RANGE _g_DACore_SIT_RunnableTiplTurnCoDriver_RunnableTiplTurnCoDriver_m_evaluatedBehaviors_out_local.TMemPool._._._m_pool._m_values._0_._elem._m_evalBehaviorList._m_value._0_._m_rpCalcResultList._m_value._0_._m_reactionPatterns._m_value._0_._m_corridor._m_guidanceConfiguration._m_drivingModeLongitudinal.CONVERSION "@@@@RuleName created by CANape" 3 0 0 "normal" 1 1 "eco" 2 2 "dynamic" DEFAULT_VALUE "" /end COMPU_VTAB_RANGE
/begin COMPU_VTAB_RANGE _g_DACore_SIT_RunnableTiplTurnCoDriver_RunnableTiplTurnCoDriver_m_evaluatedBehaviors_out_local.TMemPool._._._m_pool._m_values._0_._elem._m_evalBehaviorList._m_value._0_._m_rpCalcResultList._m_value._0_._m_reactionPatterns._m_value._0_._m_corridor._m_guidanceConfiguration._m_longitudinalMotionType.CONVERSION "@@@@RuleName created by CANape" 2 0 0 "comfort" 1 1 "emergency" DEFAULT_VALUE "" /end COMPU_VTAB_RANGE
/begin COMPU_VTAB_RANGE _g_DACore_SIT_RunnableTiplTurnCoDriver_RunnableTiplTurnCoDriver_m_evaluatedBehaviors_out_local.TMemPool._._._m_pool._m_values._0_._elem._m_evalBehaviorList._m_value._0_._m_rpCalcResultList._m_value._0_._m_reactionPatterns._m_value._0_._m_corridor._m_guidanceConfiguration._m_speedLimiter.CONVERSION "@@@@RuleName created by CANape" 3 0 0 "off" 1 1 "standby" 2 2 "on" DEFAULT_VALUE "" /end COMPU_VTAB_RANGE
/begin COMPU_VTAB_RANGE _g_DACore_SIT_RunnableTiplTurnCoDriver_RunnableTiplTurnCoDriver_m_evaluatedBehaviors_out_local.TMemPool._._._m_pool._m_values._0_._elem._m_evalBehaviorList._m_value._0_._m_rpCalcResultList._m_value._0_._m_reactionPatterns._m_value._0_._m_corridor._m_guidanceConfiguration._m_stationaryHoldMode.CONVERSION "@@@@RuleName created by CANape" 2 0 0 "normal" 1 1 "secure" DEFAULT_VALUE "" /end COMPU_VTAB_RANGE
/begin COMPU_VTAB_RANGE _g_DACore_SIT_RunnableTiplTurnCoDriver_RunnableTiplTurnCoDriver_m_evaluatedBehaviors_out_local.TMemPool._._._m_pool._m_values._0_._elem._m_evalBehaviorList._m_value._0_._m_rpCalcResultList._m_value._0_._m_reactionPatterns._m_value._0_._m_degreeOfAssistanceLongitudinal.CONVERSION "@@@@RuleName created by CANape" 5 0 0 "none" 1 1 "warning" 2 2 "driverCorrecting" 3 3 "assisting" 4 4 "autonomous" DEFAULT_VALUE "" /end COMPU_VTAB_RANGE
/begin COMPU_VTAB_RANGE _g_DACore_SIT_RunnableTiplTurnCoDriver_RunnableTiplTurnCoDriver_m_evaluatedBehaviors_out_local.TMemPool._._._m_pool._m_values._0_._elem._m_evalBehaviorList._m_value._0_._m_rpCalcResultList._m_value._0_._m_reactionPatterns._m_value._0_._m_reactionPatternType.CONVERSION "@@@@RuleName created by CANape" 7 0 0 "undefined" 1 1 "laneDriving" 2 2 "laneChange" 3 3 "emergencyBrake" 4 4 "immediateBrake" 5 5 "returnToLane" 6 6 "activeWarning" DEFAULT_VALUE "" /end COMPU_VTAB_RANGE
/begin COMPU_VTAB_RANGE _g_DACore_SIT_RunnableTiplTurnCoDriver_RunnableTiplTurnCoDriver_m_introspection_out_local.TMemPool._._._m_pool._m_values._0_._elem._m_relevantBehaviorAttributes._m_value._0_._m_behaviorRestrictions._m_value._3_._m_restrictionType.CONVERSION "@@@@RuleName created by CANape" 4 0 0 "NONE" 1 1 "OBJECT" 2 2 "BORDER_LEFT" 3 3 "BORDER_RIGHT" DEFAULT_VALUE "" /end COMPU_VTAB_RANGE
/begin COMPU_VTAB_RANGE _g_DACore_SIT_RunnableTrafficRules_RunnableTrafficRules._m_controllerTrafficContextAnnotatedLanes._m_tcalContainer._m_trafficContexts.TList._._m_nodeAlloc._m_memPool._m_storage._m_vals._v1._7_._m_value._m_class.CONVERSION "@@@@RuleName created by CANape" 3 0 0 "unknown" 1 1 "contextFromRoadSign" 2 2 "contextFromMapData" DEFAULT_VALUE "" /end COMPU_VTAB_RANGE
/begin COMPU_VTAB_RANGE _g_DACore_SIT_RunnableTrafficRules_RunnableTrafficRules._m_controllerTrafficRules._m_ruleContainer._m_rules.TList._._m_nodeAlloc._m_memPool._m_storage._m_vals._v1._9_._m_value.TrafficRule._._m_ruleClass.CONVERSION "@@@@RuleName created by CANape" 5 0 0 "RC_UNKNOWN" 1 1 "RC_FROM_ROAD_SIGN" 2 2 "RC_DEFAULT_SPEED_LIMIT" 3 3 "RC_TRAFFIC_CONTEXT" 4 4 "RC_FROM_MAP_DATA" DEFAULT_VALUE "" /end COMPU_VTAB_RANGE
/begin COMPU_VTAB_RANGE _g_DACore_SIT_RunnableTrafficRules_RunnableTrafficRules._m_controllerTrafficRules._m_ruleContainer._m_rules.TList._._m_nodeAlloc._m_memPool._m_storage._m_vals._v1._9_._m_value.TrafficRule._._m_type.CONVERSION "@@@@RuleName created by CANape" 76 0 0 "TRT_INVALID" 100 100 "TRT_SPEED_LIMIT" 101 101 "TRT_SPEED_ADVICE" 102 102 "TRT_SPEED_MINIMUM" 200 200 "TRT_NO_PASSING" 300 300 "TRT_PAY_ATTENTION_DANGER" 301 301 "TRT_PAY_ATTENTION_CURVE_LEFT" 302 302 "TRT_PAY_ATTENTION_CURVE_RIGHT" 303 303 "TRT_PAY_ATTENTION_DOUBLE_CURVE_LEFT" 304 304 "TRT_PAY_ATTENTION_DOUBLE_CURVE_RIGHT" 305 305 "TRT_PAY_ATTENTION_TRAIN" 306 306 "TRT_PAY_ATTENTION_JAM" 307 307 "TRT_PAY_ATTENTION_ROAD_WORKS" 308 308 "TRT_PAY_ATTENTION_SLOPE_DOWN" 309 309 "TRT_PAY_ATTENTION_SLOPE_UP" 310 310 "TRT_PAY_ATTENTION_CONSTRICTION" 311 311 "TRT_PAY_ATTENTION_CONSTRICTION_LEFT" 312 312 "TRT_PAY_ATTENTION_CONSTRICTION_RIGHT" 313 313 "TRT_PAY_ATTENTION_PEDESTRIANS" 314 314 "TRT_PAY_ATTENTION_KIDS" 315 315 "TRT_PAY_ATTENTION_BIKES" 316 316 "TRT_PAY_ATTENTION_SKIDDING" 317 317 "TRT_PAY_ATTENTION_ROUNDABOUT" 318 318 "TRT_PAY_ATTENTION_WILD_ANIMAL" 319 319 "TRT_PAY_ATTENTION_CATTLE" 320 320 "TRT_PAY_ATTENTION_FROGS" 321 321 "TRT_PAY_ATTENTION_BUS" 322 322 "TRT_PAY_ATTENTION_WIND" 323 323 "TRT_PAY_ATTENTION_SNOW" 324 324 "TRT_PAY_ATTENTION_PEDESTRIAN_CROSSING" 325 325 "TRT_PAY_ATTENTION_HUMP" 326 326 "TRT_PAY_ATTENTION_ROCK" 327 327 "TRT_PAY_ATTENTION_LOW_TREE" 328 328 "TRT_PAY_ATTENTION_GRAVEL" 329 329 "TRT_PAY_ATTENTION_TWO_WAY" 330 330 "TRT_PAY_ATTENTION_LIGHTS" 331 331 "TRT_PAY_ATTENTION_PLANE" 332 332 "TRT_PAY_ATTENTION_RIDER" 333 333 "TRT_PAY_ATTENTION_DRAWBRIDGE" 334 334 "TRT_PAY_ATTENTION_PIER" 335 335 "TRT_PAY_ATTENTION_JUNCTION" 336 336 "TRT_PAY_ATTENTION_CRASH_RISK" 337 337 "TRT_PAY_ATTENTION_ACCIDENT" 338 338 "TRT_PAY_ATTENTION_SMOKE" 339 339 "TRT_PAY_ATTENTION_OIL_TRAIL" 340 340 "TRT_PAY_ATTENTION_DIRTY_ROAD" 341 341 "TRT_PAY_ATTENTION_ROAD_DAMAGE" 342 342 "TRT_PAY_ATTENTION_RUTS" 343 343 "TRT_PAY_ATTENTION_SOFT_SHOULDER" 344 344 "TRT_PAY_ATTENTION_CUSTOMS" 345 345 "TRT_PAY_ATTENTION_DEAD_END" 346 346 "TRT_PAY_ATTENTION_POLLUTION" 400 400 "TRT_NO_ENTRY" 401 401 "TRT_NO_ENTRY_ONE_WAY" 500 500 "TRT_RIGHT_OF_WAY" 501 501 "TRT_RIGHT_OF_WAY_NEXT_CROSSING" 502 502 "TRT_GIVE_RIGHT_OF_WAY_NEXT_CROSSING" 503 503 "TRT_YIELD_TO_RIGHT_NEXT_CROSSING" 504 504 "TRT_YIELD_TO_LEFT_NEXT_CROSSING" 505 505 "TRT_STOP_AND_YIELD" 600 600 "TRT_DIRECTION_ONLY_STRAIGHT" 601 601 "TRT_DIRECTION_ONLY_RIGHT" 602 602 "TRT_DIRECTION_ONLY_LEFT" 603 603 "TRT_DIRECTION_ONLY_STRAIGHT_OR_LEFT" 604 604 "TRT_DIRECTION_ONLY_STRAIGHT_OR_RIGHT" 605 605 "TRT_DIRECTION_ONLY_LEFT_OR_RIGHT" 606 606 "TRT_NO_UTURN" 700 700 "TRT_NO_PARKING" 701 701 "TRT_NO_STOPPING" 702 702 "TRT_NO_STOPPING_ON_SHOULDER" 800 800 "TRT_ORDER_KEEP_DISTANCE" 801 801 "TRT_ORDER_ZEBRA_CROSSING" 802 802 "TRT_ORDER_UMWELT_ZONE" 803 803 "TRT_ORDER_TURN_LIGHTS_ON" 804 804 "TRT_ORDER_TURN_LIGHTS_OFF" 805 805 "TRT_ORDER_ONE_WAY_STREET" DEFAULT_VALUE "" /end COMPU_VTAB_RANGE
/begin COMPU_VTAB_RANGE _g_DACore_SIT_RunnableTrafficRules_RunnableTrafficRules._m_controllerTrafficRules._m_ruleContainer._m_rules.TList._._m_nodeAlloc._m_memPool._m_storage._m_vals._v1._9_._m_value._m_cancelationType.CONVERSION "@@@@RuleName created by CANape" 7 0 0 "CT_NONE" 1 1 "CT_ALL" 2 2 "CT_SPEED_LIMIT" 3 3 "CT_SPEED_ADVICE" 4 4 "CT_SPEED_MINIMUM" 5 5 "CT_NO_PASSING" 6 6 "CT_RIGHT_OF_WAY" DEFAULT_VALUE "" /end COMPU_VTAB_RANGE
/begin COMPU_VTAB_RANGE _g_triggerC1Runnable.TExtensionSystemTime._._m_systemTime._m_status.CONVERSION "@@@@RuleName created by CANape" 3 1 1 "OK" 2 2 "ERROR" 3 3 "IMPRECISE" DEFAULT_VALUE "" /end COMPU_VTAB_RANGE
/begin COMPU_VTAB _mbist_MTURegisters_cast._0_._MBISTSEL_e.CONVERSION "enumeration table" TAB_VERB 97 0 "mbist_CPU0DMEM_e" 1 "mbist_CPU0DTAG_e" 2 "mbist_CPU0PMEM_e" 3 "mbist_CPU0PTAG_e" 4 "mbist_CPU0DLMUSTBY_e" 5 "mbist_CPU1DMEM_e" 6 "mbist_CPU1DTAG_e" 7 "mbist_CPU1PMEM_e" 8 "mbist_CPU1PTAG_e" 9 "mbist_CPU1DLMUSTBY_e" 10 "mbist_CPU2DMEM_e" 11 "mbist_CPU2DTAG_e" 12 "mbist_CPU2PMEM_e" 13 "mbist_CPU2PTAG_e" 14 "mbist_CPU2DLMU_e" 15 "mbist_CPU3DMEM_e" 16 "mbist_CPU3DTAG_e" 17 "mbist_CPU3PMEM_e" 18 "mbist_CPU3PTAG_e" 19 "mbist_CPU3DLMU_e" 20 "mbist_CPU4DMEM_e" 21 "mbist_CPU4DTAG_e" 22 "mbist_CPU4PMEM_e" 23 "mbist_CPU4PTAG_e" 24 "mbist_CPU4DLMU_e" 25 "mbist_CPU5DMEM_e" 26 "mbist_CPU5DTAG_e" 27 "mbist_CPU5PMEM_e" 28 "mbist_CPU5PTAG_e" 29 "mbist_CPU5DLMU_e" 30 "mbist_LMU00_e" 31 "mbist_LMU10_e" 32 "mbist_LMU20_e" 33 "mbist_Reserved0_e" 34 "mbist_CPU0DMEM1_e" 35 "mbist_CPU1DMEM1_e" 36 "mbist_Reserved1_e" 37 "mbist_Reserved2_e" 38 "mbist_DAM0_e" 39 "mbist_DAM1_e" 40 "mbist_Reserved3_e" 41 "mbist_SADMA_e" 42 "mbist_Reserved4_e" 43 "mbist_MCDS_e" 44 "mbist_EMEM0_e" 45 "mbist_EMEM1_e" 46 "mbist_EMEM2_e" 47 "mbist_EMEM3_e" 48 "mbist_EMEMXTM_e" 49 "mbist_SPUBUFFER0_e" 50 "mbist_SPUBUFFER1_e" 51 "mbist_SPUCONFIG0_e" 52 "mbist_SPUCONFIG1_e" 53 "mbist_GTMFIFO_e" 54 "mbist_GTMMCS0SLOW_e" 55 "mbist_GTMMCS0FAST_e" 56 "mbist_GTMMCS1SLOW_e" 57 "mbist_GTMMCS1FAST_e" 58 "mbist_GTMDPLL1A_e" 59 "mbist_GTMDPLL1BC_e" 60 "mbist_GTMDPLL2_e" 61 "mbist_Reserved5_e" 62 "mbist_MCAN10_e" 63 "mbist_MCAN20_e" 64 "mbist_MCAN21_e" 65 "mbist_PSI5_e" 66 "mbist_ERAYOBF0_e" 67 "mbist_ERAYOBF1_e" 68 "mbist_ERAYTBFIBF0_e" 69 "mbist_ERAYTBFIBF1_e" 70 "mbist_ERAYMBF0_e" 71 "mbist_ERAYMBF1_e" 72 "mbist_Reserved6_e" 73 "mbist_Reserved7_e" 74 "mbist_Reserved8_e" 75 "mbist_Reserved9_e" 76 "mbist_Reserved10_e" 77 "mbist_SCRXRAM_e" 78 "mbist_SCRRAMINT_e" 79 "mbist_Reserved11_e" 80 "mbist_Reserved12_e" 81 "mbist_Reserved13_e" 82 "mbist_GIGETHRXRAM_e" 83 "mbist_GIGETHTXRAM_e" 84 "mbist_SDMMCRAM_e" 85 "mbist_HSPDMRAM_e" 86 "mbist_Reserved14_e" 87 "mbist_Reserved15_e" 88 "mbist_SPUFFT00_e" 89 "mbist_SPUFFT01_e" 90 "mbist_SPUFFT10_e" 91 "mbist_SPUFFT11_e" 92 "mbist_SPUFFT20_e" 93 "mbist_SPUFFT21_e" 94 "mbist_SPUFFT30_e" 95 "mbist_SPUFFT31_e" 96 "mbist_MaxSSH_e" /end COMPU_VTAB
/begin COMPU_VTAB _mon_config_cast._0_._depmonitem_en.CONVERSION "enumeration table" TAB_VERB 10 0 "MON_ITEM_ADCVOLTAGEPLAUSI_E" 1 "MON_ITEM_VBATOVERVOLTAGE_E" 2 "MON_ITEM_VBATUNDERVOLTAGE_E" 3 "MON_ITEM_ADCTEMPERATUREPLAUSI_E" 4 "MON_ITEM_ECUTEMPERATURERANGE_E" 5 "MON_ITEM_ECUTEMPERATUREDEFECT_E" 6 "MON_ITEM_UCTEMPERATURERANGE_E" 7 "MON_ITEM_UCTEMPERATUREDEFECT_E" 8 "MON_ITEM_SYSTEMPERATUREPLAUSI_E" 9 "MON_ENDOFITEMS_E" /end COMPU_VTAB
/begin COMPU_VTAB_RANGE _mon_config_cast._0_._type_en.CONVERSION "@@@@RuleName created by CANape" 7 0 0 "MON_TYPE_SIMPLEUNDERTHRESHOLD_E" 1 1 "MON_TYPE_SIMPLEOVERTHRESHOLD_E" 2 2 "MON_TYPE_SIMPLEUNDEROVERTHRESHOLD_E" 3 3 "MON_TYPE_HYSTERESISUNDERTHRESHOLD_E" 4 4 "MON_TYPE_HYSTERESISOVERTHRESHOLD_E" 5 5 "MON_TYPE_HYSTERESISUNDEROVERTHRESHOLD_E" 6 6 "MON_TYPE_DIRECTREPORTING_E" DEFAULT_VALUE "" /end COMPU_VTAB_RANGE
/begin COMPU_VTAB _mon_filteredstatus_aen._0_.CONVERSION "enumeration table" TAB_VERB 5 0 "MON_STATUS_PASS_E" 1 "MON_STATUS_PREPASS_E" 2 "MON_STATUS_PREFAIL_E" 3 "MON_STATUS_FAIL_E" 4 "MON_STATUS_DEFAULT_E" /end COMPU_VTAB
/begin COMPU_VTAB_RANGE _mon_status_aen._0_.CONVERSION "@@@@RuleName created by CANape" 5 0 0 "MON_STATUS_DEFAULT_E" 1 1 "MON_STATUS_PASS_E" 2 2 "MON_STATUS_PREPASS_E" 3 3 "MON_STATUS_PREFAIL_E" 4 4 "MON_STATUS_FAIL_E" DEFAULT_VALUE "" /end COMPU_VTAB_RANGE
/begin COMPU_VTAB _rbInterruptHandler_DebugInfoSample_st._UnintendedInterruptIndex_en.CONVERSION "enumeration table" TAB_VERB 8 0 "RBINTERRUPTHANDLER_INTERRUPT_DEFAULT_E" 1 "RBINTERRUPTHANDLER_INTERRUPT_DMA0ERROR_E" 2 "RBINTERRUPTHANDLER_INTERRUPT_DMACH7_E" 3 "RBINTERRUPTHANDLER_INTERRUPT_DMACH10_E" 4 "RBINTERRUPTHANDLER_INTERRUPT_CAN0INT00_E" 5 "RBINTERRUPTHANDLER_INTERRUPT_CAN1INT00_E" 6 "RBINTERRUPTHANDLER_INTERRUPT_CAN2INT00_E" 7 "RBINTERRUPTHANDLER_ENDOFLISTOFINTERRUPTS_E" /end COMPU_VTAB
/begin COMPU_VTAB _rbInterruptHandler_StoreDebugInfoState_en.CONVERSION "enumeration table" TAB_VERB 3 0 "RBINTERRUPTHANDLER_STOREDEBUGINFO_CHECKFORNEWWRITEREQUEST_E" 1 "RBINTERRUPTHANDLER_STOREDEBUGINFO_REQUESTNVMWRITE_E" 2 "RBINTERRUPTHANDLER_STOREDEBUGINFO_POLLNVMWRITESTATUS_E" /end COMPU_VTAB
/begin COMPU_VTAB _rbModeMgr_ActiveSystemMode_en.CONVERSION "enumeration table" TAB_VERB 12 0 "RBMODEMGR_SYSTEMMODE_DEFAULT_E" 1 "RBMODEMGR_SYSTEMMODE_STARTUP_MAIN_E" 2 "RBMODEMGR_SYSTEMMODE_STARTUP_ECUM_NORMAL_E" 3 "RBMODEMGR_SYSTEMMODE_STARTUP_ECUM_SAFEIRR_E" 4 "RBMODEMGR_SYSTEMMODE_STARTUP_ECUM_PRODUCTION_E" 5 "RBMODEMGR_SYSTEMMODE_STARTUP_CYCLIC_NORMAL_E" 6 "RBMODEMGR_SYSTEMMODE_STARTUP_CYCLIC_SAFEIRR_E" 7 "RBMODEMGR_SYSTEMMODE_STARTUP_CYCLIC_PRODUCTION_E" 8 "RBMODEMGR_SYSTEMMODE_RUN_E" 9 "RBMODEMGR_SYSTEMMODE_SAFEIRR_E" 10 "RBMODEMGR_SYSTEMMODE_PRODUCTION_E" 11 "RBMODEMGR_SYSTEMMODE_SHUTDOWN_E" /end COMPU_VTAB
/begin COMPU_VTAB _rbResetHandler_ResetState_en.CONVERSION "enumeration table" TAB_VERB 4 0 "RBRESETHANDLER_RESETSTATE_WAITFORRESETREQUEST_E" 1 "RBRESETHANDLER_RESETSTATE_WAITFORSHUTDOWNCOMPLETION_E" 2 "RBRESETHANDLER_RESETSTATE_NOTIFYSLAVEDEVICES_E" 3 "RBRESETHANDLER_RESETSTATE_ISSUERESET_E" /end COMPU_VTAB
/begin COMPU_VTAB _rbResetHandler_ResetType_en.CONVERSION "enumeration table" TAB_VERB 2 0 "RBRESETHANDLER_RESETTYPE_SOFTWARERESET_E" 1 "RBRESETHANDLER_RESETTYPE_APPLICATIONRESET_E" /end COMPU_VTAB
/begin COMPU_VTAB _rbSftMon_CoreClkMainState_en.CONVERSION "enumeration table" TAB_VERB 4 0 "RBSFTMON_CORECLK_MAINSTATE_ENABLETEST_E" 1 "RBSFTMON_CORECLK_MAINSTATE_TESTTRIGGER_E" 2 "RBSFTMON_CORECLK_MAINSTATE_DTCHANDLING_E" 3 "RBSFTMON_CORECLK_MAINSTATE_TESTEND_E" /end COMPU_VTAB
/begin COMPU_VTAB _rbSftMon_CoreClkTestStatus_en.CONVERSION "enumeration table" TAB_VERB 3 0 "RBSFTMON_CORECLK_STATUS_PENDING_E" 1 "RBSFTMON_CORECLK_STATUS_FAILED_E" 2 "RBSFTMON_CORECLK_STATUS_PASSED_E" /end COMPU_VTAB
/begin COMPU_VTAB _rbSftMon_CoreVoltageMainState_en.CONVERSION "enumeration table" TAB_VERB 3 0 "RBSFTMON_COREVOLTAGE_IDLE_E" 1 "RBSFTMON_COREVOLTAGE_TRIGGERTEST_E" 2 "RBSFTMON_COREVOLTAGE_EVALUATE_E" /end COMPU_VTAB
/begin COMPU_VTAB _rbSftMon_StackStatus_aen._0_.CONVERSION "enumeration table" TAB_VERB 3 0 "RBSFTMON_STACKSTATUS_PASS_E" 1 "RBSFTMON_STACKSTATUS_FAIL_E" 2 "RBSFTMON_STACKSTATUS_PREFAIL_E" /end COMPU_VTAB
/begin COMPU_VTAB _rbSftMon_coreClkRunningIndex_en.CONVERSION "enumeration table" TAB_VERB 6 0 "RBSFTMON_CORECLK_LIST_SYSTEMFPLL0_E" 1 "RBSFTMON_CORECLK_LIST_PHASEFPLL1_E" 2 "RBSFTMON_CORECLK_LIST_PHASEFPLL2_E" 3 "RBSFTMON_CORECLK_LIST_EXTENDEDSPB_E" 4 "RBSFTMON_CORECLK_LIST_BACKUP_E" 5 "RBSFTMON_CORECLK_LIST_END_E" /end COMPU_VTAB
/begin COMPU_VTAB _rbSftMon_coreClkTest_st._0_._SubState_en.CONVERSION "enumeration table" TAB_VERB 6 0 "RBSFTMON_CORECLK_SUBSTATE_START_E" 1 "RBSFTMON_CORECLK_SUBSTATE_TRIGGERTESTING_E" 2 "RBSFTMON_CORECLK_SUBSTATE_WAITFORTESTRESULT_E" 3 "RBSFTMON_CORECLK_SUBSTATE_CLEARTHEREQUEST_E" 4 "RBSFTMON_CORECLK_SUBSTATE_CLEARTHEALARM_E" 5 "RBSFTMON_CORECLK_SUBSTATE_IDLE_E" /end COMPU_VTAB
/begin COMPU_VTAB _rb_Sbst_CustSlice_en.CONVERSION "enumeration table" TAB_VERB 10 0 "rb_Sbst_Slice0_e" 1 "rb_Sbst_Slice1_e" 2 "rb_Sbst_Slice2_e" 3 "rb_Sbst_Slice3_e" 4 "rb_Sbst_Slice4_e" 5 "rb_Sbst_Slice5_e" 6 "rb_Sbst_Slice6_e" 7 "rb_Sbst_Slice7_e" 8 "rb_Sbst_Result_e" 9 "rb_Sbst_MaxSlice_e" /end COMPU_VTAB
/begin COMPU_VTAB_RANGE _rba_Can_Status_ast._9_._NodeStatus_st._Can_IPType_en.CONVERSION "@@@@RuleName created by CANape" 7 0 0 "MCAN" 1 1 "MULTICAN" 2 2 "DCAN" 3 3 "AFCAN" 4 4 "ZYNQCAN" 5 5 "RSCAN" 6 6 "FLEXCAN" DEFAULT_VALUE "" /end COMPU_VTAB_RANGE
/begin COMPU_VTAB_RANGE _rba_Can_Status_ast._9_._RequestedState_en.CONVERSION "@@@@RuleName created by CANape" 5 0 0 "CANIF_CS_UNINIT" 1 1 "CANIF_CS_STOPPED" 2 2 "CANIF_CS_STARTED" 3 3 "CANIF_CS_SLEEP" 4 4 "CANIF_CS_MAXMODE" DEFAULT_VALUE "" /end COMPU_VTAB_RANGE
/begin COMPU_VTAB_RANGE _rba_Dma_Driver_ast._9_._chStatus_en.CONVERSION "@@@@RuleName created by CANape" 3 0 0 "RBA_DMA_IDLE" 1 1 "RBA_DMA_READY" 2 2 "RBA_DMA_BUSY" DEFAULT_VALUE "" /end COMPU_VTAB_RANGE
/begin COMPU_VTAB_RANGE _rba_Emm_Cfg_IndivRTCfg_acst._0_._rba_Emm_Cfg_RTId_en.CONVERSION "@@@@RuleName created by CANape" 3 0 0 "rba_Emm_Prv_RT0_e" 1 1 "rba_Emm_Prv_RT1_e" 2 2 "rba_Emm_Prv_NumofRT_e" DEFAULT_VALUE "" /end COMPU_VTAB_RANGE
/begin COMPU_VTAB_RANGE _rba_FeeFs2_Prv_AllocBackground_st._state_en.CONVERSION "@@@@RuleName created by CANape" 3 0 0 "RBA_FEEFS2_PRV_ALLOC_BACKGROUND_IDLE_E" 1 1 "RBA_FEEFS2_PRV_ALLOC_BACKGROUND_ERASE_E" 2 2 "RBA_FEEFS2_PRV_ALLOC_BACKGROUND_SOFTREORG_E" DEFAULT_VALUE "" /end COMPU_VTAB_RANGE
/begin COMPU_VTAB_RANGE _rba_FeeFs2_Prv_AllocErase_st._state_en.CONVERSION "@@@@RuleName created by CANape" 5 0 0 "RBA_FEEFS2_PRV_ALLOC_ERASE_INIT_E" 1 1 "RBA_FEEFS2_PRV_ALLOC_ERASE_RDY4ERASE_E" 2 2 "RBA_FEEFS2_PRV_ALLOC_ERASE_FATPREPARE_E" 3 3 "RBA_FEEFS2_PRV_ALLOC_ERASE_DAT_E" 4 4 "RBA_FEEFS2_PRV_ALLOC_ERASE_FINAL_E" DEFAULT_VALUE "" /end COMPU_VTAB_RANGE
/begin COMPU_VTAB_RANGE _rba_FeeFs2_Prv_AllocMallocDat_st._state_en.CONVERSION "@@@@RuleName created by CANape" 11 0 0 "RBA_FEEFS2_PRV_ALLOC_MALLOCDAT_IDLE_E" 1 1 "RBA_FEEFS2_PRV_ALLOC_MALLOCDAT_INIT_E" 2 2 "RBA_FEEFS2_PRV_ALLOC_MALLOCDAT_MALLOCFAT_E" 3 3 "RBA_FEEFS2_PRV_ALLOC_MALLOCDAT_CREATEERASED_E" 4 4 "RBA_FEEFS2_PRV_ALLOC_MALLOCDAT_CREATEDAT_E" 5 5 "RBA_FEEFS2_PRV_ALLOC_MALLOCDAT_GETNEXTBLOCK_E" 6 6 "RBA_FEEFS2_PRV_ALLOC_MALLOCDAT_DATWRITE_E" 7 7 "RBA_FEEFS2_PRV_ALLOC_MALLOCDAT_FATWRITE_E" 8 8 "RBA_FEEFS2_PRV_ALLOC_MALLOCDAT_FINALIZEFAT_E" 9 9 "RBA_FEEFS2_PRV_ALLOC_MALLOCDAT_UNLINKDAT_E" 10 10 "RBA_FEEFS2_PRV_ALLOC_MALLOCDAT_FINAL_E" DEFAULT_VALUE "" /end COMPU_VTAB_RANGE
/begin COMPU_VTAB_RANGE _rba_FeeFs2_Prv_AllocMallocFat_st._state_en.CONVERSION "@@@@RuleName created by CANape" 8 0 0 "RBA_FEEFS2_PRV_ALLOC_MALLOCFAT_IDLE_E" 1 1 "RBA_FEEFS2_PRV_ALLOC_MALLOCFAT_INIT_E" 2 2 "RBA_FEEFS2_PRV_ALLOC_MALLOCFAT_GETERASED_E" 3 3 "RBA_FEEFS2_PRV_ALLOC_MALLOCFAT_SETFATPREPARE_E" 4 4 "RBA_FEEFS2_PRV_ALLOC_MALLOCFAT_MIGRATE_E" 5 5 "RBA_FEEFS2_PRV_ALLOC_MALLOCFAT_SETFATACTIVE_E" 6 6 "RBA_FEEFS2_PRV_ALLOC_MALLOCFAT_SETRDY4ERASE_E" 7 7 "RBA_FEEFS2_PRV_ALLOC_MALLOCFAT_FINAL_E" DEFAULT_VALUE "" /end COMPU_VTAB_RANGE
/begin COMPU_VTAB_RANGE _rba_FeeFs2_Prv_DatCopy_st._state_en.CONVERSION "" 5 0 0 "RBA_FEEFS2_PRV_DAT_COPY_IDLE_E" 1 1 "RBA_FEEFS2_PRV_DAT_COPY_INIT_E" 2 2 "RBA_FEEFS2_PRV_DAT_COPY_READ_E" 3 3 "RBA_FEEFS2_PRV_DAT_COPY_WRITE_E" 4 4 "RBA_FEEFS2_PRV_DAT_COPY_FINAL_E" DEFAULT_VALUE "" /end COMPU_VTAB_RANGE
/begin COMPU_VTAB_RANGE _rba_FeeFs2_Prv_DatCopy_st._state_en.CONVERSION0 "@@@@RuleName created by CANape" 5 0 0 "RBA_FEEFS2_PRV_DAT_COPY_IDLE_E" 1 1 "RBA_FEEFS2_PRV_DAT_COPY_INIT_E" 2 2 "RBA_FEEFS2_PRV_DAT_COPY_READ_E" 3 3 "RBA_FEEFS2_PRV_DAT_COPY_WRITE_E" 4 4 "RBA_FEEFS2_PRV_DAT_COPY_FINAL_E" DEFAULT_VALUE "" /end COMPU_VTAB_RANGE
/begin COMPU_VTAB_RANGE _rba_FeeFs2_Prv_DatUnlinkSector_st._state_en.CONVERSION "" 3 0 0 "RBA_FEEFS2_PRV_DAT_UNLINKSECTOR_IDLE_E" 1 1 "RBA_FEEFS2_PRV_DAT_UNLINKSECTOR_INIT_E" 2 2 "RBA_FEEFS2_PRV_DAT_UNLINKSECTOR_BUSY_E" DEFAULT_VALUE "" /end COMPU_VTAB_RANGE
/begin COMPU_VTAB_RANGE _rba_FeeFs2_Prv_DatUnlinkSector_st._state_en.CONVERSION0 "@@@@RuleName created by CANape" 3 0 0 "RBA_FEEFS2_PRV_DAT_UNLINKSECTOR_IDLE_E" 1 1 "RBA_FEEFS2_PRV_DAT_UNLINKSECTOR_INIT_E" 2 2 "RBA_FEEFS2_PRV_DAT_UNLINKSECTOR_BUSY_E" DEFAULT_VALUE "" /end COMPU_VTAB_RANGE
/begin COMPU_VTAB_RANGE _rba_FeeFs2_Prv_DatWrap_st._func_en.CONVERSION "" 5 0 0 "RBA_FEEFS2_PRV_DAT_FUNC_READ_E" 1 1 "RBA_FEEFS2_PRV_DAT_FUNC_WRITE_E" 2 2 "RBA_FEEFS2_PRV_DAT_FUNC_COMPARE_E" 3 3 "RBA_FEEFS2_PRV_DAT_FUNC_BLANKCHECK_E" 4 4 "RBA_FEEFS2_PRV_DAT_FUNC_CRC_E" DEFAULT_VALUE "" /end COMPU_VTAB_RANGE
/begin COMPU_VTAB_RANGE _rba_FeeFs2_Prv_DatWrap_st._func_en.CONVERSION0 "@@@@RuleName created by CANape" 5 0 0 "RBA_FEEFS2_PRV_DAT_FUNC_READ_E" 1 1 "RBA_FEEFS2_PRV_DAT_FUNC_WRITE_E" 2 2 "RBA_FEEFS2_PRV_DAT_FUNC_COMPARE_E" 3 3 "RBA_FEEFS2_PRV_DAT_FUNC_BLANKCHECK_E" 4 4 "RBA_FEEFS2_PRV_DAT_FUNC_CRC_E" DEFAULT_VALUE "" /end COMPU_VTAB_RANGE
/begin COMPU_VTAB_RANGE _rba_FeeFs2_Prv_DatWrap_st._state_en.CONVERSION "" 4 0 0 "RBA_FEEFS2_PRV_DAT_WRAP_IDLE_E" 1 1 "RBA_FEEFS2_PRV_DAT_WRAP_INIT_E" 2 2 "RBA_FEEFS2_PRV_DAT_WRAP_ACT_E" 3 3 "RBA_FEEFS2_PRV_DAT_WRAP_FINAL_E" DEFAULT_VALUE "" /end COMPU_VTAB_RANGE
/begin COMPU_VTAB_RANGE _rba_FeeFs2_Prv_DatWrap_st._state_en.CONVERSION0 "@@@@RuleName created by CANape" 4 0 0 "RBA_FEEFS2_PRV_DAT_WRAP_IDLE_E" 1 1 "RBA_FEEFS2_PRV_DAT_WRAP_INIT_E" 2 2 "RBA_FEEFS2_PRV_DAT_WRAP_ACT_E" 3 3 "RBA_FEEFS2_PRV_DAT_WRAP_FINAL_E" DEFAULT_VALUE "" /end COMPU_VTAB_RANGE
/begin COMPU_VTAB_RANGE _rba_FeeFs2_Prv_DatWrite_st._state_en.CONVERSION "" 7 0 0 "RBA_FEEFS2_PRV_DAT_WRITE_IDLE_E" 1 1 "RBA_FEEFS2_PRV_DAT_WRITE_INIT_E" 2 2 "RBA_FEEFS2_PRV_DAT_WRITE_WRITING_E" 3 3 "RBA_FEEFS2_PRV_DAT_WRITE_SAFEDATA_E" 4 4 "RBA_FEEFS2_PRV_DAT_WRITE_SETWLDFC_E" 5 5 "RBA_FEEFS2_PRV_DAT_WRITE_FINDEOD_E" 6 6 "RBA_FEEFS2_PRV_DAT_WRITE_FINAL_E" DEFAULT_VALUE "" /end COMPU_VTAB_RANGE
/begin COMPU_VTAB_RANGE _rba_FeeFs2_Prv_DatWrite_st._state_en.CONVERSION0 "@@@@RuleName created by CANape" 7 0 0 "RBA_FEEFS2_PRV_DAT_WRITE_IDLE_E" 1 1 "RBA_FEEFS2_PRV_DAT_WRITE_INIT_E" 2 2 "RBA_FEEFS2_PRV_DAT_WRITE_WRITING_E" 3 3 "RBA_FEEFS2_PRV_DAT_WRITE_SAFEDATA_E" 4 4 "RBA_FEEFS2_PRV_DAT_WRITE_SETWLDFC_E" 5 5 "RBA_FEEFS2_PRV_DAT_WRITE_FINDEOD_E" 6 6 "RBA_FEEFS2_PRV_DAT_WRITE_FINAL_E" DEFAULT_VALUE "" /end COMPU_VTAB_RANGE
/begin COMPU_VTAB_RANGE _rba_FeeFs2_Prv_FatCacheBuild_st._state_en.CONVERSION "" 2 0 0 "RBA_FEEFS2_PRV_FAT_CACHEBUILD_IDLE_E" 1 1 "RBA_FEEFS2_PRV_FAT_CACHEBUILD_BUSY_E" DEFAULT_VALUE "" /end COMPU_VTAB_RANGE
/begin COMPU_VTAB_RANGE _rba_FeeFs2_Prv_FatCacheBuild_st._state_en.CONVERSION0 "@@@@RuleName created by CANape" 2 0 0 "RBA_FEEFS2_PRV_FAT_CACHEBUILD_IDLE_E" 1 1 "RBA_FEEFS2_PRV_FAT_CACHEBUILD_BUSY_E" DEFAULT_VALUE "" /end COMPU_VTAB_RANGE
/begin COMPU_VTAB_RANGE _rba_FeeFs2_Prv_FatCache_st._mode_en.CONVERSION "" 3 0 0 "RBA_FEEFS2_PRV_FAT_CACHEMODE_UNDEF_E" 1 1 "RBA_FEEFS2_PRV_FAT_CACHEMODE_GETLATESTBYID_E" 2 2 "RBA_FEEFS2_PRV_FAT_CACHEMODE_GETLATESTBYADR_E" DEFAULT_VALUE "" /end COMPU_VTAB_RANGE
/begin COMPU_VTAB_RANGE _rba_FeeFs2_Prv_FatCache_st._mode_en.CONVERSION0 "@@@@RuleName created by CANape" 3 0 0 "RBA_FEEFS2_PRV_FAT_CACHEMODE_UNDEF_E" 1 1 "RBA_FEEFS2_PRV_FAT_CACHEMODE_GETLATESTBYID_E" 2 2 "RBA_FEEFS2_PRV_FAT_CACHEMODE_GETLATESTBYADR_E" DEFAULT_VALUE "" /end COMPU_VTAB_RANGE
/begin COMPU_VTAB_RANGE _rba_FeeFs2_Prv_FatEntry2Fls_st._state_en.CONVERSION "" 5 0 0 "RBA_FEEFS2_PRV_FAT_ENTRY2FLS_IDLE_E" 1 1 "RBA_FEEFS2_PRV_FAT_ENTRY2FLS_INIT_E" 2 2 "RBA_FEEFS2_PRV_FAT_ENTRY2FLS_WRITE_E" 3 3 "RBA_FEEFS2_PRV_FAT_ENTRY2FLS_WLERR_E" 4 4 "RBA_FEEFS2_PRV_FAT_ENTRY2FLS_FINAL_E" DEFAULT_VALUE "" /end COMPU_VTAB_RANGE
/begin COMPU_VTAB_RANGE _rba_FeeFs2_Prv_FatEntry2Fls_st._state_en.CONVERSION0 "@@@@RuleName created by CANape" 5 0 0 "RBA_FEEFS2_PRV_FAT_ENTRY2FLS_IDLE_E" 1 1 "RBA_FEEFS2_PRV_FAT_ENTRY2FLS_INIT_E" 2 2 "RBA_FEEFS2_PRV_FAT_ENTRY2FLS_WRITE_E" 3 3 "RBA_FEEFS2_PRV_FAT_ENTRY2FLS_WLERR_E" 4 4 "RBA_FEEFS2_PRV_FAT_ENTRY2FLS_FINAL_E" DEFAULT_VALUE "" /end COMPU_VTAB_RANGE
/begin COMPU_VTAB_RANGE _rba_FeeFs2_Prv_FatFinalize_st._state_en.CONVERSION "" 4 0 0 "RBA_FEEFS2_PRV_FAT_FINALIZE_INIT_E" 1 1 "RBA_FEEFS2_PRV_FAT_FINALIZE_BLANKCHECK_E" 2 2 "RBA_FEEFS2_PRV_FAT_FINALIZE_SHREDDER_E" 3 3 "RBA_FEEFS2_PRV_FAT_FINALIZE_FINAL_E" DEFAULT_VALUE "" /end COMPU_VTAB_RANGE
/begin COMPU_VTAB_RANGE _rba_FeeFs2_Prv_FatFinalize_st._state_en.CONVERSION0 "@@@@RuleName created by CANape" 4 0 0 "RBA_FEEFS2_PRV_FAT_FINALIZE_INIT_E" 1 1 "RBA_FEEFS2_PRV_FAT_FINALIZE_BLANKCHECK_E" 2 2 "RBA_FEEFS2_PRV_FAT_FINALIZE_SHREDDER_E" 3 3 "RBA_FEEFS2_PRV_FAT_FINALIZE_FINAL_E" DEFAULT_VALUE "" /end COMPU_VTAB_RANGE
/begin COMPU_VTAB_RANGE _rba_FeeFs2_Prv_FatGetLatestByAdr_st._state_en.CONVERSION "" 7 0 0 "RBA_FEEFS2_PRV_FAT_GETLATESTBYADR_IDLE_E" 1 1 "RBA_FEEFS2_PRV_FAT_GETLATESTBYADR_INIT_E" 2 2 "RBA_FEEFS2_PRV_FAT_GETLATESTBYADR_FILLCACHE_E" 3 3 "RBA_FEEFS2_PRV_FAT_GETLATESTBYADR_FILTERCACHE_E" 4 4 "RBA_FEEFS2_PRV_FAT_GETLATESTBYADR_VERIFY_E" 5 5 "RBA_FEEFS2_PRV_FAT_GETLATESTBYADR_CACHEBUILD_E" 6 6 "RBA_FEEFS2_PRV_FAT_GETLATESTBYADR_FINAL_E" DEFAULT_VALUE "" /end COMPU_VTAB_RANGE
/begin COMPU_VTAB_RANGE _rba_FeeFs2_Prv_FatGetLatestByAdr_st._state_en.CONVERSION0 "@@@@RuleName created by CANape" 7 0 0 "RBA_FEEFS2_PRV_FAT_GETLATESTBYADR_IDLE_E" 1 1 "RBA_FEEFS2_PRV_FAT_GETLATESTBYADR_INIT_E" 2 2 "RBA_FEEFS2_PRV_FAT_GETLATESTBYADR_FILLCACHE_E" 3 3 "RBA_FEEFS2_PRV_FAT_GETLATESTBYADR_FILTERCACHE_E" 4 4 "RBA_FEEFS2_PRV_FAT_GETLATESTBYADR_VERIFY_E" 5 5 "RBA_FEEFS2_PRV_FAT_GETLATESTBYADR_CACHEBUILD_E" 6 6 "RBA_FEEFS2_PRV_FAT_GETLATESTBYADR_FINAL_E" DEFAULT_VALUE "" /end COMPU_VTAB_RANGE
/begin COMPU_VTAB_RANGE _rba_FeeFs2_Prv_FatGetLatestById_st._state_en.CONVERSION "" 6 0 0 "RBA_FEEFS2_PRV_FAT_GETLATESTBYID_IDLE_E" 1 1 "RBA_FEEFS2_PRV_FAT_GETLATESTBYID_INIT_E" 2 2 "RBA_FEEFS2_PRV_FAT_GETLATESTBYID_CACHEBUILD_E" 3 3 "RBA_FEEFS2_PRV_FAT_GETLATESTBYID_SCAN_E" 4 4 "RBA_FEEFS2_PRV_FAT_GETLATESTBYID_VERIFY_E" 5 5 "RBA_FEEFS2_PRV_FAT_GETLATESTBYID_FINAL_E" DEFAULT_VALUE "" /end COMPU_VTAB_RANGE
/begin COMPU_VTAB_RANGE _rba_FeeFs2_Prv_FatGetLatestById_st._state_en.CONVERSION0 "@@@@RuleName created by CANape" 6 0 0 "RBA_FEEFS2_PRV_FAT_GETLATESTBYID_IDLE_E" 1 1 "RBA_FEEFS2_PRV_FAT_GETLATESTBYID_INIT_E" 2 2 "RBA_FEEFS2_PRV_FAT_GETLATESTBYID_CACHEBUILD_E" 3 3 "RBA_FEEFS2_PRV_FAT_GETLATESTBYID_SCAN_E" 4 4 "RBA_FEEFS2_PRV_FAT_GETLATESTBYID_VERIFY_E" 5 5 "RBA_FEEFS2_PRV_FAT_GETLATESTBYID_FINAL_E" DEFAULT_VALUE "" /end COMPU_VTAB_RANGE
/begin COMPU_VTAB_RANGE _rba_FeeFs2_Prv_FatMigrate_st._state_en.CONVERSION "" 6 0 0 "RBA_FEEFS2_PRV_FAT_MIGRATE_IDLE_E" 1 1 "RBA_FEEFS2_PRV_FAT_MIGRATE_INIT_E" 2 2 "RBA_FEEFS2_PRV_FAT_MIGRATE_GETBLOCK_E" 3 3 "RBA_FEEFS2_PRV_FAT_MIGRATE_WRITE_E" 4 4 "RBA_FEEFS2_PRV_FAT_MIGRATE_CACHEBUILD_E" 5 5 "RBA_FEEFS2_PRV_FAT_MIGRATE_FINAL_E" DEFAULT_VALUE "" /end COMPU_VTAB_RANGE
/begin COMPU_VTAB_RANGE _rba_FeeFs2_Prv_FatMigrate_st._state_en.CONVERSION0 "@@@@RuleName created by CANape" 6 0 0 "RBA_FEEFS2_PRV_FAT_MIGRATE_IDLE_E" 1 1 "RBA_FEEFS2_PRV_FAT_MIGRATE_INIT_E" 2 2 "RBA_FEEFS2_PRV_FAT_MIGRATE_GETBLOCK_E" 3 3 "RBA_FEEFS2_PRV_FAT_MIGRATE_WRITE_E" 4 4 "RBA_FEEFS2_PRV_FAT_MIGRATE_CACHEBUILD_E" 5 5 "RBA_FEEFS2_PRV_FAT_MIGRATE_FINAL_E" DEFAULT_VALUE "" /end COMPU_VTAB_RANGE
/begin COMPU_VTAB_RANGE _rba_FeeFs2_Prv_FatWrite_st._state_en.CONVERSION "" 3 0 0 "RBA_FEEFS2_PRV_FAT_FATWRITE_IDLE_E" 1 1 "RBA_FEEFS2_PRV_FAT_FATWRITE_INIT_E" 2 2 "RBA_FEEFS2_PRV_FAT_FATWRITE_WRITING_E" DEFAULT_VALUE "" /end COMPU_VTAB_RANGE
/begin COMPU_VTAB_RANGE _rba_FeeFs2_Prv_FatWrite_st._state_en.CONVERSION0 "@@@@RuleName created by CANape" 3 0 0 "RBA_FEEFS2_PRV_FAT_FATWRITE_IDLE_E" 1 1 "RBA_FEEFS2_PRV_FAT_FATWRITE_INIT_E" 2 2 "RBA_FEEFS2_PRV_FAT_FATWRITE_WRITING_E" DEFAULT_VALUE "" /end COMPU_VTAB_RANGE
/begin COMPU_VTAB_RANGE _rba_FeeFs2_Prv_InvalidateBlock_st._state_en.CONVERSION "@@@@RuleName created by CANape" 6 0 0 "RBA_FEEFS2_PRV_INVALIDATEBLOCK_IDLE_E" 1 1 "RBA_FEEFS2_PRV_INVALIDATEBLOCK_INIT_E" 2 2 "RBA_FEEFS2_PRV_INVALIDATEBLOCK_GETLATEST_E" 3 3 "RBA_FEEFS2_PRV_INVALIDATEBLOCK_MALLOCFAT_E" 4 4 "RBA_FEEFS2_PRV_INVALIDATEBLOCK_FATWRITE_E" 5 5 "RBA_FEEFS2_PRV_INVALIDATEBLOCK_FINAL_E" DEFAULT_VALUE "" /end COMPU_VTAB_RANGE
/begin COMPU_VTAB_RANGE _rba_FeeFs2_Prv_Read_st._state_en.CONVERSION "@@@@RuleName created by CANape" 5 0 0 "RBA_FEEFS2_PRV_READ_IDLE_E" 1 1 "RBA_FEEFS2_PRV_READ_INIT_E" 2 2 "RBA_FEEFS2_PRV_READ_GETLATEST_E" 3 3 "RBA_FEEFS2_PRV_READ_READING_E" 4 4 "RBA_FEEFS2_PRV_READ_FINAL_E" DEFAULT_VALUE "" /end COMPU_VTAB_RANGE
/begin COMPU_VTAB_RANGE _rba_FeeFs2_Prv_SectorErase_st._formerWorkingState_en.CONVERSION "@@@@RuleName created by CANape" 9 0 0 "FEE_RB_IDLE_E" 1 1 "FEE_RB_WRITE_MODE_E" 2 2 "FEE_RB_READ_MODE_E" 3 3 "FEE_RB_INVALIDATE_MODE_E" 4 4 "FEE_RB_MAINTAIN_MODE_E" 5 5 "FEE_RB_SOFT_SECTOR_REORG_MODE_E" 6 6 "FEE_RB_HARD_SECTOR_REORG_MODE_E" 7 7 "FEE_RB_SECTOR_ERASE_E" 8 8 "FEE_RB_STOPMODE_E" DEFAULT_VALUE "" /end COMPU_VTAB_RANGE
/begin COMPU_VTAB_RANGE _rba_FeeFs2_Prv_SectorErase_st._state_en.CONVERSION "" 6 0 0 "RBA_FEEFS2_PRV_SECTOR_ERASE_IDLE_E" 1 1 "RBA_FEEFS2_PRV_SECTOR_ERASE_INIT_E" 2 2 "RBA_FEEFS2_PRV_SECTOR_ERASE_OVERPROGRAMHEADER_E" 3 3 "RBA_FEEFS2_PRV_SECTOR_ERASE_ERASING_E" 4 4 "RBA_FEEFS2_PRV_SECTOR_ERASE_SETSTATE_E" 5 5 "RBA_FEEFS2_PRV_SECTOR_ERASE_FINAL_E" DEFAULT_VALUE "" /end COMPU_VTAB_RANGE
/begin COMPU_VTAB_RANGE _rba_FeeFs2_Prv_SectorErase_st._state_en.CONVERSION0 "@@@@RuleName created by CANape" 6 0 0 "RBA_FEEFS2_PRV_SECTOR_ERASE_IDLE_E" 1 1 "RBA_FEEFS2_PRV_SECTOR_ERASE_INIT_E" 2 2 "RBA_FEEFS2_PRV_SECTOR_ERASE_OVERPROGRAMHEADER_E" 3 3 "RBA_FEEFS2_PRV_SECTOR_ERASE_ERASING_E" 4 4 "RBA_FEEFS2_PRV_SECTOR_ERASE_SETSTATE_E" 5 5 "RBA_FEEFS2_PRV_SECTOR_ERASE_FINAL_E" DEFAULT_VALUE "" /end COMPU_VTAB_RANGE
/begin COMPU_VTAB_RANGE _rba_FeeFs2_Prv_SectorSetState_st._newSectorState_en.CONVERSION "@@@@RuleName created by CANape" 7 0 0 "RBA_FEEFS2_PRV_SECTOR_STATE_UNDEF_E" 1 1 "RBA_FEEFS2_PRV_SECTOR_STATE_ERASED_E" 2 2 "RBA_FEEFS2_PRV_SECTOR_STATE_FATPREPARE_E" 3 3 "RBA_FEEFS2_PRV_SECTOR_STATE_FATACTIVE_E" 4 4 "RBA_FEEFS2_PRV_SECTOR_STATE_DAT_E" 5 5 "RBA_FEEFS2_PRV_SECTOR_STATE_RDY4ERASE_E" 6 6 "RBA_FEEFS2_PRV_SECTOR_STATE_END_E" DEFAULT_VALUE "" /end COMPU_VTAB_RANGE
/begin COMPU_VTAB_RANGE _rba_FeeFs2_Prv_SectorSetState_st._state_en.CONVERSION "" 3 0 0 "RBA_FEEFS2_PRV_SECTOR_SETSTATE_IDLE_E" 1 1 "RBA_FEEFS2_PRV_SECTOR_SETSTATE_INIT_E" 2 2 "RBA_FEEFS2_PRV_SECTOR_SETSTATE_WRITING_E" DEFAULT_VALUE "" /end COMPU_VTAB_RANGE
/begin COMPU_VTAB_RANGE _rba_FeeFs2_Prv_SectorSetState_st._state_en.CONVERSION0 "@@@@RuleName created by CANape" 3 0 0 "RBA_FEEFS2_PRV_SECTOR_SETSTATE_IDLE_E" 1 1 "RBA_FEEFS2_PRV_SECTOR_SETSTATE_INIT_E" 2 2 "RBA_FEEFS2_PRV_SECTOR_SETSTATE_WRITING_E" DEFAULT_VALUE "" /end COMPU_VTAB_RANGE
/begin COMPU_VTAB_RANGE _rba_FeeFs2_Prv_SectorSetWlDfc_st._state_en.CONVERSION "" 3 0 0 "RBA_FEEFS2_PRV_SECTOR_SETWLDFC_IDLE_E" 1 1 "RBA_FEEFS2_PRV_SECTOR_SETWLDFC_INIT_E" 2 2 "RBA_FEEFS2_PRV_SECTOR_SETWLDFC_WRITING_E" DEFAULT_VALUE "" /end COMPU_VTAB_RANGE
/begin COMPU_VTAB_RANGE _rba_FeeFs2_Prv_SectorSetWlDfc_st._state_en.CONVERSION0 "@@@@RuleName created by CANape" 3 0 0 "RBA_FEEFS2_PRV_SECTOR_SETWLDFC_IDLE_E" 1 1 "RBA_FEEFS2_PRV_SECTOR_SETWLDFC_INIT_E" 2 2 "RBA_FEEFS2_PRV_SECTOR_SETWLDFC_WRITING_E" DEFAULT_VALUE "" /end COMPU_VTAB_RANGE
/begin COMPU_VTAB_RANGE _rba_FeeFs2_Prv_SectorWriteMarker_st._state_en.CONVERSION "" 3 0 0 "RBA_FEEFS2_PRV_SECTOR_WRITEMARKER_IDLE_E" 1 1 "RBA_FEEFS2_PRV_SECTOR_WRITEMARKER_INIT_E" 2 2 "RBA_FEEFS2_PRV_SECTOR_WRITEMARKER_WRITING_E" DEFAULT_VALUE "" /end COMPU_VTAB_RANGE
/begin COMPU_VTAB_RANGE _rba_FeeFs2_Prv_SectorWriteMarker_st._state_en.CONVERSION0 "@@@@RuleName created by CANape" 3 0 0 "RBA_FEEFS2_PRV_SECTOR_WRITEMARKER_IDLE_E" 1 1 "RBA_FEEFS2_PRV_SECTOR_WRITEMARKER_INIT_E" 2 2 "RBA_FEEFS2_PRV_SECTOR_WRITEMARKER_WRITING_E" DEFAULT_VALUE "" /end COMPU_VTAB_RANGE
/begin COMPU_VTAB_RANGE _rba_FeeFs2_Prv_Write_st._state_en.CONVERSION "@@@@RuleName created by CANape" 11 0 0 "RBA_FEEFS2_PRV_WRITE_IDLE_E" 1 1 "RBA_FEEFS2_PRV_WRITE_INIT_E" 2 2 "RBA_FEEFS2_PRV_WRITE_CALCCRCINRAM_E" 3 3 "RBA_FEEFS2_PRV_WRITE_GETLATEST_E" 4 4 "RBA_FEEFS2_PRV_WRITE_COMPARE_E" 5 5 "RBA_FEEFS2_PRV_WRITE_MALLOCDAT_E" 6 6 "RBA_FEEFS2_PRV_WRITE_MALLOCFAT_E" 7 7 "RBA_FEEFS2_PRV_WRITE_DATWRITE_E" 8 8 "RBA_FEEFS2_PRV_WRITE_VERIFY_E" 9 9 "RBA_FEEFS2_PRV_WRITE_FATWRITE_E" 10 10 "RBA_FEEFS2_PRV_WRITE_FINAL_E" DEFAULT_VALUE "" /end COMPU_VTAB_RANGE
/begin COMPU_VTAB_RANGE _rba_QueuedSpi_HwUnitCfg_0._0_._DmaConfigRx._TfrReqTyp_en.CONVERSION "" 6 0 0 "RBA_DMA_SW_TRIG_COMPLETE_TRANSACTION" 1 1 "RBA_DMA_SW_TRIG_SINGLE_TRANSFER" 2 2 "RBA_DMA_HW_TRIG_COMPLETE_TRANSACTION" 3 3 "RBA_DMA_HW_TRIG_SINGLE_TRANSFER" 4 4 "RBA_DMA_HW_TRIG_CONTINUOUS_SINGLE_TRANSFER" 5 5 "RBA_DMA_HW_TRIG_CONTINUOUS_COMPLETE_TRANSACTION" DEFAULT_VALUE "" /end COMPU_VTAB_RANGE
/begin COMPU_VTAB _rba_QueuedSpi_HwUnit_cast._0_._DmaConfigTx1_st._LinkedListTyp_en.CONVERSION "enumeration table" TAB_VERB 5 0 "RBA_DMA_NO_LINKEDLIST" 12 "RBA_DMA_LINKEDLIST" 13 "RBA_DMA_ACCUMULATED_LINKEDLIST" 14 "RBA_DMA_SAFE_LINKEDLIST" 15 "RBA_DMA_CONDITIONAL_LINKEDLIST" /end COMPU_VTAB
/begin COMPU_VTAB_RANGE _rba_QueuedSpi_HwUnit_cast._0_._stAsyncMode_en.CONVERSION "" 2 0 0 "SPI_RB_LO_POLLING_MODE" 1 1 "SPI_RB_LO_INTERRUPT_MODE" DEFAULT_VALUE "" /end COMPU_VTAB_RANGE
/begin COMPU_VTAB_RANGE _rba_QueuedSpi_HwUnit_cast._0_._stHwUnit_en.CONVERSION "" 3 0 0 "SPI_RB_LO_UNINIT" 1 1 "SPI_RB_LO_IDLE" 2 2 "SPI_RB_LO_BUSY" DEFAULT_VALUE "" /end COMPU_VTAB_RANGE
/begin COMPU_VTAB_RANGE _rba_QueuedSpi_HwUnit_cast._5_._DmaConfigTx2_st._ChDataWidth_en.CONVERSION "@@@@RuleName created by CANape" 6 0 0 "RBA_DMA_MOVE_HAS_8_BIT_DATA" 1 1 "RBA_DMA_MOVE_HAS_16_BIT_DATA" 2 2 "RBA_DMA_MOVE_HAS_32_BIT_DATA" 3 3 "RBA_DMA_MOVE_HAS_64_BIT_DATA" 4 4 "RBA_DMA_MOVE_HAS_128_BIT_DATA" 5 5 "RBA_DMA_MOVE_HAS_256_BIT_DATA" DEFAULT_VALUE "" /end COMPU_VTAB_RANGE
/begin COMPU_VTAB_RANGE _rba_QueuedSpi_HwUnit_cast._5_._DmaConfigTx2_st._IntTrigTyp_en.CONVERSION "@@@@RuleName created by CANape" 4 0 0 "RBA_DMA_NO_INT_BUT_FLAG_FOR_COMPLETE_TRANSACTION" 1 1 "RBA_DMA_NO_INT_BUT_FLAG_FOR_EACH_TRANSFER" 2 2 "RBA_DMA_INT_TRIG_AND_FLAG_FOR_COMPLETE_TRANSACTION" 3 3 "RBA_DMA_INT_TRIG_AND_FLAG_FOR_EACH_TRANSFER" DEFAULT_VALUE "" /end COMPU_VTAB_RANGE
/begin COMPU_VTAB_RANGE _rba_QueuedSpi_HwUnit_cast._5_._DmaConfigTx2_st._MovesPerTfr_en.CONVERSION "@@@@RuleName created by CANape" 8 0 0 "RBA_DMA_TFR_HAS_1_DMA_MOVE" 1 1 "RBA_DMA_TFR_HAS_2_DMA_MOVES" 2 2 "RBA_DMA_TFR_HAS_4_DMA_MOVES" 3 3 "RBA_DMA_TFR_HAS_8_DMA_MOVES" 4 4 "RBA_DMA_TFR_HAS_16_DMA_MOVES" 5 5 "RBA_DMA_TFR_HAS_3_DMA_MOVES" 6 6 "RBA_DMA_TFR_HAS_5_DMA_MOVES" 7 7 "RBA_DMA_TFR_HAS_9_DMA_MOVES" DEFAULT_VALUE "" /end COMPU_VTAB_RANGE
/begin COMPU_VTAB_RANGE _rba_QueuedSpi_HwUnit_cast._5_._DmaConfigTx2_st._SrcAddrModifier_en.CONVERSION "@@@@RuleName created by CANape" 17 0 0 "RBA_DMA_DECREMENT_ADDR_BY_1_X_DATAWIDTH" 1 1 "RBA_DMA_DECREMENT_ADDR_BY_2_X_DATAWIDTH" 2 2 "RBA_DMA_DECREMENT_ADDR_BY_4_X_DATAWIDTH" 3 3 "RBA_DMA_DECREMENT_ADDR_BY_8_X_DATAWIDTH" 4 4 "RBA_DMA_DECREMENT_ADDR_BY_16_X_DATAWIDTH" 5 5 "RBA_DMA_DECREMENT_ADDR_BY_32_X_DATAWIDTH" 6 6 "RBA_DMA_DECREMENT_ADDR_BY_64_X_DATAWIDTH" 7 7 "RBA_DMA_DECREMENT_ADDR_BY_128_X_DATAWIDTH" 8 8 "RBA_DMA_INCREMENT_ADDR_BY_1_X_DATAWIDTH" 9 9 "RBA_DMA_INCREMENT_ADDR_BY_2_X_DATAWIDTH" 10 10 "RBA_DMA_INCREMENT_ADDR_BY_4_X_DATAWIDTH" 11 11 "RBA_DMA_INCREMENT_ADDR_BY_8_X_DATAWIDTH" 12 12 "RBA_DMA_INCREMENT_ADDR_BY_16_X_DATAWIDTH" 13 13 "RBA_DMA_INCREMENT_ADDR_BY_32_X_DATAWIDTH" 14 14 "RBA_DMA_INCREMENT_ADDR_BY_64_X_DATAWIDTH" 15 15 "RBA_DMA_INCREMENT_ADDR_BY_128_X_DATAWIDTH" 16 16 "RBA_DMA_NO_MODIFICATION_OF_ADDRESS" DEFAULT_VALUE "" /end COMPU_VTAB_RANGE
/begin COMPU_VTAB_RANGE _rba_QueuedSpi_HwUnit_cast._5_._DmaConfigTx2_st._TfrReqTyp_en.CONVERSION "@@@@RuleName created by CANape" 6 0 0 "RBA_DMA_SW_TRIG_COMPLETE_TRANSACTION" 1 1 "RBA_DMA_SW_TRIG_SINGLE_TRANSFER" 2 2 "RBA_DMA_HW_TRIG_COMPLETE_TRANSACTION" 3 3 "RBA_DMA_HW_TRIG_SINGLE_TRANSFER" 4 4 "RBA_DMA_HW_TRIG_CONTINUOUS_SINGLE_TRANSFER" 5 5 "RBA_DMA_HW_TRIG_CONTINUOUS_COMPLETE_TRANSACTION" DEFAULT_VALUE "" /end COMPU_VTAB_RANGE
/begin COMPU_VTAB_RANGE _rba_QueuedSpi_HwUnit_cast._5_._stAsyncMode_en.CONVERSION "@@@@RuleName created by CANape" 2 0 0 "SPI_RB_LO_POLLING_MODE" 1 1 "SPI_RB_LO_INTERRUPT_MODE" DEFAULT_VALUE "" /end COMPU_VTAB_RANGE
/begin COMPU_VTAB_RANGE _rba_QueuedSpi_HwUnit_cast._5_._stHwUnit_en.CONVERSION "@@@@RuleName created by CANape" 3 0 0 "SPI_RB_LO_UNINIT" 1 1 "SPI_RB_LO_IDLE" 2 2 "SPI_RB_LO_BUSY" DEFAULT_VALUE "" /end COMPU_VTAB_RANGE
/begin COMPU_VTAB _rbsftmon_CoreClockInitializationState_en.CONVERSION "enumeration table" TAB_VERB 4 0 "RBSFTMON_CORECLK_INITSUBSTATE_ENABLESMUALARM_E" 1 "RBSFTMON_CORECLK_INITSUBSTATE_ENABLEMAINCLOCK_E" 2 "RBSFTMON_CORECLK_INITSUBSTATE_ENABLEBACKUPCLOCK_E" 3 "RBSFTMON_CORECLK_INITSUBSTATE_IDLEMODE_E" /end COMPU_VTAB
/begin COMPU_VTAB_RANGE _stLLDRet_st._stRet_en.CONVERSION "@@@@RuleName created by CANape" 9 0 0 "FLS_RB_ST_OK_E" 1 1 "FLS_RB_ST_ERROR_E" 2 2 "FLS_RB_ST_ERASING_E" 3 3 "FLS_RB_ST_PROGRAMMING_E" 4 4 "FLS_RB_ST_READING_E" 5 5 "FLS_RB_ST_COMPARING_E" 6 6 "FLS_RB_ST_COMPARE_FAILED_E" 254 254 "FLS_RB_ST_ADDR_ERR_E" 255 255 "FLS_RB_ST_LENGTH_ERR_E" DEFAULT_VALUE "" /end COMPU_VTAB_RANGE
/begin COMPU_VTAB_RANGE _syslog_dataLog._FreezeTrigger.CONVERSION "" 3 0 0 "SYSLOG_FREEZE_TRAHA" 1 1 "SYSLOG_FREEZE_RTAOS" 2 2 "SYSLOG_FREEZE_NOFREEZE" DEFAULT_VALUE "" /end COMPU_VTAB_RANGE
/begin COMPU_VTAB_RANGE _syslog_dataLog._LastResetReason.CONVERSION "@@@@RuleName created by CANape" 17 0 0 "MCU_ESR0_RESET" 1 1 "MCU_ESR1_RESET" 2 2 "MCU_SMU_RESET" 3 3 "MCU_SW_RESET" 4 4 "MCU_STM0_RESET" 5 5 "MCU_STM1_RESET" 6 6 "MCU_STM2_RESET" 7 7 "MCU_STM3_RESET" 8 8 "MCU_STM4_RESET" 9 9 "MCU_STM5_RESET" 10 10 "MCU_CB0_RESET" 11 11 "MCU_CB1_RESET" 12 12 "MCU_CB3_RESET" 13 13 "MCU_STBYR_RESET" 14 14 "MCU_WARM_POWER_ON_RESET" 15 15 "MCU_POWER_ON_RESET" 16 16 "MCU_RESET_UNDEFINED" DEFAULT_VALUE "" /end COMPU_VTAB_RANGE
/begin COMPU_VTAB_RANGE _warningArray._m_value._3_.CONVERSION "@@@@RuleName created by CANape" 5 0 0 "typeAcoustical" 1 1 "typeBrakeJerk" 2 2 "typePartialBrake" 3 3 "typeNoWarning" 4 4 "numTotalValues" DEFAULT_VALUE "" /end COMPU_VTAB_RANGE
/begin COMPU_VTAB calibRotState "enumeration table" TAB_VERB 3 0 "NOT_FINISHED" 1 "FINISHED_SUCCESSFULLY" 2 "FINISHED_UNSUCCESSFULLY" /end COMPU_VTAB
/begin COMPU_VTAB_RANGE d_builtin_type_print "" 10 0 0 "D_PRINT_DEFAULT" 1 1 "D_PRINT_INT" 2 2 "D_PRINT_UNSIGNED" 3 3 "D_PRINT_LONG" 4 4 "D_PRINT_UNSIGNED_LONG" 5 5 "D_PRINT_LONG_LONG" 6 6 "D_PRINT_UNSIGNED_LONG_LONG" 7 7 "D_PRINT_BOOL" 8 8 "D_PRINT_FLOAT" 9 9 "D_PRINT_VOID" DEFAULT_VALUE "" /end COMPU_VTAB_RANGE
/begin COMPU_VTAB driverHandsOnSteeringWheelCapacitive "enumeration table" TAB_VERB 3 0 "unknown" 1 "offWheel" 2 "onWheel" /end COMPU_VTAB
/begin COMPU_VTAB driverHandsOnSteeringWheelTorque "enumeration table" TAB_VERB 2 0 "notDetected" 1 "onWheel" /end COMPU_VTAB
/begin COMPU_VTAB driverIntendedSteeringDirection "enumeration table" TAB_VERB 3 0 "none" 1 "toLeft" 2 "toRight" /end COMPU_VTAB
/begin COMPU_VTAB drivingGearSelection "enumeration table" TAB_VERB 4 0 "parking" 1 "reverse" 2 "neutral" 3 "forward" /end COMPU_VTAB
/begin COMPU_VTAB_RANGE eErrorId "" 35 0 0 "RIF_CONF_ENABLE_TIMEOUT" 1 1 "RIF_CONF_DISABLE_TIMEOUT" 2 2 "RIF_CONF_RESET_TIMEOUT" 3 3 "RIF_DATA_CRC" 4 4 "RIF_DATA_COUNTER" 5 5 "RIF_DFU_LKSTP" 6 6 "RIF_REG_CRC" 7 7 "RIF_SFTY_CTRL" 8 8 "RIF_CAL_DESKEW" 9 9 "RIF_CAL_TIMEOUT" 10 10 "SPU_INT_TIMEOUT" 11 11 "SPU_MON_STAT_REG" 12 12 "SPU_HW_INIT" 13 13 "SPU_SBST" 14 14 "MMIC_CONFIG_FAILED" 15 15 "MMIC_MODRUN_FAILED" 16 16 "MMIC_EVALMON_FAILED" 17 17 "MMIC_TXLOWPOW_ERR" 18 18 "MMIC_TXAMPDRFT_ERR" 19 19 "MMIC_TXPHADRFT_ERR" 20 20 "MMIC_RXAMPDRFT_ERR" 21 21 "MMIC_RXPHADRFT_ERR" 22 22 "MMIC_RXGAIN_ERR" 23 23 "MMIC_RXCORFRQ_ERR" 24 24 "MMIC_UNDERVOLT_ERR" 25 25 "MMIC_BALLBREAK_ERR" 26 26 "MMIC_MBC_ERR" 27 27 "MMIC_OVERVOLT_ERR" 28 28 "MMIC_PLLDLDUNLOCK_ERR" 29 29 "MMIC_SPISEGV_ERR" 30 30 "MMIC_LVDS_ERR" 31 31 "MMIC_RMP_ERR" 32 32 "MMIC_RFSP_ERR" 33 33 "ERROR_DSP_INTERNAL" 34 34 "LENGTH_ERROR_LIST" DEFAULT_VALUE "" /end COMPU_VTAB_RANGE
/begin COMPU_VTAB_RANGE eErrorId.OLD_1 "" 31 0 0 "RIF_CONF_ENABLE_TIMEOUT" 1 1 "RIF_CONF_DISABLE_TIMEOUT" 2 2 "RIF_CONF_RESET_TIMEOUT" 3 3 "RIF_DATA_CRC" 4 4 "RIF_DATA_COUNTER" 5 5 "RIF_CAL_DESKEW" 6 6 "RIF_CAL_TIMEOUT" 7 7 "SPU_INT_TIMEOUT" 8 8 "SPU_MON_STAT_REG" 9 9 "SPU_HW_INIT" 10 10 "SPU_SBST" 11 11 "MMIC_CONFIG_FAILED" 12 12 "MMIC_MODRUN_FAILED" 13 13 "MMIC_EVALMON_FAILED" 14 14 "MMIC_TXLOWPOW_ERR" 15 15 "MMIC_TXAMPDRFT_ERR" 16 16 "MMIC_TXPHADRFT_ERR" 17 17 "MMIC_RXAMPDRFT_ERR" 18 18 "MMIC_RXPHADRFT_ERR" 19 19 "MMIC_RXGAIN_ERR" 20 20 "MMIC_RXCORFRQ_ERR" 21 21 "MMIC_UNDERVOLT_ERR" 22 22 "MMIC_BALLBREAK_ERR" 23 23 "MMIC_MBC_ERR" 24 24 "MMIC_OVERVOLT_ERR" 25 25 "MMIC_PLLDLDUNLOCK_ERR" 26 26 "MMIC_SPISEGV_ERR" 27 27 "MMIC_LVDS_ERR" 28 28 "MMIC_RMP_ERR" 29 29 "ERROR_DSP_INTERNAL" 30 30 "LENGTH_ERROR_LIST" DEFAULT_VALUE "" /end COMPU_VTAB_RANGE
/begin COMPU_VTAB eUnitInCommand "enumeration table" TAB_VERB 6 0 "none" 1 "ssc" 2 "foc" 3 "csc" 4 "cra" 5 "psc" /end COMPU_VTAB
/begin COMPU_VTAB ecy_hsm_Csai_KeyIdTag "enumeration table" TAB_VERB 35 0 "ecy_hsm_CSAI_KEYID_AES_KEY_start" 0 "ecy_hsm_CSAI_KEYID_AES_KEY_DYNAMIC_CFG_CRYPTO_AES128_KEY_DYNAMIC_0_BASE_0" 1 "ecy_hsm_CSAI_KEYID_AES_KEY_DYNAMIC_CFG_CRYPTO_AES128_KEY_DYNAMIC_0_INST_1" 2 "ecy_hsm_CSAI_KEYID_AES_KEY_end" 256 "ecy_hsm_CSAI_KEYID_RSA_KEY_start" 256 "ecy_hsm_CSAI_KEYID_RSA_KEY_STATIC_CFG_RSA2048_KEY_PUB_STATIC_0" 257 "ecy_hsm_CSAI_KEYID_RSA_KEY_end" 512 "ecy_hsm_CSAI_KEYID_ECC_KEY_start" 513 "ecy_hsm_CSAI_KEYID_ECC_KEY_end" 768 "ecy_hsm_CSAI_KEYID_CERT_start" 768 "ecy_hsm_CSAI_KEYID_CERT_STATIC_CFG_CERT_0_CVC_RSA2048__RBPKI_PRJ" 769 "ecy_hsm_CSAI_KEYID_CERT_STATIC_CFG_CERT_1_CVC_RSA2048__RBPKI_RESERVED" 770 "ecy_hsm_CSAI_KEYID_CERT_end" 1024 "ecy_hsm_CSAI_KEYID_OID_start" 1024 "ecy_hsm_CSAI_KEYID_OID_STATIC_CFG_OID_0_CVC_RSA2048__RBPKI_PRJ" 1025 "ecy_hsm_CSAI_KEYID_OID_STATIC_CFG_OID_1_CVC_RSA2048__RBPKI_RESERVED" 1026 "ecy_hsm_CSAI_KEYID_OID_end" 1280 "ecy_hsm_CSAI_KEYID_SECRET_DATA_start" 1280 "ecy_hsm_CSAI_KEYID_SECRET_DATA_DYNAMIC_CFG_SECRET_DATA_0_2B__RBPLATFORM_LCPONCTR" 1281 "ecy_hsm_CSAI_KEYID_SECRET_DATA_DYNAMIC_CFG_SECRET_DATA_1_2B__RESERVED" 1282 "ecy_hsm_CSAI_KEYID_SECRET_DATA_end" 1536 "ecy_hsm_CSAI_KEYID_INT_DATA_start" 1536 "ecy_hsm_CSAI_KEYID_INT_DATA_STATIC_CFG_INT_DATA_0" 1537 "ecy_hsm_CSAI_KEYID_INT_DATA_DYNAMIC_CFG_INT_DATA_TRUSTED_BOOT_REF" 1538 "ecy_hsm_CSAI_KEYID_INT_DATA_DYNAMIC_CFG_LIFE_CYCLE_STATE" 1539 "ecy_hsm_CSAI_KEYID_INT_DATA_DYNAMIC_CFG_PASSWORDS" 1540 "ecy_hsm_CSAI_KEYID_INT_DATA_DYNAMIC_CFG_SERIALNUMBER" 1541 "ecy_hsm_CSAI_KEYID_INT_DATA_DYNAMIC_CFG_HSM_UPDATE_PASSWORD" 1542 "ecy_hsm_CSAI_KEYID_INT_DATA_STATIC_CFG_HSM_SUSPEND_TIME" 1543 "ecy_hsm_CSAI_KEYID_INT_DATA_DYNAMIC_CFG_SECACC_NONCE" 1544 "ecy_hsm_CSAI_KEYID_INT_DATA_STATIC_CFG_SECURE_DEBUG_NONCE_CNTRL" 1545 "ecy_hsm_CSAI_KEYID_INT_DATA_STATIC_CFG_SECURE_DEBUG_USE_CASE" 1546 "ecy_hsm_CSAI_KEYID_INT_DATA_STATIC_CFG_SECURE_DEBUG_CHALLENGE_LEN" 1547 "ecy_hsm_CSAI_KEYID_INT_DATA_end" 2147483647 "ecy_hsm_CSAI_SHE_KEYID_RESERVED" /end COMPU_VTAB
/begin COMPU_VTAB_RANGE messagePriority "" 4 0 0 "high" 1 1 "medium" 2 2 "low" 3 3 "unpriorized" DEFAULT_VALUE "" /end COMPU_VTAB_RANGE
/begin COMPU_VTAB_RANGE messageType "" 4 0 0 "warning" 1 1 "textMessage" 2 2 "otherInformation" 3 3 "none" DEFAULT_VALUE "" /end COMPU_VTAB_RANGE
/begin COMPU_VTAB rbCS520_ExtClkType_en "enumeration table" TAB_VERB 2 0 "rbCS520_SSCCLK_e" 1 "rbCS520_UCCLK_e" /end COMPU_VTAB
/begin COMPU_VTAB rbEcuEOL_DriveTestMode_en "enumeration table" TAB_VERB 4 0 "RBECUEOL_NO_DRIVE_TEST_E" 1 "RBECUEOL_PRODUCTION_WITHOUT_BUS" 2 "RBECUEOL_ANALYSE_WITH_BUS" 3 "RBECUEOL_NR_OF_MODES" /end COMPU_VTAB
/begin COMPU_VTAB rbEcuEOL_DriveTestResults_en "enumeration table" TAB_VERB 7 85 "RBECUEOL_DT_PASSED" 170 "RBECUEOL_DT_FAILED" 187 "RBECUEOL_DT_FAILED_MODOFF" 192 "RBECUEOL_DT_MODE_ERROR" 193 "RBECUEOL_DT_TIME_INTERVAL_ERROR" 194 "RBECUEOL_DT_CRC_ERROR" 195 "RBECUEOL_DT_ECU_ID_RANGE_ERROR" /end COMPU_VTAB
/begin COMPU_VTAB rbHsmPrepare_AccessState_en "enumeration table" TAB_VERB 5 0 "rbHsmPrepare_NotStarted_e" 1 "rbHsmPrepare_AccessPending_e" 2 "rbHsmPrepare_AccessFailed_e" 3 "rbHsmPrepare_AccessStateOK_e" 4 "rbHsmPrepare_PreInitDone_e" /end COMPU_VTAB
/begin COMPU_VTAB rbMcu_LastResetType_en "enumeration table" TAB_VERB 6 0 "RBMCU_COLD_PORST_E" 1 "RBMCU_WARM_PORST_E" 2 "RBMCU_COLD_WARM_PORST_E" 3 "RBMCU_SYSTEM_SW_E" 4 "RBMCU_SYSTEM_SMU_E" 5 "RBMCU_INVALID_RESET_E" /end COMPU_VTAB
/begin COMPU_VTAB rbMonReact_EventState "enumeration table" TAB_VERB 3 0 "rbMonReact_EventStateFailed_e" 1 "rbMonReact_EventStatePassed_e" 2 "rbMonReact_Prv_EventStateInit_e" /end COMPU_VTAB
/begin COMPU_VTAB rbMonReact_State_en "enumeration table" TAB_VERB 5 0 "RBMONREACT_UNINIT" 1 "RBMONREACT_INIT" 2 "RBMONREACT_RUN" 3 "RBMONREACT_SAFE" 4 "RBMONREACT_ERRORSAFE" /end COMPU_VTAB
/begin COMPU_VTAB rbNetCom_State_e "enumeration table" TAB_VERB 6 0 "rbNetCom_ErrorInvalid_e" 1 "rbNetCom_Valid_e" 2 "rbNetCom_OutOfRange_e" 3 "rbNetCom_NoSpecialValue_e" 4 "rbNetCom_Received_e" 5 "rbNetCom_InRange_e" /end COMPU_VTAB
/begin COMPU_VTAB_RANGE rbNet_State_e "" 2 0 0 "rbNet_Valid_e" 1 1 "rbNet_ErrorInvalid_e" DEFAULT_VALUE "" /end COMPU_VTAB_RANGE
/begin COMPU_VTAB rbPFlashIntegrity_CrcStatus_en "enumeration table" TAB_VERB 6 0 "RBPFLSINTY_NOTSTARTED" 1 "RBPFLSINTY_INITFAILED" 2 "RBPFLSINTY_CALCINPROGRESS" 3 "RBPFLSINTY_CALCCOMPLETED" 4 "RBPFLSINTY_EVALCOMPLETEDPASSED" 5 "RBPFLSINTY_EVALCOMPLETEDFAILED" /end COMPU_VTAB
/begin COMPU_VTAB rbPdm_EDevelopmentError "enumeration table" TAB_VERB 6 0 "NoError_e" 1 "WriteError_e" 2 "ReadError_e" 3 "StatusError_e" 4 "RamBlockMissingError_e" 5 "InvalidBlockIdArgumentError_e" /end COMPU_VTAB
/begin COMPU_VTAB rbPdm_EJobStatus "enumeration table" TAB_VERB 16 0 "JobStatusInit_e" 1 "JobWriteAccepted_e" 2 "JobWriteRejected_e" 3 "JobWriteRetriggerOnGoing_e" 4 "JobWriteCompleted_e" 5 "JobWriteFailed_e" 6 "JobReadCompleted_e" 7 "JobReadFailed_e" 8 "JobRestoreAccepted_e" 9 "JobRestoreRejected_e" 10 "JobRestoreCompleted_e" 11 "JobRestoreFailed_e" 12 "JobInvalidateAccepted_e" 13 "JobInvalidateRejected_e" 14 "JobInvalidateCompleted_e" 15 "JobInvalidateFailed_e" /end COMPU_VTAB
/begin COMPU_VTAB rbPdm_ERequestType "enumeration table" TAB_VERB 6 0 "RequestNone_e" 1 "RequestWrite_e" 2 "RequestWriteImmediate_e" 3 "RequestRead_e" 4 "RequestInvalidate_e" 5 "RequestRestore_e" /end COMPU_VTAB
/begin COMPU_VTAB rbSftMon_CoreClkList_en "enumeration table" TAB_VERB 5 0 "RBSFTMON_CORECLK_SYSTEMFPLL0_E" 1 "RBSFTMON_CORECLK_PHASEFPLL1_E" 2 "RBSFTMON_CORECLK_PHASEFPLL2_E" 3 "RBSFTMON_CORECLK_EXTENDEDSPB_E" 4 "RBSFTMON_CORECLK_BACKUP_E" /end COMPU_VTAB
/begin COMPU_VTAB rbSftMon_StackStatus_en "enumeration table" TAB_VERB 3 0 "RBSFTMON_STACKSTATUS_NOT_TESTED_E" 1 "RBSFTMON_STACKSTATUS_PASS_E" 2 "RBSFTMON_STACKSTATUS_FAIL_E" /end COMPU_VTAB
/begin COMPU_VTAB_RANGE rbSysEvM_EventState "" 5 0 0 "PASSED" 1 1 "FAILED" 2 2 "PREPASSED" 3 3 "PREFAILED" 5 5 "NO_UPDATE" DEFAULT_VALUE "" /end COMPU_VTAB_RANGE
/begin COMPU_VTAB rbSysLog_InvalidateStatus_en "enumeration table" TAB_VERB 5 0 "RBSYSLOG_INVALIDATE_NOT_REQUESTED_EN" 1 "RBSYSLOG_INVALIDATE_SUCCESSFUL_EN" 2 "RBSYSLOG_INVALIDATE_JOB_REQUEST_FAILED_EN" 3 "RBSYSLOG_INVALIDATE_JOB_FAILED_EN" 4 "RBSYSLOG_INVALIDATE_TIMEOUT_EN" /end COMPU_VTAB
/begin COMPU_VTAB rbSyslog_Invalidate_state_en "enumeration table" TAB_VERB 3 0 "RBSYSLOG_INVALIDATE_UNSUCCESSFUL" 1 "RBSYSLOG_INVALIDATE_PENDING" 2 "RBSYSLOG_INVALIDATE_SUCCESSFUL" /end COMPU_VTAB
/begin COMPU_VTAB rcy_hsm_Csai_JobPriorityTag "enumeration table" TAB_VERB 7 0 "ecy_hsm_CSAI_PRIO_BACKGROUND" 1 "ecy_hsm_CSAI_PRIO_LOW" 2 "ecy_hsm_CSAI_PRIO_MEDIUM" 3 "ecy_hsm_CSAI_PRIO_HIGH" 3 "ecy_hsm_CSAI_PRIO_SAFETY" 5 "ecy_hsm_CSAI_PRIO_UNCHANGED" 2147483647 "ecy_hsm_CSAI_JOBPRIORITY_RESERVED" /end COMPU_VTAB
/begin COMPU_VTAB rcy_hsm_Csai_SecAcc_NonceCtrl "enumeration table" TAB_VERB 8 1 "ecy_hsm_CSAI_NONCE_ZERO" 2 "ecy_hsm_CSAI_NONCE_RND" 3 "ecy_hsm_CSAI_NONCE_RND_STORE_DFLASH" 4 "ecy_hsm_CSAI_NONCE_FROM_DFLASH" 5 "ecy_hsm_CSAI_NONCE_DEVICE_ID" 6 "ecy_hsm_CSAI_NONCE_HASHED_DEVICE_ID" 7 "ecy_hsm_CSAI_NONCE_NUMTYPES" 2147483647 "ecy_hsm_CSAI_NONCE_RESERVED" /end COMPU_VTAB
/begin COMPU_VTAB validLineState "enumeration table" TAB_VERB 4 0 "invalid" 1 "noValidLines" 2 "oneValidLine" 3 "twoValidLines" /end COMPU_VTAB
/begin RECORD_LAYOUT NewString.RecordLayout FNC_VALUES 1 UBYTE COLUMN_DIR DIRECT ALIGNMENT_FLOAT64_IEEE 8 ALIGNMENT_INT64 8 /end RECORD_LAYOUT
/begin RECORD_LAYOUT SSV__A_INT64_S AXIS_PTS_X 1 A_INT64 INDEX_INCR DIRECT ALIGNMENT_FLOAT64_IEEE 8 ALIGNMENT_INT64 8 /end RECORD_LAYOUT
/begin RECORD_LAYOUT SSV__A_UINT64_S AXIS_PTS_X 1 A_UINT64 INDEX_INCR DIRECT ALIGNMENT_FLOAT64_IEEE 8 ALIGNMENT_INT64 8 /end RECORD_LAYOUT
/begin RECORD_LAYOUT SSV__FLOAT32_IEEE_S AXIS_PTS_X 1 FLOAT32_IEEE INDEX_INCR DIRECT ALIGNMENT_FLOAT64_IEEE 8 ALIGNMENT_INT64 8 /end RECORD_LAYOUT
/begin RECORD_LAYOUT SSV__FLOAT64_IEEE_S AXIS_PTS_X 1 FLOAT64_IEEE INDEX_INCR DIRECT ALIGNMENT_FLOAT64_IEEE 8 ALIGNMENT_INT64 8 /end RECORD_LAYOUT
/begin RECORD_LAYOUT SSV__SBYTE_S AXIS_PTS_X 1 SBYTE INDEX_INCR DIRECT ALIGNMENT_FLOAT64_IEEE 8 ALIGNMENT_INT64 8 /end RECORD_LAYOUT
/begin RECORD_LAYOUT SSV__SLONG_S AXIS_PTS_X 1 SLONG INDEX_INCR DIRECT ALIGNMENT_FLOAT64_IEEE 8 ALIGNMENT_INT64 8 /end RECORD_LAYOUT
/begin RECORD_LAYOUT SSV__SWORD_S AXIS_PTS_X 1 SWORD INDEX_INCR DIRECT ALIGNMENT_FLOAT64_IEEE 8 ALIGNMENT_INT64 8 /end RECORD_LAYOUT
/begin RECORD_LAYOUT SSV__UBYTE_S AXIS_PTS_X 1 UBYTE INDEX_INCR DIRECT ALIGNMENT_FLOAT64_IEEE 8 ALIGNMENT_INT64 8 /end RECORD_LAYOUT
/begin RECORD_LAYOUT SSV__ULONG_S AXIS_PTS_X 1 ULONG INDEX_INCR DIRECT ALIGNMENT_FLOAT64_IEEE 8 ALIGNMENT_INT64 8 /end RECORD_LAYOUT
/begin RECORD_LAYOUT SSV__UWORD_S AXIS_PTS_X 1 UWORD INDEX_INCR DIRECT ALIGNMENT_FLOAT64_IEEE 8 ALIGNMENT_INT64 8 /end RECORD_LAYOUT
/begin RECORD_LAYOUT SWORD_COL_DIRECT FNC_VALUES 1 SWORD COLUMN_DIR DIRECT ALIGNMENT_FLOAT64_IEEE 8 ALIGNMENT_INT64 8 /end RECORD_LAYOUT
/begin RECORD_LAYOUT __A_INT64_S FNC_VALUES 1 A_INT64 COLUMN_DIR DIRECT ALIGNMENT_FLOAT64_IEEE 8 ALIGNMENT_INT64 8 /end RECORD_LAYOUT
/begin RECORD_LAYOUT __A_INT64_Z FNC_VALUES 1 A_INT64 ROW_DIR DIRECT ALIGNMENT_FLOAT64_IEEE 8 ALIGNMENT_INT64 8 /end RECORD_LAYOUT
/begin RECORD_LAYOUT __A_UINT64_S FNC_VALUES 1 A_UINT64 COLUMN_DIR DIRECT ALIGNMENT_FLOAT64_IEEE 8 ALIGNMENT_INT64 8 /end RECORD_LAYOUT
/begin RECORD_LAYOUT __A_UINT64_Z FNC_VALUES 1 A_UINT64 ROW_DIR DIRECT ALIGNMENT_FLOAT64_IEEE 8 ALIGNMENT_INT64 8 /end RECORD_LAYOUT
/begin RECORD_LAYOUT __FLOAT32_IEEE_S FNC_VALUES 1 FLOAT32_IEEE COLUMN_DIR DIRECT ALIGNMENT_FLOAT64_IEEE 8 ALIGNMENT_INT64 8 /end RECORD_LAYOUT
/begin RECORD_LAYOUT __FLOAT32_IEEE_Z FNC_VALUES 1 FLOAT32_IEEE ROW_DIR DIRECT ALIGNMENT_FLOAT64_IEEE 8 ALIGNMENT_INT64 8 /end RECORD_LAYOUT
/begin RECORD_LAYOUT __FLOAT64_IEEE_S FNC_VALUES 1 FLOAT64_IEEE COLUMN_DIR DIRECT ALIGNMENT_FLOAT64_IEEE 8 ALIGNMENT_INT64 8 /end RECORD_LAYOUT
/begin RECORD_LAYOUT __FLOAT64_IEEE_Z FNC_VALUES 1 FLOAT64_IEEE ROW_DIR DIRECT ALIGNMENT_FLOAT64_IEEE 8 ALIGNMENT_INT64 8 /end RECORD_LAYOUT
/begin RECORD_LAYOUT __Float32_Value FNC_VALUES 1 FLOAT32_IEEE ROW_DIR DIRECT /end RECORD_LAYOUT
/begin RECORD_LAYOUT __SBYTE_S FNC_VALUES 1 SBYTE COLUMN_DIR DIRECT ALIGNMENT_FLOAT64_IEEE 8 ALIGNMENT_INT64 8 /end RECORD_LAYOUT
/begin RECORD_LAYOUT __SBYTE_Z FNC_VALUES 1 SBYTE ROW_DIR DIRECT ALIGNMENT_FLOAT64_IEEE 8 ALIGNMENT_INT64 8 /end RECORD_LAYOUT
/begin RECORD_LAYOUT __SByte_Value FNC_VALUES 1 SBYTE ROW_DIR DIRECT /end RECORD_LAYOUT
/begin RECORD_LAYOUT __SLONG_S FNC_VALUES 1 SLONG COLUMN_DIR DIRECT ALIGNMENT_FLOAT64_IEEE 8 ALIGNMENT_INT64 8 /end RECORD_LAYOUT
/begin RECORD_LAYOUT __SLONG_Z FNC_VALUES 1 SLONG ROW_DIR DIRECT ALIGNMENT_FLOAT64_IEEE 8 ALIGNMENT_INT64 8 /end RECORD_LAYOUT
/begin RECORD_LAYOUT __SLong_Value FNC_VALUES 1 SLONG ROW_DIR DIRECT /end RECORD_LAYOUT
/begin RECORD_LAYOUT __SWORD_S FNC_VALUES 1 SWORD COLUMN_DIR DIRECT ALIGNMENT_FLOAT64_IEEE 8 ALIGNMENT_INT64 8 /end RECORD_LAYOUT
/begin RECORD_LAYOUT __SWORD_Z FNC_VALUES 1 SWORD ROW_DIR DIRECT ALIGNMENT_FLOAT64_IEEE 8 ALIGNMENT_INT64 8 /end RECORD_LAYOUT
/begin RECORD_LAYOUT __SWord_Value FNC_VALUES 1 SWORD ROW_DIR DIRECT /end RECORD_LAYOUT
/begin RECORD_LAYOUT __UBYTE_S FNC_VALUES 1 UBYTE COLUMN_DIR DIRECT ALIGNMENT_FLOAT64_IEEE 8 ALIGNMENT_INT64 8 /end RECORD_LAYOUT
/begin RECORD_LAYOUT __UBYTE_S_M_M_M_S1_S1_M FNC_VALUES 1 UBYTE COLUMN_DIR DIRECT ALIGNMENT_FLOAT64_IEEE 8 ALIGNMENT_INT64 8 /end RECORD_LAYOUT
/begin RECORD_LAYOUT __UByte_Value FNC_VALUES 1 UBYTE ROW_DIR DIRECT /end RECORD_LAYOUT
/begin RECORD_LAYOUT __ULONG_S FNC_VALUES 1 ULONG COLUMN_DIR DIRECT ALIGNMENT_FLOAT64_IEEE 8 ALIGNMENT_INT64 8 /end RECORD_LAYOUT
/begin RECORD_LAYOUT __ULONG_Z FNC_VALUES 1 ULONG ROW_DIR DIRECT ALIGNMENT_FLOAT64_IEEE 8 ALIGNMENT_INT64 8 /end RECORD_LAYOUT
/begin RECORD_LAYOUT __UWORD_S FNC_VALUES 1 UWORD COLUMN_DIR DIRECT ALIGNMENT_FLOAT64_IEEE 8 ALIGNMENT_INT64 8 /end RECORD_LAYOUT
/begin RECORD_LAYOUT __UWORD_Z FNC_VALUES 1 UWORD ROW_DIR DIRECT ALIGNMENT_FLOAT64_IEEE 8 ALIGNMENT_INT64 8 /end RECORD_LAYOUT
/begin RECORD_LAYOUT __UWord_Value FNC_VALUES 1 UWORD ROW_DIR DIRECT /end RECORD_LAYOUT
/end MODULE
/end PROJECT
