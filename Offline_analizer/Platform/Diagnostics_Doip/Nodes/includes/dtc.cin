/*@!Encoding:1252*/
/**
 * @file dtc.cin
 * @author ADAS_HIL_TEAM
 * @date 08-21-2023
 * @brief 
 *
 * ################################################################
 * C O P Y R I G H T S
 * ----------------------------------------------------------------
 * Copyright (c) 2023 by Robert Bosch GmbH. All rights reserved.
 
 * The reproduction, distribution and utilization of this file as
 * well as the communication of its contents to others without express
 * authorization is prohibited. Offenders will be held liable for the
 * payment of damages. All rights reserved in the event of the grant
 * of a patent, utility model or design.
 *
 * ################################################################
*/

on sysvar_update sysvar::DIAG_Tester::DTC_INFO::DTC_Read
{ 
    if ( @this ) 
    {
            ClearDtcDisplay();
            DOIP_DiagService( READ_DTC_BY_ST );//19 02 09
    }
}

on sysvar_update sysvar::DIAG_Tester::DTC_INFO::DTC_Clear
{ 
    if ( @this ) 
    {
      DOIP_DiagService( CLEAR_DTC );//0x14 FF FF FF
	    ClearDtcDisplay();
    }
}

on sysvar_update sysvar::DIAG_Tester::DTC_INFO::DTC_Passive
{ 
        if ( @this ) 
        {
            ClearDtcDisplay();
            DOIP_DiagService( READ_DTC_PASS );//0x19 02 08
        }
}

on sysvar_update sysvar::DIAG_Tester::DTC_INFO::DTC_CountDown
{ 
        if ( @this ) 
        {
            gCurrentDTC--;
            ShowDTCs(); 
        }
}

on sysvar_update sysvar::DIAG_Tester::DTC_INFO::DTC_CountUP
{ 
    if ( @this ) 
    {
            gCurrentDTC++;
            ShowDTCs(); 
        }
}


void ClearDtcDisplay (void)
{
   
   gNrOfReadDTC = 0;
   gCurrentDTC  = 0;
   ShowDTCs();
}

void ShowDTCs (void)
{
   char buffer[50];
   long buffer_dec;
   
   if ( gCurrentDTC > gNrOfReadDTC )
   {
      gCurrentDTC = gNrOfReadDTC;
   } 
   else if ( (gCurrentDTC < 1) && (gNrOfReadDTC) )
   {
      gCurrentDTC = 1;
   }
   else if ( (gCurrentDTC < 0) && (!gNrOfReadDTC) )
   {
      gCurrentDTC = 0;
   } 
   
   snprintf (buffer, 49, "%02d/%02d", gCurrentDTC, gNrOfReadDTC);
   sysSetVariableString(sysvar::DIAG_Tester::DTC_INFO::DTC_Position,buffer);
   
   if ( gCurrentDTC )
   {
      // DTC No
      snprintf (buffer, 49, "%06x",   gerrorDTC[gCurrentDTC]);
      sysSetVariableString(sysvar::DIAG_Tester::DTC_INFO::DTC_Nr,buffer);
      
      //DTC Status
      snprintf (buffer, 49, "%02x", gerrorStatus[gCurrentDTC]);
      sysSetVariableString(sysvar::DIAG_Tester::DTC_INFO::DTC_State,buffer);
      GetDtcName (gerrorDTC[gCurrentDTC],1);
   }
   else
   {
      sysSetVariableString(sysvar::DIAG_Tester::DTC_INFO::DTC_Nr,"----");
      sysSetVariableString(sysvar::DIAG_Tester::DTC_INFO::DTC_State,"--");
      sysSetVariableString(sysvar::DIAG_Tester::DTC_INFO::DTC_Name,"----");
    } 
}

void GetDtcName (dword error,int DTC_or_historical)
{	
	char DTCText [256];
  long res;
  
  // Hole DTC Beschreibung aus Tabelle
  res=GetDTCdescription_Kamera(error, DTCText);
  
  if(res == 0) // DTC in Tabelle nicht gefunden
  {
        snprintf( DTCText, 255,"Unknown Error: %d",error);
  }

 	if (DTC_or_historical==1)  //ReadDTC
	{
			write("DTCText::%s",DTCText);
		  res=sysSetVariableString(sysvar::DIAG_Tester::DTC_INFO::DTC_Name,DTCText);
	}
   
}



