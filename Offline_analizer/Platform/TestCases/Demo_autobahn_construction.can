/*@!Encoding:1252*/
/**
 * @file Demo_autobahn_construction.can
 * @author ADAS_HIL_TEAM
 * @date 05-06-2023
 * @brief 
 *
 * ################################################################
 * C O P Y R I G H T S
 * ----------------------------------------------------------------
 * Copyright (c) 2023 by Robert Bosch GmbH. All rights reserved.
 
 * The reproduction, distribution and utilization of this file as
 * well as the communication of its contents to others without express
 * authorization is prohibited. Offenders will be held liable for the
 * payment of damages. All rights reserved in the event of the grant
 * of a patent, utility model or design.
 *
 * ################################################################
*/

includes
{
  #include "common_test_functions.cin"
}

variables
{
  int i;
}

testcase Demo_autobahn_construction(int config, double ego_speed, double tgt_speed)
{
  cf_testPreparation();
  @hil_drv::DIL_mode = @hil_drv::DIL_mode::steeringwheel_g29;
  sysSetVariableString(sysvar::Customer_specific::cm_scenario, "Demo_autobahn_construction");
  PreConditionsCM(config);
  @Customer_specific::load_scenario = 1;
  CM_start();
  PreConditionsACC();
  testStep("Test case","Start");
  testWaitForTimeout(10000);
  @Classe_Obj_Sim::obj_ctrl.obj_target_v_long[0] = tgt_speed;
//  $CIM_Swt_ADAS=1; //Set ACC aktive
//  testWaitForTimeout(500);
//  $CIM_Swt_ADAS=0;
//  testWaitForTimeout(500);
//  if ($ADAS_Sts_ACC == 3) //Check Status ACC
//  {
//  TestStepPass();//TestStepPass("ACC is active");
//  //write ("ACC active");
//  }
//  else
//  {
//   TestStepFail();//TestStepFail("ACC is not active"); 
//  }
//  testWaitForTimeout(200);
//  $CIM_Swt_ADAS = 2; // pressed button LKS
//  testWaitForTimeout(2000); // short push on the button
//  $CIM_Swt_ADAS = 0; // button released
//  testWaitForTimeout(5000);
//    switch($ADAS_RdWhlAgReqActive)
//    {
//      case 0:
//       TestStepFail();//TestStepFail("Test case","LKS not activated");
//      break;
//      case 1:
//       TestStepPass();//TestStepPass("Test case","LKS activated");
//      break;
//    }
//    for(i = 0; i < 2; i++) //set ACC Speed to 50kph
//   {

//    $CIM_SpdRgln_ADAS=1; // set ACC +10 kph
//    // write ("i %d", i);
//    testWaitForTimeout(1000);
//    $CIM_SpdRgln_ADAS=0;
//    testWaitForTimeout(300);
//   }
	
    testWaitForTimeout(180000); 
  
    // Check lane change
 
    TestStepPass ("Demo Testcase is done");
    testWaitForTimeout(200);
    PostConditionsACC();
    PostConditionsCM();
}
