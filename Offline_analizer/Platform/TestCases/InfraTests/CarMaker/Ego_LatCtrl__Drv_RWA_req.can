/*@!Encoding:1252*/
includes
{
  #include "../../common_test_functions.cin"
}

variables
{
}

testcase Ego_LatCtrl__Drv_RWA_req(
  int config,
  int vehicle_code
)
{
  long result;
  double ego_speed;
  long ego_speed_reached;
  long lat_ctrl_vehicle_model;
  long steering_characteristic_type;
  double rwa_req;
  double SWA_RWA_ratio;
  double yaw_rate_in_deg_p_s;
  
  // -----------------
  // Test precondition
  
  SetSysvarInt(sysvar::hil_adas::lat_ctrl_is_enabled, @hil_adas::lat_ctrl_is_enabled::disabled, "Disable ADAS control over lateral movement of Ego");
  SetSysvarInt(sysvar::hil_adas::long_ctrl_is_enabled, @hil_adas::long_ctrl_is_enabled::disabled, "Disable ADAS control over longitudinal movement of Ego");
  
  @hil_ctrl::vehicle = vehicle_code; //set the vehicle variant 
  cf_testPreparation();
  sysSetVariableString(sysvar::Customer_specific::cm_scenario, "Infra_scenarios/Ego_LatCtrl__Drv_RWA_req");
  testWaitForTimeoutSilent(100);
  PreConditionsCM(config);
  @Customer_specific::load_scenario = 1;
  CM_start();
  PreConditionsAEB();
  
  lat_ctrl_vehicle_model = @hil_ctrl::lat_ctrl_vehicle_model;
  SetSysvarInt(sysvar::hil_ctrl::lat_ctrl_vehicle_model, @hil_ctrl::lat_ctrl_vehicle_model::enabled, "");
  steering_characteristic_type = @hil_vehicle::steering_characteristic_type;
  SetSysvarInt(sysvar::hil_vehicle::steering_characteristic_type, @hil_vehicle::steering_characteristic_type::SWA_RWA_RATIO, "");
  SWA_RWA_ratio = @hil_vehicle::steering_characteristic_swa_rwa_ratio;
  
  testWaitForTimeoutSilent(200);
  
  @hil_drv::steering_wheel_angle_req = 15;
  TestWaitForSignalInRange(sysvar::hil_hvm::road_wheel_angle, 0.5, 90, 60000);
  testWaitForTimeoutSilent(200);
  if(@hil_hvm::steering_wheel_angle != 0)
  {
    SetSysvarFloat(sysvar::hil_vehicle::steering_characteristic_swa_rwa_ratio, @hil_hvm::road_wheel_angle / @hil_hvm::steering_wheel_angle, "");
  }
  @hil_drv::steering_wheel_angle_req = 0;
  testWaitForTimeoutSilent(200);
  
  TestStep(0, "INFO", "RWA control (CLASSE only) has been enabled.");
  
  // ----------
  // Test steps
  
  testStep("Test case","Start");
  
  // steering settings
  @hil_vehicle::driven_wheel = @hil_vehicle::driven_wheel::FWD;
  
  ego_speed = 18;
  SetSysvarFloat(sysvar::hil_drv::target_velocity, ego_speed, "");
  testWaitForTimeoutSilent(1000);
  
  ego_speed_reached = TestWaitForSignalInRange(sysvar::hil_hvm::velocity_x, ego_speed-0.01, ego_speed+0.01, 60000);
  
  if(ego_speed_reached == 1)
  {
    
// ==================
// LEFT
    
    rwa_req = -2;
    TestStep("Step 01", "Driver RWA request towards LEFT");
    @hil_drv::road_wheel_angle_req = rwa_req-0.02;
    testWaitForTimeoutSilent(1500);
    SetSysvarFloat(sysvar::hil_drv::road_wheel_angle_req, rwa_req, "");
    
    TestStep(0, "", "Expected values related to Steering wheel (CLASSE sysvars):");
    
    WaitForSysVarInRange(
      sysvar::hil_hvm::steering_wheel_angle,
      rwa_req/@hil_vehicle::steering_characteristic_swa_rwa_ratio-3,
      rwa_req/@hil_vehicle::steering_characteristic_swa_rwa_ratio+3, 
      3000);
    
    TestStep(0, "", "Expected values related to Road wheel (CLASSE sysvars):");
    
    WaitForSysVarInRange(
      sysvar::hil_hvm::wheel_angle_fl,
      rwa_req-0.25,
      rwa_req+0.25,
      50);
    WaitForSysVarInRange(
      sysvar::hil_hvm::wheel_angle_fr,
      rwa_req-0.25,
      rwa_req+0.25,
      50);
    WaitForSysVarInRange(
      sysvar::hil_hvm::wheel_angle_rl,
      0,
      0, 
      50);
    WaitForSysVarInRange(
      sysvar::hil_hvm::wheel_angle_rr,
      0,
      0,
      50);
    WaitForSysVarInRange(
      sysvar::hil_hvm::wheel_speed_fl,
      ego_speed-0.5,
      ego_speed+0.5,
      50);
    WaitForSysVarInRange(
      sysvar::hil_hvm::wheel_speed_fr,
      ego_speed-0.5,
      ego_speed+0.5,
      50);
    WaitForSysVarInRange(
      sysvar::hil_hvm::wheel_speed_rl,
      ego_speed-0.5,
      ego_speed+0.5,
      50);
    WaitForSysVarInRange(
      sysvar::hil_hvm::wheel_speed_rr,
      ego_speed-0.5,
      ego_speed+0.5,
      50);
    
    TestStep(0, "", "Expected order of wheel speed values : RL < FL < RR < FR");
    if((@hil_hvm::wheel_speed_rl < @hil_hvm::wheel_speed_fl)
    && (@hil_hvm::wheel_speed_fl < @hil_hvm::wheel_speed_rr)
    && (@hil_hvm::wheel_speed_rr < @hil_hvm::wheel_speed_fr))
    {
      TestStep(0, "", "Calculated order is expected");
    }
    else
    {
      TestStep(0, "", "Calculated order is NOT expected");
    }
    
    TestStep(0, "", "Expected values related to Ego movement (CLASSE sysvars):");
    
    yaw_rate_in_deg_p_s = Get_YawRate_in_deg_p_s();
    
    WaitForSysVarInRange(
      sysvar::hil_hvm::yaw_rate,
      yaw_rate_in_deg_p_s-0.4,
      yaw_rate_in_deg_p_s+2.2,
      50);
    
    testWaitForTimeoutSilent(1000);
    
// ==================
// RIGHT
    
    rwa_req = 2;
    TestStep("Step 02", "Driver RWA request towards RIGHT");
    @hil_drv::road_wheel_angle_req = rwa_req+0.02;
    testWaitForTimeoutSilent(1500);
    SetSysvarFloat(sysvar::hil_drv::road_wheel_angle_req, rwa_req, "");
    
    TestStep(0, "", "Expected values related to Steering wheel (CLASSE sysvars):");
    
    WaitForSysVarInRange(
      sysvar::hil_hvm::steering_wheel_angle,
      rwa_req/@hil_vehicle::steering_characteristic_swa_rwa_ratio-3,
      rwa_req/@hil_vehicle::steering_characteristic_swa_rwa_ratio+3, 
      3000);
    
    TestStep(0, "", "Expected values related to Road wheel (CLASSE sysvars):");
    
    WaitForSysVarInRange(
      sysvar::hil_hvm::wheel_angle_fl,
      rwa_req-0.25,
      rwa_req+0.25,
      50);
    WaitForSysVarInRange(
      sysvar::hil_hvm::wheel_angle_fr,
      rwa_req-0.25,
      rwa_req+0.25,
      50);
    WaitForSysVarInRange(
      sysvar::hil_hvm::wheel_angle_rl,
      0,
      0, 
      50);
    WaitForSysVarInRange(
      sysvar::hil_hvm::wheel_angle_rr,
      0,
      0,
      50);
    WaitForSysVarInRange(
      sysvar::hil_hvm::wheel_speed_fl,
      ego_speed-0.5,
      ego_speed+0.5,
      50);
    WaitForSysVarInRange(
      sysvar::hil_hvm::wheel_speed_fr,
      ego_speed-0.5,
      ego_speed+0.5,
      50);
    WaitForSysVarInRange(
      sysvar::hil_hvm::wheel_speed_rl,
      ego_speed-0.5,
      ego_speed+0.5,
      50);
    WaitForSysVarInRange(
      sysvar::hil_hvm::wheel_speed_rr,
      ego_speed-0.5,
      ego_speed+0.5,
      50);
    
    TestStep(0, "", "Expected order of wheel speed values : RR < FR < RL < FL");
    if((@hil_hvm::wheel_speed_rr < @hil_hvm::wheel_speed_fr)
    && (@hil_hvm::wheel_speed_fr < @hil_hvm::wheel_speed_rl)
    && (@hil_hvm::wheel_speed_rl < @hil_hvm::wheel_speed_fl))
    {
      TestStep(0, "", "Calculated order is expected");
    }
    else
    {
      TestStep(0, "", "Calculated order is NOT expected");
    }
    
    TestStep(0, "", "Expected values related to Ego movement (CLASSE sysvars):");
    
    yaw_rate_in_deg_p_s = Get_YawRate_in_deg_p_s();
    
    WaitForSysVarInRange(
      sysvar::hil_hvm::yaw_rate,
      yaw_rate_in_deg_p_s-2.4,
      yaw_rate_in_deg_p_s+0.2,
      50);
    
    testWaitForTimeoutSilent(1000);

// ==================
// no RWA req (center)
    
    rwa_req = 0;
    TestStep("Step 02", "Driver RWA request to drive STRAIGHT");
    SetSysvarFloat(sysvar::hil_drv::road_wheel_angle_req, rwa_req, "");
    testWaitForTimeoutSilent(1500);
    
    TestStep(0, "", "Expected values related to Steering wheel (CLASSE sysvars):");
    
    WaitForSysVarInRange(
      sysvar::hil_hvm::steering_wheel_angle,
      rwa_req,
      rwa_req, 
      2000);
    
    TestStep(0, "", "Expected values related to Road wheel (CLASSE sysvars):");
    
    WaitForSysVarInRange(
      sysvar::hil_hvm::wheel_angle_fl,
      -0.1,
      0.1, 
      200);
    WaitForSysVarInRange(
      sysvar::hil_hvm::wheel_angle_fl,
      -0.05,
      0.05, 
      5000);
    WaitForSysVarInRange(
      sysvar::hil_hvm::wheel_angle_fr,
      -0.05,
      0.05,
      50);
    WaitForSysVarInRange(
      sysvar::hil_hvm::wheel_angle_rl,
      0,
      0, 
      50);
    WaitForSysVarInRange(
      sysvar::hil_hvm::wheel_angle_rr,
      0,
      0,
      50);
    WaitForSysVarInRange(
      sysvar::hil_hvm::wheel_speed_fl,
      ego_speed-0.2,
      ego_speed+0.2,
      50);
    WaitForSysVarInRange(
      sysvar::hil_hvm::wheel_speed_fr,
      ego_speed-0.2,
      ego_speed+0.2,
      50);
    WaitForSysVarInRange(
      sysvar::hil_hvm::wheel_speed_rl,
      ego_speed-0.2,
      ego_speed+0.2,
      50);
    WaitForSysVarInRange(
      sysvar::hil_hvm::wheel_speed_rr,
      ego_speed-0.2,
      ego_speed+0.2,
      50);
    
    TestStep(0, "", "Expected values related to Ego movement (CLASSE sysvars):");
    
    yaw_rate_in_deg_p_s = Get_YawRate_in_deg_p_s();
    
    WaitForSysVarInRange(
      sysvar::hil_hvm::yaw_rate,
      yaw_rate_in_deg_p_s-0.25,
      yaw_rate_in_deg_p_s+0.25,
      50);
  }
  
  testWaitForTimeoutSilent(1000);
  
  // -----------
  // Finish test
  
  @hil_drv::target_velocity = 0;
  @hil_ctrl::lat_ctrl_vehicle_model = lat_ctrl_vehicle_model;
  @hil_vehicle::steering_characteristic_type = steering_characteristic_type;
  @hil_vehicle::steering_characteristic_swa_rwa_ratio = SWA_RWA_ratio;
  
  testWaitForTimeoutSilent(1000);
  
  WaitForSysVarInRange(sysvar::hil_hvm::velocity_x, 0, 0.001, 60000);
  
  PostConditionsAEB();
  PostConditionsCM();
  
  SetSysvarInt(sysvar::hil_adas::lat_ctrl_is_enabled, @hil_adas::lat_ctrl_is_enabled::enabled, "Enable ADAS control over lateral movement of Ego");
  SetSysvarInt(sysvar::hil_adas::long_ctrl_is_enabled, @hil_adas::long_ctrl_is_enabled::enabled, "Enable ADAS control over longitudinal movement of Ego");
}