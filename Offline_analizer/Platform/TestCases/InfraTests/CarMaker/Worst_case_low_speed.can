/*@!Encoding:1252*/
includes
{
  #include "../../common_test_functions.cin"
}

variables
{
  float current_ego_tx,current_ego_ty, current_target_tx, current_target_ty, delta_tx, delta_ty;
  int cnt;
  char temp_string[255];
}

testcase Worst_case_low_speed(int config, double ego_speed, double tgt_speed, int vehicle_code)
{
  SetSysvarInt(sysvar::hil_adas::lat_ctrl_is_enabled, @hil_adas::lat_ctrl_is_enabled::disabled, "Disable ADAS control over lateral movement of Ego");
  SetSysvarInt(sysvar::hil_adas::long_ctrl_is_enabled, @hil_adas::long_ctrl_is_enabled::disabled, "Disable ADAS control over longitudinal movement of Ego");
  
  @hil_ctrl::vehicle = vehicle_code; //set the vehicle variant 
  cf_testPreparation();
  sysSetVariableString(sysvar::Customer_specific::cm_scenario, "Worst_case_low_speed");
  PreConditionsCM(config);
  @Customer_specific::load_scenario = 1;
  CM_start();
  PreConditionsAEB();
  testStep("Test case","Start");
  // while loop mainqueue load :: simulation  != 0 then fail
  @hil_drv::target_velocity = ego_speed;
  @Classe_Obj_Sim::obj_ctrl.ctrl_status_velocity[0] = 1;
  @Classe_Obj_Sim::obj_ctrl.obj_target_v_long[0] = tgt_speed;
  @hil_drv::gear_req = @hil_drv::gear_req::reverse;
  testWaitForTimeout(20000);
  // while loop
  for (cnt=0;cnt<200;cnt++)
  {
    snprintf(temp_string, 255,"Main Queue Load =: %f", @CANoe::Simulation::MainQueueLoad);
    teststep(2,temp_string,"");
    if (@CANoe::Simulation::MainQueueLoad==0) 
      testStepPass("MainQueue load = 0 -> OK");
    else
      testStepFail("MainQueue load > 0 -> NOK");
    testWaitForTimeout(100);
  }
  PostConditionsAEB();
  PostConditionsCM();
  
  SetSysvarInt(sysvar::hil_adas::lat_ctrl_is_enabled, @hil_adas::lat_ctrl_is_enabled::enabled, "Enable ADAS control over lateral movement of Ego");
  SetSysvarInt(sysvar::hil_adas::long_ctrl_is_enabled, @hil_adas::long_ctrl_is_enabled::enabled, "Enable ADAS control over longitudinal movement of Ego");
}