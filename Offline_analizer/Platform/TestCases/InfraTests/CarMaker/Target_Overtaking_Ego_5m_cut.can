/*@!Encoding:1252*/
/**
 * @file Target_Overtaking_Ego_10m_cut.can
 * @author ADAS_HIL_TEAM
 * @date 10-16-2023
 * @brief 
 *
 * ################################################################
 * C O P Y R I G H T S
 * ----------------------------------------------------------------
 * Copyright (c) 2023 by Robert Bosch GmbH. All rights reserved.
 
 * The reproduction, distribution and utilization of this file as
 * well as the communication of its contents to others without express
 * authorization is prohibited. Offenders will be held liable for the
 * payment of damages. All rights reserved in the event of the grant
 * of a patent, utility model or design.
 *
 * ################################################################
*/

includes
{
  #include "../../common_test_functions.cin"
}

variables
{
  float current_ego_tx,current_ego_ty, current_target_tx, current_target_ty, delta_tx, delta_ty;
}

testcase Target_Overtaking_Ego_5m_cut(int config, double ego_speed, double tgt_speed, int vehicle_code)
{
  SetSysvarInt(sysvar::hil_adas::lat_ctrl_is_enabled, @hil_adas::lat_ctrl_is_enabled::disabled, "Disable ADAS control over lateral movement of Ego");
  SetSysvarInt(sysvar::hil_adas::long_ctrl_is_enabled, @hil_adas::long_ctrl_is_enabled::disabled, "Disable ADAS control over longitudinal movement of Ego");
  
  @hil_ctrl::vehicle = vehicle_code; //set the vehicle variant 
  cf_testPreparation();
  sysSetVariableString(sysvar::Customer_specific::cm_scenario, "Target_Overtaking_Ego_10m_cut");
  PreConditionsCM(config);
  @Customer_specific::load_scenario = 1;
  CM_start();
  PreConditionsAEB();
  testStep("Test case","Start");
  @hil_drv::target_velocity = ego_speed;
  @Classe_Obj_Sim::obj_ctrl.obj_target_v_long[0] = tgt_speed;
  @Classe_Obj_Sim::obj_ctrl.ctrl_status_velocity[0] = 1;
  @Classe_Obj_Sim::obj_ctrl.obj_target_lane_lat_offset[0] = 0;
  @Classe_Obj_Sim::obj_ctrl.ctrl_status_lane_lat_offset[0] = 1;
  @Classe_Obj_Sim::obj_ctrl.par_lane_offset_timeconstraint = 1; // set to 1 sec the time to change the lane
  testWaitForTimeout(5000);
  testWaitForSignalInRange(sysvar::CarMaker::RB::TrafficObj::object0::dtx, -5,-1,30000);
  @Classe_Obj_Sim::obj_ctrl.obj_target_lane_lat_offset[0] = 3.5;
  testWaitForSignalInRange(sysvar::CarMaker::RB::TrafficObj::object0::dtx, 5,20,30000);
  @Classe_Obj_Sim::obj_ctrl.obj_target_lane_lat_offset[0] = 0;
  
  PostConditionsAEB();
  PostConditionsCM();
  
  SetSysvarInt(sysvar::hil_adas::lat_ctrl_is_enabled, @hil_adas::lat_ctrl_is_enabled::enabled, "Enable ADAS control over lateral movement of Ego");
  SetSysvarInt(sysvar::hil_adas::long_ctrl_is_enabled, @hil_adas::long_ctrl_is_enabled::enabled, "Enable ADAS control over longitudinal movement of Ego");
}