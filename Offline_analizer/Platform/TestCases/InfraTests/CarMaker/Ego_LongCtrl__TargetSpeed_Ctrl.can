/*@!Encoding:1252*/
includes
{
  #include "../../common_test_functions.cin"
}

variables
{
}

testcase Ego_LongCtrl__TargetSpeed_Ctrl(
  int config,
  int vehicle_code
)
{
  double target_speed;
  double ego_speed_actl;
  double hil_hvm_ego_target_vel_max_acceleration;
  double hil_hvm_ego_target_vel_max_deceleration;
  long i;
  
  // -----------------
  // Test precondition
  
//  @hil_ctrl::init_all = 1;
//  testWaitForTimeoutSilent(100);
//  @hil_ctrl::init_all = 0;
//  testWaitForTimeoutSilent(5000);
  
  SetSysvarInt(sysvar::hil_adas::lat_ctrl_is_enabled, @hil_adas::lat_ctrl_is_enabled::disabled, "Disable ADAS control over lateral movement of Ego");
  SetSysvarInt(sysvar::hil_adas::long_ctrl_is_enabled, @hil_adas::long_ctrl_is_enabled::disabled, "Disable ADAS control over longitudinal movement of Ego");
  
  @hil_ctrl::vehicle = vehicle_code; //set the vehicle variant 
  cf_testPreparation();
  sysSetVariableString(sysvar::Customer_specific::cm_scenario, "Infra_scenarios/Ego_LongCtrl__TargetSpeed_Ctrl");
  testWaitForTimeoutSilent(100);
  PreConditionsCM(config);
  @Customer_specific::load_scenario = 1;
  CM_start();
  PreConditionsAEB();
  
  // wait for CarMaker scenario has been started
  for(i=0;i<400;i++)
  {
    if(@CarMaker::SC::State == 8) break;
    testWaitForTimeoutSilent(100);
  }
  
  hil_hvm_ego_target_vel_max_acceleration = @hil_hvm::ego_target_vel_max_acceleration;
  hil_hvm_ego_target_vel_max_deceleration = @hil_hvm::ego_target_vel_max_deceleration;
  
  // ----------
  // Test steps
  
  testStep("Test case","Start");
  
  target_speed = 0.6;
  TestStep("Step 01", "Target Ego speed : %f km/h", target_speed);
  
  SetSysvarFloat(sysvar::hil_drv::target_velocity, target_speed, "");
  testWaitForTimeoutSilent(5000);
  
  WaitForSysVarInRange(sysvar::hil_hvm::velocity_x, target_speed*0.999, target_speed*1.001, 30000);
  WaitForSysVarInRange(sysvar::hil_hvm::brake_pedal_position, 1, 15, 100);
  WaitForSysVarInRange(sysvar::hil_hvm::gas_pedal_position, 0, 0, 100);
  WaitForSysVarInRange(sysvar::hil_hvm::velocity_x, target_speed*0.999, target_speed*1.001, 10000);
  WaitForSysVarInRange(sysvar::hil_hvm::brake_pedal_position, 1, 15, 100);
  WaitForSysVarInRange(sysvar::hil_hvm::gas_pedal_position, 0, 0, 100);
  testWaitForTimeout(1000);
  WaitForSysVarInRange(sysvar::hil_hvm::velocity_x, target_speed*0.999, target_speed*1.001, 100);
  WaitForSysVarInRange(sysvar::hil_hvm::brake_pedal_position, 1, 15, 100);
  WaitForSysVarInRange(sysvar::hil_hvm::gas_pedal_position, 0, 0, 100);
  
  target_speed = 65;
  TestStep("Step 02", "Target Ego speed : %f km/h", target_speed);
  SetSysvarFloat(sysvar::hil_drv::target_velocity, target_speed, "");
  testWaitForTimeoutSilent(100);
  
  WaitForSysVarInRange(sysvar::hil_hvm::velocity_x, target_speed*0.2, target_speed*0.25, 10000);
  WaitForSysVarInRange(sysvar::hil_hvm::acceleration_x, 1.5, @hil_hvm::ego_target_vel_max_acceleration, 100);
  WaitForSysVarInRange(sysvar::hil_hvm::brake_pedal_position, 0, 0, 100);
  WaitForSysVarInRange(sysvar::hil_hvm::gas_pedal_position, 50, 99, 100);
  WaitForSysVarInRange(sysvar::hil_hvm::velocity_x, target_speed*0.4, target_speed*0.45, 10000);
  WaitForSysVarInRange(sysvar::hil_hvm::brake_pedal_position, 0, 0, 100);
  WaitForSysVarInRange(sysvar::hil_hvm::gas_pedal_position, 50, 99, 100);
  WaitForSysVarInRange(sysvar::hil_hvm::velocity_x, target_speed*0.6, target_speed*0.65, 10000);
  WaitForSysVarInRange(sysvar::hil_hvm::brake_pedal_position, 0, 0, 100);
  WaitForSysVarInRange(sysvar::hil_hvm::gas_pedal_position, 50, 99, 100);
  WaitForSysVarInRange(sysvar::hil_hvm::velocity_x, target_speed*0.8, target_speed*0.85, 10000);
  WaitForSysVarInRange(sysvar::hil_hvm::brake_pedal_position, 0, 0, 100);
  WaitForSysVarInRange(sysvar::hil_hvm::gas_pedal_position, 50, 99, 100);
  WaitForSysVarInRange(sysvar::hil_hvm::velocity_x, target_speed*0.999, target_speed*0.9999, 10000);
  WaitForSysVarInRange(sysvar::hil_hvm::acceleration_x, 0.001, 1, 100);
  WaitForSysVarInRange(sysvar::hil_hvm::brake_pedal_position, 0, 0, 100);
  WaitForSysVarInRange(sysvar::hil_hvm::gas_pedal_position, 10, 35, 100);
  testWaitForTimeout(1000);
  WaitForSysVarInRange(sysvar::hil_hvm::velocity_x, target_speed*0.99, target_speed*1.01, 100);
  
  ego_speed_actl = @hil_hvm::velocity_x;
  target_speed = 180;
  TestStep("Step 03", "Target Ego speed : %f km/h", target_speed);
  SetSysvarFloat(sysvar::hil_drv::target_velocity, target_speed, "");
  testWaitForTimeoutSilent(100);
  
  WaitForSysVarInRange(sysvar::hil_hvm::velocity_x, ego_speed_actl+(target_speed-ego_speed_actl)*0.2, ego_speed_actl+(target_speed-ego_speed_actl)*0.25, 15000);
  WaitForSysVarInRange(sysvar::hil_hvm::acceleration_x, 1, @hil_hvm::ego_target_vel_max_acceleration, 100);
  WaitForSysVarInRange(sysvar::hil_hvm::velocity_x, ego_speed_actl+(target_speed-ego_speed_actl)*0.4, ego_speed_actl+(target_speed-ego_speed_actl)*0.45, 15000);
  WaitForSysVarInRange(sysvar::hil_hvm::velocity_x, ego_speed_actl+(target_speed-ego_speed_actl)*0.6, ego_speed_actl+(target_speed-ego_speed_actl)*0.65, 15000);
  WaitForSysVarInRange(sysvar::hil_hvm::velocity_x, ego_speed_actl+(target_speed-ego_speed_actl)*0.8, ego_speed_actl+(target_speed-ego_speed_actl)*0.85, 15000);
  WaitForSysVarInRange(sysvar::hil_hvm::velocity_x, ego_speed_actl+(target_speed-ego_speed_actl)*0.999, ego_speed_actl+(target_speed-ego_speed_actl)*0.9999, 15000);
  testWaitForTimeout(1000);
  WaitForSysVarInRange(sysvar::hil_hvm::velocity_x, ego_speed_actl+(target_speed-ego_speed_actl)*0.99, ego_speed_actl+(target_speed-ego_speed_actl)*1.01, 100);
  
  ego_speed_actl = @hil_hvm::velocity_x;
  target_speed = 10;
  TestStep("Step 04", "Target Ego speed : %f km/h", target_speed);
  SetSysvarFloat(sysvar::hil_drv::target_velocity, target_speed, "");
  testWaitForTimeoutSilent(100);
  
  WaitForSysVarInRange(sysvar::hil_hvm::velocity_x, target_speed+(ego_speed_actl-target_speed)*0.8, target_speed+(ego_speed_actl-target_speed)*0.85, 10000);
  WaitForSysVarInRange(sysvar::hil_hvm::acceleration_x, @hil_hvm::ego_target_vel_max_deceleration, -3, 100);
  WaitForSysVarInRange(sysvar::hil_hvm::brake_pedal_position, 40, 99, 100);
  WaitForSysVarInRange(sysvar::hil_hvm::gas_pedal_position, 0, 0, 100);
  WaitForSysVarInRange(sysvar::hil_hvm::velocity_x, target_speed+(ego_speed_actl-target_speed)*0.6, target_speed+(ego_speed_actl-target_speed)*0.65, 10000);
  WaitForSysVarInRange(sysvar::hil_hvm::brake_pedal_position, 40, 99, 100);
  WaitForSysVarInRange(sysvar::hil_hvm::gas_pedal_position, 0, 0, 100);
  WaitForSysVarInRange(sysvar::hil_hvm::velocity_x, target_speed+(ego_speed_actl-target_speed)*0.4, target_speed+(ego_speed_actl-target_speed)*0.45, 10000);
  WaitForSysVarInRange(sysvar::hil_hvm::brake_pedal_position, 40, 99, 100);
  WaitForSysVarInRange(sysvar::hil_hvm::gas_pedal_position, 0, 0, 100);
  WaitForSysVarInRange(sysvar::hil_hvm::velocity_x, target_speed+(ego_speed_actl-target_speed)*0.2, target_speed+(ego_speed_actl-target_speed)*0.25, 10000);
  WaitForSysVarInRange(sysvar::hil_hvm::brake_pedal_position, 40, 99, 100);
  WaitForSysVarInRange(sysvar::hil_hvm::gas_pedal_position, 0, 0, 100);
  WaitForSysVarInRange(sysvar::hil_hvm::velocity_x, target_speed+(ego_speed_actl-target_speed)*0.0001, target_speed+(ego_speed_actl-target_speed)*0.001, 10000);
  WaitForSysVarInRange(sysvar::hil_hvm::acceleration_x, -1, -0.001, 100);
  testWaitForTimeout(2000);
  WaitForSysVarInRange(sysvar::hil_hvm::velocity_x, target_speed*0.98, target_speed+(ego_speed_actl-target_speed)*0.001, 100);
  WaitForSysVarInRange(sysvar::hil_hvm::acceleration_x, -0.2, 0.2, 100);
  
  ego_speed_actl = @hil_hvm::velocity_x;
  target_speed = 0;
  TestStep("Step 05", "Target Ego speed : %f km/h", target_speed);
  
  hil_hvm_ego_target_vel_max_acceleration = @hil_hvm::ego_target_vel_max_acceleration;
  hil_hvm_ego_target_vel_max_deceleration = @hil_hvm::ego_target_vel_max_deceleration;
  SetSysvarFloat(sysvar::hil_hvm::ego_target_vel_max_deceleration, -1, "");
  
  SetSysvarFloat(sysvar::hil_drv::target_velocity, target_speed, "");
  
  WaitForSysVarInRange(sysvar::hil_hvm::velocity_x, ego_speed_actl*0.8, ego_speed_actl*0.85, 5000);
  WaitForSysVarInRange(sysvar::hil_hvm::velocity_x, ego_speed_actl*0.6, ego_speed_actl*0.65, 5000);
  WaitForSysVarInRange(sysvar::hil_hvm::velocity_x, ego_speed_actl*0.4, ego_speed_actl*0.45, 5000);
  WaitForSysVarInRange(sysvar::hil_hvm::velocity_x, ego_speed_actl*0.2, ego_speed_actl*0.25, 5000);
  WaitForSysVarInRange(sysvar::hil_hvm::velocity_x, 0, 0.001, 10000);
  testWaitForTimeout(1000);
  WaitForSysVarInRange(sysvar::hil_hvm::velocity_x, 0, 0.0001, 10000);
  
  // -----------
  // Finish test
  
  @hil_hvm::ego_target_vel_max_deceleration = hil_hvm_ego_target_vel_max_deceleration;
  
  PostConditionsAEB();
  PostConditionsCM();
  
  SetSysvarInt(sysvar::hil_adas::lat_ctrl_is_enabled, @hil_adas::lat_ctrl_is_enabled::enabled, "Enable ADAS control over lateral movement of Ego");
  SetSysvarInt(sysvar::hil_adas::long_ctrl_is_enabled, @hil_adas::long_ctrl_is_enabled::enabled, "Enable ADAS control over longitudinal movement of Ego");
}