/*@!Encoding:1252*/
includes
{
  #include "../../common_test_functions.cin"
}

variables
{
  double i=0;
  double tolerance = 3;  // tolerance (in m) for checking distance
  double angle_from_CM = 0; //heading angle of the target as loopback from CarMaker (taken from RB::Radar DVAs structure)
  char temp_string[255];
  int current_object = 0;
  char current_object_string[255];
  char current_pos_x_string[255];
  char current_pos_y_string[255];
  double FC_mounting_pos = 0;
  double FL_mounting_pos = 45;
  double FR_mounting_pos = -45;
  double RL_mounting_pos = 135;
  double RR_mounting_pos = -135;
  double ego_length = 5.5;
  double expected_RL_dx = 0;
  double expected_RL_dy = 0;
  double expected_RR_dx = 0;
  double expected_RR_dy = 0;
}


testcase Radars_11obj_in_FOV_of_rear_radars_tx_ty(int config, double ego_speed, int vendor, int vehicle_code)
{
  SetSysvarInt(sysvar::hil_adas::lat_ctrl_is_enabled, @hil_adas::lat_ctrl_is_enabled::disabled, "Disable ADAS control over lateral movement of Ego");
  SetSysvarInt(sysvar::hil_adas::long_ctrl_is_enabled, @hil_adas::long_ctrl_is_enabled::disabled, "Disable ADAS control over longitudinal movement of Ego");
  
  FC_mounting_pos = @sysvar::radarfc_par::mounting_ori_yaw*57.29577951307854999853275233034; //radian-to-degree
  FL_mounting_pos = @sysvar::radarfl_par::mounting_ori_yaw*57.29577951307854999853275233034; //radian-to-degree
  FR_mounting_pos = @sysvar::radarfr_par::mounting_ori_yaw*57.29577951307854999853275233034; //radian-to-degree
  RL_mounting_pos = @sysvar::radarrl_par::mounting_ori_yaw*57.29577951307854999853275233034; //radian-to-degree
  RR_mounting_pos = @sysvar::radarrr_par::mounting_ori_yaw*57.29577951307854999853275233034; //radian-to-degree 
  @hil_ctrl::vehicle = vehicle_code; //set the vehicle variant 
  cf_testPreparation();
  sysSetVariableString(sysvar::Customer_specific::cm_scenario, "Radars_11obj_in_FOV_of_rear_radars_tx_ty");
  PreConditionsCM(config);
  @Customer_specific::load_scenario = 1;
  CM_start();
  //testWaitForTimeout(30000); //this scenario starts very slowly
  TestWaitForSignalMatch(sysvar::CarMaker::SC::State, 8, 30000);
  
  @hil_drv::gear_req = @hil_drv::gear_req::park;

  testStep("Test case","Start");
  @hil_drv::target_velocity = 0;//ego_speed;  
  @hil_ctrl::starmodel_max_loc_nr = 15;
  @hil_ctrl::clara_model_max_loc_nr_per_obj = 15;
  
  @Classe_Obj_Sim::obj_ctrl.ctrl_status_pos_x[0] = 1;
  @Classe_Obj_Sim::obj_ctrl.ctrl_status_pos_x[1] = 1;
  @Classe_Obj_Sim::obj_ctrl.ctrl_status_pos_x[2] = 1;
  @Classe_Obj_Sim::obj_ctrl.ctrl_status_pos_x[3] = 1;
  @Classe_Obj_Sim::obj_ctrl.ctrl_status_pos_x[4] = 1;
  @Classe_Obj_Sim::obj_ctrl.ctrl_status_pos_x[5] = 1;
  @Classe_Obj_Sim::obj_ctrl.ctrl_status_pos_x[6] = 1;
  @Classe_Obj_Sim::obj_ctrl.ctrl_status_pos_x[7] = 1;
  @Classe_Obj_Sim::obj_ctrl.ctrl_status_pos_x[8] = 1;
  @Classe_Obj_Sim::obj_ctrl.ctrl_status_pos_x[9] = 1;
  @Classe_Obj_Sim::obj_ctrl.ctrl_status_pos_x[10] = 1;
  testWaitForTimeout(1000);
  @Classe_Obj_Sim::obj_ctrl.ctrl_status_pos_y[0] = 1;
  @Classe_Obj_Sim::obj_ctrl.ctrl_status_pos_y[1] = 1;
  @Classe_Obj_Sim::obj_ctrl.ctrl_status_pos_y[2] = 1;
  @Classe_Obj_Sim::obj_ctrl.ctrl_status_pos_y[3] = 1;
  @Classe_Obj_Sim::obj_ctrl.ctrl_status_pos_y[4] = 1;
  @Classe_Obj_Sim::obj_ctrl.ctrl_status_pos_y[5] = 1;
  @Classe_Obj_Sim::obj_ctrl.ctrl_status_pos_y[6] = 1;
  @Classe_Obj_Sim::obj_ctrl.ctrl_status_pos_y[7] = 1;
  @Classe_Obj_Sim::obj_ctrl.ctrl_status_pos_y[8] = 1;
  @Classe_Obj_Sim::obj_ctrl.ctrl_status_pos_y[9] = 1;
  @Classe_Obj_Sim::obj_ctrl.ctrl_status_pos_y[10] = 1;
  
  testWaitForTimeout(10000); 
  
 
  
  for (i=-6;i>=-10;i=i-0.2) //checking pos X
  {
    snprintf(current_pos_x_string, 255,"Checking with pos X = %f", i);
    //write("!!!DEBUG!!! current_pos_x_string = %s",current_pos_x_string);
    teststep(2,current_pos_x_string,"");    
    
    @Classe_Obj_Sim::obj_ctrl.obj_target_pos_x[0] = i;
    @Classe_Obj_Sim::obj_ctrl.obj_target_pos_x[1] = i;
    @Classe_Obj_Sim::obj_ctrl.obj_target_pos_x[2] = i;
    @Classe_Obj_Sim::obj_ctrl.obj_target_pos_x[3] = i;
    @Classe_Obj_Sim::obj_ctrl.obj_target_pos_x[4] = i; 
    @Classe_Obj_Sim::obj_ctrl.obj_target_pos_x[5] = i;
    @Classe_Obj_Sim::obj_ctrl.obj_target_pos_x[6] = i;
    @Classe_Obj_Sim::obj_ctrl.obj_target_pos_x[7] = i;
    @Classe_Obj_Sim::obj_ctrl.obj_target_pos_x[8] = i;
    @Classe_Obj_Sim::obj_ctrl.obj_target_pos_x[9] = i;   
    @Classe_Obj_Sim::obj_ctrl.obj_target_pos_x[10] = i; 
    
    testWaitForTimeout(300);
    
    Read_CarMaker_DVAs();
    
    //checks:
    
    for (current_object=0;current_object<11;current_object=current_object+1)
    {
      snprintf(current_object_string, 255,"Checking CarMaker radar data sent via UDP : %d", current_object);
      //write("!!!DEBUG!!! current_object_string = %s",current_object_string);
      teststep(3,current_object_string,"");
   
      //RL
      if (@hil_ctrl::radar_rl_loc_sim!=0 || @hil_ctrl::radar_rl_obj_sim!=0 || @hil_ctrl::radar_rl_raw_sim!=0 || @hil_ctrl::radar_rl_sim!=0 || @hil_ctrl::ra6_rl_lgu_loc_sim!=0 || @hil_ctrl::ra6_rl_sgu_obj_sim!=0)
      {
        //check Radar RL only in if it is selected from sensor set
        testStep(1,"Checking RL radar object data","");
        
        // Teststep for longitudinal distance
        expected_RL_dx = ((i-@RBSData::RL.mountPosX) * cos(@sysvar::radarrl_par::mounting_ori_yaw)) + ((0-@RBSData::RL.mountPosY) * sin(@sysvar::radarrl_par::mounting_ori_yaw));
        if (abs(expected_RL_dx-target_radar_rl_sim_objdata_obj_distance_x[current_object])<tolerance)
          testStepPass("Distance X Radar RL is in range");
        else
        {
          snprintf(temp_string, 255,"expected RL_dx : %f", expected_RL_dx);
          teststep(2,temp_string,"");
          snprintf(temp_string, 255,"value of target_radar_rl_sim_objdata_obj_distance_x[%d] : %f", current_object, target_radar_rl_sim_objdata_obj_distance_x[current_object]);
          teststep(2,temp_string,"");
          testStepFail("Distance X Radar RL is NOT in range");
        }
        
        // Teststep for lateral distance
        expected_RL_dy = ((0-@RBSData::RL.mountPosY) * cos(@sysvar::radarrl_par::mounting_ori_yaw)) - ((i-@RBSData::RL.mountPosX) * sin(@sysvar::radarrl_par::mounting_ori_yaw));
        if (abs(expected_RL_dy-target_radar_rl_sim_objdata_obj_distance_y[current_object])<tolerance)
          testStepPass("Distance Y Radar RL is in range");
        else
        {
          snprintf(temp_string, 255,"expected RL_dy : %f", expected_RL_dy);
          teststep(2,temp_string,"");
          snprintf(temp_string, 255,"value of target_radar_rl_sim_objdata_obj_distance_y[%d] : %f", current_object, target_radar_rl_sim_objdata_obj_distance_y[current_object]);
          teststep(2,temp_string,"");
          testStepFail("Distance Y Radar RL is NOT in range");
        }
        
        // Space for debugging
        //write("!!!DEBUG!!! Value of Radar RL dx = %f, expected value = %f",target_radar_rl_sim_objdata_obj_distance_x[0],expected_RL_dx);
        //write("!!!DEBUG!!! Value of Radar RL dy = %f, expected value = %f",target_radar_rl_sim_objdata_obj_distance_y[0],expected_RL_dy);
      }
      
      //RR
      if (@hil_ctrl::radar_rr_loc_sim!=0 || @hil_ctrl::radar_rr_obj_sim!=0 || @hil_ctrl::radar_rr_raw_sim!=0 || @hil_ctrl::radar_rr_sim!=0 || @hil_ctrl::ra6_rr_lgu_loc_sim!=0 || @hil_ctrl::ra6_rr_sgu_obj_sim!=0)
      {
        //check Radar RR only in if it is selected from sensor set
        testStep(2,"Checking RR radar object data","");
        
        // Teststep for longitudinal distance
        expected_RR_dx = (i-@RBSData::RR.mountPosX) * cos(@sysvar::radarrr_par::mounting_ori_yaw) + (0-@RBSData::RR.mountPosY) * sin(@sysvar::radarrr_par::mounting_ori_yaw);
        if (abs(expected_RR_dx-target_radar_rr_sim_objdata_obj_distance_x[current_object])<tolerance)
          testStepPass("Distance X Radar RR is in range");
        else
        {
          snprintf(temp_string, 255,"expected RR_dx : %f", expected_RR_dx);
          teststep(2,temp_string,"");
          snprintf(temp_string, 255,"value of target_radar_rr_sim_objdata_obj_distance_x[%d] : %f", current_object, target_radar_rr_sim_objdata_obj_distance_x[current_object]);
          teststep(2,temp_string,"");
          testStepFail("Distance X Radar RR is NOT in range");
        }
        
        // Teststep for lateral distance
        expected_RR_dy = (0-@RBSData::RR.mountPosY) * cos(@sysvar::radarrr_par::mounting_ori_yaw) - (i-@RBSData::RR.mountPosX) * sin(@sysvar::radarrr_par::mounting_ori_yaw);
        if (abs(expected_RR_dy-target_radar_rr_sim_objdata_obj_distance_y[current_object])<=tolerance)
          testStepPass("Distance Y Radar RR is in range");
        else
        {
          snprintf(temp_string, 255,"expected RR_dy : %f", expected_RR_dy);
          teststep(2,temp_string,"");
          snprintf(temp_string, 255,"value of target_radar_rr_sim_objdata_obj_distance_y[%d] : %f", current_object, target_radar_rr_sim_objdata_obj_distance_y[current_object]);
          teststep(2,temp_string,"");
          testStepFail("Distance Y Radar RR is NOT in range");
        }
        
        // Space for debugging
        //write("!!!DEBUG!!! Value of Radar RR dx = %f",target_radar_rr_sim_objdata_obj_distance_x[current_object]);
        //write("!!!DEBUG!!! Value of Radar RR dy = %f",target_radar_rr_sim_objdata_obj_distance_y[current_object]);
      }
    }
  }  
  
  //for testing of Pos Y -> the Pos X is fixed to -10 m
  @Classe_Obj_Sim::obj_ctrl.obj_target_pos_x[0] = -10;
  @Classe_Obj_Sim::obj_ctrl.obj_target_pos_x[1] = -10;
  @Classe_Obj_Sim::obj_ctrl.obj_target_pos_x[2] = -10;
  @Classe_Obj_Sim::obj_ctrl.obj_target_pos_x[3] = -10;
  @Classe_Obj_Sim::obj_ctrl.obj_target_pos_x[4] = -10; 
  @Classe_Obj_Sim::obj_ctrl.obj_target_pos_x[5] = -10;
  @Classe_Obj_Sim::obj_ctrl.obj_target_pos_x[6] = -10;
  @Classe_Obj_Sim::obj_ctrl.obj_target_pos_x[7] = -10;
  @Classe_Obj_Sim::obj_ctrl.obj_target_pos_x[8] = -10;
  @Classe_Obj_Sim::obj_ctrl.obj_target_pos_x[9] = -10;   
  @Classe_Obj_Sim::obj_ctrl.obj_target_pos_x[10] = -10;
    
  for (i=-3;i<-0.5;i=i+0.2) //checking pos Y
  {
    snprintf(current_pos_x_string, 255,"Checking with pos Y = %f", i);
    //write("!!!DEBUG!!! current_pos_y_string = %s",current_pos_y_string);
    teststep(2,current_pos_x_string,"");    
    
    @Classe_Obj_Sim::obj_ctrl.obj_target_pos_y[0] = i;
    @Classe_Obj_Sim::obj_ctrl.obj_target_pos_y[1] = i;
    @Classe_Obj_Sim::obj_ctrl.obj_target_pos_y[2] = i;
    @Classe_Obj_Sim::obj_ctrl.obj_target_pos_y[3] = i;
    @Classe_Obj_Sim::obj_ctrl.obj_target_pos_y[4] = i; 
    @Classe_Obj_Sim::obj_ctrl.obj_target_pos_y[5] = i;
    @Classe_Obj_Sim::obj_ctrl.obj_target_pos_y[6] = i;
    @Classe_Obj_Sim::obj_ctrl.obj_target_pos_y[7] = i;
    @Classe_Obj_Sim::obj_ctrl.obj_target_pos_y[8] = i;
    @Classe_Obj_Sim::obj_ctrl.obj_target_pos_y[9] = i;   
    @Classe_Obj_Sim::obj_ctrl.obj_target_pos_y[10] = i; 
    
    testWaitForTimeout(300);
    
    Read_CarMaker_DVAs();
    
    //checks:
    
    for (current_object=0;current_object<11;current_object=current_object+1)
    {
      snprintf(current_object_string, 255,"Checking CarMaker radar data sent via UDP : %d", current_object);
      //write("!!!DEBUG!!! current_object_string = %s",current_object_string);
      teststep(3,current_object_string,"");
      

      //RL
      if (@hil_ctrl::radar_rl_loc_sim!=0 || @hil_ctrl::radar_rl_obj_sim!=0 || @hil_ctrl::radar_rl_raw_sim!=0 || @hil_ctrl::radar_rl_sim!=0 || @hil_ctrl::ra6_rl_lgu_loc_sim!=0 || @hil_ctrl::ra6_rl_sgu_obj_sim!=0)
      {
        //check Radar RL only in if it is selected from sensor set
        testStep(1,"Checking FL radar object data","");
        
        // Teststep for longitudinal distance
        expected_RL_dx = (-10-@RBSData::RL.mountPosX) * cos(@sysvar::radarrl_par::mounting_ori_yaw) + (i-@RBSData::RL.mountPosY) * sin(@sysvar::radarrl_par::mounting_ori_yaw);
        if (abs(expected_RL_dx-target_radar_rl_sim_objdata_obj_distance_x[current_object])<tolerance)
          testStepPass("Distance X Radar RL is in range");
        else
        {
          snprintf(temp_string, 255,"expected RL_dx : %f", expected_RL_dx);
          teststep(2,temp_string,"");
          snprintf(temp_string, 255,"value of target_radar_rl_sim_objdata_obj_distance_x[%d] : %f", current_object, target_radar_rl_sim_objdata_obj_distance_x[current_object]);
          teststep(2,temp_string,"");
          testStepFail("Distance X Radar RL is NOT in range");
        }
        
        // Teststep for lateral distance
        expected_RL_dy = (i-@RBSData::RL.mountPosY) * cos(@sysvar::radarrl_par::mounting_ori_yaw) - (-10-@RBSData::RL.mountPosX) * sin(@sysvar::radarrl_par::mounting_ori_yaw);
        if (abs(expected_RL_dy-target_radar_rl_sim_objdata_obj_distance_y[current_object])<tolerance)
          testStepPass("Distance Y Radar RL is in range");
        else
        {
          snprintf(temp_string, 255,"expected RL_dy : %f", expected_RL_dy);
          teststep(2,temp_string,"");
          snprintf(temp_string, 255,"value of target_radar_rl_sim_objdata_obj_distance_y[%d] : %f", current_object, target_radar_rl_sim_objdata_obj_distance_y[current_object]);
          teststep(2,temp_string,"");
          testStepFail("Distance Y Radar RL is NOT in range");
        }
        
        // Space for debugging
        //write("!!!DEBUG!!! Value of Radar RL dx = %f",target_radar_rl_sim_objdata_obj_distance_x[0]);
        //write("!!!DEBUG!!! Value of Radar RL dy = %f",target_radar_rl_sim_objdata_obj_distance_y[0]);
      }
      
      //RR
      if (@hil_ctrl::radar_rr_loc_sim!=0 || @hil_ctrl::radar_rr_obj_sim!=0 || @hil_ctrl::radar_rr_raw_sim!=0 || @hil_ctrl::radar_rr_sim!=0 || @hil_ctrl::ra6_rr_lgu_loc_sim!=0 || @hil_ctrl::ra6_rr_sgu_obj_sim!=0)
      {
        //check Radar RR only in if it is selected from sensor set
        testStep(2,"Checking RR radar object data","");
        
        // Teststep for longitudinal distance
        expected_RR_dx = (-10-@RBSData::RR.mountPosX) * cos(@sysvar::radarrr_par::mounting_ori_yaw) + (i-@RBSData::RR.mountPosY) * sin(@sysvar::radarrr_par::mounting_ori_yaw);
        if (abs(expected_RR_dx-target_radar_rr_sim_objdata_obj_distance_x[current_object])<tolerance)
          testStepPass("Distance X Radar RR is in range");
        else
        {
          snprintf(temp_string, 255,"expected RR_dx : %f", expected_RR_dx);
          teststep(2,temp_string,"");
          snprintf(temp_string, 255,"value of target_radar_rr_sim_objdata_obj_distance_x[%d] : %f", current_object, target_radar_rr_sim_objdata_obj_distance_x[current_object]);
          teststep(2,temp_string,"");
          testStepFail("Distance X Radar RR is NOT in range");
        }
        
        // Teststep for lateral distance
        expected_RR_dy = (i-@RBSData::RR.mountPosY) * cos(@sysvar::radarrr_par::mounting_ori_yaw) - (-10-@RBSData::RR.mountPosX) * sin(@sysvar::radarrr_par::mounting_ori_yaw);
        if (abs(expected_RR_dy-target_radar_rr_sim_objdata_obj_distance_y[current_object])<tolerance)
          testStepPass("Distance Y Radar RR is in range");
        else
        {
          snprintf(temp_string, 255,"expected RR_dy : %f", expected_RR_dy);
          teststep(2,temp_string,"");
          snprintf(temp_string, 255,"value of target_radar_rr_sim_objdata_obj_distance_y[%d] : %f", current_object, target_radar_rr_sim_objdata_obj_distance_y[current_object]);
          teststep(2,temp_string,"");
          testStepFail("Distance Y Radar RR is NOT in range");
        }
        
        // Space for debugging
        //write("!!!DEBUG!!! Value of Radar RR dx = %f",target_radar_rr_sim_objdata_obj_distance_x[current_object]);
        //write("!!!DEBUG!!! Value of Radar RR dy = %f",target_radar_rr_sim_objdata_obj_distance_y[current_object]);
      }
    }
  }
  
  PostConditionsAEB();
  PostConditionsCM();
  
  SetSysvarInt(sysvar::hil_adas::lat_ctrl_is_enabled, @hil_adas::lat_ctrl_is_enabled::enabled, "Enable ADAS control over lateral movement of Ego");
  SetSysvarInt(sysvar::hil_adas::long_ctrl_is_enabled, @hil_adas::long_ctrl_is_enabled::enabled, "Enable ADAS control over longitudinal movement of Ego");
}
