/*@!Encoding:1252*/
includes
{
  #include "../../common_test_functions.cin"
}

variables
{
  double i=0;
  double tolerance = 5;  
  double angle_from_CM = 0; //heading angle of the target as loopback from CarMaker (taken from RB::Radar DVAs structure)
  char temp_string[255];
  int current_object = 0;
  char current_object_string[255];
  char current_pos_x_string[255];
  char current_pos_y_string[255];
  const int number_of_objects_in_testcase = 11;
  double FC_mounting_pos = 0;
  double FL_mounting_pos = 45;
  double FR_mounting_pos = -45;
  double RL_mounting_pos = 135;
  double RR_mounting_pos = -135;
  double ego_length = 5.5;
  double expected_FL_px = 0;
  double expected_FL_py = 0;
  double expected_FR_px = 0;
  double expected_FR_py = 0;
  double expected_FC_px = 0;
  double expected_FC_py = 0;
  double RCG_offset = 0;
  double target_length = 5.0;
}


testcase Radars_11obj_in_FOV_of_front_radars_SGU_Px_Py(int config, double ego_speed, int number_of_locations_per_object, int vendor, int vehicle_code)
{
  SetSysvarInt(sysvar::hil_adas::lat_ctrl_is_enabled, @hil_adas::lat_ctrl_is_enabled::disabled, "Disable ADAS control over lateral movement of Ego");
  SetSysvarInt(sysvar::hil_adas::long_ctrl_is_enabled, @hil_adas::long_ctrl_is_enabled::disabled, "Disable ADAS control over longitudinal movement of Ego");
  
  FC_mounting_pos = @sysvar::radarfc_par::mounting_ori_yaw*57.29577951307854999853275233034; //radian-to-degree
  FL_mounting_pos = @sysvar::radarfl_par::mounting_ori_yaw*57.29577951307854999853275233034; //radian-to-degree
  FR_mounting_pos = @sysvar::radarfr_par::mounting_ori_yaw*57.29577951307854999853275233034; //radian-to-degree
  RL_mounting_pos = @sysvar::radarrl_par::mounting_ori_yaw*57.29577951307854999853275233034; //radian-to-degree
  RR_mounting_pos = @sysvar::radarrr_par::mounting_ori_yaw*57.29577951307854999853275233034; //radian-to-degree 
  
  @hil_ctrl::vehicle = vehicle_code; //set the vehicle variant 
  cf_testPreparation();
  sysSetVariableString(sysvar::Customer_specific::cm_scenario, "Radars_11obj_in_FOV_of_front_radars_tx_ty");
  PreConditionsCM(config);
  @Customer_specific::load_scenario = 1;
  CM_start();
  //testWaitForTimeout(30000); //this scenario starts very slowly
  TestWaitForSignalMatch(sysvar::CarMaker::SC::State, 8, 40000);  
  
  @CAN_RadarFC_RFC_Object::TP_enable_loopback_reading = 1;
  @CAN_RadarFL_RFL_Object::TP_enable_loopback_reading = 1;
  @CAN_RadarFR_RFR_Object::TP_enable_loopback_reading = 1;
  
  @CAN_RadarFC::RFC_Object::RFC_Object_Obj1.Read = 1;
  @CAN_RadarFC::RFC_Object::RFC_Object_Obj2.Read = 1;
  @CAN_RadarFC::RFC_Object::RFC_Object_Obj3.Read = 1;
  @CAN_RadarFC::RFC_Object::RFC_Object_Obj4.Read = 1;
  @CAN_RadarFC::RFC_Object::RFC_Object_Obj5.Read = 1;
  @CAN_RadarFC::RFC_Object::RFC_Object_Obj6.Read = 1;
  @CAN_RadarFC::RFC_Object::RFC_Object_Obj7.Read = 1;
  @CAN_RadarFC::RFC_Object::RFC_Object_Obj8.Read = 1;
  @CAN_RadarFC::RFC_Object::RFC_Object_Obj9.Read = 1;
  @CAN_RadarFC::RFC_Object::RFC_Object_Obj10.Read = 1;
  @CAN_RadarFC::RFC_Object::RFC_Object_Obj11.Read = 1;
  
  @CAN_RadarFL::RFL_Object::RFL_Object_Obj1.Read = 1;
  @CAN_RadarFL::RFL_Object::RFL_Object_Obj2.Read = 1;
  @CAN_RadarFL::RFL_Object::RFL_Object_Obj3.Read = 1;
  @CAN_RadarFL::RFL_Object::RFL_Object_Obj4.Read = 1;
  @CAN_RadarFL::RFL_Object::RFL_Object_Obj5.Read = 1;
  @CAN_RadarFL::RFL_Object::RFL_Object_Obj6.Read = 1;
  @CAN_RadarFL::RFL_Object::RFL_Object_Obj7.Read = 1;
  @CAN_RadarFL::RFL_Object::RFL_Object_Obj8.Read = 1;
  @CAN_RadarFL::RFL_Object::RFL_Object_Obj9.Read = 1;
  @CAN_RadarFL::RFL_Object::RFL_Object_Obj10.Read = 1;
  @CAN_RadarFL::RFL_Object::RFL_Object_Obj11.Read = 1;
  
  @CAN_RadarFR::RFR_Object::RFR_Object_Obj1.Read = 1;
  @CAN_RadarFR::RFR_Object::RFR_Object_Obj2.Read = 1;
  @CAN_RadarFR::RFR_Object::RFR_Object_Obj3.Read = 1;
  @CAN_RadarFR::RFR_Object::RFR_Object_Obj4.Read = 1;
  @CAN_RadarFR::RFR_Object::RFR_Object_Obj5.Read = 1;
  @CAN_RadarFR::RFR_Object::RFR_Object_Obj6.Read = 1;
  @CAN_RadarFR::RFR_Object::RFR_Object_Obj7.Read = 1;
  @CAN_RadarFR::RFR_Object::RFR_Object_Obj8.Read = 1;
  @CAN_RadarFR::RFR_Object::RFR_Object_Obj9.Read = 1;
  @CAN_RadarFR::RFR_Object::RFR_Object_Obj10.Read = 1;
  @CAN_RadarFR::RFR_Object::RFR_Object_Obj11.Read = 1;
  
  @hil_drv::gear_req = @hil_drv::gear_req::park;

  testStep("Test case","Start");
  @hil_drv::target_velocity = 0;//ego_speed;  
  @hil_ctrl::starmodel_max_loc_nr = number_of_locations_per_object;
  @hil_ctrl::clara_model_max_loc_nr_per_obj = number_of_locations_per_object;
  
  @Classe_Obj_Sim::obj_ctrl.ctrl_status_pos_x[0] = 1;
  @Classe_Obj_Sim::obj_ctrl.ctrl_status_pos_x[1] = 1;
  @Classe_Obj_Sim::obj_ctrl.ctrl_status_pos_x[2] = 1;
  @Classe_Obj_Sim::obj_ctrl.ctrl_status_pos_x[3] = 1;
  @Classe_Obj_Sim::obj_ctrl.ctrl_status_pos_x[4] = 1;
  @Classe_Obj_Sim::obj_ctrl.ctrl_status_pos_x[5] = 1;
  @Classe_Obj_Sim::obj_ctrl.ctrl_status_pos_x[6] = 1;
  @Classe_Obj_Sim::obj_ctrl.ctrl_status_pos_x[7] = 1;
  @Classe_Obj_Sim::obj_ctrl.ctrl_status_pos_x[8] = 1;
  @Classe_Obj_Sim::obj_ctrl.ctrl_status_pos_x[9] = 1;
  @Classe_Obj_Sim::obj_ctrl.ctrl_status_pos_x[10] = 1;
  
  @Classe_Obj_Sim::obj_ctrl.ctrl_status_pos_y[0] = 1;
  @Classe_Obj_Sim::obj_ctrl.ctrl_status_pos_y[1] = 1;
  @Classe_Obj_Sim::obj_ctrl.ctrl_status_pos_y[2] = 1;
  @Classe_Obj_Sim::obj_ctrl.ctrl_status_pos_y[3] = 1;
  @Classe_Obj_Sim::obj_ctrl.ctrl_status_pos_y[4] = 1;
  @Classe_Obj_Sim::obj_ctrl.ctrl_status_pos_y[5] = 1;
  @Classe_Obj_Sim::obj_ctrl.ctrl_status_pos_y[6] = 1;
  @Classe_Obj_Sim::obj_ctrl.ctrl_status_pos_y[7] = 1;
  @Classe_Obj_Sim::obj_ctrl.ctrl_status_pos_y[8] = 1;
  @Classe_Obj_Sim::obj_ctrl.ctrl_status_pos_y[9] = 1;
  @Classe_Obj_Sim::obj_ctrl.ctrl_status_pos_y[10] = 1;

  testWaitForTimeout(5000); 
  
  RCG_offset = ego_length - 0.5; //around 5 meters
  for (i=10;i<=20;i=i+1) //checking pos X
  {
    snprintf(current_pos_x_string, 255,"Checking with pos X = %f", i);
    //write("!!!DEBUG!!! current_pos_x_string = %s",current_pos_x_string);
    teststep(2,current_pos_x_string,"");    
    
    @Classe_Obj_Sim::obj_ctrl.obj_target_pos_x[0] = i;
    @Classe_Obj_Sim::obj_ctrl.obj_target_pos_x[1] = i;
    @Classe_Obj_Sim::obj_ctrl.obj_target_pos_x[2] = i;
    @Classe_Obj_Sim::obj_ctrl.obj_target_pos_x[3] = i;
    @Classe_Obj_Sim::obj_ctrl.obj_target_pos_x[4] = i; 
    @Classe_Obj_Sim::obj_ctrl.obj_target_pos_x[5] = i;
    @Classe_Obj_Sim::obj_ctrl.obj_target_pos_x[6] = i;
    @Classe_Obj_Sim::obj_ctrl.obj_target_pos_x[7] = i;
    @Classe_Obj_Sim::obj_ctrl.obj_target_pos_x[8] = i;
    @Classe_Obj_Sim::obj_ctrl.obj_target_pos_x[9] = i;   
    @Classe_Obj_Sim::obj_ctrl.obj_target_pos_x[10] = i; 
    @Classe_Obj_Sim::obj_ctrl.obj_target_pos_y[0] = 0;//lateral offset
    @Classe_Obj_Sim::obj_ctrl.obj_target_pos_y[1] = 0;
    @Classe_Obj_Sim::obj_ctrl.obj_target_pos_y[2] = 0;
    @Classe_Obj_Sim::obj_ctrl.obj_target_pos_y[3] = 0;
    @Classe_Obj_Sim::obj_ctrl.obj_target_pos_y[4] = 0; 
    @Classe_Obj_Sim::obj_ctrl.obj_target_pos_y[5] = 0;
    @Classe_Obj_Sim::obj_ctrl.obj_target_pos_y[6] = 0;
    @Classe_Obj_Sim::obj_ctrl.obj_target_pos_y[7] = 0;
    @Classe_Obj_Sim::obj_ctrl.obj_target_pos_y[8] = 0;
    @Classe_Obj_Sim::obj_ctrl.obj_target_pos_y[9] = 0;   
    @Classe_Obj_Sim::obj_ctrl.obj_target_pos_y[10] = 0; 
    testWaitForTimeout(300);
    
    Read_CarMaker_DVAs();
    
    //checks:
    
    for (current_object=0;current_object<number_of_objects_in_testcase;current_object=current_object+1)
    {
      snprintf(current_object_string, 255,"Checking Road Object : %d", current_object);
      //write("!!!DEBUG!!! current_object_string = %s",current_object_string);
      teststep(2,current_object_string,"");
      
     
      //FL
      //check Radar FL only in if it is selected from sensor set
      if (@hil_ctrl::radar_fl_loc_sim!=0 || @hil_ctrl::radar_fl_obj_sim!=0 || @hil_ctrl::radar_fl_raw_sim!=0 || @hil_ctrl::radar_fl_sim!=0 || @hil_ctrl::ra6_fl_lgu_loc_sim || @hil_ctrl::ra6_fl_sgu_obj_sim)
      {
        testStep(1,"Checking FL radar object injection data","");
        
        expected_FL_px = (i-target_length-RCG_offset);
        expected_FL_py = -1.5; //ego width to the left
          
        snprintf(temp_string, 255,"expected FL_PX : %f", expected_FL_px);
        teststep(2,temp_string,"");
        snprintf(temp_string, 255,"value of RFL_Object_Obj[%d].Px : %f", current_object, target_radar_fl_sim_objdata_obj_px[current_object]);
        teststep(2,temp_string,"");
        
        snprintf(temp_string, 255,"expected FL_PY : %f", expected_FL_py);
        teststep(2,temp_string,"");
        snprintf(temp_string, 255,"value of RFL_Object_Obj[%d].Py : %f", current_object, target_radar_fl_sim_objdata_obj_py[current_object]);
        teststep(2,temp_string,"");
         
        if (abs(expected_FL_px-target_radar_fl_sim_objdata_obj_px[current_object])<tolerance)
          testStepPass("Distance Px Radar FL is in range");
        else
          testStepFail("Distance Px Radar FL is NOT in range");
        if (abs(expected_FL_py-target_radar_fl_sim_objdata_obj_py[current_object])<tolerance)
          testStepPass("Distance Py Radar FL is in range");
        else
          testStepFail("Distance Py Radar FL is NOT in range");
      }

      
      //FR
      //check Radar FR only in if it is selected from sensor set
      if (@hil_ctrl::radar_fr_loc_sim!=0 || @hil_ctrl::radar_fr_obj_sim!=0 || @hil_ctrl::radar_fr_raw_sim!=0 || @hil_ctrl::radar_fr_sim!=0 || @hil_ctrl::ra6_fr_lgu_loc_sim || @hil_ctrl::ra6_fr_sgu_obj_sim)
      {
        testStep(1,"Checking FR radar object injection data","");
        
        expected_FR_px = (i-target_length-RCG_offset);
        expected_FR_py = -1.5; //ego width to the left
          
        snprintf(temp_string, 255,"expected FR_PX : %f", expected_FR_px);
        teststep(2,temp_string,"");
        snprintf(temp_string, 255,"value of RFR_Object_Obj[%d].Px : %f", current_object, target_radar_fr_sim_objdata_obj_px[current_object]);
        teststep(2,temp_string,"");
        
        snprintf(temp_string, 255,"expected FR_PY : %f", expected_FR_py);
        teststep(2,temp_string,"");
        snprintf(temp_string, 255,"value of RFR_Object_Obj[%d].Py : %f", current_object, target_radar_fr_sim_objdata_obj_py[current_object]);
        teststep(2,temp_string,"");
         
        if (abs(expected_FR_px-target_radar_fr_sim_objdata_obj_px[current_object])<tolerance)
          testStepPass("Distance Px Radar FR is in range");
        else
          testStepFail("Distance Px Radar FR is NOT in range");
        if (abs(expected_FR_py-target_radar_fr_sim_objdata_obj_py[current_object])<tolerance)
          testStepPass("Distance Py Radar FR is in range");
        else
          testStepFail("Distance Py Radar FR is NOT in range");
      }
    }
  }  
  
 
  @Classe_Obj_Sim::obj_ctrl.ctrl_status_pos_x[0] = 0;
  @Classe_Obj_Sim::obj_ctrl.ctrl_status_pos_x[1] = 0;
  @Classe_Obj_Sim::obj_ctrl.ctrl_status_pos_x[2] = 0;
  @Classe_Obj_Sim::obj_ctrl.ctrl_status_pos_x[3] = 0;
  @Classe_Obj_Sim::obj_ctrl.ctrl_status_pos_x[4] = 0;
  @Classe_Obj_Sim::obj_ctrl.ctrl_status_pos_x[5] = 0;
  @Classe_Obj_Sim::obj_ctrl.ctrl_status_pos_x[6] = 0;
  @Classe_Obj_Sim::obj_ctrl.ctrl_status_pos_x[7] = 0;
  @Classe_Obj_Sim::obj_ctrl.ctrl_status_pos_x[8] = 0;
  @Classe_Obj_Sim::obj_ctrl.ctrl_status_pos_x[9] = 0;
  @Classe_Obj_Sim::obj_ctrl.ctrl_status_pos_x[10] = 0;
  
  @Classe_Obj_Sim::obj_ctrl.ctrl_status_pos_y[0] = 0;
  @Classe_Obj_Sim::obj_ctrl.ctrl_status_pos_y[1] = 0;
  @Classe_Obj_Sim::obj_ctrl.ctrl_status_pos_y[2] = 0;
  @Classe_Obj_Sim::obj_ctrl.ctrl_status_pos_y[3] = 0;
  @Classe_Obj_Sim::obj_ctrl.ctrl_status_pos_y[4] = 0;
  @Classe_Obj_Sim::obj_ctrl.ctrl_status_pos_y[5] = 0;
  @Classe_Obj_Sim::obj_ctrl.ctrl_status_pos_y[6] = 0;
  @Classe_Obj_Sim::obj_ctrl.ctrl_status_pos_y[7] = 0;
  @Classe_Obj_Sim::obj_ctrl.ctrl_status_pos_y[8] = 0;
  @Classe_Obj_Sim::obj_ctrl.ctrl_status_pos_y[9] = 0;
  @Classe_Obj_Sim::obj_ctrl.ctrl_status_pos_y[10] = 0;
  
  PostConditionsAEB();
  PostConditionsCM();
  
  SetSysvarInt(sysvar::hil_adas::lat_ctrl_is_enabled, @hil_adas::lat_ctrl_is_enabled::enabled, "Enable ADAS control over lateral movement of Ego");
  SetSysvarInt(sysvar::hil_adas::long_ctrl_is_enabled, @hil_adas::long_ctrl_is_enabled::enabled, "Enable ADAS control over longitudinal movement of Ego");
}