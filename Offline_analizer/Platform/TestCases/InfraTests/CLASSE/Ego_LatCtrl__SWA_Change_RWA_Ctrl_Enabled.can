/*@!Encoding:1252*/
includes
{
  #include "../../common_test_functions.cin"
}

variables
{
}



testcase Ego_LatCtrl__SWA_Change_RWA_Ctrl_Enabled(
  int config,
  double ego_speed,
  double driver_swa_req_in_deg
)
{
  long result;
  long ego_speed_reached;
  long lat_ctrl_vehicle_model;
  long steering_characteristic_type;
  double yaw_rate_in_deg_p_s;
  double rwa_fl, rwa_fr;
  
  // -----------------
  // Test precondition
  
  cf_testPreparation();
  @hil_ctrl::hil_mode = @hil_ctrl::hil_mode::Classe;
  PreConditionsAEB();
  
  lat_ctrl_vehicle_model = @hil_ctrl::lat_ctrl_vehicle_model;
  @hil_ctrl::lat_ctrl_vehicle_model = @hil_ctrl::lat_ctrl_vehicle_model::enabled;
  steering_characteristic_type = @hil_vehicle::steering_characteristic_type;
  @hil_vehicle::steering_characteristic_type = @hil_vehicle::steering_characteristic_type::SWA_RWA_RATIO;
  //@hil_vehicle::steering_characteristic_swa_rwa_ratio = 1;
  
  TestStep(0, "INFO", "RWA control (CLASSE only) has been enabled.");
  
  // ----------
  // Test steps
  
  testStep("Test case","Start");
  
  // steering settings
  @hil_vehicle::driven_wheel = @hil_vehicle::driven_wheel::FWD;
  
  @hil_drv::target_velocity = ego_speed;
  testWaitForTimeout(1000);
  
  ego_speed_reached = TestWaitForSignalInRange(sysvar::hil_hvm::velocity_x, ego_speed-0.01, ego_speed+0.01, 60000);
  
  if(ego_speed_reached == 1)
  {
    TestStep("Step 01", "Change SWA towards left by %f° (%frad)", driver_swa_req_in_deg, driver_swa_req_in_deg / RADIANS_IN_DEGREE);
    
    @hil_drv::steering_wheel_angle_req = -driver_swa_req_in_deg; // in actual VehModel implementation, ego coord system is mirrored
    
    TestStep(0, "", "Expected values related to Steering wheel (CLASSE sysvars):");
    
    WaitForSysVarInRange(
      sysvar::hil_hvm::steering_wheel_angle,
      driver_swa_req_in_deg,
      driver_swa_req_in_deg, 
      50);
    
    testWaitForTimeout(100);
    
    TestStep(0, "", "Expected values related to Road wheel (CLASSE sysvars):");
    
    GetRWA(
      (double)@hil_vehicle::wheelbase, 
      (double)@hil_vehicle::front_axis_length, 
      @hil_hvm::steering_wheel_angle * @hil_vehicle::steering_characteristic_swa_rwa_ratio, 
      rwa_fl, 
      rwa_fr);
    
    WaitForSysVarInRange(
      sysvar::hil_hvm::wheel_angle_fl,
      rwa_fl-0.001,
      rwa_fl+0.001,
      50);
    WaitForSysVarInRange(
      sysvar::hil_hvm::wheel_angle_fr,
      rwa_fr-0.001,
      rwa_fr+0.001,
      50);
    WaitForSysVarInRange(
      sysvar::hil_hvm::wheel_angle_rl,
      0,
      0, 
      50);
    WaitForSysVarInRange(
      sysvar::hil_hvm::wheel_angle_rr,
      0,
      0,
      50);
    WaitForSysVarInRange(
      sysvar::hil_hvm::wheel_speed_fl,
      ego_speed-0.15,
      ego_speed+0.15,
      50);
    WaitForSysVarInRange(
      sysvar::hil_hvm::wheel_speed_fr,
      ego_speed-0.15,
      ego_speed+0.15,
      50);
    WaitForSysVarInRange(
      sysvar::hil_hvm::wheel_speed_rl,
      ego_speed-0.15,
      ego_speed+0.15,
      50);
    WaitForSysVarInRange(
      sysvar::hil_hvm::wheel_speed_rr,
      ego_speed-0.15,
      ego_speed+0.15,
      50);
    
    TestStepPass(0, "", "Expected order of wheel speed values : RL < FL < RR < FR");
    if((@hil_hvm::wheel_speed_rl < @hil_hvm::wheel_speed_fl)
    && (@hil_hvm::wheel_speed_fl < @hil_hvm::wheel_speed_rr)
    && (@hil_hvm::wheel_speed_rr < @hil_hvm::wheel_speed_fr))
    {
      TestStepPass(0, "", "Calculated order is expected");
    }
    else
    {
      TestStepFail(0, "", "Calculated order is NOT expected");
    }
    
    TestStep(0, "", "Expected values related to Ego movement (CLASSE sysvars):");
    
    yaw_rate_in_deg_p_s = Get_YawRate_in_deg_p_s();
    
    WaitForSysVarInRange(
      sysvar::hil_hvm::yaw_rate,
      yaw_rate_in_deg_p_s-0.01,
      yaw_rate_in_deg_p_s+0.01,
      50);
    
    testWaitForTimeout(1000);
    
    TestStep("Step 01", "Change SWA towards right by %f° (%frad)", -driver_swa_req_in_deg, -driver_swa_req_in_deg / RADIANS_IN_DEGREE);
    
    @hil_drv::steering_wheel_angle_req = driver_swa_req_in_deg; // in actual VehModel implementation, ego coord system is mirrored
    
    TestStep(0, "", "Expected values related to Steering wheel (CLASSE sysvars):");
    
    WaitForSysVarInRange(
      sysvar::hil_hvm::steering_wheel_angle,
      -driver_swa_req_in_deg,
      -driver_swa_req_in_deg, 
      50);
    
    testWaitForTimeout(100);
    
    TestStep(0, "", "Expected values related to Road wheel (CLASSE sysvars):");
    
    
     GetRWA(
      (double)@hil_vehicle::wheelbase, 
      (double)@hil_vehicle::front_axis_length, 
      @hil_hvm::steering_wheel_angle * @hil_vehicle::steering_characteristic_swa_rwa_ratio, 
      rwa_fl, 
      rwa_fr);
    
    WaitForSysVarInRange(
      sysvar::hil_hvm::wheel_angle_fl,
      rwa_fl-0.001,
      rwa_fl+0.001,
      50);
    WaitForSysVarInRange(
      sysvar::hil_hvm::wheel_angle_fr,
      rwa_fr-0.001,
      rwa_fr+0.001,
      50);
    WaitForSysVarInRange(
      sysvar::hil_hvm::wheel_angle_rl,
      0,
      0, 
      50);
    WaitForSysVarInRange(
      sysvar::hil_hvm::wheel_angle_rr,
      0,
      0,
      50);
    WaitForSysVarInRange(
      sysvar::hil_hvm::wheel_speed_fl,
      ego_speed-0.15,
      ego_speed+0.15,
      50);
    WaitForSysVarInRange(
      sysvar::hil_hvm::wheel_speed_fr,
      ego_speed-0.15,
      ego_speed+0.15,
      50);
    WaitForSysVarInRange(
      sysvar::hil_hvm::wheel_speed_rl,
      ego_speed-0.15,
      ego_speed+0.15,
      50);
    WaitForSysVarInRange(
      sysvar::hil_hvm::wheel_speed_rr,
      ego_speed-0.15,
      ego_speed+0.15,
      50);
    
    TestStepPass(0, "", "Expected order of wheel speed values : RR < FR < RL < FL");
    if((@hil_hvm::wheel_speed_rr < @hil_hvm::wheel_speed_fr)
    && (@hil_hvm::wheel_speed_fr < @hil_hvm::wheel_speed_rl)
    && (@hil_hvm::wheel_speed_rl < @hil_hvm::wheel_speed_fl))
    {
      TestStepPass(0, "", "Calculated order is expected");
    }
    else
    {
      TestStepFail(0, "", "Calculated order is NOT expected");
    }
    
    TestStep(0, "", "Expected values related to Ego movement (CLASSE sysvars):");
    
    yaw_rate_in_deg_p_s = Get_YawRate_in_deg_p_s();
    
    WaitForSysVarInRange(
      sysvar::hil_hvm::yaw_rate,
      yaw_rate_in_deg_p_s-0.01,
      yaw_rate_in_deg_p_s+0.01,
      50);
  }
  
  testWaitForTimeout(1000);
  
  // -----------
  // Finish test
  
  @hil_drv::target_velocity = 0;
  @hil_ctrl::lat_ctrl_vehicle_model = lat_ctrl_vehicle_model;
  @hil_vehicle::steering_characteristic_type = steering_characteristic_type;
  @hil_drv::steering_wheel_angle_req = 0;
  
  testWaitForTimeout(1000);
  
  ego_speed_reached = TestWaitForSignalInRange(sysvar::hil_hvm::velocity_x, 0, 0, 60000);
  
  PostConditionsAEB();
}