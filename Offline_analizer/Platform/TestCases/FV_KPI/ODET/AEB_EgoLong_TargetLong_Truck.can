/*@!Encoding:1252*/
/**
 * @file AEB_EgoLong_TargetLong_Car__AEB_CCRs.can
 * @author ADAS_HIL_TEAM
 * @date 05-06-2023
 * @brief 
 *
 * ################################################################
 * C O P Y R I G H T S
 * ----------------------------------------------------------------
 * Copyright (c) 2023 by Robert Bosch GmbH. All rights reserved.
 
 * The reproduction, distribution and utilization of this file as
 * well as the communication of its contents to others without express
 * authorization is prohibited. Offenders will be held liable for the
 * payment of damages. All rights reserved in the event of the grant
 * of a patent, utility model or design.
 *
 * ################################################################
*/

includes
{
  #include "..\common_test_functions_FvKPI.cin"
}

variables
{
}

testcase AEB_EgoLong_TargetLong_Truck(int config, double ego_speed, double tgt_speed)
{
  cf_testPreparation();
  sysSetVariableString(sysvar::Customer_specific::cm_scenario, "FV_KPI_Scenarios\\\\ODET\\\\AEB_EgoLong_TargetLong_Truck");
  PreConditionsCM(config, ego_speed);
  @Customer_specific::load_scenario = 1;
  CM_start();
  //PreConditionAEB_Activation();
  Set_Ego_Ready_ToMove();
  testStep("Test case","Start");
  @hil_drv::target_velocity = ego_speed;
  @Classe_Obj_Sim::obj_ctrl.obj_target_v_long[0] = tgt_speed;
  @Classe_Obj_Sim::obj_ctrl.ctrl_status_velocity[0] = 1;
  testWaitForSignalInRange(sysvar::hil_hvm::velocity_x, ego_speed-1,ego_speed+1,25000);
  TestWaitForSignalMatch(sysvarMember::target_fvideo_sim::objdata.number_of_obj,0x1,15000); // wait till object is detected
  TestWaitForSignalMatch(sysvarMember::target_fvideo_sim::objdata.number_of_obj,0x0,40000); // Run the Ego Vehicle until no further objects in scenario
  // testWaitForSignalInRange(sysvar::hil_adas::acceleration_x_type_req, 1,3,40000);
  // switch(@hil_adas::acceleration_x_type_req)
  // {
  //   case 0:
  //    TestStepFail();//TestStepFail("Test case","AEB not activated");
  //   break;
  //   case 1:
  //    TestStepPass();//TestStepPass("Test case","AEB activated");
  //   break;
  //   case 2:
  //    TestStepPass();//TestStepPass("Test case","AEB activated");
  //   break;
  //   case 3:
  //    TestStepPass();//TestStepPass("Test case","AEB activated");
  //   break;
  // }
  testWaitForTimeout(2000);
 // PostConditionAEB_Deactivation();
 Set_Ego_Ready_ToStop();
  PostConditionsCM();
}
