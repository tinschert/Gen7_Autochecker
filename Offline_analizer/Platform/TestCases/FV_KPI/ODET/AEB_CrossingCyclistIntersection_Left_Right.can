/*@!Encoding:1252*/
/**
 * @file AEB_EgoLong_TargetLong_Car__AEB_CCRs.can
 * @author ADAS_HIL_TEAM
 * @date 05-06-2023
 * @brief 
 *
 * ################################################################
 * C O P Y R I G H T S
 * ----------------------------------------------------------------
 * Copyright (c) 2023 by Robert Bosch GmbH. All rights reserved.
 
 * The reproduction, distribution and utilization of this file as
 * well as the communication of its contents to others without express
 * authorization is prohibited. Offenders will be held liable for the
 * payment of damages. All rights reserved in the event of the grant
 * of a patent, utility model or design.
 *
 * ################################################################
*/

includes
{
  #include "..\common_test_functions_FvKPI.cin"
}

variables
{
}

testcase AEB_CrossingCyclistIntersection_Left_Right(int config, double ego_speed, double tgt_speed)
{
  cf_testPreparation();
  sysSetVariableString(sysvar::Customer_specific::cm_scenario, "FV_KPI_Scenarios\\\\ODET\\\\AEB_CrossingCyclistIntersection_Left_Right");
  PreConditionsCM(config, ego_speed);
  @Customer_specific::load_scenario = 1;
  CM_start();
  Set_Ego_Ready_ToMove();
  testStep("Test case","Start");
  @hil_drv::target_velocity = ego_speed;
  testWaitForSignalInRange(sysvar::hil_hvm::velocity_x, ego_speed-1,ego_speed+1,25000);
  Calculate_wait_time_Cyclist(ego_speed);
  @Classe_Obj_Sim::obj_ctrl.obj_target_v_long[0] = tgt_speed;
  @Classe_Obj_Sim::obj_ctrl.ctrl_status_velocity[0] = 1;
  @hil_ctrl::trigger_tgt_collision_cross = 0;
  TestWaitForSignalMatch(sysvarMember::target_fvideo_sim::objdata.number_of_obj,0x1,15000); // wait till object is detected
  TestWaitForSignalMatch(sysvarMember::target_fvideo_sim::objdata.number_of_obj,0x0,40000); // Run the Ego Vehicle until no further objects in scenario
  testWaitForTimeout(2000);
  Set_Ego_Ready_ToStop();
  PostConditionsCM();
}
