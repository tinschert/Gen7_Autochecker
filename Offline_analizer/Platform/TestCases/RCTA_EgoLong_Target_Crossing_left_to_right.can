/*@!Encoding:1252*/
/**
 * @file RCTA_EgoLong_Target_Crossing_left_to_right.can
 * @author ADAS_HIL_TEAM
 * @date 05-06-2023
 * @brief 
 *
 * ################################################################
 * C O P Y R I G H T S
 * ----------------------------------------------------------------
 * Copyright (c) 2023 by Robert Bosch GmbH. All rights reserved.
 
 * The reproduction, distribution and utilization of this file as
 * well as the communication of its contents to others without express
 * authorization is prohibited. Offenders will be held liable for the
 * payment of damages. All rights reserved in the event of the grant
 * of a patent, utility model or design.
 *
 * ################################################################
*/

includes
{
  #include "common_test_functions.cin"
}

variables
{
}

testcase RCTA_EgoLong_Target_Crossing_left_to_right(int config, double ego_speed, double tgt_speed)
{
  cf_testPreparation();
  sysSetVariableString(sysvar::Customer_specific::cm_scenario, "RCTA_EgoLong_Target_Crossing_left_to_right");
  PreConditionsCM(config);
  @Customer_specific::load_scenario = 1;
  CM_start();
  PreConditionsRCTA();
  testStep("Test case","Start");
  testWaitForTimeout(2000);
  @hil_drv::target_velocity = ego_speed;
  @Classe_Obj_Sim::obj_ctrl.obj_target_v_long[0] = tgt_speed;
  testWaitForSignalInRange(sysvar::hil_hvm::velocity_x, ego_speed-1,ego_speed+1,25000);
  testWaitForSignalInRange(sysvar::hil_adas::acceleration_x_type_req, 1,3,5000);
  switch(@hil_adas::acceleration_x_type_req)
  {
    case 0:
     TestStepFail();//TestStepFail("Test case","RCTA not activated");
    break;
    case 1:
     TestStepPass();//TestStepPass("Test case","RCTA activated");
    break;
    case 2:
     TestStepPass();//TestStepPass("Test case","RCTA activated");
    break;
    case 3:
     TestStepPass();//TestStepPass("Test case","RCTA activated");
    break;
  }
  testWaitForTimeout(1000);
  PostConditionsAEB();
  PostConditionsCM();
}