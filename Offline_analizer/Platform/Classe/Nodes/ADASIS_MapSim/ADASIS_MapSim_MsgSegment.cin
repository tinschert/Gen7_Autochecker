/*@!Encoding:1252*/
/**
 * @file ADASIS_MapSim_MsgSegment.cin
 * @author ADAS_HIL_TEAM
 * @date 08-21-2023
 * @brief  Implemented by node Traffic Sign
 *
 * ################################################################
 * C O P Y R I G H T S
 * ----------------------------------------------------------------
 * Copyright (c) 2023 by Robert Bosch GmbH. All rights reserved.
 
 * The reproduction, distribution and utilization of this file as
 * well as the communication of its contents to others without express
 * authorization is prohibited. Offenders will be held liable for the
 * payment of damages. All rights reserved in the event of the grant
 * of a patent, utility model or design.
 *
 * ################################################################
*/

includes
{
}

variables
{
}

