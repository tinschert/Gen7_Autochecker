
// Autogenerated by -> Platform\Classe\Scripts\Rbs_Scripts\create_ininode.py 
includes
{
}

variables
{
}
/***** Automated code generation starts here *****/

void init_classe_init_value()
{
  int object_id;
  int array_len;
  if(init_count == 1)
  {
  @hil_ctrl::simulation_cycle_time = 5;
  @hil_ctrl::test_case_start = 0;
  @hil_ctrl::init_done = 0;
  @hil_ctrl::init_xcp_done = 0;
  @hil_ctrl::scenario_start = 0;
  @hil_ctrl::ext_control = 0;
  @hil_ctrl::adas_hil_version = 2.17;
  @hil_ctrl::adas_hil_version_minor = 1;
  @hil_ctrl::global_counter = 0;
  @hil_ctrl::global_counter_loop_back = 0;
  @hil_ctrl::global_counter_missed_loops = 0;
  @hil_ctrl::global_counter_max_missed_loops = 0;
  @hil_ctrl::global_counter_delta_time = 0;
  @hil_ctrl::global_counter_freezed_loops = 0;
  @hil_ctrl::clock_sync_delta_canoe = 0;
  @hil_ctrl::clock_sync_delta_cm = 0;
  @hil_ctrl::simulation_overrrun = 0;
  @hil_ctrl::ack_abort_msg_btn = 0;
  @hil_ctrl::preconditions_done = 0;
  @hil_ctrl::remember_config = 1;
  @hil_ctrl::testcase_id = -1;
  @hil_ctrl::fdx_counter_missed_loops = 0;
  @hil_ctrl::fdx_counter_max_missed_loops = 0;
  @hil_ctrl::fdx_counter_delta_time = 0;
  @hil_ctrl::fdx_abort_message = 0;
  }
  if(init_count == 2)
  {
  @hil_ctrl::update_v_tgt_cross = 0;
  @hil_ctrl::update_v_tgt_turncross = 0;
  @hil_ctrl::update_v_tgt_turnlong = 0;
  @hil_ctrl::update_v_tgt_oncoming = 0;
  @hil_ctrl::update_v_tgt_blindspot = 0;
  @hil_ctrl::update_v_tgt_rearcross = 0;
  @hil_ctrl::v_tgt_cross = 0;
  @hil_ctrl::v_tgt_turncross = 0;
  @hil_ctrl::v_tgt_turnlong = 0;
  @hil_ctrl::v_tgt_blindspot = 0;
  @hil_ctrl::v_tgt_rearcross = 0;
  @hil_ctrl::trigger_tgt_collision_cross = 255;
  @hil_ctrl::trigger_tgt_collision_turncross = 255;
  @hil_ctrl::trigger_tgt_collision_turnlong = 255;
  @hil_ctrl::trigger_tgt_collision_oncoming = 255;
  @hil_ctrl::trigger_tgt_collision_blindspot = 255;
  @hil_ctrl::trigger_tgt_collision_rearcross = 255;
  @hil_ctrl::long_dist_tgt_turncross = 2;
  @hil_ctrl::long_dist_tgt_turnlong = 2;
  @hil_ctrl::update_long_vel_tgt = 0;
  @hil_ctrl::trigger_cross_tgt_collision_vel = 255;
  @hil_ctrl::fmu_is_active = 0;
  @hil_ctrl::traffic_obj_0_lane_offset = 0;
  @hil_ctrl::traffic_obj_1_lane_offset = 0;
  @hil_ctrl::traffic_obj_0_lane_offset_timeconstant = 5;
  }
  if(init_count == 3)
  {
  @hil_ctrl::traffic_obj_1_lane_offset_timeconstant = 5;
  @hil_ctrl::Ego_lane_offset = 0;
  @hil_ctrl::Ego_lane_offset_actual = 0;
  @hil_ctrl::Ego_lane_offset_time = 4;
  @hil_ctrl::traffic_obj_0_tx = 0;
  @hil_ctrl::traffic_obj_0_ty = 0;
  @hil_ctrl::traffic_obj_0_tz = 0;
  @hil_ctrl::traffic_obj_0_sRoad = 0;
  @hil_ctrl::roadobj_counter = 0;
  @hil_ctrl::roadobj_counter_loop_back = 0;
  @hil_ctrl::abort_warning_blinker = 0;
  @hil_ctrl::cm_driving_parking_mode = 0;
  @hil_ctrl::clara_model_max_loc_nr_per_obj = 6;
  @hil_ctrl::clara_model_loc_separation_angle = 7;
  @hil_ctrl::location_distribution_model = 1;
  }
  if(init_count == 4)
  {
  object_id = 0;
  array_len = 12;
  for (object_id; object_id < array_len; object_id++)
  {
    @hil_ctrl::uss.mtt_a_sensor_fault[object_id] = 0;
  }
  }
  if(init_count == 5)
  {
  object_id = 0;
  array_len = 12;
  for (object_id; object_id < array_len; object_id++)
  {
    @hil_ctrl::uss.mtt_b_sensor_fault[object_id] = 0;
  }
  }
  if(init_count == 6)
  {
    @hil_ctrl::uss.mtt_a_front_sensor_cluster_fault = 0;
    @hil_ctrl::uss.mtt_a_rear_sensor_cluster_fault = 0;
    @hil_ctrl::uss.mtt_b_front_sensor_cluster_fault = 0;
    @hil_ctrl::uss.mtt_b_rear_sensor_cluster_fault = 0;
  }
  if(init_count == 7)
  {
  object_id = 0;
  array_len = 13;
  for (object_id; object_id < array_len; object_id++)
  {
    @hil_ctrl::obj_target_velocity.long_velocity_tgt[object_id] = 0;
  }
  }
  if(init_count == 8)
  {
  @hil_ctrl::bus_ctrl_vehicle_model = 1;
  @hil_ctrl::lat_ctrl_vehicle_model = 1;
  @hil_ctrl::movienx_camera_x_direciton = 0;
  @hil_ctrl::movienx_camera_y_direciton = 0;
  @hil_ctrl::movienx_camera_z_direciton = 0;
  @hil_ctrl::movienx_camera_x_roll = 0;
  @hil_ctrl::movienx_camera_y_pitch = 0;
  @hil_ctrl::movienx_camera_z_yaw = 0;
  @hil_ctrl::trigger_net_share_check = 0;
  @hil_ctrl::radar_fc_type_req = 0;
  @hil_ctrl::radar_fl_type_req = 0;
  @hil_ctrl::radar_fr_type_req = 0;
  @hil_ctrl::radar_rl_type_req = 0;
  @hil_ctrl::radar_rr_type_req = 0;
  @Python_coupling::Python_Framework_IsTestcaseCurrentlyRunning = 0;
  @Python_coupling::Python_Framework_TDP_refresh_rate = 500;
  @Python_coupling::Python_Framework_CANoe_counter_loopback = 0;
  @Python_coupling::Start_Generator_Button = 0;
  @Python_coupling::Start_GUI_button = 0;
  @Python_coupling::int_result_from_Python = 0;
  @Python_coupling::script_1_exec_button = 0;
  @hil_vehicle::target_velocity = 0;
  @hil_vehicle::target_velocity_active = 0;
  @hil_vehicle::acceleration_x_req = 0;
  @hil_vehicle::gear_req = 0;
  }
  if(init_count == 9)
  {
  @hil_vehicle::gear_type = 0;
  @hil_vehicle::wheel_angle_req_active = 0;
  @hil_vehicle::door_status_general = 0;
  @hil_vehicle::door_status_fl = 0;
  @hil_vehicle::door_status_fr = 0;
  @hil_vehicle::door_status_rl = 0;
  @hil_vehicle::door_status_rr = 0;
  @hil_vehicle::door_status_trunk = 0;
  @hil_hvm::acceleration_x = 0;
  @hil_hvm::acceleration_y = 0;
  @hil_hvm::acceleration_z = 0;
  @hil_hvm::velocity_x = 0;
  @hil_hvm::velocity_y = 0;
  @hil_hvm::steering_wheel_angle = 0;
  @hil_hvm::steering_wheel_angle_speed = 0;
  @hil_hvm::steering_wheel_torque = 0;
  @hil_hvm::road_wheel_angle = 0;
  @hil_hvm::delta_heading_angle = 0;
  @hil_hvm::yaw_rate = 0;
  @hil_hvm::pitch_rate = 0;
  @hil_hvm::roll_rate = 0;
  @hil_hvm::turning_radius_fl = 0;
  @hil_hvm::turning_radius_fr = 0;
  @hil_hvm::turning_radius_rl = 0;
  @hil_hvm::turning_radius_rr = 0;
  }
  if(init_count == 10)
  {
  @hil_hvm::wheel_angle_fl = 0;
  @hil_hvm::wheel_angle_fr = 0;
  @hil_hvm::wheel_angle_rl = 0;
  @hil_hvm::wheel_angle_rr = 0;
  @hil_hvm::wheel_speed_fl = 0;
  @hil_hvm::wheel_speed_fr = 0;
  @hil_hvm::wheel_speed_rl = 0;
  @hil_hvm::wheel_speed_rr = 0;
  @hil_hvm::wheel_rotation_speed_fl = 0;
  @hil_hvm::wheel_rotation_speed_fr = 0;
  @hil_hvm::wheel_rotation_speed_rl = 0;
  @hil_hvm::wheel_rotation_speed_rr = 0;
  @hil_hvm::standstill = 1;
  @hil_hvm::moving_dir = 1;
  @hil_hvm::gear = 0;
  @hil_hvm::gear_pos = 0;
  @hil_hvm::power_mode = 2;
  @hil_hvm::wic_calc_incr_fl = 0;
  @hil_hvm::wic_calc_incr_fr = 0;
  @hil_hvm::wic_calc_incr_rl = 0;
  @hil_hvm::wic_calc_incr_rr = 0;
  @hil_hvm::brake_pedal_position = 0;
  @hil_hvm::gas_pedal_position = 0;
  @hil_hvm::ego_target_vel_pid_err_coeff = 1;
  @hil_hvm::ego_target_vel_pid_int_coeff = 0;
  }
  if(init_count == 11)
  {
  @hil_hvm::ego_target_vel_pid_der_coeff = 0;
  @hil_hvm::ego_target_vel_max_acceleration = 11;
  @hil_hvm::ego_target_vel_max_deceleration = -11;
  @hil_hvm::road_steepness_pitch = 0;
  @hil_hvm::road_steepness_roll = 0;
  @hil_hvm::susp_delta_to_nrh_fl = 0;
  @hil_hvm::susp_delta_to_nrh_fr = 0;
  @hil_hvm::susp_delta_to_nrh_rl = 0;
  @hil_hvm::susp_delta_to_nrh_rr = 0;
  @hil_hvm::velocity_pitch = 0;
  @hil_hvm::velocity_roll = 0;
  @hil_hvm::velocity_yaw = 0;
  @hil_hvm::pos_x = 0;
  @hil_hvm::pos_y = 0;
  @hil_hvm::pos_z = 0;
  @hil_hvm::ori_x = 0;
  @hil_hvm::ori_y = 0;
  @hil_hvm::ori_z = 0;
  @hil_hvm::driven_distance = 0;
  @hil_hvm::abs_status = 0;
  @hil_drv::acceleration_x_req = 0;
  @hil_drv::gear_req = 0;
  @hil_drv::gear_pos_req = 0;
  @hil_drv::gear_pos_selector = 0;
  @hil_drv::target_velocity = 0;
  }
  if(init_count == 12)
  {
  @hil_drv::target_velocity_status = 0;
  @hil_drv::steering_wheel_angle_req = 0;
  @hil_drv::steering_wheel_angle_speed = 0;
  @hil_drv::steering_wheel_torque = 0;
  @hil_drv::road_wheel_angle_req = 0;
  @hil_drv::brake_pedal_position = 0;
  @hil_drv::gas_pedal_position = 0;
  @hil_drv::clutch_pedal_position = 0;
  @hil_drv::acceleration_x_type_req = 0;
  @hil_drv::latl_req_type = 0;
  @hil_drv::DIL_mode = 1;
  @hil_drv::hmi_btn_adas_acc = 0;
  @hil_drv::hmi_btn_adas_elk = 0;
  @hil_drv::hmi_btn_adas_ldw = 0;
  @hil_drv::hmi_btn_adas_lka = 0;
  @hil_drv::hmi_btn_adas_lks = 0;
  @hil_drv::hmi_btn_adas_long_gap = 0;
  @hil_drv::hmi_btn_adas_tja = 0;
  @hil_drv::hmi_btn_adas_tsr = 0;
  @hil_drv::hmi_btn_cc = 0;
  @hil_drv::hmi_btn_lane = 0;
  @hil_drv::indicator_light = 0;
  @hil_drv::hmi_btn_adas_acc2 = 0;
  @hil_drv::hmi_btn_cc2 = 0;
  @hil_drv::heading_angle_req = 0;
  }
  if(init_count == 13)
  {
  @hil_drv::max_abs_yaw_rate = 0;
  @hil_drv::low_beam_is_on = 0;
  @hil_drv::high_beam_is_on = 0;
  @hil_drv::driver_is_steering = 0;
  @hil_adas::acceleration_x_req = 0;
  @hil_adas::acceleration_x_type_req = 0;
  @hil_adas::latl_req_type = 0;
  @hil_adas::gear_req = 99;
  @hil_adas::gear_req_active = 0;
  @hil_adas::road_wheel_angle_req = 0;
  @hil_adas::steering_wheel_angle_req = 0;
  @hil_adas::target_velocity = 0;
  @hil_adas::hmi_display_abs_status = 0;
  @hil_map::GCS_altitude = 0;
  @hil_map::GCS_latitude = 0;
  @hil_map::GCS_longitude = 0;
  @hil_map::GCS_coord_source = 0;
  @hil_drv_g29::left_handle = 0;
  @hil_drv_g29::right_handle = 0;
  @hil_drv_g29::triangle = 0;
  @hil_drv_g29::circle = 0;
  @hil_drv_g29::square = 0;
  @hil_drv_g29::cross = 0;
  @hil_drv_g29::plus = 0;
  @hil_drv_g29::minus = 0;
  }
  if(init_count == 14)
  {
  @hil_drv_g29::enter = 0;
  @hil_drv_g29::l3 = 0;
  @hil_drv_g29::l2 = 0;
  @hil_drv_g29::r2 = 0;
  @hil_drv_g29::r3 = 0;
  @hil_drv_g29::start = 0;
  @hil_drv_g29::options = 0;
  @hil_drv_g29::ps = 0;
  @hil_drv_g29::clockwise = 0;
  @hil_drv_g29::anti_clockwise = 0;
  @hil_drv_g29::dpad_N = 0;
  @hil_drv_g29::dpad_NE = 0;
  @hil_drv_g29::dpad_E = 0;
  @hil_drv_g29::dpad_ES = 0;
  @hil_drv_g29::dpad_S = 0;
  @hil_drv_g29::dpad_SW = 0;
  @hil_drv_g29::dpad_W = 0;
  @hil_drv_g29::dpad_NW = 0;
  @hil_drv_g29::gas_pedal_position = 0;
  @hil_drv_g29::brake_pedal_position = 0;
  @hil_drv_g29::clutch_pedal_position = 0;
  @hil_drv_g29::gas_pedal_flg = 0;
  @hil_drv_g29::brake_pedal_flg = 0;
  @hil_drv_g29::clutch_pedal_flg = 0;
  @hil_drv_g29::steering_wheel_angle_req = 0;
  }
  if(init_count == 15)
  {
  @hil_drv_g29::auto_steering_wheel_angle_req = 0;
  @hil_drv_g29::wheel_ctrl_status = 0;
  @hil_drv_g29::device_is_active = 0;
  @hil_drv_g29::HIL_is_active = 0;
  @hil_tgt_g29::left_handle = 0;
  @hil_tgt_g29::right_handle = 0;
  @hil_tgt_g29::triangle = 0;
  @hil_tgt_g29::circle = 0;
  @hil_tgt_g29::square = 0;
  @hil_tgt_g29::cross = 0;
  @hil_tgt_g29::plus = 0;
  @hil_tgt_g29::minus = 0;
  @hil_tgt_g29::enter = 0;
  @hil_tgt_g29::l3 = 0;
  @hil_tgt_g29::l2 = 0;
  @hil_tgt_g29::r2 = 0;
  @hil_tgt_g29::r3 = 0;
  @hil_tgt_g29::start = 0;
  @hil_tgt_g29::options = 0;
  @hil_tgt_g29::ps = 0;
  @hil_tgt_g29::clockwise = 0;
  @hil_tgt_g29::anti_clockwise = 0;
  @hil_tgt_g29::dpad_N = 0;
  @hil_tgt_g29::dpad_NE = 0;
  @hil_tgt_g29::dpad_E = 0;
  }
  if(init_count == 16)
  {
  @hil_tgt_g29::dpad_ES = 0;
  @hil_tgt_g29::dpad_S = 0;
  @hil_tgt_g29::dpad_SW = 0;
  @hil_tgt_g29::dpad_W = 0;
  @hil_tgt_g29::dpad_NW = 0;
  @hil_tgt_g29::gas_pedal_position = 0;
  @hil_tgt_g29::brake_pedal_position = 0;
  @hil_tgt_g29::clutch_pedal_position = 0;
  @hil_tgt_g29::gas_pedal_flg = 0;
  @hil_tgt_g29::brake_pedal_flg = 0;
  @hil_tgt_g29::clutch_pedal_flg = 0;
  @hil_tgt_g29::steering_wheel_angle_req = 0;
  @hil_tgt_g29::auto_steering_wheel_angle_req = 0;
  @hil_tgt_g29::wheel_ctrl_status = 0;
  @hil_tgt_g29::floating_target_id = 0;
  @hil_tgt_g29::selected_target_id = 0;
  @hil_tgt_g29::device_is_active = 0;
  @Classe_Obj_Sim::obj_delete_btn = 0.0;
  @Classe_Obj_Sim::obj_dx_nr_box = 0.0;
  @Classe_Obj_Sim::obj_dy_nr_box = 0.0;
  @Classe_Obj_Sim::obj_handler = 0.0;
  @Classe_Obj_Sim::obj_id_nr_box = 0.0;
  @Classe_Obj_Sim::obj_insert_btn = 0.0;
  @Classe_Obj_Sim::obj_length_nr_box = 0.0;
  @Classe_Obj_Sim::obj_sim_cradarfl_on = 0.0;
  }
  if(init_count == 17)
  {
  @Classe_Obj_Sim::obj_sim_cradarfr_on = 0.0;
  @Classe_Obj_Sim::obj_sim_cradarrl_on = 0.0;
  @Classe_Obj_Sim::obj_sim_cradarrr_on = 0.0;
  @Classe_Obj_Sim::obj_sim_fradar_on = 0.0;
  @Classe_Obj_Sim::obj_sim_fvideo_on = 0.0;
  @Classe_Obj_Sim::obj_sim_on = 0.0;
  @Classe_Obj_Sim::obj_type_nr_box = 0.0;
  @Classe_Obj_Sim::obj_vx_nr_box = 0.0;
  @Classe_Obj_Sim::obj_vy_nr_box = 0.0;
  @Classe_Obj_Sim::obj_width_nr_box = 0.0;
  }
  if(init_count == 18)
  {
  object_id = 0;
  array_len = 20;
  for (object_id; object_id < array_len; object_id++)
  {
    @Classe_Obj_Sim::objdata.obj_id[object_id] = 0.0;
  }
  }
  if(init_count == 19)
  {
  object_id = 0;
  array_len = 20;
  for (object_id; object_id < array_len; object_id++)
  {
    @Classe_Obj_Sim::objdata.obj_type[object_id] = 0.0;
  }
  }
  if(init_count == 20)
  {
  object_id = 0;
  array_len = 20;
  for (object_id; object_id < array_len; object_id++)
  {
    @Classe_Obj_Sim::objdata.obj_typeProb[object_id] = 0.0;
  }
  }
  if(init_count == 21)
  {
  object_id = 0;
  array_len = 20;
  for (object_id; object_id < array_len; object_id++)
  {
    @Classe_Obj_Sim::objdata.obj_relative_vx[object_id] = 0.0;
  }
  }
  if(init_count == 22)
  {
  object_id = 0;
  array_len = 20;
  for (object_id; object_id < array_len; object_id++)
  {
    @Classe_Obj_Sim::objdata.obj_relative_vy[object_id] = 0.0;
  }
  }
  if(init_count == 23)
  {
  object_id = 0;
  array_len = 20;
  for (object_id; object_id < array_len; object_id++)
  {
    @Classe_Obj_Sim::objdata.obj_dx[object_id] = 0.0;
  }
  }
  if(init_count == 24)
  {
  object_id = 0;
  array_len = 20;
  for (object_id; object_id < array_len; object_id++)
  {
    @Classe_Obj_Sim::objdata.obj_dy[object_id] = 0.0;
  }
  }
  if(init_count == 25)
  {
  object_id = 0;
  array_len = 20;
  for (object_id; object_id < array_len; object_id++)
  {
    @Classe_Obj_Sim::objdata.obj_width[object_id] = 0.0;
  }
  }
  if(init_count == 26)
  {
  object_id = 0;
  array_len = 20;
  for (object_id; object_id < array_len; object_id++)
  {
    @Classe_Obj_Sim::objdata.obj_length[object_id] = 0.0;
  }
  }
  if(init_count == 27)
  {
  object_id = 0;
  array_len = 20;
  for (object_id; object_id < array_len; object_id++)
  {
    @Classe_Obj_Sim::objdata.obj_ax[object_id] = 0.0;
  }
  }
  if(init_count == 28)
  {
  object_id = 0;
  array_len = 20;
  for (object_id; object_id < array_len; object_id++)
  {
    @Classe_Obj_Sim::objdata.obj_ay[object_id] = 0.0;
  }
  }
  if(init_count == 29)
  {
  object_id = 0;
  array_len = 20;
  for (object_id; object_id < array_len; object_id++)
  {
    @Classe_Obj_Sim::objdata.obj_sim_cradarfl_on[object_id] = 0.0;
  }
  }
  if(init_count == 30)
  {
  object_id = 0;
  array_len = 20;
  for (object_id; object_id < array_len; object_id++)
  {
    @Classe_Obj_Sim::objdata.obj_sim_cradarfr_on[object_id] = 0.0;
  }
  }
  if(init_count == 31)
  {
  object_id = 0;
  array_len = 20;
  for (object_id; object_id < array_len; object_id++)
  {
    @Classe_Obj_Sim::objdata.obj_sim_cradarrl_on[object_id] = 0.0;
  }
  }
  if(init_count == 32)
  {
  object_id = 0;
  array_len = 20;
  for (object_id; object_id < array_len; object_id++)
  {
    @Classe_Obj_Sim::objdata.obj_sim_cradarrr_on[object_id] = 0.0;
  }
  }
  if(init_count == 33)
  {
  object_id = 0;
  array_len = 20;
  for (object_id; object_id < array_len; object_id++)
  {
    @Classe_Obj_Sim::objdata.obj_sim_fradar_on[object_id] = 0.0;
  }
  }
  if(init_count == 34)
  {
  object_id = 0;
  array_len = 20;
  for (object_id; object_id < array_len; object_id++)
  {
    @Classe_Obj_Sim::objdata.obj_sim_fvideo_on[object_id] = 0.0;
  }
  }
  if(init_count == 35)
  {
  object_id = 0;
  array_len = 20;
  for (object_id; object_id < array_len; object_id++)
  {
    @Classe_Obj_Sim::objdata.obj_vx[object_id] = 0.0;
  }
  }
  if(init_count == 36)
  {
  object_id = 0;
  array_len = 20;
  for (object_id; object_id < array_len; object_id++)
  {
    @Classe_Obj_Sim::objdata.obj_vy[object_id] = 0.0;
  }
  }
  if(init_count == 37)
  {
  object_id = 0;
  array_len = 20;
  for (object_id; object_id < array_len; object_id++)
  {
    @Classe_Obj_Sim::objdata.obj_phileft[object_id] = 0.0;
  }
  }
  if(init_count == 38)
  {
  object_id = 0;
  array_len = 20;
  for (object_id; object_id < array_len; object_id++)
  {
    @Classe_Obj_Sim::objdata.obj_phiright[object_id] = 0.0;
  }
  }
  if(init_count == 39)
  {
  object_id = 0;
  array_len = 20;
  for (object_id; object_id < array_len; object_id++)
  {
    @Classe_Obj_Sim::objdata.obj_norm_vx[object_id] = 0.0;
  }
  }
  if(init_count == 40)
  {
  object_id = 0;
  array_len = 11;
  for (object_id; object_id < array_len; object_id++)
  {
    @Classe_Obj_Sim::obj_ctrl.autoslow_is_on[object_id] = 1.0;
  }
  }
  if(init_count == 41)
  {
  object_id = 0;
  array_len = 11;
  for (object_id; object_id < array_len; object_id++)
  {
    @Classe_Obj_Sim::obj_ctrl.ctrl_status_lane_lat_offset[object_id] = 0.0;
  }
  }
  if(init_count == 42)
  {
  object_id = 0;
  array_len = 11;
  for (object_id; object_id < array_len; object_id++)
  {
    @Classe_Obj_Sim::obj_ctrl.ctrl_status_lane_long_offset[object_id] = 0.0;
  }
  }
  if(init_count == 43)
  {
  object_id = 0;
  array_len = 11;
  for (object_id; object_id < array_len; object_id++)
  {
    @Classe_Obj_Sim::obj_ctrl.ctrl_status_maneveur_lat[object_id] = 0.0;
  }
  }
  if(init_count == 44)
  {
  object_id = 0;
  array_len = 11;
  for (object_id; object_id < array_len; object_id++)
  {
    @Classe_Obj_Sim::obj_ctrl.ctrl_status_maneveur_long[object_id] = 0.0;
  }
  }
  if(init_count == 45)
  {
  object_id = 0;
  array_len = 11;
  for (object_id; object_id < array_len; object_id++)
  {
    @Classe_Obj_Sim::obj_ctrl.ctrl_status_pos_x[object_id] = 0.0;
  }
  }
  if(init_count == 46)
  {
  object_id = 0;
  array_len = 11;
  for (object_id; object_id < array_len; object_id++)
  {
    @Classe_Obj_Sim::obj_ctrl.ctrl_status_pos_y[object_id] = 0.0;
  }
  }
  if(init_count == 47)
  {
  object_id = 0;
  array_len = 11;
  for (object_id; object_id < array_len; object_id++)
  {
    @Classe_Obj_Sim::obj_ctrl.ctrl_status_pos_z[object_id] = 0.0;
  }
  }
  if(init_count == 48)
  {
  object_id = 0;
  array_len = 11;
  for (object_id; object_id < array_len; object_id++)
  {
    @Classe_Obj_Sim::obj_ctrl.ctrl_status_rot_z[object_id] = 0.0;
  }
  }
  if(init_count == 49)
  {
  object_id = 0;
  array_len = 11;
  for (object_id; object_id < array_len; object_id++)
  {
    @Classe_Obj_Sim::obj_ctrl.ctrl_status_tgt_steering_wheel_angle[object_id] = 0.0;
  }
  }
  if(init_count == 50)
  {
  object_id = 0;
  array_len = 11;
  for (object_id; object_id < array_len; object_id++)
  {
    @Classe_Obj_Sim::obj_ctrl.ctrl_status_velocity[object_id] = 0.0;
  }
  }
  if(init_count == 51)
  {
  object_id = 0;
  array_len = 11;
  for (object_id; object_id < array_len; object_id++)
  {
    @Classe_Obj_Sim::obj_ctrl.dil_ctrl_is_on[object_id] = 0.0;
  }
  }
  if(init_count == 52)
  {
    @Classe_Obj_Sim::obj_ctrl.nbr_of_obj = 0.0;
  }
  if(init_count == 53)
  {
  object_id = 0;
  array_len = 11;
  for (object_id; object_id < array_len; object_id++)
  {
    @Classe_Obj_Sim::obj_ctrl.obj_a_lat[object_id] = 0.0;
  }
  }
  if(init_count == 54)
  {
  object_id = 0;
  array_len = 11;
  for (object_id; object_id < array_len; object_id++)
  {
    @Classe_Obj_Sim::obj_ctrl.obj_a_long[object_id] = 0.0;
  }
  }
  if(init_count == 55)
  {
  object_id = 0;
  array_len = 11;
  for (object_id; object_id < array_len; object_id++)
  {
    @Classe_Obj_Sim::obj_ctrl.obj_gear[object_id] = 0.0;
  }
  }
  if(init_count == 56)
  {
  object_id = 0;
  array_len = 11;
  for (object_id; object_id < array_len; object_id++)
  {
    @Classe_Obj_Sim::obj_ctrl.obj_high_beam[object_id] = 0.0;
  }
  }
  if(init_count == 57)
  {
  object_id = 0;
  array_len = 11;
  for (object_id; object_id < array_len; object_id++)
  {
    @Classe_Obj_Sim::obj_ctrl.obj_id[object_id] = 0.0;
  }
  }
  if(init_count == 58)
  {
  object_id = 0;
  array_len = 11;
  for (object_id; object_id < array_len; object_id++)
  {
    @Classe_Obj_Sim::obj_ctrl.obj_indicator_light[object_id] = 0.0;
  }
  }
  if(init_count == 59)
  {
  object_id = 0;
  array_len = 11;
  for (object_id; object_id < array_len; object_id++)
  {
    @Classe_Obj_Sim::obj_ctrl.obj_is_valid[object_id] = 0.0;
  }
  }
  if(init_count == 60)
  {
  object_id = 0;
  array_len = 11;
  for (object_id; object_id < array_len; object_id++)
  {
    @Classe_Obj_Sim::obj_ctrl.obj_lane_lat_offset[object_id] = 0.0;
  }
  }
  if(init_count == 61)
  {
  object_id = 0;
  array_len = 11;
  for (object_id; object_id < array_len; object_id++)
  {
    @Classe_Obj_Sim::obj_ctrl.obj_lane_long_offset[object_id] = 0.0;
  }
  }
  if(init_count == 62)
  {
  object_id = 0;
  array_len = 11;
  for (object_id; object_id < array_len; object_id++)
  {
    @Classe_Obj_Sim::obj_ctrl.obj_light_ctrl[object_id] = 0.0;
  }
  }
  if(init_count == 63)
  {
  object_id = 0;
  array_len = 11;
  for (object_id; object_id < array_len; object_id++)
  {
    @Classe_Obj_Sim::obj_ctrl.obj_low_beam[object_id] = 0.0;
  }
  }
  if(init_count == 64)
  {
  object_id = 0;
  array_len = 11;
  for (object_id; object_id < array_len; object_id++)
  {
    @Classe_Obj_Sim::obj_ctrl.obj_maneuver_lat_step_id[object_id] = 0.0;
  }
  }
  if(init_count == 65)
  {
  object_id = 0;
  array_len = 11;
  for (object_id; object_id < array_len; object_id++)
  {
    @Classe_Obj_Sim::obj_ctrl.obj_maneuver_long_step_id[object_id] = 0.0;
  }
  }
  if(init_count == 66)
  {
  object_id = 0;
  array_len = 11;
  for (object_id; object_id < array_len; object_id++)
  {
    @Classe_Obj_Sim::obj_ctrl.obj_target_a_long[object_id] = 0.0;
  }
  }
  if(init_count == 67)
  {
  object_id = 0;
  array_len = 11;
  for (object_id; object_id < array_len; object_id++)
  {
    @Classe_Obj_Sim::obj_ctrl.obj_target_brake_pedal_position[object_id] = 0.0;
  }
  }
  if(init_count == 68)
  {
  object_id = 0;
  array_len = 11;
  for (object_id; object_id < array_len; object_id++)
  {
    @Classe_Obj_Sim::obj_ctrl.obj_target_gas_pedal_position[object_id] = 0.0;
  }
  }
  if(init_count == 69)
  {
  object_id = 0;
  array_len = 11;
  for (object_id; object_id < array_len; object_id++)
  {
    @Classe_Obj_Sim::obj_ctrl.obj_target_lane_lat_offset[object_id] = 0.0;
  }
  }
  if(init_count == 70)
  {
  object_id = 0;
  array_len = 11;
  for (object_id; object_id < array_len; object_id++)
  {
    @Classe_Obj_Sim::obj_ctrl.obj_target_pos_x[object_id] = 0.0;
  }
  }
  if(init_count == 71)
  {
  object_id = 0;
  array_len = 11;
  for (object_id; object_id < array_len; object_id++)
  {
    @Classe_Obj_Sim::obj_ctrl.obj_target_pos_y[object_id] = 0.0;
  }
  }
  if(init_count == 72)
  {
  object_id = 0;
  array_len = 11;
  for (object_id; object_id < array_len; object_id++)
  {
    @Classe_Obj_Sim::obj_ctrl.obj_target_pos_z[object_id] = 0.0;
  }
  }
  if(init_count == 73)
  {
  object_id = 0;
  array_len = 11;
  for (object_id; object_id < array_len; object_id++)
  {
    @Classe_Obj_Sim::obj_ctrl.obj_target_rot_z[object_id] = 0.0;
  }
  }
  if(init_count == 74)
  {
  object_id = 0;
  array_len = 11;
  for (object_id; object_id < array_len; object_id++)
  {
    @Classe_Obj_Sim::obj_ctrl.obj_target_v_long[object_id] = 0.0;
  }
  }
  if(init_count == 75)
  {
  object_id = 0;
  array_len = 11;
  for (object_id; object_id < array_len; object_id++)
  {
    @Classe_Obj_Sim::obj_ctrl.obj_tgt_steering_wheel_angle[object_id] = 0.0;
  }
  }
  if(init_count == 76)
  {
  object_id = 0;
  array_len = 11;
  for (object_id; object_id < array_len; object_id++)
  {
    @Classe_Obj_Sim::obj_ctrl.obj_type[object_id] = 0.0;
  }
  }
  if(init_count == 77)
  {
  object_id = 0;
  array_len = 11;
  for (object_id; object_id < array_len; object_id++)
  {
    @Classe_Obj_Sim::obj_ctrl.obj_v_long[object_id] = 0.0;
  }
  }
  if(init_count == 78)
  {
    @Classe_Obj_Sim::obj_ctrl.par_base_slowing_decel = 1.0;
    @Classe_Obj_Sim::obj_ctrl.par_exp_slowing_decel = 4.0;
    @Classe_Obj_Sim::obj_ctrl.par_lane_offset_timeconstraint = 5.0;
    @Classe_Obj_Sim::obj_ctrl.par_max_accel = 11.0;
    @Classe_Obj_Sim::obj_ctrl.par_max_decel = -11.0;
    @Classe_Obj_Sim::obj_ctrl.par_max_dil_accel = 5.0;
    @Classe_Obj_Sim::obj_ctrl.par_max_dil_decel = -8.0;
    @Classe_Obj_Sim::obj_ctrl.par_max_fwd_speed = 200.0;
    @Classe_Obj_Sim::obj_ctrl.par_max_rev_speed = -40.0;
    @Classe_Obj_Sim::obj_ctrl.par_swa_rwa_factor = 1.0;
    @Lane_Simulation::LaneSim_LaneFunction_Status.LKA_status = 0.0;
    @Lane_Simulation::LaneSim_LaneFunction_Status.LKS_status = 3.0;
    @Lane_Simulation::LaneSim_LanePositions_Output.distance_to_left_border = 0.0;
    @Lane_Simulation::LaneSim_LanePositions_Output.distance_to_right_border = 0.0;
    @Lane_Simulation::LaneSim_LanePositions_Output.distance_between_front_center_and_left_border = 0.0;
    @Lane_Simulation::LaneSim_LanePositions_Output.distance_between_front_center_and_right_border = 0.0;
    @Lane_Simulation::LaneSim_RoadScenario_Input.road_scenario = 0.0;
    @Lane_Simulation::LaneSim_RoadScenario_Input.road_length = 0.0;
    @Lane_Simulation::LaneSim_RoadScenario_Input.position_on_the_road_section = 0.0;
    @Lane_Simulation::LaneSim_Segment_Input.line_id = 0.0;
    @Lane_Simulation::LaneSim_Segment_Input.lane_width = 3500.0;
    @Lane_Simulation::LaneSim_Segment_Input.road_edge_offset = 400.0;
    @Lane_Simulation::LaneSim_Segment_Input.raised_edge_offset = 200.0;
    @Lane_Simulation::LaneSim_Segment_Input.line_type = 1.0;
  }
  if(init_count == 79)
  {
  object_id = 0;
  array_len = 16;
  for (object_id; object_id < array_len; object_id++)
  {
    @Lane_Simulation::LaneSim_Simulated_Segments.line_id[object_id] = 0.0;
  }
  }
  if(init_count == 80)
  {
  object_id = 0;
  array_len = 16;
  for (object_id; object_id < array_len; object_id++)
  {
    @Lane_Simulation::LaneSim_Simulated_Segments.line_distance_Y[object_id] = 0.0;
  }
  }
  if(init_count == 81)
  {
  object_id = 0;
  array_len = 16;
  for (object_id; object_id < array_len; object_id++)
  {
    @Lane_Simulation::LaneSim_Simulated_Segments.line_distance_X_start[object_id] = 0.0;
  }
  }
  if(init_count == 82)
  {
  object_id = 0;
  array_len = 16;
  for (object_id; object_id < array_len; object_id++)
  {
    @Lane_Simulation::LaneSim_Simulated_Segments.line_distance_X_end[object_id] = 0.0;
  }
  }
  if(init_count == 83)
  {
  object_id = 0;
  array_len = 16;
  for (object_id; object_id < array_len; object_id++)
  {
    @Lane_Simulation::LaneSim_Simulated_Segments.line_curvature[object_id] = 0.0;
  }
  }
  if(init_count == 84)
  {
  object_id = 0;
  array_len = 16;
  for (object_id; object_id < array_len; object_id++)
  {
    @Lane_Simulation::LaneSim_Simulated_Segments.line_curvature_change[object_id] = 0.0;
  }
  }
  if(init_count == 85)
  {
  object_id = 0;
  array_len = 16;
  for (object_id; object_id < array_len; object_id++)
  {
    @Lane_Simulation::LaneSim_Simulated_Segments.line_type[object_id] = 0.0;
  }
  }
  if(init_count == 86)
  {
  object_id = 0;
  array_len = 16;
  for (object_id; object_id < array_len; object_id++)
  {
    @Lane_Simulation::LaneSim_Simulated_Segments.line_heading_angle[object_id] = 0.0;
  }
  }
  if(init_count == 87)
  {
  object_id = 0;
  array_len = 16;
  for (object_id; object_id < array_len; object_id++)
  {
    @Lane_Simulation::LaneSim_Simulated_Segments.lane_width[object_id] = 3500.0;
  }
  }
  if(init_count == 88)
  {
  object_id = 0;
  array_len = 16;
  for (object_id; object_id < array_len; object_id++)
  {
    @Lane_Simulation::LaneSim_Simulated_Segments.line_is_valid[object_id] = 0.0;
  }
  }
  if(init_count == 89)
  {
    @Lane_Simulation::LaneSim_Vehicle_Motion_Input.heading_direction = 0.0;
    @Lane_Simulation::LaneSim_Vehicle_Motion_Input.vehicle_heading_angle_signed = 0.0;
    @Lane_Simulation::LaneSim_Vehicle_Motion_Input.requested_vehicle_heading_angle = 0.0;
    @Lane_Simulation::LaneSim_Vehicle_Motion_Input.requested_vehicle_heading_angle_signed = 0.0;
    @Lane_Simulation::LaneSim_Vehicle_Motion_Input.vehicle_road_wheel_angle = 0.0;
    @Lane_Simulation::LaneSim_Vehicle_Motion_Input.max_nbr_of_function_reaction = 2.0;
    @Lane_Simulation::LaneSim_VehicleData.vehicle_width = 2000.0;
    @Lane_Simulation::LaneSim_VehicleData.vehicle_length = 2631.0;
  @Lane_Simulation::LaneSim_AllMsgAreValid = 0.0;
  @Lane_Simulation::LaneSim_BackToLaneCenterIsActive = 0.0;
  @Lane_Simulation::LaneSim_EnableAutoLaneKeeping = 1.0;
  @Lane_Simulation::LaneSim_Line_Left_ON = 0.0;
  @Lane_Simulation::LaneSim_Line_LeftLeft_ON = 0.0;
  @Lane_Simulation::LaneSim_Line_Right_ON = 0.0;
  @Lane_Simulation::LaneSim_Line_RightRight_ON = 0.0;
  @Lane_Simulation::LaneSim_LKA_ON = 0.0;
  @Lane_Simulation::LaneSim_LKS_ON = 0.0;
  @Lane_Simulation::LaneSim_New_Wheel_Angle_Requested_LED = 0.0;
  @Lane_Simulation::LaneSim_RaisedEdge_Left_ON = 0.0;
  @Lane_Simulation::LaneSim_RaisedEdge_Right_ON = 0.0;
  @Lane_Simulation::LaneSim_RoadEdge_Left_ON = 0.0;
  @Lane_Simulation::LaneSim_RoadEdge_Right_ON = 0.0;
  @Lane_Simulation::LaneSim_Steering = 0.0;
  @Lane_Simulation::LaneSim_TurnLeft_LED = 0.0;
  @Lane_Simulation::LaneSim_TurnRight_LED = 0.0;
  }
  if(init_count == 90)
  {
    @Traffic_Sign::ts_sim_settings_input_data.ts_current_hour = 0.0;
    @Traffic_Sign::ts_sim_settings_input_data.ts_current_minute = 0.0;
    @Traffic_Sign::ts_sim_settings_input_data.ts_simulated_distance = 0.0;
    @Traffic_Sign::ts_sim_settings_input_data.ts_auto_increment_ts_id = 1.0;
  }
  if(init_count == 91)
  {
  object_id = 0;
  array_len = 16;
  for (object_id; object_id < array_len; object_id++)
  {
    @Traffic_Sign::ts_traffic_sign_input_data_array.ts_additional_sign_array[object_id] = 0.0;
  }
  }
  if(init_count == 92)
  {
  object_id = 0;
  array_len = 16;
  for (object_id; object_id < array_len; object_id++)
  {
    @Traffic_Sign::ts_traffic_sign_input_data_array.ts_lane_id_of_traffic_sign_array[object_id] = 0.0;
  }
  }
  if(init_count == 93)
  {
  object_id = 0;
  array_len = 16;
  for (object_id; object_id < array_len; object_id++)
  {
    @Traffic_Sign::ts_traffic_sign_input_data_array.ts_sign_offset_array[object_id] = 0.0;
  }
  }
  if(init_count == 94)
  {
  object_id = 0;
  array_len = 16;
  for (object_id; object_id < array_len; object_id++)
  {
    @Traffic_Sign::ts_traffic_sign_input_data_array.ts_sign_type_array[object_id] = 0.0;
  }
  }
  if(init_count == 95)
  {
  object_id = 0;
  array_len = 16;
  for (object_id; object_id < array_len; object_id++)
  {
    @Traffic_Sign::ts_traffic_sign_input_data_array.ts_sign_location_array[object_id] = 1.0;
  }
  }
  if(init_count == 96)
  {
  object_id = 0;
  array_len = 16;
  for (object_id; object_id < array_len; object_id++)
  {
    @Traffic_Sign::ts_traffic_sign_input_data_array.ts_sign_type_effective_info_array[object_id] = 0.0;
  }
  }
  if(init_count == 97)
  {
  object_id = 0;
  array_len = 16;
  for (object_id; object_id < array_len; object_id++)
  {
    @Traffic_Sign::ts_traffic_sign_input_data_array.ts_sign_type_effective_other_array[object_id] = 0.0;
  }
  }
  if(init_count == 98)
  {
  object_id = 0;
  array_len = 16;
  for (object_id; object_id < array_len; object_id++)
  {
    @Traffic_Sign::ts_traffic_sign_input_data_array.ts_sign_type_effective_prohibition_array[object_id] = 0.0;
  }
  }
  if(init_count == 99)
  {
  object_id = 0;
  array_len = 16;
  for (object_id; object_id < array_len; object_id++)
  {
    @Traffic_Sign::ts_traffic_sign_input_data_array.ts_sign_type_effective_prio_array[object_id] = 0.0;
  }
  }
  if(init_count == 100)
  {
  object_id = 0;
  array_len = 16;
  for (object_id; object_id < array_len; object_id++)
  {
    @Traffic_Sign::ts_traffic_sign_input_data_array.ts_sign_type_effective_SL_array[object_id] = 0.0;
  }
  }
  if(init_count == 101)
  {
  object_id = 0;
  array_len = 16;
  for (object_id; object_id < array_len; object_id++)
  {
    @Traffic_Sign::ts_traffic_sign_input_data_array.ts_sign_type_effective_warning_array[object_id] = 0.0;
  }
  }
  if(init_count == 102)
  {
  object_id = 0;
  array_len = 16;
  for (object_id; object_id < array_len; object_id++)
  {
    @Traffic_Sign::ts_traffic_sign_input_data_array.ts_simulated_distance_array[object_id] = 0.0;
  }
  }
  if(init_count == 103)
  {
  object_id = 0;
  array_len = 16;
  for (object_id; object_id < array_len; object_id++)
  {
    @Traffic_Sign::ts_traffic_sign_input_data_array.ts_source_array[object_id] = 0.0;
  }
  }
  if(init_count == 104)
  {
  object_id = 0;
  array_len = 16;
  for (object_id; object_id < array_len; object_id++)
  {
    @Traffic_Sign::ts_traffic_sign_input_data_array.ts_speed_limit_unit_array[object_id] = 0.0;
  }
  }
  if(init_count == 105)
  {
  object_id = 0;
  array_len = 16;
  for (object_id; object_id < array_len; object_id++)
  {
    @Traffic_Sign::ts_traffic_sign_input_data_array.ts_time_condition_array[object_id] = 0.0;
  }
  }
  if(init_count == 106)
  {
  object_id = 0;
  array_len = 16;
  for (object_id; object_id < array_len; object_id++)
  {
    @Traffic_Sign::ts_traffic_sign_input_data_array.ts_traffic_sign_id_array[object_id] = 0.0;
  }
  }
  if(init_count == 107)
  {
    @Traffic_Sign::ts_traffic_sign_input_data.ts_additional_sign = 0.0;
    @Traffic_Sign::ts_traffic_sign_input_data.ts_lane_id_of_traffic_sign = 0.0;
    @Traffic_Sign::ts_traffic_sign_input_data.ts_sign_offset = 0.0;
    @Traffic_Sign::ts_traffic_sign_input_data.ts_sign_type = 0.0;
    @Traffic_Sign::ts_traffic_sign_input_data.ts_sign_location = 1.0;
    @Traffic_Sign::ts_traffic_sign_input_data.ts_sign_type_effective_info = 0.0;
    @Traffic_Sign::ts_traffic_sign_input_data.ts_sign_type_effective_other = 0.0;
    @Traffic_Sign::ts_traffic_sign_input_data.ts_sign_type_effective_prohibition = 0.0;
    @Traffic_Sign::ts_traffic_sign_input_data.ts_sign_type_effective_prio = 0.0;
    @Traffic_Sign::ts_traffic_sign_input_data.ts_sign_type_effective_SL = 0.0;
    @Traffic_Sign::ts_traffic_sign_input_data.ts_sign_type_effective_warning = 0.0;
    @Traffic_Sign::ts_traffic_sign_input_data.ts_speed_limit_unit = 0.0;
    @Traffic_Sign::ts_traffic_sign_input_data.ts_time_condition = 0.0;
    @Traffic_Sign::ts_traffic_sign_input_data.ts_traffic_sign_id = 1.0;
    @Traffic_Sign::ts_vehicle_position_output_data.ts_current_lane_id = 0.0;
    @Traffic_Sign::ts_vehicle_position_output_data.ts_vehicle_position = 0.0;
  @Traffic_Sign::ts_debug_update_TS_list_on = 0.0;
  @Traffic_Sign::ts_traffic_sign_map_source_cBox = 1.0;
  @Traffic_Sign::ts_traffic_sign_simulation_on = 0.0;
  @Traffic_Sign::ts_traffic_sign_video_source_cBox = 0.0;
  @g29::button_array = 0.0;
  @g29_tgt::button_array = 0.0;
  @Customer_sysint::enable_AEB = 0;
  @Customer_sysint::enable_AEB_RPC = 0;
  @Customer_sysint::aeb_active = 0;
  }
  if(init_count == 108)
  {
  @Customer_sysint::aeb_active_RPC = 0;
  @Customer_sysint::aeb_available = 0;
  @Customer_sysint::aeb_available_RPC = 0;
  @Customer_sysint::fusion_set_RPC = 0;
  @Customer_sysint::fusion_set_DPC = 0;
  @Customer_sysint::aeb_Pedestrian_active = 0;
  @Vehicle_Model::FDX_counter_missed_loops = 0;
  @Vehicle_Model::FDX_counter_max_missed_loops = 0;
  @Vehicle_Model::FDX_counter_delta_time = 0;
  @Vehicle_Model::FDX_abort_message = 0;
  @Vehicle_Model::preconditions_done = 0;
  @Vehicle_Model::testcase_id = -1;
  @Customer_Prj::hil_failure_injection_1 = 0;
  @Customer_Prj::hil_failure_injection_2 = 0;
  @Customer_Prj::hil_failure_injection_3 = 0;
  @Customer_Prj::hil_failure_injection_4 = 0;
  @Customer_Prj::hil_failure_injection_5 = 0;
  @Customer_Prj::hil_failure_injection_6 = 0;
  @Customer_Prj::hil_failure_injection_7 = 0;
  @Customer_Prj::hil_failure_injection_8 = 0;
  @Customer_Prj::hil_failure_injection_9 = 0;
  @Customer_Prj::hil_failure_injection_10 = 0;
  @Customer_Prj::hil_failure_injection_11 = 0;
  @Customer_Prj::hil_failure_injection_12 = 0;
  @Customer_Prj::hil_failure_injection_13 = 0;
  }
  if(init_count == 109)
  {
  @Customer_Prj::hil_failure_injection_14 = 0;
  @Customer_Prj::hil_failure_injection_15 = 0;
  @Customer_Prj::hil_failure_injection_16 = 0;
  @Customer_Prj::hil_failure_injection_17 = 0;
  @Customer_Prj::hil_failure_injection_18 = 0;
  @Customer_Prj::hil_failure_injection_19 = 0;
  @Customer_Prj::hil_failure_injection_20 = 0;
  @Customer_Prj::hil_failure_injection_21 = 0;
  @Customer_Prj::hil_failure_injection_22 = 0;
  @Customer_Prj::hil_failure_injection_23 = 0;
  @Customer_Prj::hil_failure_injection_24 = 0;
  @Customer_Prj::hil_failure_injection_25 = 0;
  @Customer_Prj::hil_failure_injection_26 = 0;
  @Customer_Prj::hil_failure_injection_27 = 0;
  @Customer_Prj::hil_failure_injection_28 = 0;
  @Customer_Prj::hil_failure_injection_29 = 0;
  @Customer_Prj::hil_failure_injection_30 = 0;
  @Customer_Prj::hil_failure_injection_31 = 0;
  @Customer_Prj::hil_failure_injection_32 = 0;
  @Customer_Prj::hil_failure_injection_33 = 0;
  @Customer_Prj::hil_failure_injection_34 = 0;
  @Customer_Prj::hil_failure_injection_35 = 0;
  @Customer_Prj::hil_failure_injection_36 = 0;
  @Customer_Prj::hil_failure_injection_37 = 0;
  @Customer_Prj::hil_failure_injection_38 = 0;
  }
  if(init_count == 110)
  {
  @Customer_Prj::hil_failure_injection_39 = 0;
  @Customer_Prj::hil_failure_injection_40 = 0;
  @Customer_Prj::hil_failure_injection_41 = 0;
  @Customer_Prj::hil_failure_injection_42 = 0;
  @Customer_Prj::hil_failure_injection_43 = 0;
  @Customer_Prj::hil_failure_injection_44 = 0;
  @Customer_Prj::hil_failure_injection_45 = 0;
  @Customer_Prj::hil_failure_injection_46 = 0;
  @Customer_Prj::hil_failure_injection_47 = 0;
  @Customer_Prj::hil_failure_injection_48 = 0;
  @Customer_Prj::hil_failure_injection_49 = 0;
  @Customer_Prj::hil_failure_injection_50 = 0;
  @Customer_Prj::hil_failure_injection_51 = 0;
  @Customer_Prj::hil_failure_injection_52 = 0;
  @Customer_Prj::hil_failure_injection_53 = 0;
  @Customer_Prj::hil_failure_injection_54 = 0;
  @Customer_Prj::hil_failure_injection_55 = 0;
  @Customer_Prj::hil_failure_injection_56 = 0;
  @Customer_Prj::hil_failure_injection_57 = 0;
  @Customer_Prj::hil_failure_injection_58 = 0;
  @Customer_Prj::hil_failure_injection_59 = 0;
  @Customer_Prj::hil_failure_injection_60 = 0;
  @Customer_Prj::hil_failure_injection_61 = 0;
  @Customer_Prj::hil_failure_injection_62 = 0;
  @Customer_Prj::hil_failure_injection_63 = 0;
  }
  if(init_count == 111)
  {
  @Customer_Prj::hil_failure_injection_64 = 0;
  @Customer_Prj::hil_failure_injection_65 = 0;
  @Customer_Prj::hil_failure_injection_66 = 0;
  @Customer_Prj::hil_failure_injection_67 = 0;
  @Customer_Prj::hil_failure_injection_68 = 0;
  @Customer_Prj::hil_failure_injection_69 = 0;
  @Customer_Prj::hil_failure_injection_70 = 0;
  @Customer_Prj::hil_failure_injection_71 = 0;
  @Customer_Prj::hil_failure_injection_72 = 0;
  @Customer_Prj::hil_failure_injection_73 = 0;
  @Customer_Prj::hil_failure_injection_74 = 0;
  @Customer_Prj::hil_failure_injection_75 = 0;
  @Customer_Prj::hil_failure_injection_76 = 0;
  @Customer_Prj::hil_failure_injection_77 = 0;
  @Customer_Prj::hil_failure_injection_78 = 0;
  @Customer_Prj::hil_failure_injection_79 = 0;
  @Customer_Prj::hil_failure_injection_80 = 0;
  @Customer_Prj::hil_failure_injection_81 = 0;
  @Customer_Prj::hil_failure_injection_82 = 0;
  @Customer_Prj::hil_failure_injection_83 = 0;
  @Customer_Prj::hil_failure_injection_84 = 0;
  @Customer_Prj::hil_failure_injection_85 = 0;
  @Customer_Prj::hil_failure_injection_86 = 0;
  @Customer_Prj::hil_failure_injection_87 = 0;
  @Customer_Prj::hil_failure_injection_88 = 0;
  }
  if(init_count == 112)
  {
  @Customer_Prj::hil_failure_injection_89 = 0;
  @Customer_Prj::hil_failure_injection_90 = 0;
  @Customer_Prj::hil_failure_injection_91 = 0;
  @Customer_Prj::hil_failure_injection_92 = 0;
  @Customer_Prj::hil_failure_injection_93 = 0;
  @Customer_Prj::hil_failure_injection_94 = 0;
  @Customer_Prj::hil_failure_injection_95 = 0;
  @Customer_Prj::hil_failure_injection_96 = 0;
  @Customer_Prj::hil_failure_injection_97 = 0;
  @Customer_Prj::hil_failure_injection_98 = 0;
  @Customer_Prj::hil_failure_injection_99 = 0;
  @Customer_Prj::hil_failure_injection_100 = 0;
  @Customer_Prj::hil_failure_injection_101 = 0;
  @Customer_Prj::hil_failure_injection_102 = 0;
  @Customer_Prj::hil_failure_injection_103 = 0;
  @Customer_Prj::hil_failure_injection_104 = 0;
  @Customer_Prj::hil_failure_injection_105 = 0;
  @Customer_Prj::hil_failure_injection_106 = 0;
  @Customer_Prj::hil_failure_injection_107 = 0;
  @Customer_Prj::hil_failure_injection_108 = 0;
  @Customer_Prj::hil_failure_injection_109 = 0;
  @Customer_Prj::hil_failure_injection_110 = 0;
  @Customer_Prj::hil_failure_injection_111 = 0;
  @Customer_Prj::hil_failure_injection_112 = 0;
  @Customer_Prj::hil_failure_injection_113 = 0;
  }
  if(init_count == 113)
  {
  @Customer_Prj::hil_failure_injection_114 = 0;
  @Customer_Prj::hil_failure_injection_115 = 0;
  @Customer_Prj::hil_failure_injection_116 = 0;
  @Customer_Prj::hil_failure_injection_117 = 0;
  @Customer_Prj::hil_failure_injection_118 = 0;
  @Customer_Prj::hil_failure_injection_119 = 0;
  @Customer_Prj::hil_failure_injection_120 = 0;
  @Customer_Prj::hil_failure_injection_121 = 0;
  @Customer_Prj::hil_failure_injection_122 = 0;
  @Customer_Prj::hil_failure_injection_123 = 0;
  @Customer_Prj::hil_failure_injection_124 = 0;
  @Customer_Prj::hil_failure_injection_125 = 0;
  @Customer_Prj::hil_failure_injection_126 = 0;
  @Customer_Prj::hil_failure_injection_127 = 0;
  @Customer_Prj::hil_failure_injection_128 = 0;
  @Customer_Prj::hil_failure_injection_129 = 0;
  @Customer_Prj::hil_failure_injection_130 = 0;
  @Customer_Prj::hil_failure_injection_131 = 0;
  @Customer_Prj::hil_failure_injection_132 = 0;
  @Customer_Prj::hil_failure_injection_133 = 0;
  @Customer_Prj::hil_failure_injection_134 = 0;
  @Customer_Prj::hil_failure_injection_135 = 0;
  @Customer_Prj::hil_failure_injection_136 = 0;
  @Customer_Prj::hil_failure_injection_137 = 0;
  @Customer_Prj::hil_failure_injection_138 = 0;
  }
  if(init_count == 114)
  {
  @Customer_Prj::hil_failure_injection_139 = 0;
  @Customer_Prj::hil_failure_injection_140 = 0;
  @Customer_Prj::hil_failure_injection_141 = 0;
  @Customer_Prj::hil_failure_injection_142 = 0;
  @Customer_Prj::hil_failure_injection_143 = 0;
  @Customer_Prj::hil_failure_injection_144 = 0;
  @Customer_Prj::hil_failure_injection_145 = 0;
  @Customer_Prj::hil_failure_injection_146 = 0;
  @Customer_Prj::hil_failure_injection_147 = 0;
  @Customer_Prj::hil_failure_injection_148 = 0;
  @Customer_Prj::hil_failure_injection_149 = 0;
  @Customer_Prj::hil_failure_injection_150 = 0;
  @Customer_Prj::hil_failure_injection_151 = 0;
  @Customer_Prj::hil_failure_injection_152 = 0;
  @Customer_Prj::hil_failure_injection_153 = 0;
  @Customer_Prj::hil_failure_injection_154 = 0;
  @Customer_Prj::hil_failure_injection_155 = 0;
  @Customer_Prj::hil_failure_injection_156 = 0;
  @Customer_Prj::hil_failure_injection_157 = 0;
  @Customer_Prj::hil_failure_injection_158 = 0;
  @Customer_Prj::hil_failure_injection_159 = 0;
  @Customer_Prj::hil_failure_injection_160 = 0;
  @Customer_Prj::hil_failure_injection_161 = 0;
  @Customer_Prj::hil_failure_injection_162 = 0;
  @Customer_Prj::hil_failure_injection_163 = 0;
  }
  if(init_count == 115)
  {
  @Customer_Prj::hil_failure_injection_164 = 0;
  @Customer_Prj::hil_failure_injection_165 = 0;
  @Customer_Prj::hil_failure_injection_166 = 0;
  @Customer_Prj::hil_failure_injection_167 = 0;
  @Customer_Prj::hil_failure_injection_168 = 0;
  @Customer_Prj::hil_failure_injection_169 = 0;
  @Customer_Prj::hil_failure_injection_170 = 0;
  @Customer_Prj::hil_failure_injection_171 = 0;
  @Customer_Prj::hil_failure_injection_172 = 0;
  @Customer_Prj::hil_failure_injection_173 = 0;
  @Customer_Prj::hil_failure_injection_174 = 0;
  @Customer_Prj::hil_failure_injection_175 = 0;
  @Customer_Prj::hil_failure_injection_176 = 0;
  @Customer_Prj::hil_failure_injection_177 = 0;
  @Customer_Prj::hil_failure_injection_178 = 0;
  @Customer_Prj::hil_failure_injection_179 = 0;
  @Customer_Prj::hil_failure_injection_180 = 0;
  @Customer_Prj::hil_failure_injection_181 = 0;
  @Customer_Prj::hil_failure_injection_182 = 0;
  @Customer_Prj::hil_failure_injection_183 = 0;
  @Customer_Prj::hil_failure_injection_184 = 0;
  @Customer_Prj::hil_failure_injection_185 = 0;
  @Customer_Prj::hil_failure_injection_186 = 0;
  @Customer_Prj::hil_failure_injection_187 = 0;
  @Customer_Prj::hil_failure_injection_188 = 0;
  }
  if(init_count == 116)
  {
  @Customer_Prj::hil_failure_injection_189 = 0;
  @Customer_Prj::hil_failure_injection_190 = 0;
  @Customer_Prj::hil_failure_injection_191 = 0;
  @Customer_Prj::hil_failure_injection_192 = 0;
  @Customer_Prj::hil_failure_injection_193 = 0;
  @Customer_Prj::hil_failure_injection_194 = 0;
  @Customer_Prj::hil_failure_injection_195 = 0;
  @Customer_Prj::hil_failure_injection_196 = 0;
  @Customer_Prj::hil_failure_injection_197 = 0;
  @Customer_Prj::hil_failure_injection_198 = 0;
  @Customer_Prj::hil_failure_injection_199 = 0;
  @Customer_Prj::hil_failure_injection_200 = 0;
  @Customer_Prj::hil_failure_injection_201 = 0;
  @Customer_Prj::hil_failure_injection_202 = 0;
  @Customer_Prj::hil_failure_injection_203 = 0;
  @Customer_Prj::hil_failure_injection_204 = 0;
  @Customer_Prj::hil_failure_injection_205 = 0;
  @Customer_Prj::hil_failure_injection_206 = 0;
  @Customer_Prj::hil_failure_injection_207 = 0;
  @Customer_Prj::hil_failure_injection_208 = 0;
  @Customer_Prj::hil_failure_injection_209 = 0;
  @Customer_Prj::hil_failure_injection_210 = 0;
  @Customer_Prj::hil_failure_injection_211 = 0;
  @Customer_Prj::hil_failure_injection_212 = 0;
  @Customer_Prj::hil_failure_injection_213 = 0;
  }
  if(init_count == 117)
  {
  @Customer_Prj::hil_failure_injection_214 = 0;
  @Customer_Prj::hil_failure_injection_215 = 0;
  @Customer_Prj::hil_failure_injection_216 = 0;
  @Customer_Prj::hil_failure_injection_217 = 0;
  @Customer_Prj::hil_failure_injection_218 = 0;
  @Customer_Prj::hil_failure_injection_219 = 0;
  @Customer_Prj::hil_failure_injection_220 = 0;
  @Customer_Prj::hil_failure_injection_221 = 0;
  @Customer_Prj::hil_failure_injection_222 = 0;
  @Customer_Prj::hil_failure_injection_223 = 0;
  @Customer_Prj::hil_failure_injection_224 = 0;
  @Customer_Prj::hil_failure_injection_225 = 0;
  @Customer_Prj::hil_failure_injection_226 = 0;
  @Customer_Prj::hil_failure_injection_227 = 0;
  @Customer_Prj::hil_failure_injection_228 = 0;
  @Customer_Prj::hil_failure_injection_229 = 0;
  @Customer_Prj::hil_failure_injection_230 = 0;
  @Customer_Prj::hil_failure_injection_231 = 0;
  @Customer_Prj::hil_failure_injection_232 = 0;
  @Customer_Prj::hil_failure_injection_233 = 0;
  @Customer_Prj::hil_failure_injection_234 = 0;
  @Customer_Prj::hil_failure_injection_235 = 0;
  @Customer_Prj::hil_failure_injection_236 = 0;
  @Customer_Prj::hil_failure_injection_237 = 0;
  @Customer_Prj::hil_failure_injection_238 = 0;
  }
  if(init_count == 118)
  {
  @Customer_Prj::hil_failure_injection_239 = 0;
  @Customer_Prj::hil_failure_injection_240 = 0;
  @Customer_Prj::hil_failure_injection_241 = 0;
  @Customer_Prj::hil_failure_injection_242 = 0;
  @Customer_Prj::hil_failure_injection_243 = 0;
  @Customer_Prj::hil_failure_injection_244 = 0;
  @Customer_Prj::hil_failure_injection_245 = 0;
  @Customer_Prj::hil_failure_injection_246 = 0;
  @Customer_Prj::hil_failure_injection_247 = 0;
  @Customer_Prj::hil_failure_injection_248 = 0;
  @Customer_Prj::hil_failure_injection_249 = 0;
  @Customer_Prj::hil_failure_injection_250 = 0;
  @Customer_Prj::hil_failure_injection_251 = 0;
  @Customer_Prj::hil_failure_injection_252 = 0;
  @Customer_Prj::hil_failure_injection_253 = 0;
  @Customer_Prj::hil_failure_injection_254 = 0;
  @Customer_Prj::hil_failure_injection_255 = 0;
  @Customer_Prj::hil_fct_preconditions_1 = 0;
  @Customer_Prj::hil_fct_preconditions_2 = 0;
  @Customer_Prj::hil_fct_preconditions_3 = 0;
  @Customer_Prj::hil_fct_preconditions_4 = 0;
  @Customer_Prj::hil_fct_preconditions_5 = 0;
  @Customer_Prj::hil_fct_preconditions_6 = 0;
  @Customer_Prj::hil_fct_preconditions_7 = 0;
  @Customer_Prj::hil_fct_preconditions_8 = 0;
  }
  if(init_count == 119)
  {
  @Customer_Prj::hil_fct_preconditions_9 = 0;
  @Customer_Prj::hil_fct_preconditions_10 = 0;
  @Customer_Prj::hil_fct_preconditions_11 = 0;
  @Customer_Prj::hil_fct_preconditions_12 = 0;
  @Customer_Prj::hil_fct_preconditions_13 = 0;
  @Customer_Prj::hil_fct_preconditions_14 = 0;
  @Customer_Prj::hil_fct_preconditions_15 = 0;
  @Customer_Prj::hil_fct_preconditions_16 = 0;
  @Customer_Prj::hil_fct_preconditions_17 = 0;
  @Customer_Prj::hil_fct_preconditions_18 = 0;
  @Customer_Prj::hil_fct_preconditions_19 = 0;
  @Customer_Prj::hil_fct_preconditions_20 = 0;
  @Customer_Prj::hil_fct_preconditions_21 = 0;
  @Customer_Prj::hil_fct_preconditions_22 = 0;
  @Customer_Prj::hil_fct_preconditions_23 = 0;
  @Customer_Prj::hil_fct_preconditions_24 = 0;
  @Customer_Prj::hil_fct_preconditions_25 = 0;
  @Customer_Prj::hil_fct_preconditions_26 = 0;
  @Customer_Prj::hil_fct_preconditions_27 = 0;
  @Customer_Prj::hil_fct_preconditions_28 = 0;
  @Customer_Prj::hil_fct_preconditions_29 = 0;
  @Customer_Prj::hil_fct_preconditions_30 = 0;
  @Customer_Prj::hil_fct_preconditions_31 = 0;
  @Customer_Prj::hil_fct_preconditions_32 = 0;
  @Customer_Prj::hil_fct_preconditions_33 = 0;
  }
  if(init_count == 120)
  {
  @Customer_Prj::hil_fct_preconditions_34 = 0;
  @Customer_Prj::hil_fct_preconditions_35 = 0;
  @Customer_Prj::hil_fct_preconditions_36 = 0;
  @Customer_Prj::hil_fct_preconditions_37 = 0;
  @Customer_Prj::hil_fct_preconditions_38 = 0;
  @Customer_Prj::hil_fct_preconditions_39 = 0;
  @Customer_Prj::hil_fct_preconditions_40 = 0;
  @Customer_Prj::hil_fct_preconditions_41 = 0;
  @Customer_Prj::hil_fct_preconditions_42 = 0;
  @Customer_Prj::hil_fct_preconditions_43 = 0;
  @Customer_Prj::hil_fct_preconditions_44 = 0;
  @Customer_Prj::hil_fct_preconditions_45 = 0;
  @Customer_Prj::hil_fct_preconditions_46 = 0;
  @Customer_Prj::hil_fct_preconditions_47 = 0;
  @Customer_Prj::hil_fct_preconditions_48 = 0;
  @Customer_Prj::hil_fct_preconditions_49 = 0;
  @Customer_Prj::hil_fct_preconditions_50 = 0;
  @Customer_Prj::hil_fct_preconditions_51 = 0;
  @Customer_Prj::hil_fct_preconditions_52 = 0;
  @Customer_Prj::hil_fct_preconditions_53 = 0;
  @Customer_Prj::hil_fct_preconditions_54 = 0;
  @Customer_Prj::hil_fct_preconditions_55 = 0;
  @Customer_Prj::hil_fct_preconditions_56 = 0;
  @Customer_Prj::hil_fct_preconditions_57 = 0;
  @Customer_Prj::hil_fct_preconditions_58 = 0;
  }
  if(init_count == 121)
  {
  @Customer_Prj::hil_fct_preconditions_59 = 0;
  @Customer_Prj::hil_fct_preconditions_60 = 0;
  @Customer_Prj::hil_fct_preconditions_61 = 0;
  @Customer_Prj::hil_fct_preconditions_62 = 0;
  @Customer_Prj::hil_fct_preconditions_63 = 0;
  @Customer_Prj::hil_fct_preconditions_64 = 0;
  @Customer_Prj::hil_fct_preconditions_65 = 0;
  @Customer_Prj::hil_fct_preconditions_66 = 0;
  @Customer_Prj::hil_fct_preconditions_67 = 0;
  @Customer_Prj::hil_fct_preconditions_68 = 0;
  @Customer_Prj::hil_fct_preconditions_69 = 0;
  @Customer_Prj::hil_fct_preconditions_70 = 0;
  @Customer_Prj::hil_fct_preconditions_71 = 0;
  @Customer_Prj::hil_fct_preconditions_72 = 0;
  @Customer_Prj::hil_fct_preconditions_73 = 0;
  @Customer_Prj::hil_fct_preconditions_74 = 0;
  @Customer_Prj::hil_fct_preconditions_75 = 0;
  @Customer_Prj::hil_fct_preconditions_76 = 0;
  @Customer_Prj::hil_fct_preconditions_77 = 0;
  @Customer_Prj::hil_fct_preconditions_78 = 0;
  @Customer_Prj::hil_fct_preconditions_79 = 0;
  @Customer_Prj::hil_fct_preconditions_80 = 0;
  @Customer_Prj::hil_fct_preconditions_81 = 0;
  @Customer_Prj::hil_fct_preconditions_82 = 0;
  @Customer_Prj::hil_fct_preconditions_83 = 0;
  }
  if(init_count == 122)
  {
  @Customer_Prj::hil_fct_preconditions_84 = 0;
  @Customer_Prj::hil_fct_preconditions_85 = 0;
  @Customer_Prj::hil_fct_preconditions_86 = 0;
  @Customer_Prj::hil_fct_preconditions_87 = 0;
  @Customer_Prj::hil_fct_preconditions_88 = 0;
  @Customer_Prj::hil_fct_preconditions_89 = 0;
  @Customer_Prj::hil_fct_preconditions_90 = 0;
  @Customer_Prj::hil_fct_preconditions_91 = 0;
  @Customer_Prj::hil_fct_preconditions_92 = 0;
  @Customer_Prj::hil_fct_preconditions_93 = 0;
  @Customer_Prj::hil_fct_preconditions_94 = 0;
  @Customer_Prj::hil_fct_preconditions_95 = 0;
  @Customer_Prj::hil_fct_preconditions_96 = 0;
  @Customer_Prj::hil_fct_preconditions_97 = 0;
  @Customer_Prj::hil_fct_preconditions_98 = 0;
  @Customer_Prj::hil_fct_preconditions_99 = 0;
  @Customer_Prj::hil_fct_preconditions_100 = 0;
  @Customer_Prj::hil_fct_preconditions_101 = 0;
  @Customer_Prj::hil_fct_preconditions_102 = 0;
  @Customer_Prj::hil_fct_preconditions_103 = 0;
  @Customer_Prj::hil_fct_preconditions_104 = 0;
  @Customer_Prj::hil_fct_preconditions_105 = 0;
  @Customer_Prj::hil_fct_preconditions_106 = 0;
  @Customer_Prj::hil_fct_preconditions_107 = 0;
  @Customer_Prj::hil_fct_preconditions_108 = 0;
  }
  if(init_count == 123)
  {
  @Customer_Prj::hil_fct_preconditions_109 = 0;
  @Customer_Prj::hil_fct_preconditions_110 = 0;
  @Customer_Prj::hil_fct_preconditions_111 = 0;
  @Customer_Prj::hil_fct_preconditions_112 = 0;
  @Customer_Prj::hil_fct_preconditions_113 = 0;
  @Customer_Prj::hil_fct_preconditions_114 = 0;
  @Customer_Prj::hil_fct_preconditions_115 = 0;
  @Customer_Prj::hil_fct_preconditions_116 = 0;
  @Customer_Prj::hil_fct_preconditions_117 = 0;
  @Customer_Prj::hil_fct_preconditions_118 = 0;
  @Customer_Prj::hil_fct_preconditions_119 = 0;
  @Customer_Prj::hil_fct_preconditions_120 = 0;
  @Customer_Prj::hil_fct_preconditions_121 = 0;
  @Customer_Prj::hil_fct_preconditions_122 = 0;
  @Customer_Prj::hil_fct_preconditions_123 = 0;
  @Customer_Prj::hil_fct_preconditions_124 = 0;
  @Customer_Prj::hil_fct_preconditions_125 = 0;
  @Customer_Prj::hil_fct_preconditions_126 = 0;
  @Customer_Prj::hil_fct_preconditions_127 = 0;
  @Customer_Prj::hil_fct_preconditions_128 = 0;
  @Customer_Prj::hil_fct_preconditions_129 = 0;
  @Customer_Prj::hil_fct_preconditions_130 = 0;
  @Customer_Prj::hil_fct_preconditions_131 = 0;
  @Customer_Prj::hil_fct_preconditions_132 = 0;
  @Customer_Prj::hil_fct_preconditions_133 = 0;
  }
  if(init_count == 124)
  {
  @Customer_Prj::hil_fct_preconditions_134 = 0;
  @Customer_Prj::hil_fct_preconditions_135 = 0;
  @Customer_Prj::hil_fct_preconditions_136 = 0;
  @Customer_Prj::hil_fct_preconditions_137 = 0;
  @Customer_Prj::hil_fct_preconditions_138 = 0;
  @Customer_Prj::hil_fct_preconditions_139 = 0;
  @Customer_Prj::hil_fct_preconditions_140 = 0;
  @Customer_Prj::hil_fct_preconditions_141 = 0;
  @Customer_Prj::hil_fct_preconditions_142 = 0;
  @Customer_Prj::hil_fct_preconditions_143 = 0;
  @Customer_Prj::hil_fct_preconditions_144 = 0;
  @Customer_Prj::hil_fct_preconditions_145 = 0;
  @Customer_Prj::hil_fct_preconditions_146 = 0;
  @Customer_Prj::hil_fct_preconditions_147 = 0;
  @Customer_Prj::hil_fct_preconditions_148 = 0;
  @Customer_Prj::hil_fct_preconditions_149 = 0;
  @Customer_Prj::hil_fct_preconditions_150 = 0;
  @Customer_Prj::hil_fct_preconditions_151 = 0;
  @Customer_Prj::hil_fct_preconditions_152 = 0;
  @Customer_Prj::hil_fct_preconditions_153 = 0;
  @Customer_Prj::hil_fct_preconditions_154 = 0;
  @Customer_Prj::hil_fct_preconditions_155 = 0;
  @Customer_Prj::hil_fct_preconditions_156 = 0;
  @Customer_Prj::hil_fct_preconditions_157 = 0;
  @Customer_Prj::hil_fct_preconditions_158 = 0;
  }
  if(init_count == 125)
  {
  @Customer_Prj::hil_fct_preconditions_159 = 0;
  @Customer_Prj::hil_fct_preconditions_160 = 0;
  @Customer_Prj::hil_fct_preconditions_161 = 0;
  @Customer_Prj::hil_fct_preconditions_162 = 0;
  @Customer_Prj::hil_fct_preconditions_163 = 0;
  @Customer_Prj::hil_fct_preconditions_164 = 0;
  @Customer_Prj::hil_fct_preconditions_165 = 0;
  @Customer_Prj::hil_fct_preconditions_166 = 0;
  @Customer_Prj::hil_fct_preconditions_167 = 0;
  @Customer_Prj::hil_fct_preconditions_168 = 0;
  @Customer_Prj::hil_fct_preconditions_169 = 0;
  @Customer_Prj::hil_fct_preconditions_170 = 0;
  @Customer_Prj::hil_fct_preconditions_171 = 0;
  @Customer_Prj::hil_fct_preconditions_172 = 0;
  @Customer_Prj::hil_fct_preconditions_173 = 0;
  @Customer_Prj::hil_fct_preconditions_174 = 0;
  @Customer_Prj::hil_fct_preconditions_175 = 0;
  @Customer_Prj::hil_fct_preconditions_176 = 0;
  @Customer_Prj::hil_fct_preconditions_177 = 0;
  @Customer_Prj::hil_fct_preconditions_178 = 0;
  @Customer_Prj::hil_fct_preconditions_179 = 0;
  @Customer_Prj::hil_fct_preconditions_180 = 0;
  @Customer_Prj::hil_fct_preconditions_181 = 0;
  @Customer_Prj::hil_fct_preconditions_182 = 0;
  @Customer_Prj::hil_fct_preconditions_183 = 0;
  }
  if(init_count == 126)
  {
  @Customer_Prj::hil_fct_preconditions_184 = 0;
  @Customer_Prj::hil_fct_preconditions_185 = 0;
  @Customer_Prj::hil_fct_preconditions_186 = 0;
  @Customer_Prj::hil_fct_preconditions_187 = 0;
  @Customer_Prj::hil_fct_preconditions_188 = 0;
  @Customer_Prj::hil_fct_preconditions_189 = 0;
  @Customer_Prj::hil_fct_preconditions_190 = 0;
  @Customer_Prj::hil_fct_preconditions_191 = 0;
  @Customer_Prj::hil_fct_preconditions_192 = 0;
  @Customer_Prj::hil_fct_preconditions_193 = 0;
  @Customer_Prj::hil_fct_preconditions_194 = 0;
  @Customer_Prj::hil_fct_preconditions_195 = 0;
  @Customer_Prj::hil_fct_preconditions_196 = 0;
  @Customer_Prj::hil_fct_preconditions_197 = 0;
  @Customer_Prj::hil_fct_preconditions_198 = 0;
  @Customer_Prj::hil_fct_preconditions_199 = 0;
  @Customer_Prj::hil_fct_preconditions_200 = 0;
  @Customer_Prj::hil_fct_preconditions_201 = 0;
  @Customer_Prj::hil_fct_preconditions_202 = 0;
  @Customer_Prj::hil_fct_preconditions_203 = 0;
  @Customer_Prj::hil_fct_preconditions_204 = 0;
  @Customer_Prj::hil_fct_preconditions_205 = 0;
  @Customer_Prj::hil_fct_preconditions_206 = 0;
  @Customer_Prj::hil_fct_preconditions_207 = 0;
  @Customer_Prj::hil_fct_preconditions_208 = 0;
  }
  if(init_count == 127)
  {
  @Customer_Prj::hil_fct_preconditions_209 = 0;
  @Customer_Prj::hil_fct_preconditions_210 = 0;
  @Customer_Prj::hil_fct_preconditions_211 = 0;
  @Customer_Prj::hil_fct_preconditions_212 = 0;
  @Customer_Prj::hil_fct_preconditions_213 = 0;
  @Customer_Prj::hil_fct_preconditions_214 = 0;
  @Customer_Prj::hil_fct_preconditions_215 = 0;
  @Customer_Prj::hil_fct_preconditions_216 = 0;
  @Customer_Prj::hil_fct_preconditions_217 = 0;
  @Customer_Prj::hil_fct_preconditions_218 = 0;
  @Customer_Prj::hil_fct_preconditions_219 = 0;
  @Customer_Prj::hil_fct_preconditions_220 = 0;
  @Customer_Prj::hil_fct_preconditions_221 = 0;
  @Customer_Prj::hil_fct_preconditions_222 = 0;
  @Customer_Prj::hil_fct_preconditions_223 = 0;
  @Customer_Prj::hil_fct_preconditions_224 = 0;
  @Customer_Prj::hil_fct_preconditions_225 = 0;
  @Customer_Prj::hil_fct_preconditions_226 = 0;
  @Customer_Prj::hil_fct_preconditions_227 = 0;
  @Customer_Prj::hil_fct_preconditions_228 = 0;
  @Customer_Prj::hil_fct_preconditions_229 = 0;
  @Customer_Prj::hil_fct_preconditions_230 = 0;
  @Customer_Prj::hil_fct_preconditions_231 = 0;
  @Customer_Prj::hil_fct_preconditions_232 = 0;
  @Customer_Prj::hil_fct_preconditions_233 = 0;
  }
  if(init_count == 128)
  {
  @Customer_Prj::hil_fct_preconditions_234 = 0;
  @Customer_Prj::hil_fct_preconditions_235 = 0;
  @Customer_Prj::hil_fct_preconditions_236 = 0;
  @Customer_Prj::hil_fct_preconditions_237 = 0;
  @Customer_Prj::hil_fct_preconditions_238 = 0;
  @Customer_Prj::hil_fct_preconditions_239 = 0;
  @Customer_Prj::hil_fct_preconditions_240 = 0;
  @Customer_Prj::hil_fct_preconditions_241 = 0;
  @Customer_Prj::hil_fct_preconditions_242 = 0;
  @Customer_Prj::hil_fct_preconditions_243 = 0;
  @Customer_Prj::hil_fct_preconditions_244 = 0;
  @Customer_Prj::hil_fct_preconditions_245 = 0;
  @Customer_Prj::hil_fct_preconditions_246 = 0;
  @Customer_Prj::hil_fct_preconditions_247 = 0;
  @Customer_Prj::hil_fct_preconditions_248 = 0;
  @Customer_Prj::hil_fct_preconditions_249 = 0;
  @Customer_Prj::hil_fct_preconditions_250 = 0;
  @Customer_Prj::hil_fct_preconditions_251 = 0;
  @Customer_Prj::hil_fct_preconditions_252 = 0;
  @Customer_Prj::hil_fct_preconditions_253 = 0;
  @Customer_Prj::hil_fct_preconditions_254 = 0;
  @Customer_Prj::hil_fct_preconditions_255 = 0;
  @RBSData::udpServerAppErrorNumber = 0.0;
  @RBSData::packetCounter = 0.0;
  @RBSData::packetTimestamp = 0.0;
  }
  if(init_count == 129)
  {
  @RBSData::FC.mountPosX = 0;
  @RBSData::FC.mountPosY = 0;
  @RBSData::FC.mountPosZ = 0;
  @RBSData::FC.sensorBlocked = 0;
  @RBSData::FC.objectCount = 0;
  @RBSData::FC.object0.objID = 0;
  @RBSData::FC.object0.classification = 0;
  @RBSData::FC.object0.radar_type = 0;
  @RBSData::FC.object0.dxN = 0;
  @RBSData::FC.object0.dyN = 0;
  @RBSData::FC.object0.dzN = 0;
  @RBSData::FC.object0.vxN = 0;
  @RBSData::FC.object0.vyN = 0;
  @RBSData::FC.object0.axN = 0;
  @RBSData::FC.object0.ayN = 0;
  @RBSData::FC.object0.dWidthN = 0;
  @RBSData::FC.object0.dLengthN = 0;
  @RBSData::FC.object0.rcsN = 0;
  @RBSData::FC.object0.snrN = 0;
  @RBSData::FC.object0.alpPiYawAngleN = 0;
  @RBSData::FC.object0.signalStrengthN = 0;
  @RBSData::FC.object1.objID = 0;
  @RBSData::FC.object1.classification = 0;
  @RBSData::FC.object1.radar_type = 0;
  @RBSData::FC.object1.dxN = 0;
  }
  if(init_count == 130)
  {
  @RBSData::FC.object1.dyN = 0;
  @RBSData::FC.object1.dzN = 0;
  @RBSData::FC.object1.vxN = 0;
  @RBSData::FC.object1.vyN = 0;
  @RBSData::FC.object1.axN = 0;
  @RBSData::FC.object1.ayN = 0;
  @RBSData::FC.object1.dWidthN = 0;
  @RBSData::FC.object1.dLengthN = 0;
  @RBSData::FC.object1.rcsN = 0;
  @RBSData::FC.object1.snrN = 0;
  @RBSData::FC.object1.alpPiYawAngleN = 0;
  @RBSData::FC.object1.signalStrengthN = 0;
  @RBSData::FC.object2.objID = 0;
  @RBSData::FC.object2.classification = 0;
  @RBSData::FC.object2.radar_type = 0;
  @RBSData::FC.object2.dxN = 0;
  @RBSData::FC.object2.dyN = 0;
  @RBSData::FC.object2.dzN = 0;
  @RBSData::FC.object2.vxN = 0;
  @RBSData::FC.object2.vyN = 0;
  @RBSData::FC.object2.axN = 0;
  @RBSData::FC.object2.ayN = 0;
  @RBSData::FC.object2.dWidthN = 0;
  @RBSData::FC.object2.dLengthN = 0;
  @RBSData::FC.object2.rcsN = 0;
  }
  if(init_count == 131)
  {
  @RBSData::FC.object2.snrN = 0;
  @RBSData::FC.object2.alpPiYawAngleN = 0;
  @RBSData::FC.object2.signalStrengthN = 0;
  @RBSData::FC.object3.objID = 0;
  @RBSData::FC.object3.classification = 0;
  @RBSData::FC.object3.radar_type = 0;
  @RBSData::FC.object3.dxN = 0;
  @RBSData::FC.object3.dyN = 0;
  @RBSData::FC.object3.dzN = 0;
  @RBSData::FC.object3.vxN = 0;
  @RBSData::FC.object3.vyN = 0;
  @RBSData::FC.object3.axN = 0;
  @RBSData::FC.object3.ayN = 0;
  @RBSData::FC.object3.dWidthN = 0;
  @RBSData::FC.object3.dLengthN = 0;
  @RBSData::FC.object3.rcsN = 0;
  @RBSData::FC.object3.snrN = 0;
  @RBSData::FC.object3.alpPiYawAngleN = 0;
  @RBSData::FC.object3.signalStrengthN = 0;
  @RBSData::FC.object4.objID = 0;
  @RBSData::FC.object4.classification = 0;
  @RBSData::FC.object4.radar_type = 0;
  @RBSData::FC.object4.dxN = 0;
  @RBSData::FC.object4.dyN = 0;
  @RBSData::FC.object4.dzN = 0;
  }
  if(init_count == 132)
  {
  @RBSData::FC.object4.vxN = 0;
  @RBSData::FC.object4.vyN = 0;
  @RBSData::FC.object4.axN = 0;
  @RBSData::FC.object4.ayN = 0;
  @RBSData::FC.object4.dWidthN = 0;
  @RBSData::FC.object4.dLengthN = 0;
  @RBSData::FC.object4.rcsN = 0;
  @RBSData::FC.object4.snrN = 0;
  @RBSData::FC.object4.alpPiYawAngleN = 0;
  @RBSData::FC.object4.signalStrengthN = 0;
  @RBSData::FC.object5.objID = 0;
  @RBSData::FC.object5.classification = 0;
  @RBSData::FC.object5.radar_type = 0;
  @RBSData::FC.object5.dxN = 0;
  @RBSData::FC.object5.dyN = 0;
  @RBSData::FC.object5.dzN = 0;
  @RBSData::FC.object5.vxN = 0;
  @RBSData::FC.object5.vyN = 0;
  @RBSData::FC.object5.axN = 0;
  @RBSData::FC.object5.ayN = 0;
  @RBSData::FC.object5.dWidthN = 0;
  @RBSData::FC.object5.dLengthN = 0;
  @RBSData::FC.object5.rcsN = 0;
  @RBSData::FC.object5.snrN = 0;
  @RBSData::FC.object5.alpPiYawAngleN = 0;
  }
  if(init_count == 133)
  {
  @RBSData::FC.object5.signalStrengthN = 0;
  @RBSData::FC.object6.objID = 0;
  @RBSData::FC.object6.classification = 0;
  @RBSData::FC.object6.radar_type = 0;
  @RBSData::FC.object6.dxN = 0;
  @RBSData::FC.object6.dyN = 0;
  @RBSData::FC.object6.dzN = 0;
  @RBSData::FC.object6.vxN = 0;
  @RBSData::FC.object6.vyN = 0;
  @RBSData::FC.object6.axN = 0;
  @RBSData::FC.object6.ayN = 0;
  @RBSData::FC.object6.dWidthN = 0;
  @RBSData::FC.object6.dLengthN = 0;
  @RBSData::FC.object6.rcsN = 0;
  @RBSData::FC.object6.snrN = 0;
  @RBSData::FC.object6.alpPiYawAngleN = 0;
  @RBSData::FC.object6.signalStrengthN = 0;
  @RBSData::FC.object7.objID = 0;
  @RBSData::FC.object7.classification = 0;
  @RBSData::FC.object7.radar_type = 0;
  @RBSData::FC.object7.dxN = 0;
  @RBSData::FC.object7.dyN = 0;
  @RBSData::FC.object7.dzN = 0;
  @RBSData::FC.object7.vxN = 0;
  @RBSData::FC.object7.vyN = 0;
  }
  if(init_count == 134)
  {
  @RBSData::FC.object7.axN = 0;
  @RBSData::FC.object7.ayN = 0;
  @RBSData::FC.object7.dWidthN = 0;
  @RBSData::FC.object7.dLengthN = 0;
  @RBSData::FC.object7.rcsN = 0;
  @RBSData::FC.object7.snrN = 0;
  @RBSData::FC.object7.alpPiYawAngleN = 0;
  @RBSData::FC.object7.signalStrengthN = 0;
  @RBSData::FC.object8.objID = 0;
  @RBSData::FC.object8.classification = 0;
  @RBSData::FC.object8.radar_type = 0;
  @RBSData::FC.object8.dxN = 0;
  @RBSData::FC.object8.dyN = 0;
  @RBSData::FC.object8.dzN = 0;
  @RBSData::FC.object8.vxN = 0;
  @RBSData::FC.object8.vyN = 0;
  @RBSData::FC.object8.axN = 0;
  @RBSData::FC.object8.ayN = 0;
  @RBSData::FC.object8.dWidthN = 0;
  @RBSData::FC.object8.dLengthN = 0;
  @RBSData::FC.object8.rcsN = 0;
  @RBSData::FC.object8.snrN = 0;
  @RBSData::FC.object8.alpPiYawAngleN = 0;
  @RBSData::FC.object8.signalStrengthN = 0;
  @RBSData::FC.object9.objID = 0;
  }
  if(init_count == 135)
  {
  @RBSData::FC.object9.classification = 0;
  @RBSData::FC.object9.radar_type = 0;
  @RBSData::FC.object9.dxN = 0;
  @RBSData::FC.object9.dyN = 0;
  @RBSData::FC.object9.dzN = 0;
  @RBSData::FC.object9.vxN = 0;
  @RBSData::FC.object9.vyN = 0;
  @RBSData::FC.object9.axN = 0;
  @RBSData::FC.object9.ayN = 0;
  @RBSData::FC.object9.dWidthN = 0;
  @RBSData::FC.object9.dLengthN = 0;
  @RBSData::FC.object9.rcsN = 0;
  @RBSData::FC.object9.snrN = 0;
  @RBSData::FC.object9.alpPiYawAngleN = 0;
  @RBSData::FC.object9.signalStrengthN = 0;
  @RBSData::FC.object10.objID = 0;
  @RBSData::FC.object10.classification = 0;
  @RBSData::FC.object10.radar_type = 0;
  @RBSData::FC.object10.dxN = 0;
  @RBSData::FC.object10.dyN = 0;
  @RBSData::FC.object10.dzN = 0;
  @RBSData::FC.object10.vxN = 0;
  @RBSData::FC.object10.vyN = 0;
  @RBSData::FC.object10.axN = 0;
  @RBSData::FC.object10.ayN = 0;
  }
  if(init_count == 136)
  {
  @RBSData::FC.object10.dWidthN = 0;
  @RBSData::FC.object10.dLengthN = 0;
  @RBSData::FC.object10.rcsN = 0;
  @RBSData::FC.object10.snrN = 0;
  @RBSData::FC.object10.alpPiYawAngleN = 0;
  @RBSData::FC.object10.signalStrengthN = 0;
  @RBSData::FC.object11.objID = 0;
  @RBSData::FC.object11.classification = 0;
  @RBSData::FC.object11.radar_type = 0;
  @RBSData::FC.object11.dxN = 0;
  @RBSData::FC.object11.dyN = 0;
  @RBSData::FC.object11.dzN = 0;
  @RBSData::FC.object11.vxN = 0;
  @RBSData::FC.object11.vyN = 0;
  @RBSData::FC.object11.axN = 0;
  @RBSData::FC.object11.ayN = 0;
  @RBSData::FC.object11.dWidthN = 0;
  @RBSData::FC.object11.dLengthN = 0;
  @RBSData::FC.object11.rcsN = 0;
  @RBSData::FC.object11.snrN = 0;
  @RBSData::FC.object11.alpPiYawAngleN = 0;
  @RBSData::FC.object11.signalStrengthN = 0;
  @RBSData::FC.object12.objID = 0;
  @RBSData::FC.object12.classification = 0;
  @RBSData::FC.object12.radar_type = 0;
  }
  if(init_count == 137)
  {
  @RBSData::FC.object12.dxN = 0;
  @RBSData::FC.object12.dyN = 0;
  @RBSData::FC.object12.dzN = 0;
  @RBSData::FC.object12.vxN = 0;
  @RBSData::FC.object12.vyN = 0;
  @RBSData::FC.object12.axN = 0;
  @RBSData::FC.object12.ayN = 0;
  @RBSData::FC.object12.dWidthN = 0;
  @RBSData::FC.object12.dLengthN = 0;
  @RBSData::FC.object12.rcsN = 0;
  @RBSData::FC.object12.snrN = 0;
  @RBSData::FC.object12.alpPiYawAngleN = 0;
  @RBSData::FC.object12.signalStrengthN = 0;
  @RBSData::FC.object13.objID = 0;
  @RBSData::FC.object13.classification = 0;
  @RBSData::FC.object13.radar_type = 0;
  @RBSData::FC.object13.dxN = 0;
  @RBSData::FC.object13.dyN = 0;
  @RBSData::FC.object13.dzN = 0;
  @RBSData::FC.object13.vxN = 0;
  @RBSData::FC.object13.vyN = 0;
  @RBSData::FC.object13.axN = 0;
  @RBSData::FC.object13.ayN = 0;
  @RBSData::FC.object13.dWidthN = 0;
  @RBSData::FC.object13.dLengthN = 0;
  }
  if(init_count == 138)
  {
  @RBSData::FC.object13.rcsN = 0;
  @RBSData::FC.object13.snrN = 0;
  @RBSData::FC.object13.alpPiYawAngleN = 0;
  @RBSData::FC.object13.signalStrengthN = 0;
  @RBSData::FC.object14.objID = 0;
  @RBSData::FC.object14.classification = 0;
  @RBSData::FC.object14.radar_type = 0;
  @RBSData::FC.object14.dxN = 0;
  @RBSData::FC.object14.dyN = 0;
  @RBSData::FC.object14.dzN = 0;
  @RBSData::FC.object14.vxN = 0;
  @RBSData::FC.object14.vyN = 0;
  @RBSData::FC.object14.axN = 0;
  @RBSData::FC.object14.ayN = 0;
  @RBSData::FC.object14.dWidthN = 0;
  @RBSData::FC.object14.dLengthN = 0;
  @RBSData::FC.object14.rcsN = 0;
  @RBSData::FC.object14.snrN = 0;
  @RBSData::FC.object14.alpPiYawAngleN = 0;
  @RBSData::FC.object14.signalStrengthN = 0;
  @RBSData::FC.object15.objID = 0;
  @RBSData::FC.object15.classification = 0;
  @RBSData::FC.object15.radar_type = 0;
  @RBSData::FC.object15.dxN = 0;
  @RBSData::FC.object15.dyN = 0;
  }
  if(init_count == 139)
  {
  @RBSData::FC.object15.dzN = 0;
  @RBSData::FC.object15.vxN = 0;
  @RBSData::FC.object15.vyN = 0;
  @RBSData::FC.object15.axN = 0;
  @RBSData::FC.object15.ayN = 0;
  @RBSData::FC.object15.dWidthN = 0;
  @RBSData::FC.object15.dLengthN = 0;
  @RBSData::FC.object15.rcsN = 0;
  @RBSData::FC.object15.snrN = 0;
  @RBSData::FC.object15.alpPiYawAngleN = 0;
  @RBSData::FC.object15.signalStrengthN = 0;
  @RBSData::FC.object16.objID = 0;
  @RBSData::FC.object16.classification = 0;
  @RBSData::FC.object16.radar_type = 0;
  @RBSData::FC.object16.dxN = 0;
  @RBSData::FC.object16.dyN = 0;
  @RBSData::FC.object16.dzN = 0;
  @RBSData::FC.object16.vxN = 0;
  @RBSData::FC.object16.vyN = 0;
  @RBSData::FC.object16.axN = 0;
  @RBSData::FC.object16.ayN = 0;
  @RBSData::FC.object16.dWidthN = 0;
  @RBSData::FC.object16.dLengthN = 0;
  @RBSData::FC.object16.rcsN = 0;
  @RBSData::FC.object16.snrN = 0;
  }
  if(init_count == 140)
  {
  @RBSData::FC.object16.alpPiYawAngleN = 0;
  @RBSData::FC.object16.signalStrengthN = 0;
  @RBSData::FC.object17.objID = 0;
  @RBSData::FC.object17.classification = 0;
  @RBSData::FC.object17.radar_type = 0;
  @RBSData::FC.object17.dxN = 0;
  @RBSData::FC.object17.dyN = 0;
  @RBSData::FC.object17.dzN = 0;
  @RBSData::FC.object17.vxN = 0;
  @RBSData::FC.object17.vyN = 0;
  @RBSData::FC.object17.axN = 0;
  @RBSData::FC.object17.ayN = 0;
  @RBSData::FC.object17.dWidthN = 0;
  @RBSData::FC.object17.dLengthN = 0;
  @RBSData::FC.object17.rcsN = 0;
  @RBSData::FC.object17.snrN = 0;
  @RBSData::FC.object17.alpPiYawAngleN = 0;
  @RBSData::FC.object17.signalStrengthN = 0;
  @RBSData::FC.object18.objID = 0;
  @RBSData::FC.object18.classification = 0;
  @RBSData::FC.object18.radar_type = 0;
  @RBSData::FC.object18.dxN = 0;
  @RBSData::FC.object18.dyN = 0;
  @RBSData::FC.object18.dzN = 0;
  @RBSData::FC.object18.vxN = 0;
  }
  if(init_count == 141)
  {
  @RBSData::FC.object18.vyN = 0;
  @RBSData::FC.object18.axN = 0;
  @RBSData::FC.object18.ayN = 0;
  @RBSData::FC.object18.dWidthN = 0;
  @RBSData::FC.object18.dLengthN = 0;
  @RBSData::FC.object18.rcsN = 0;
  @RBSData::FC.object18.snrN = 0;
  @RBSData::FC.object18.alpPiYawAngleN = 0;
  @RBSData::FC.object18.signalStrengthN = 0;
  @RBSData::FC.object19.objID = 0;
  @RBSData::FC.object19.classification = 0;
  @RBSData::FC.object19.radar_type = 0;
  @RBSData::FC.object19.dxN = 0;
  @RBSData::FC.object19.dyN = 0;
  @RBSData::FC.object19.dzN = 0;
  @RBSData::FC.object19.vxN = 0;
  @RBSData::FC.object19.vyN = 0;
  @RBSData::FC.object19.axN = 0;
  @RBSData::FC.object19.ayN = 0;
  @RBSData::FC.object19.dWidthN = 0;
  @RBSData::FC.object19.dLengthN = 0;
  @RBSData::FC.object19.rcsN = 0;
  @RBSData::FC.object19.snrN = 0;
  @RBSData::FC.object19.alpPiYawAngleN = 0;
  @RBSData::FC.object19.signalStrengthN = 0;
  }
  if(init_count == 142)
  {
  @RBSData::FC.object20.objID = 0;
  @RBSData::FC.object20.classification = 0;
  @RBSData::FC.object20.radar_type = 0;
  @RBSData::FC.object20.dxN = 0;
  @RBSData::FC.object20.dyN = 0;
  @RBSData::FC.object20.dzN = 0;
  @RBSData::FC.object20.vxN = 0;
  @RBSData::FC.object20.vyN = 0;
  @RBSData::FC.object20.axN = 0;
  @RBSData::FC.object20.ayN = 0;
  @RBSData::FC.object20.dWidthN = 0;
  @RBSData::FC.object20.dLengthN = 0;
  @RBSData::FC.object20.rcsN = 0;
  @RBSData::FC.object20.snrN = 0;
  @RBSData::FC.object20.alpPiYawAngleN = 0;
  @RBSData::FC.object20.signalStrengthN = 0;
  @RBSData::FC.object21.objID = 0;
  @RBSData::FC.object21.classification = 0;
  @RBSData::FC.object21.radar_type = 0;
  @RBSData::FC.object21.dxN = 0;
  @RBSData::FC.object21.dyN = 0;
  @RBSData::FC.object21.dzN = 0;
  @RBSData::FC.object21.vxN = 0;
  @RBSData::FC.object21.vyN = 0;
  @RBSData::FC.object21.axN = 0;
  }
  if(init_count == 143)
  {
  @RBSData::FC.object21.ayN = 0;
  @RBSData::FC.object21.dWidthN = 0;
  @RBSData::FC.object21.dLengthN = 0;
  @RBSData::FC.object21.rcsN = 0;
  @RBSData::FC.object21.snrN = 0;
  @RBSData::FC.object21.alpPiYawAngleN = 0;
  @RBSData::FC.object21.signalStrengthN = 0;
  @RBSData::FC.object22.objID = 0;
  @RBSData::FC.object22.classification = 0;
  @RBSData::FC.object22.radar_type = 0;
  @RBSData::FC.object22.dxN = 0;
  @RBSData::FC.object22.dyN = 0;
  @RBSData::FC.object22.dzN = 0;
  @RBSData::FC.object22.vxN = 0;
  @RBSData::FC.object22.vyN = 0;
  @RBSData::FC.object22.axN = 0;
  @RBSData::FC.object22.ayN = 0;
  @RBSData::FC.object22.dWidthN = 0;
  @RBSData::FC.object22.dLengthN = 0;
  @RBSData::FC.object22.rcsN = 0;
  @RBSData::FC.object22.snrN = 0;
  @RBSData::FC.object22.alpPiYawAngleN = 0;
  @RBSData::FC.object22.signalStrengthN = 0;
  @RBSData::FC.object23.objID = 0;
  @RBSData::FC.object23.classification = 0;
  }
  if(init_count == 144)
  {
  @RBSData::FC.object23.radar_type = 0;
  @RBSData::FC.object23.dxN = 0;
  @RBSData::FC.object23.dyN = 0;
  @RBSData::FC.object23.dzN = 0;
  @RBSData::FC.object23.vxN = 0;
  @RBSData::FC.object23.vyN = 0;
  @RBSData::FC.object23.axN = 0;
  @RBSData::FC.object23.ayN = 0;
  @RBSData::FC.object23.dWidthN = 0;
  @RBSData::FC.object23.dLengthN = 0;
  @RBSData::FC.object23.rcsN = 0;
  @RBSData::FC.object23.snrN = 0;
  @RBSData::FC.object23.alpPiYawAngleN = 0;
  @RBSData::FC.object23.signalStrengthN = 0;
  @RBSData::FC.object24.objID = 0;
  @RBSData::FC.object24.classification = 0;
  @RBSData::FC.object24.radar_type = 0;
  @RBSData::FC.object24.dxN = 0;
  @RBSData::FC.object24.dyN = 0;
  @RBSData::FC.object24.dzN = 0;
  @RBSData::FC.object24.vxN = 0;
  @RBSData::FC.object24.vyN = 0;
  @RBSData::FC.object24.axN = 0;
  @RBSData::FC.object24.ayN = 0;
  @RBSData::FC.object24.dWidthN = 0;
  }
  if(init_count == 145)
  {
  @RBSData::FC.object24.dLengthN = 0;
  @RBSData::FC.object24.rcsN = 0;
  @RBSData::FC.object24.snrN = 0;
  @RBSData::FC.object24.alpPiYawAngleN = 0;
  @RBSData::FC.object24.signalStrengthN = 0;
  @RBSData::FC.object25.objID = 0;
  @RBSData::FC.object25.classification = 0;
  @RBSData::FC.object25.radar_type = 0;
  @RBSData::FC.object25.dxN = 0;
  @RBSData::FC.object25.dyN = 0;
  @RBSData::FC.object25.dzN = 0;
  @RBSData::FC.object25.vxN = 0;
  @RBSData::FC.object25.vyN = 0;
  @RBSData::FC.object25.axN = 0;
  @RBSData::FC.object25.ayN = 0;
  @RBSData::FC.object25.dWidthN = 0;
  @RBSData::FC.object25.dLengthN = 0;
  @RBSData::FC.object25.rcsN = 0;
  @RBSData::FC.object25.snrN = 0;
  @RBSData::FC.object25.alpPiYawAngleN = 0;
  @RBSData::FC.object25.signalStrengthN = 0;
  @RBSData::FC.object26.objID = 0;
  @RBSData::FC.object26.classification = 0;
  @RBSData::FC.object26.radar_type = 0;
  @RBSData::FC.object26.dxN = 0;
  }
  if(init_count == 146)
  {
  @RBSData::FC.object26.dyN = 0;
  @RBSData::FC.object26.dzN = 0;
  @RBSData::FC.object26.vxN = 0;
  @RBSData::FC.object26.vyN = 0;
  @RBSData::FC.object26.axN = 0;
  @RBSData::FC.object26.ayN = 0;
  @RBSData::FC.object26.dWidthN = 0;
  @RBSData::FC.object26.dLengthN = 0;
  @RBSData::FC.object26.rcsN = 0;
  @RBSData::FC.object26.snrN = 0;
  @RBSData::FC.object26.alpPiYawAngleN = 0;
  @RBSData::FC.object26.signalStrengthN = 0;
  @RBSData::FC.object27.objID = 0;
  @RBSData::FC.object27.classification = 0;
  @RBSData::FC.object27.radar_type = 0;
  @RBSData::FC.object27.dxN = 0;
  @RBSData::FC.object27.dyN = 0;
  @RBSData::FC.object27.dzN = 0;
  @RBSData::FC.object27.vxN = 0;
  @RBSData::FC.object27.vyN = 0;
  @RBSData::FC.object27.axN = 0;
  @RBSData::FC.object27.ayN = 0;
  @RBSData::FC.object27.dWidthN = 0;
  @RBSData::FC.object27.dLengthN = 0;
  @RBSData::FC.object27.rcsN = 0;
  }
  if(init_count == 147)
  {
  @RBSData::FC.object27.snrN = 0;
  @RBSData::FC.object27.alpPiYawAngleN = 0;
  @RBSData::FC.object27.signalStrengthN = 0;
  @RBSData::FC.object28.objID = 0;
  @RBSData::FC.object28.classification = 0;
  @RBSData::FC.object28.radar_type = 0;
  @RBSData::FC.object28.dxN = 0;
  @RBSData::FC.object28.dyN = 0;
  @RBSData::FC.object28.dzN = 0;
  @RBSData::FC.object28.vxN = 0;
  @RBSData::FC.object28.vyN = 0;
  @RBSData::FC.object28.axN = 0;
  @RBSData::FC.object28.ayN = 0;
  @RBSData::FC.object28.dWidthN = 0;
  @RBSData::FC.object28.dLengthN = 0;
  @RBSData::FC.object28.rcsN = 0;
  @RBSData::FC.object28.snrN = 0;
  @RBSData::FC.object28.alpPiYawAngleN = 0;
  @RBSData::FC.object28.signalStrengthN = 0;
  @RBSData::FC.object29.objID = 0;
  @RBSData::FC.object29.classification = 0;
  @RBSData::FC.object29.radar_type = 0;
  @RBSData::FC.object29.dxN = 0;
  @RBSData::FC.object29.dyN = 0;
  @RBSData::FC.object29.dzN = 0;
  }
  if(init_count == 148)
  {
  @RBSData::FC.object29.vxN = 0;
  @RBSData::FC.object29.vyN = 0;
  @RBSData::FC.object29.axN = 0;
  @RBSData::FC.object29.ayN = 0;
  @RBSData::FC.object29.dWidthN = 0;
  @RBSData::FC.object29.dLengthN = 0;
  @RBSData::FC.object29.rcsN = 0;
  @RBSData::FC.object29.snrN = 0;
  @RBSData::FC.object29.alpPiYawAngleN = 0;
  @RBSData::FC.object29.signalStrengthN = 0;
  @RBSData::FC.object30.objID = 0;
  @RBSData::FC.object30.classification = 0;
  @RBSData::FC.object30.radar_type = 0;
  @RBSData::FC.object30.dxN = 0;
  @RBSData::FC.object30.dyN = 0;
  @RBSData::FC.object30.dzN = 0;
  @RBSData::FC.object30.vxN = 0;
  @RBSData::FC.object30.vyN = 0;
  @RBSData::FC.object30.axN = 0;
  @RBSData::FC.object30.ayN = 0;
  @RBSData::FC.object30.dWidthN = 0;
  @RBSData::FC.object30.dLengthN = 0;
  @RBSData::FC.object30.rcsN = 0;
  @RBSData::FC.object30.snrN = 0;
  @RBSData::FC.object30.alpPiYawAngleN = 0;
  }
  if(init_count == 149)
  {
  @RBSData::FC.object30.signalStrengthN = 0;
  @RBSData::FC.object31.objID = 0;
  @RBSData::FC.object31.classification = 0;
  @RBSData::FC.object31.radar_type = 0;
  @RBSData::FC.object31.dxN = 0;
  @RBSData::FC.object31.dyN = 0;
  @RBSData::FC.object31.dzN = 0;
  @RBSData::FC.object31.vxN = 0;
  @RBSData::FC.object31.vyN = 0;
  @RBSData::FC.object31.axN = 0;
  @RBSData::FC.object31.ayN = 0;
  @RBSData::FC.object31.dWidthN = 0;
  @RBSData::FC.object31.dLengthN = 0;
  @RBSData::FC.object31.rcsN = 0;
  @RBSData::FC.object31.snrN = 0;
  @RBSData::FC.object31.alpPiYawAngleN = 0;
  @RBSData::FC.object31.signalStrengthN = 0;
  @RBSData::FC.object32.objID = 0;
  @RBSData::FC.object32.classification = 0;
  @RBSData::FC.object32.radar_type = 0;
  @RBSData::FC.object32.dxN = 0;
  @RBSData::FC.object32.dyN = 0;
  @RBSData::FC.object32.dzN = 0;
  @RBSData::FC.object32.vxN = 0;
  @RBSData::FC.object32.vyN = 0;
  }
  if(init_count == 150)
  {
  @RBSData::FC.object32.axN = 0;
  @RBSData::FC.object32.ayN = 0;
  @RBSData::FC.object32.dWidthN = 0;
  @RBSData::FC.object32.dLengthN = 0;
  @RBSData::FC.object32.rcsN = 0;
  @RBSData::FC.object32.snrN = 0;
  @RBSData::FC.object32.alpPiYawAngleN = 0;
  @RBSData::FC.object32.signalStrengthN = 0;
  @RBSData::FC.object33.objID = 0;
  @RBSData::FC.object33.classification = 0;
  @RBSData::FC.object33.radar_type = 0;
  @RBSData::FC.object33.dxN = 0;
  @RBSData::FC.object33.dyN = 0;
  @RBSData::FC.object33.dzN = 0;
  @RBSData::FC.object33.vxN = 0;
  @RBSData::FC.object33.vyN = 0;
  @RBSData::FC.object33.axN = 0;
  @RBSData::FC.object33.ayN = 0;
  @RBSData::FC.object33.dWidthN = 0;
  @RBSData::FC.object33.dLengthN = 0;
  @RBSData::FC.object33.rcsN = 0;
  @RBSData::FC.object33.snrN = 0;
  @RBSData::FC.object33.alpPiYawAngleN = 0;
  @RBSData::FC.object33.signalStrengthN = 0;
  @RBSData::FC.object34.objID = 0;
  }
  if(init_count == 151)
  {
  @RBSData::FC.object34.classification = 0;
  @RBSData::FC.object34.radar_type = 0;
  @RBSData::FC.object34.dxN = 0;
  @RBSData::FC.object34.dyN = 0;
  @RBSData::FC.object34.dzN = 0;
  @RBSData::FC.object34.vxN = 0;
  @RBSData::FC.object34.vyN = 0;
  @RBSData::FC.object34.axN = 0;
  @RBSData::FC.object34.ayN = 0;
  @RBSData::FC.object34.dWidthN = 0;
  @RBSData::FC.object34.dLengthN = 0;
  @RBSData::FC.object34.rcsN = 0;
  @RBSData::FC.object34.snrN = 0;
  @RBSData::FC.object34.alpPiYawAngleN = 0;
  @RBSData::FC.object34.signalStrengthN = 0;
  @RBSData::FC.object35.objID = 0;
  @RBSData::FC.object35.classification = 0;
  @RBSData::FC.object35.radar_type = 0;
  @RBSData::FC.object35.dxN = 0;
  @RBSData::FC.object35.dyN = 0;
  @RBSData::FC.object35.dzN = 0;
  @RBSData::FC.object35.vxN = 0;
  @RBSData::FC.object35.vyN = 0;
  @RBSData::FC.object35.axN = 0;
  @RBSData::FC.object35.ayN = 0;
  }
  if(init_count == 152)
  {
  @RBSData::FC.object35.dWidthN = 0;
  @RBSData::FC.object35.dLengthN = 0;
  @RBSData::FC.object35.rcsN = 0;
  @RBSData::FC.object35.snrN = 0;
  @RBSData::FC.object35.alpPiYawAngleN = 0;
  @RBSData::FC.object35.signalStrengthN = 0;
  @RBSData::FC.object36.objID = 0;
  @RBSData::FC.object36.classification = 0;
  @RBSData::FC.object36.radar_type = 0;
  @RBSData::FC.object36.dxN = 0;
  @RBSData::FC.object36.dyN = 0;
  @RBSData::FC.object36.dzN = 0;
  @RBSData::FC.object36.vxN = 0;
  @RBSData::FC.object36.vyN = 0;
  @RBSData::FC.object36.axN = 0;
  @RBSData::FC.object36.ayN = 0;
  @RBSData::FC.object36.dWidthN = 0;
  @RBSData::FC.object36.dLengthN = 0;
  @RBSData::FC.object36.rcsN = 0;
  @RBSData::FC.object36.snrN = 0;
  @RBSData::FC.object36.alpPiYawAngleN = 0;
  @RBSData::FC.object36.signalStrengthN = 0;
  @RBSData::FC.object37.objID = 0;
  @RBSData::FC.object37.classification = 0;
  @RBSData::FC.object37.radar_type = 0;
  }
  if(init_count == 153)
  {
  @RBSData::FC.object37.dxN = 0;
  @RBSData::FC.object37.dyN = 0;
  @RBSData::FC.object37.dzN = 0;
  @RBSData::FC.object37.vxN = 0;
  @RBSData::FC.object37.vyN = 0;
  @RBSData::FC.object37.axN = 0;
  @RBSData::FC.object37.ayN = 0;
  @RBSData::FC.object37.dWidthN = 0;
  @RBSData::FC.object37.dLengthN = 0;
  @RBSData::FC.object37.rcsN = 0;
  @RBSData::FC.object37.snrN = 0;
  @RBSData::FC.object37.alpPiYawAngleN = 0;
  @RBSData::FC.object37.signalStrengthN = 0;
  @RBSData::FC.object38.objID = 0;
  @RBSData::FC.object38.classification = 0;
  @RBSData::FC.object38.radar_type = 0;
  @RBSData::FC.object38.dxN = 0;
  @RBSData::FC.object38.dyN = 0;
  @RBSData::FC.object38.dzN = 0;
  @RBSData::FC.object38.vxN = 0;
  @RBSData::FC.object38.vyN = 0;
  @RBSData::FC.object38.axN = 0;
  @RBSData::FC.object38.ayN = 0;
  @RBSData::FC.object38.dWidthN = 0;
  @RBSData::FC.object38.dLengthN = 0;
  }
  if(init_count == 154)
  {
  @RBSData::FC.object38.rcsN = 0;
  @RBSData::FC.object38.snrN = 0;
  @RBSData::FC.object38.alpPiYawAngleN = 0;
  @RBSData::FC.object38.signalStrengthN = 0;
  @RBSData::FC.object39.objID = 0;
  @RBSData::FC.object39.classification = 0;
  @RBSData::FC.object39.radar_type = 0;
  @RBSData::FC.object39.dxN = 0;
  @RBSData::FC.object39.dyN = 0;
  @RBSData::FC.object39.dzN = 0;
  @RBSData::FC.object39.vxN = 0;
  @RBSData::FC.object39.vyN = 0;
  @RBSData::FC.object39.axN = 0;
  @RBSData::FC.object39.ayN = 0;
  @RBSData::FC.object39.dWidthN = 0;
  @RBSData::FC.object39.dLengthN = 0;
  @RBSData::FC.object39.rcsN = 0;
  @RBSData::FC.object39.snrN = 0;
  @RBSData::FC.object39.alpPiYawAngleN = 0;
  @RBSData::FC.object39.signalStrengthN = 0;
  @RBSData::FL.mountPosX = 0;
  @RBSData::FL.mountPosY = 0;
  @RBSData::FL.mountPosZ = 0;
  @RBSData::FL.sensorBlocked = 0;
  @RBSData::FL.objectCount = 0;
  }
  if(init_count == 155)
  {
  @RBSData::FL.object0.objID = 0;
  @RBSData::FL.object0.classification = 0;
  @RBSData::FL.object0.radar_type = 0;
  @RBSData::FL.object0.dxN = 0;
  @RBSData::FL.object0.dyN = 0;
  @RBSData::FL.object0.dzN = 0;
  @RBSData::FL.object0.vxN = 0;
  @RBSData::FL.object0.vyN = 0;
  @RBSData::FL.object0.axN = 0;
  @RBSData::FL.object0.ayN = 0;
  @RBSData::FL.object0.dWidthN = 0;
  @RBSData::FL.object0.dLengthN = 0;
  @RBSData::FL.object0.rcsN = 0;
  @RBSData::FL.object0.snrN = 0;
  @RBSData::FL.object0.alpPiYawAngleN = 0;
  @RBSData::FL.object0.signalStrengthN = 0;
  @RBSData::FL.object1.objID = 0;
  @RBSData::FL.object1.classification = 0;
  @RBSData::FL.object1.radar_type = 0;
  @RBSData::FL.object1.dxN = 0;
  @RBSData::FL.object1.dyN = 0;
  @RBSData::FL.object1.dzN = 0;
  @RBSData::FL.object1.vxN = 0;
  @RBSData::FL.object1.vyN = 0;
  @RBSData::FL.object1.axN = 0;
  }
  if(init_count == 156)
  {
  @RBSData::FL.object1.ayN = 0;
  @RBSData::FL.object1.dWidthN = 0;
  @RBSData::FL.object1.dLengthN = 0;
  @RBSData::FL.object1.rcsN = 0;
  @RBSData::FL.object1.snrN = 0;
  @RBSData::FL.object1.alpPiYawAngleN = 0;
  @RBSData::FL.object1.signalStrengthN = 0;
  @RBSData::FL.object2.objID = 0;
  @RBSData::FL.object2.classification = 0;
  @RBSData::FL.object2.radar_type = 0;
  @RBSData::FL.object2.dxN = 0;
  @RBSData::FL.object2.dyN = 0;
  @RBSData::FL.object2.dzN = 0;
  @RBSData::FL.object2.vxN = 0;
  @RBSData::FL.object2.vyN = 0;
  @RBSData::FL.object2.axN = 0;
  @RBSData::FL.object2.ayN = 0;
  @RBSData::FL.object2.dWidthN = 0;
  @RBSData::FL.object2.dLengthN = 0;
  @RBSData::FL.object2.rcsN = 0;
  @RBSData::FL.object2.snrN = 0;
  @RBSData::FL.object2.alpPiYawAngleN = 0;
  @RBSData::FL.object2.signalStrengthN = 0;
  @RBSData::FL.object3.objID = 0;
  @RBSData::FL.object3.classification = 0;
  }
  if(init_count == 157)
  {
  @RBSData::FL.object3.radar_type = 0;
  @RBSData::FL.object3.dxN = 0;
  @RBSData::FL.object3.dyN = 0;
  @RBSData::FL.object3.dzN = 0;
  @RBSData::FL.object3.vxN = 0;
  @RBSData::FL.object3.vyN = 0;
  @RBSData::FL.object3.axN = 0;
  @RBSData::FL.object3.ayN = 0;
  @RBSData::FL.object3.dWidthN = 0;
  @RBSData::FL.object3.dLengthN = 0;
  @RBSData::FL.object3.rcsN = 0;
  @RBSData::FL.object3.snrN = 0;
  @RBSData::FL.object3.alpPiYawAngleN = 0;
  @RBSData::FL.object3.signalStrengthN = 0;
  @RBSData::FL.object4.objID = 0;
  @RBSData::FL.object4.classification = 0;
  @RBSData::FL.object4.radar_type = 0;
  @RBSData::FL.object4.dxN = 0;
  @RBSData::FL.object4.dyN = 0;
  @RBSData::FL.object4.dzN = 0;
  @RBSData::FL.object4.vxN = 0;
  @RBSData::FL.object4.vyN = 0;
  @RBSData::FL.object4.axN = 0;
  @RBSData::FL.object4.ayN = 0;
  @RBSData::FL.object4.dWidthN = 0;
  }
  if(init_count == 158)
  {
  @RBSData::FL.object4.dLengthN = 0;
  @RBSData::FL.object4.rcsN = 0;
  @RBSData::FL.object4.snrN = 0;
  @RBSData::FL.object4.alpPiYawAngleN = 0;
  @RBSData::FL.object4.signalStrengthN = 0;
  @RBSData::FL.object5.objID = 0;
  @RBSData::FL.object5.classification = 0;
  @RBSData::FL.object5.radar_type = 0;
  @RBSData::FL.object5.dxN = 0;
  @RBSData::FL.object5.dyN = 0;
  @RBSData::FL.object5.dzN = 0;
  @RBSData::FL.object5.vxN = 0;
  @RBSData::FL.object5.vyN = 0;
  @RBSData::FL.object5.axN = 0;
  @RBSData::FL.object5.ayN = 0;
  @RBSData::FL.object5.dWidthN = 0;
  @RBSData::FL.object5.dLengthN = 0;
  @RBSData::FL.object5.rcsN = 0;
  @RBSData::FL.object5.snrN = 0;
  @RBSData::FL.object5.alpPiYawAngleN = 0;
  @RBSData::FL.object5.signalStrengthN = 0;
  @RBSData::FL.object6.objID = 0;
  @RBSData::FL.object6.classification = 0;
  @RBSData::FL.object6.radar_type = 0;
  @RBSData::FL.object6.dxN = 0;
  }
  if(init_count == 159)
  {
  @RBSData::FL.object6.dyN = 0;
  @RBSData::FL.object6.dzN = 0;
  @RBSData::FL.object6.vxN = 0;
  @RBSData::FL.object6.vyN = 0;
  @RBSData::FL.object6.axN = 0;
  @RBSData::FL.object6.ayN = 0;
  @RBSData::FL.object6.dWidthN = 0;
  @RBSData::FL.object6.dLengthN = 0;
  @RBSData::FL.object6.rcsN = 0;
  @RBSData::FL.object6.snrN = 0;
  @RBSData::FL.object6.alpPiYawAngleN = 0;
  @RBSData::FL.object6.signalStrengthN = 0;
  @RBSData::FL.object7.objID = 0;
  @RBSData::FL.object7.classification = 0;
  @RBSData::FL.object7.radar_type = 0;
  @RBSData::FL.object7.dxN = 0;
  @RBSData::FL.object7.dyN = 0;
  @RBSData::FL.object7.dzN = 0;
  @RBSData::FL.object7.vxN = 0;
  @RBSData::FL.object7.vyN = 0;
  @RBSData::FL.object7.axN = 0;
  @RBSData::FL.object7.ayN = 0;
  @RBSData::FL.object7.dWidthN = 0;
  @RBSData::FL.object7.dLengthN = 0;
  @RBSData::FL.object7.rcsN = 0;
  }
  if(init_count == 160)
  {
  @RBSData::FL.object7.snrN = 0;
  @RBSData::FL.object7.alpPiYawAngleN = 0;
  @RBSData::FL.object7.signalStrengthN = 0;
  @RBSData::FL.object8.objID = 0;
  @RBSData::FL.object8.classification = 0;
  @RBSData::FL.object8.radar_type = 0;
  @RBSData::FL.object8.dxN = 0;
  @RBSData::FL.object8.dyN = 0;
  @RBSData::FL.object8.dzN = 0;
  @RBSData::FL.object8.vxN = 0;
  @RBSData::FL.object8.vyN = 0;
  @RBSData::FL.object8.axN = 0;
  @RBSData::FL.object8.ayN = 0;
  @RBSData::FL.object8.dWidthN = 0;
  @RBSData::FL.object8.dLengthN = 0;
  @RBSData::FL.object8.rcsN = 0;
  @RBSData::FL.object8.snrN = 0;
  @RBSData::FL.object8.alpPiYawAngleN = 0;
  @RBSData::FL.object8.signalStrengthN = 0;
  @RBSData::FL.object9.objID = 0;
  @RBSData::FL.object9.classification = 0;
  @RBSData::FL.object9.radar_type = 0;
  @RBSData::FL.object9.dxN = 0;
  @RBSData::FL.object9.dyN = 0;
  @RBSData::FL.object9.dzN = 0;
  }
  if(init_count == 161)
  {
  @RBSData::FL.object9.vxN = 0;
  @RBSData::FL.object9.vyN = 0;
  @RBSData::FL.object9.axN = 0;
  @RBSData::FL.object9.ayN = 0;
  @RBSData::FL.object9.dWidthN = 0;
  @RBSData::FL.object9.dLengthN = 0;
  @RBSData::FL.object9.rcsN = 0;
  @RBSData::FL.object9.snrN = 0;
  @RBSData::FL.object9.alpPiYawAngleN = 0;
  @RBSData::FL.object9.signalStrengthN = 0;
  @RBSData::FL.object10.objID = 0;
  @RBSData::FL.object10.classification = 0;
  @RBSData::FL.object10.radar_type = 0;
  @RBSData::FL.object10.dxN = 0;
  @RBSData::FL.object10.dyN = 0;
  @RBSData::FL.object10.dzN = 0;
  @RBSData::FL.object10.vxN = 0;
  @RBSData::FL.object10.vyN = 0;
  @RBSData::FL.object10.axN = 0;
  @RBSData::FL.object10.ayN = 0;
  @RBSData::FL.object10.dWidthN = 0;
  @RBSData::FL.object10.dLengthN = 0;
  @RBSData::FL.object10.rcsN = 0;
  @RBSData::FL.object10.snrN = 0;
  @RBSData::FL.object10.alpPiYawAngleN = 0;
  }
  if(init_count == 162)
  {
  @RBSData::FL.object10.signalStrengthN = 0;
  @RBSData::FL.object11.objID = 0;
  @RBSData::FL.object11.classification = 0;
  @RBSData::FL.object11.radar_type = 0;
  @RBSData::FL.object11.dxN = 0;
  @RBSData::FL.object11.dyN = 0;
  @RBSData::FL.object11.dzN = 0;
  @RBSData::FL.object11.vxN = 0;
  @RBSData::FL.object11.vyN = 0;
  @RBSData::FL.object11.axN = 0;
  @RBSData::FL.object11.ayN = 0;
  @RBSData::FL.object11.dWidthN = 0;
  @RBSData::FL.object11.dLengthN = 0;
  @RBSData::FL.object11.rcsN = 0;
  @RBSData::FL.object11.snrN = 0;
  @RBSData::FL.object11.alpPiYawAngleN = 0;
  @RBSData::FL.object11.signalStrengthN = 0;
  @RBSData::FL.object12.objID = 0;
  @RBSData::FL.object12.classification = 0;
  @RBSData::FL.object12.radar_type = 0;
  @RBSData::FL.object12.dxN = 0;
  @RBSData::FL.object12.dyN = 0;
  @RBSData::FL.object12.dzN = 0;
  @RBSData::FL.object12.vxN = 0;
  @RBSData::FL.object12.vyN = 0;
  }
  if(init_count == 163)
  {
  @RBSData::FL.object12.axN = 0;
  @RBSData::FL.object12.ayN = 0;
  @RBSData::FL.object12.dWidthN = 0;
  @RBSData::FL.object12.dLengthN = 0;
  @RBSData::FL.object12.rcsN = 0;
  @RBSData::FL.object12.snrN = 0;
  @RBSData::FL.object12.alpPiYawAngleN = 0;
  @RBSData::FL.object12.signalStrengthN = 0;
  @RBSData::FL.object13.objID = 0;
  @RBSData::FL.object13.classification = 0;
  @RBSData::FL.object13.radar_type = 0;
  @RBSData::FL.object13.dxN = 0;
  @RBSData::FL.object13.dyN = 0;
  @RBSData::FL.object13.dzN = 0;
  @RBSData::FL.object13.vxN = 0;
  @RBSData::FL.object13.vyN = 0;
  @RBSData::FL.object13.axN = 0;
  @RBSData::FL.object13.ayN = 0;
  @RBSData::FL.object13.dWidthN = 0;
  @RBSData::FL.object13.dLengthN = 0;
  @RBSData::FL.object13.rcsN = 0;
  @RBSData::FL.object13.snrN = 0;
  @RBSData::FL.object13.alpPiYawAngleN = 0;
  @RBSData::FL.object13.signalStrengthN = 0;
  @RBSData::FL.object14.objID = 0;
  }
  if(init_count == 164)
  {
  @RBSData::FL.object14.classification = 0;
  @RBSData::FL.object14.radar_type = 0;
  @RBSData::FL.object14.dxN = 0;
  @RBSData::FL.object14.dyN = 0;
  @RBSData::FL.object14.dzN = 0;
  @RBSData::FL.object14.vxN = 0;
  @RBSData::FL.object14.vyN = 0;
  @RBSData::FL.object14.axN = 0;
  @RBSData::FL.object14.ayN = 0;
  @RBSData::FL.object14.dWidthN = 0;
  @RBSData::FL.object14.dLengthN = 0;
  @RBSData::FL.object14.rcsN = 0;
  @RBSData::FL.object14.snrN = 0;
  @RBSData::FL.object14.alpPiYawAngleN = 0;
  @RBSData::FL.object14.signalStrengthN = 0;
  @RBSData::FL.object15.objID = 0;
  @RBSData::FL.object15.classification = 0;
  @RBSData::FL.object15.radar_type = 0;
  @RBSData::FL.object15.dxN = 0;
  @RBSData::FL.object15.dyN = 0;
  @RBSData::FL.object15.dzN = 0;
  @RBSData::FL.object15.vxN = 0;
  @RBSData::FL.object15.vyN = 0;
  @RBSData::FL.object15.axN = 0;
  @RBSData::FL.object15.ayN = 0;
  }
  if(init_count == 165)
  {
  @RBSData::FL.object15.dWidthN = 0;
  @RBSData::FL.object15.dLengthN = 0;
  @RBSData::FL.object15.rcsN = 0;
  @RBSData::FL.object15.snrN = 0;
  @RBSData::FL.object15.alpPiYawAngleN = 0;
  @RBSData::FL.object15.signalStrengthN = 0;
  @RBSData::FL.object16.objID = 0;
  @RBSData::FL.object16.classification = 0;
  @RBSData::FL.object16.radar_type = 0;
  @RBSData::FL.object16.dxN = 0;
  @RBSData::FL.object16.dyN = 0;
  @RBSData::FL.object16.dzN = 0;
  @RBSData::FL.object16.vxN = 0;
  @RBSData::FL.object16.vyN = 0;
  @RBSData::FL.object16.axN = 0;
  @RBSData::FL.object16.ayN = 0;
  @RBSData::FL.object16.dWidthN = 0;
  @RBSData::FL.object16.dLengthN = 0;
  @RBSData::FL.object16.rcsN = 0;
  @RBSData::FL.object16.snrN = 0;
  @RBSData::FL.object16.alpPiYawAngleN = 0;
  @RBSData::FL.object16.signalStrengthN = 0;
  @RBSData::FL.object17.objID = 0;
  @RBSData::FL.object17.classification = 0;
  @RBSData::FL.object17.radar_type = 0;
  }
  if(init_count == 166)
  {
  @RBSData::FL.object17.dxN = 0;
  @RBSData::FL.object17.dyN = 0;
  @RBSData::FL.object17.dzN = 0;
  @RBSData::FL.object17.vxN = 0;
  @RBSData::FL.object17.vyN = 0;
  @RBSData::FL.object17.axN = 0;
  @RBSData::FL.object17.ayN = 0;
  @RBSData::FL.object17.dWidthN = 0;
  @RBSData::FL.object17.dLengthN = 0;
  @RBSData::FL.object17.rcsN = 0;
  @RBSData::FL.object17.snrN = 0;
  @RBSData::FL.object17.alpPiYawAngleN = 0;
  @RBSData::FL.object17.signalStrengthN = 0;
  @RBSData::FL.object18.objID = 0;
  @RBSData::FL.object18.classification = 0;
  @RBSData::FL.object18.radar_type = 0;
  @RBSData::FL.object18.dxN = 0;
  @RBSData::FL.object18.dyN = 0;
  @RBSData::FL.object18.dzN = 0;
  @RBSData::FL.object18.vxN = 0;
  @RBSData::FL.object18.vyN = 0;
  @RBSData::FL.object18.axN = 0;
  @RBSData::FL.object18.ayN = 0;
  @RBSData::FL.object18.dWidthN = 0;
  @RBSData::FL.object18.dLengthN = 0;
  }
  if(init_count == 167)
  {
  @RBSData::FL.object18.rcsN = 0;
  @RBSData::FL.object18.snrN = 0;
  @RBSData::FL.object18.alpPiYawAngleN = 0;
  @RBSData::FL.object18.signalStrengthN = 0;
  @RBSData::FL.object19.objID = 0;
  @RBSData::FL.object19.classification = 0;
  @RBSData::FL.object19.radar_type = 0;
  @RBSData::FL.object19.dxN = 0;
  @RBSData::FL.object19.dyN = 0;
  @RBSData::FL.object19.dzN = 0;
  @RBSData::FL.object19.vxN = 0;
  @RBSData::FL.object19.vyN = 0;
  @RBSData::FL.object19.axN = 0;
  @RBSData::FL.object19.ayN = 0;
  @RBSData::FL.object19.dWidthN = 0;
  @RBSData::FL.object19.dLengthN = 0;
  @RBSData::FL.object19.rcsN = 0;
  @RBSData::FL.object19.snrN = 0;
  @RBSData::FL.object19.alpPiYawAngleN = 0;
  @RBSData::FL.object19.signalStrengthN = 0;
  @RBSData::FL.object20.objID = 0;
  @RBSData::FL.object20.classification = 0;
  @RBSData::FL.object20.radar_type = 0;
  @RBSData::FL.object20.dxN = 0;
  @RBSData::FL.object20.dyN = 0;
  }
  if(init_count == 168)
  {
  @RBSData::FL.object20.dzN = 0;
  @RBSData::FL.object20.vxN = 0;
  @RBSData::FL.object20.vyN = 0;
  @RBSData::FL.object20.axN = 0;
  @RBSData::FL.object20.ayN = 0;
  @RBSData::FL.object20.dWidthN = 0;
  @RBSData::FL.object20.dLengthN = 0;
  @RBSData::FL.object20.rcsN = 0;
  @RBSData::FL.object20.snrN = 0;
  @RBSData::FL.object20.alpPiYawAngleN = 0;
  @RBSData::FL.object20.signalStrengthN = 0;
  @RBSData::FL.object21.objID = 0;
  @RBSData::FL.object21.classification = 0;
  @RBSData::FL.object21.radar_type = 0;
  @RBSData::FL.object21.dxN = 0;
  @RBSData::FL.object21.dyN = 0;
  @RBSData::FL.object21.dzN = 0;
  @RBSData::FL.object21.vxN = 0;
  @RBSData::FL.object21.vyN = 0;
  @RBSData::FL.object21.axN = 0;
  @RBSData::FL.object21.ayN = 0;
  @RBSData::FL.object21.dWidthN = 0;
  @RBSData::FL.object21.dLengthN = 0;
  @RBSData::FL.object21.rcsN = 0;
  @RBSData::FL.object21.snrN = 0;
  }
  if(init_count == 169)
  {
  @RBSData::FL.object21.alpPiYawAngleN = 0;
  @RBSData::FL.object21.signalStrengthN = 0;
  @RBSData::FL.object22.objID = 0;
  @RBSData::FL.object22.classification = 0;
  @RBSData::FL.object22.radar_type = 0;
  @RBSData::FL.object22.dxN = 0;
  @RBSData::FL.object22.dyN = 0;
  @RBSData::FL.object22.dzN = 0;
  @RBSData::FL.object22.vxN = 0;
  @RBSData::FL.object22.vyN = 0;
  @RBSData::FL.object22.axN = 0;
  @RBSData::FL.object22.ayN = 0;
  @RBSData::FL.object22.dWidthN = 0;
  @RBSData::FL.object22.dLengthN = 0;
  @RBSData::FL.object22.rcsN = 0;
  @RBSData::FL.object22.snrN = 0;
  @RBSData::FL.object22.alpPiYawAngleN = 0;
  @RBSData::FL.object22.signalStrengthN = 0;
  @RBSData::FL.object23.objID = 0;
  @RBSData::FL.object23.classification = 0;
  @RBSData::FL.object23.radar_type = 0;
  @RBSData::FL.object23.dxN = 0;
  @RBSData::FL.object23.dyN = 0;
  @RBSData::FL.object23.dzN = 0;
  @RBSData::FL.object23.vxN = 0;
  }
  if(init_count == 170)
  {
  @RBSData::FL.object23.vyN = 0;
  @RBSData::FL.object23.axN = 0;
  @RBSData::FL.object23.ayN = 0;
  @RBSData::FL.object23.dWidthN = 0;
  @RBSData::FL.object23.dLengthN = 0;
  @RBSData::FL.object23.rcsN = 0;
  @RBSData::FL.object23.snrN = 0;
  @RBSData::FL.object23.alpPiYawAngleN = 0;
  @RBSData::FL.object23.signalStrengthN = 0;
  @RBSData::FL.object24.objID = 0;
  @RBSData::FL.object24.classification = 0;
  @RBSData::FL.object24.radar_type = 0;
  @RBSData::FL.object24.dxN = 0;
  @RBSData::FL.object24.dyN = 0;
  @RBSData::FL.object24.dzN = 0;
  @RBSData::FL.object24.vxN = 0;
  @RBSData::FL.object24.vyN = 0;
  @RBSData::FL.object24.axN = 0;
  @RBSData::FL.object24.ayN = 0;
  @RBSData::FL.object24.dWidthN = 0;
  @RBSData::FL.object24.dLengthN = 0;
  @RBSData::FL.object24.rcsN = 0;
  @RBSData::FL.object24.snrN = 0;
  @RBSData::FL.object24.alpPiYawAngleN = 0;
  @RBSData::FL.object24.signalStrengthN = 0;
  }
  if(init_count == 171)
  {
  @RBSData::FL.object25.objID = 0;
  @RBSData::FL.object25.classification = 0;
  @RBSData::FL.object25.radar_type = 0;
  @RBSData::FL.object25.dxN = 0;
  @RBSData::FL.object25.dyN = 0;
  @RBSData::FL.object25.dzN = 0;
  @RBSData::FL.object25.vxN = 0;
  @RBSData::FL.object25.vyN = 0;
  @RBSData::FL.object25.axN = 0;
  @RBSData::FL.object25.ayN = 0;
  @RBSData::FL.object25.dWidthN = 0;
  @RBSData::FL.object25.dLengthN = 0;
  @RBSData::FL.object25.rcsN = 0;
  @RBSData::FL.object25.snrN = 0;
  @RBSData::FL.object25.alpPiYawAngleN = 0;
  @RBSData::FL.object25.signalStrengthN = 0;
  @RBSData::FL.object26.objID = 0;
  @RBSData::FL.object26.classification = 0;
  @RBSData::FL.object26.radar_type = 0;
  @RBSData::FL.object26.dxN = 0;
  @RBSData::FL.object26.dyN = 0;
  @RBSData::FL.object26.dzN = 0;
  @RBSData::FL.object26.vxN = 0;
  @RBSData::FL.object26.vyN = 0;
  @RBSData::FL.object26.axN = 0;
  }
  if(init_count == 172)
  {
  @RBSData::FL.object26.ayN = 0;
  @RBSData::FL.object26.dWidthN = 0;
  @RBSData::FL.object26.dLengthN = 0;
  @RBSData::FL.object26.rcsN = 0;
  @RBSData::FL.object26.snrN = 0;
  @RBSData::FL.object26.alpPiYawAngleN = 0;
  @RBSData::FL.object26.signalStrengthN = 0;
  @RBSData::FL.object27.objID = 0;
  @RBSData::FL.object27.classification = 0;
  @RBSData::FL.object27.radar_type = 0;
  @RBSData::FL.object27.dxN = 0;
  @RBSData::FL.object27.dyN = 0;
  @RBSData::FL.object27.dzN = 0;
  @RBSData::FL.object27.vxN = 0;
  @RBSData::FL.object27.vyN = 0;
  @RBSData::FL.object27.axN = 0;
  @RBSData::FL.object27.ayN = 0;
  @RBSData::FL.object27.dWidthN = 0;
  @RBSData::FL.object27.dLengthN = 0;
  @RBSData::FL.object27.rcsN = 0;
  @RBSData::FL.object27.snrN = 0;
  @RBSData::FL.object27.alpPiYawAngleN = 0;
  @RBSData::FL.object27.signalStrengthN = 0;
  @RBSData::FL.object28.objID = 0;
  @RBSData::FL.object28.classification = 0;
  }
  if(init_count == 173)
  {
  @RBSData::FL.object28.radar_type = 0;
  @RBSData::FL.object28.dxN = 0;
  @RBSData::FL.object28.dyN = 0;
  @RBSData::FL.object28.dzN = 0;
  @RBSData::FL.object28.vxN = 0;
  @RBSData::FL.object28.vyN = 0;
  @RBSData::FL.object28.axN = 0;
  @RBSData::FL.object28.ayN = 0;
  @RBSData::FL.object28.dWidthN = 0;
  @RBSData::FL.object28.dLengthN = 0;
  @RBSData::FL.object28.rcsN = 0;
  @RBSData::FL.object28.snrN = 0;
  @RBSData::FL.object28.alpPiYawAngleN = 0;
  @RBSData::FL.object28.signalStrengthN = 0;
  @RBSData::FL.object29.objID = 0;
  @RBSData::FL.object29.classification = 0;
  @RBSData::FL.object29.radar_type = 0;
  @RBSData::FL.object29.dxN = 0;
  @RBSData::FL.object29.dyN = 0;
  @RBSData::FL.object29.dzN = 0;
  @RBSData::FL.object29.vxN = 0;
  @RBSData::FL.object29.vyN = 0;
  @RBSData::FL.object29.axN = 0;
  @RBSData::FL.object29.ayN = 0;
  @RBSData::FL.object29.dWidthN = 0;
  }
  if(init_count == 174)
  {
  @RBSData::FL.object29.dLengthN = 0;
  @RBSData::FL.object29.rcsN = 0;
  @RBSData::FL.object29.snrN = 0;
  @RBSData::FL.object29.alpPiYawAngleN = 0;
  @RBSData::FL.object29.signalStrengthN = 0;
  @RBSData::FL.object30.objID = 0;
  @RBSData::FL.object30.classification = 0;
  @RBSData::FL.object30.radar_type = 0;
  @RBSData::FL.object30.dxN = 0;
  @RBSData::FL.object30.dyN = 0;
  @RBSData::FL.object30.dzN = 0;
  @RBSData::FL.object30.vxN = 0;
  @RBSData::FL.object30.vyN = 0;
  @RBSData::FL.object30.axN = 0;
  @RBSData::FL.object30.ayN = 0;
  @RBSData::FL.object30.dWidthN = 0;
  @RBSData::FL.object30.dLengthN = 0;
  @RBSData::FL.object30.rcsN = 0;
  @RBSData::FL.object30.snrN = 0;
  @RBSData::FL.object30.alpPiYawAngleN = 0;
  @RBSData::FL.object30.signalStrengthN = 0;
  @RBSData::FL.object31.objID = 0;
  @RBSData::FL.object31.classification = 0;
  @RBSData::FL.object31.radar_type = 0;
  @RBSData::FL.object31.dxN = 0;
  }
  if(init_count == 175)
  {
  @RBSData::FL.object31.dyN = 0;
  @RBSData::FL.object31.dzN = 0;
  @RBSData::FL.object31.vxN = 0;
  @RBSData::FL.object31.vyN = 0;
  @RBSData::FL.object31.axN = 0;
  @RBSData::FL.object31.ayN = 0;
  @RBSData::FL.object31.dWidthN = 0;
  @RBSData::FL.object31.dLengthN = 0;
  @RBSData::FL.object31.rcsN = 0;
  @RBSData::FL.object31.snrN = 0;
  @RBSData::FL.object31.alpPiYawAngleN = 0;
  @RBSData::FL.object31.signalStrengthN = 0;
  @RBSData::FL.object32.objID = 0;
  @RBSData::FL.object32.classification = 0;
  @RBSData::FL.object32.radar_type = 0;
  @RBSData::FL.object32.dxN = 0;
  @RBSData::FL.object32.dyN = 0;
  @RBSData::FL.object32.dzN = 0;
  @RBSData::FL.object32.vxN = 0;
  @RBSData::FL.object32.vyN = 0;
  @RBSData::FL.object32.axN = 0;
  @RBSData::FL.object32.ayN = 0;
  @RBSData::FL.object32.dWidthN = 0;
  @RBSData::FL.object32.dLengthN = 0;
  @RBSData::FL.object32.rcsN = 0;
  }
  if(init_count == 176)
  {
  @RBSData::FL.object32.snrN = 0;
  @RBSData::FL.object32.alpPiYawAngleN = 0;
  @RBSData::FL.object32.signalStrengthN = 0;
  @RBSData::FL.object33.objID = 0;
  @RBSData::FL.object33.classification = 0;
  @RBSData::FL.object33.radar_type = 0;
  @RBSData::FL.object33.dxN = 0;
  @RBSData::FL.object33.dyN = 0;
  @RBSData::FL.object33.dzN = 0;
  @RBSData::FL.object33.vxN = 0;
  @RBSData::FL.object33.vyN = 0;
  @RBSData::FL.object33.axN = 0;
  @RBSData::FL.object33.ayN = 0;
  @RBSData::FL.object33.dWidthN = 0;
  @RBSData::FL.object33.dLengthN = 0;
  @RBSData::FL.object33.rcsN = 0;
  @RBSData::FL.object33.snrN = 0;
  @RBSData::FL.object33.alpPiYawAngleN = 0;
  @RBSData::FL.object33.signalStrengthN = 0;
  @RBSData::FL.object34.objID = 0;
  @RBSData::FL.object34.classification = 0;
  @RBSData::FL.object34.radar_type = 0;
  @RBSData::FL.object34.dxN = 0;
  @RBSData::FL.object34.dyN = 0;
  @RBSData::FL.object34.dzN = 0;
  }
  if(init_count == 177)
  {
  @RBSData::FL.object34.vxN = 0;
  @RBSData::FL.object34.vyN = 0;
  @RBSData::FL.object34.axN = 0;
  @RBSData::FL.object34.ayN = 0;
  @RBSData::FL.object34.dWidthN = 0;
  @RBSData::FL.object34.dLengthN = 0;
  @RBSData::FL.object34.rcsN = 0;
  @RBSData::FL.object34.snrN = 0;
  @RBSData::FL.object34.alpPiYawAngleN = 0;
  @RBSData::FL.object34.signalStrengthN = 0;
  @RBSData::FL.object35.objID = 0;
  @RBSData::FL.object35.classification = 0;
  @RBSData::FL.object35.radar_type = 0;
  @RBSData::FL.object35.dxN = 0;
  @RBSData::FL.object35.dyN = 0;
  @RBSData::FL.object35.dzN = 0;
  @RBSData::FL.object35.vxN = 0;
  @RBSData::FL.object35.vyN = 0;
  @RBSData::FL.object35.axN = 0;
  @RBSData::FL.object35.ayN = 0;
  @RBSData::FL.object35.dWidthN = 0;
  @RBSData::FL.object35.dLengthN = 0;
  @RBSData::FL.object35.rcsN = 0;
  @RBSData::FL.object35.snrN = 0;
  @RBSData::FL.object35.alpPiYawAngleN = 0;
  }
  if(init_count == 178)
  {
  @RBSData::FL.object35.signalStrengthN = 0;
  @RBSData::FL.object36.objID = 0;
  @RBSData::FL.object36.classification = 0;
  @RBSData::FL.object36.radar_type = 0;
  @RBSData::FL.object36.dxN = 0;
  @RBSData::FL.object36.dyN = 0;
  @RBSData::FL.object36.dzN = 0;
  @RBSData::FL.object36.vxN = 0;
  @RBSData::FL.object36.vyN = 0;
  @RBSData::FL.object36.axN = 0;
  @RBSData::FL.object36.ayN = 0;
  @RBSData::FL.object36.dWidthN = 0;
  @RBSData::FL.object36.dLengthN = 0;
  @RBSData::FL.object36.rcsN = 0;
  @RBSData::FL.object36.snrN = 0;
  @RBSData::FL.object36.alpPiYawAngleN = 0;
  @RBSData::FL.object36.signalStrengthN = 0;
  @RBSData::FL.object37.objID = 0;
  @RBSData::FL.object37.classification = 0;
  @RBSData::FL.object37.radar_type = 0;
  @RBSData::FL.object37.dxN = 0;
  @RBSData::FL.object37.dyN = 0;
  @RBSData::FL.object37.dzN = 0;
  @RBSData::FL.object37.vxN = 0;
  @RBSData::FL.object37.vyN = 0;
  }
  if(init_count == 179)
  {
  @RBSData::FL.object37.axN = 0;
  @RBSData::FL.object37.ayN = 0;
  @RBSData::FL.object37.dWidthN = 0;
  @RBSData::FL.object37.dLengthN = 0;
  @RBSData::FL.object37.rcsN = 0;
  @RBSData::FL.object37.snrN = 0;
  @RBSData::FL.object37.alpPiYawAngleN = 0;
  @RBSData::FL.object37.signalStrengthN = 0;
  @RBSData::FL.object38.objID = 0;
  @RBSData::FL.object38.classification = 0;
  @RBSData::FL.object38.radar_type = 0;
  @RBSData::FL.object38.dxN = 0;
  @RBSData::FL.object38.dyN = 0;
  @RBSData::FL.object38.dzN = 0;
  @RBSData::FL.object38.vxN = 0;
  @RBSData::FL.object38.vyN = 0;
  @RBSData::FL.object38.axN = 0;
  @RBSData::FL.object38.ayN = 0;
  @RBSData::FL.object38.dWidthN = 0;
  @RBSData::FL.object38.dLengthN = 0;
  @RBSData::FL.object38.rcsN = 0;
  @RBSData::FL.object38.snrN = 0;
  @RBSData::FL.object38.alpPiYawAngleN = 0;
  @RBSData::FL.object38.signalStrengthN = 0;
  @RBSData::FL.object39.objID = 0;
  }
  if(init_count == 180)
  {
  @RBSData::FL.object39.classification = 0;
  @RBSData::FL.object39.radar_type = 0;
  @RBSData::FL.object39.dxN = 0;
  @RBSData::FL.object39.dyN = 0;
  @RBSData::FL.object39.dzN = 0;
  @RBSData::FL.object39.vxN = 0;
  @RBSData::FL.object39.vyN = 0;
  @RBSData::FL.object39.axN = 0;
  @RBSData::FL.object39.ayN = 0;
  @RBSData::FL.object39.dWidthN = 0;
  @RBSData::FL.object39.dLengthN = 0;
  @RBSData::FL.object39.rcsN = 0;
  @RBSData::FL.object39.snrN = 0;
  @RBSData::FL.object39.alpPiYawAngleN = 0;
  @RBSData::FL.object39.signalStrengthN = 0;
  @RBSData::FR.mountPosX = 0;
  @RBSData::FR.mountPosY = 0;
  @RBSData::FR.mountPosZ = 0;
  @RBSData::FR.sensorBlocked = 0;
  @RBSData::FR.objectCount = 0;
  @RBSData::FR.object0.objID = 0;
  @RBSData::FR.object0.classification = 0;
  @RBSData::FR.object0.radar_type = 0;
  @RBSData::FR.object0.dxN = 0;
  @RBSData::FR.object0.dyN = 0;
  }
  if(init_count == 181)
  {
  @RBSData::FR.object0.dzN = 0;
  @RBSData::FR.object0.vxN = 0;
  @RBSData::FR.object0.vyN = 0;
  @RBSData::FR.object0.axN = 0;
  @RBSData::FR.object0.ayN = 0;
  @RBSData::FR.object0.dWidthN = 0;
  @RBSData::FR.object0.dLengthN = 0;
  @RBSData::FR.object0.rcsN = 0;
  @RBSData::FR.object0.snrN = 0;
  @RBSData::FR.object0.alpPiYawAngleN = 0;
  @RBSData::FR.object0.signalStrengthN = 0;
  @RBSData::FR.object1.objID = 0;
  @RBSData::FR.object1.classification = 0;
  @RBSData::FR.object1.radar_type = 0;
  @RBSData::FR.object1.dxN = 0;
  @RBSData::FR.object1.dyN = 0;
  @RBSData::FR.object1.dzN = 0;
  @RBSData::FR.object1.vxN = 0;
  @RBSData::FR.object1.vyN = 0;
  @RBSData::FR.object1.axN = 0;
  @RBSData::FR.object1.ayN = 0;
  @RBSData::FR.object1.dWidthN = 0;
  @RBSData::FR.object1.dLengthN = 0;
  @RBSData::FR.object1.rcsN = 0;
  @RBSData::FR.object1.snrN = 0;
  }
  if(init_count == 182)
  {
  @RBSData::FR.object1.alpPiYawAngleN = 0;
  @RBSData::FR.object1.signalStrengthN = 0;
  @RBSData::FR.object2.objID = 0;
  @RBSData::FR.object2.classification = 0;
  @RBSData::FR.object2.radar_type = 0;
  @RBSData::FR.object2.dxN = 0;
  @RBSData::FR.object2.dyN = 0;
  @RBSData::FR.object2.dzN = 0;
  @RBSData::FR.object2.vxN = 0;
  @RBSData::FR.object2.vyN = 0;
  @RBSData::FR.object2.axN = 0;
  @RBSData::FR.object2.ayN = 0;
  @RBSData::FR.object2.dWidthN = 0;
  @RBSData::FR.object2.dLengthN = 0;
  @RBSData::FR.object2.rcsN = 0;
  @RBSData::FR.object2.snrN = 0;
  @RBSData::FR.object2.alpPiYawAngleN = 0;
  @RBSData::FR.object2.signalStrengthN = 0;
  @RBSData::FR.object3.objID = 0;
  @RBSData::FR.object3.classification = 0;
  @RBSData::FR.object3.radar_type = 0;
  @RBSData::FR.object3.dxN = 0;
  @RBSData::FR.object3.dyN = 0;
  @RBSData::FR.object3.dzN = 0;
  @RBSData::FR.object3.vxN = 0;
  }
  if(init_count == 183)
  {
  @RBSData::FR.object3.vyN = 0;
  @RBSData::FR.object3.axN = 0;
  @RBSData::FR.object3.ayN = 0;
  @RBSData::FR.object3.dWidthN = 0;
  @RBSData::FR.object3.dLengthN = 0;
  @RBSData::FR.object3.rcsN = 0;
  @RBSData::FR.object3.snrN = 0;
  @RBSData::FR.object3.alpPiYawAngleN = 0;
  @RBSData::FR.object3.signalStrengthN = 0;
  @RBSData::FR.object4.objID = 0;
  @RBSData::FR.object4.classification = 0;
  @RBSData::FR.object4.radar_type = 0;
  @RBSData::FR.object4.dxN = 0;
  @RBSData::FR.object4.dyN = 0;
  @RBSData::FR.object4.dzN = 0;
  @RBSData::FR.object4.vxN = 0;
  @RBSData::FR.object4.vyN = 0;
  @RBSData::FR.object4.axN = 0;
  @RBSData::FR.object4.ayN = 0;
  @RBSData::FR.object4.dWidthN = 0;
  @RBSData::FR.object4.dLengthN = 0;
  @RBSData::FR.object4.rcsN = 0;
  @RBSData::FR.object4.snrN = 0;
  @RBSData::FR.object4.alpPiYawAngleN = 0;
  @RBSData::FR.object4.signalStrengthN = 0;
  }
  if(init_count == 184)
  {
  @RBSData::FR.object5.objID = 0;
  @RBSData::FR.object5.classification = 0;
  @RBSData::FR.object5.radar_type = 0;
  @RBSData::FR.object5.dxN = 0;
  @RBSData::FR.object5.dyN = 0;
  @RBSData::FR.object5.dzN = 0;
  @RBSData::FR.object5.vxN = 0;
  @RBSData::FR.object5.vyN = 0;
  @RBSData::FR.object5.axN = 0;
  @RBSData::FR.object5.ayN = 0;
  @RBSData::FR.object5.dWidthN = 0;
  @RBSData::FR.object5.dLengthN = 0;
  @RBSData::FR.object5.rcsN = 0;
  @RBSData::FR.object5.snrN = 0;
  @RBSData::FR.object5.alpPiYawAngleN = 0;
  @RBSData::FR.object5.signalStrengthN = 0;
  @RBSData::FR.object6.objID = 0;
  @RBSData::FR.object6.classification = 0;
  @RBSData::FR.object6.radar_type = 0;
  @RBSData::FR.object6.dxN = 0;
  @RBSData::FR.object6.dyN = 0;
  @RBSData::FR.object6.dzN = 0;
  @RBSData::FR.object6.vxN = 0;
  @RBSData::FR.object6.vyN = 0;
  @RBSData::FR.object6.axN = 0;
  }
  if(init_count == 185)
  {
  @RBSData::FR.object6.ayN = 0;
  @RBSData::FR.object6.dWidthN = 0;
  @RBSData::FR.object6.dLengthN = 0;
  @RBSData::FR.object6.rcsN = 0;
  @RBSData::FR.object6.snrN = 0;
  @RBSData::FR.object6.alpPiYawAngleN = 0;
  @RBSData::FR.object6.signalStrengthN = 0;
  @RBSData::FR.object7.objID = 0;
  @RBSData::FR.object7.classification = 0;
  @RBSData::FR.object7.radar_type = 0;
  @RBSData::FR.object7.dxN = 0;
  @RBSData::FR.object7.dyN = 0;
  @RBSData::FR.object7.dzN = 0;
  @RBSData::FR.object7.vxN = 0;
  @RBSData::FR.object7.vyN = 0;
  @RBSData::FR.object7.axN = 0;
  @RBSData::FR.object7.ayN = 0;
  @RBSData::FR.object7.dWidthN = 0;
  @RBSData::FR.object7.dLengthN = 0;
  @RBSData::FR.object7.rcsN = 0;
  @RBSData::FR.object7.snrN = 0;
  @RBSData::FR.object7.alpPiYawAngleN = 0;
  @RBSData::FR.object7.signalStrengthN = 0;
  @RBSData::FR.object8.objID = 0;
  @RBSData::FR.object8.classification = 0;
  }
  if(init_count == 186)
  {
  @RBSData::FR.object8.radar_type = 0;
  @RBSData::FR.object8.dxN = 0;
  @RBSData::FR.object8.dyN = 0;
  @RBSData::FR.object8.dzN = 0;
  @RBSData::FR.object8.vxN = 0;
  @RBSData::FR.object8.vyN = 0;
  @RBSData::FR.object8.axN = 0;
  @RBSData::FR.object8.ayN = 0;
  @RBSData::FR.object8.dWidthN = 0;
  @RBSData::FR.object8.dLengthN = 0;
  @RBSData::FR.object8.rcsN = 0;
  @RBSData::FR.object8.snrN = 0;
  @RBSData::FR.object8.alpPiYawAngleN = 0;
  @RBSData::FR.object8.signalStrengthN = 0;
  @RBSData::FR.object9.objID = 0;
  @RBSData::FR.object9.classification = 0;
  @RBSData::FR.object9.radar_type = 0;
  @RBSData::FR.object9.dxN = 0;
  @RBSData::FR.object9.dyN = 0;
  @RBSData::FR.object9.dzN = 0;
  @RBSData::FR.object9.vxN = 0;
  @RBSData::FR.object9.vyN = 0;
  @RBSData::FR.object9.axN = 0;
  @RBSData::FR.object9.ayN = 0;
  @RBSData::FR.object9.dWidthN = 0;
  }
  if(init_count == 187)
  {
  @RBSData::FR.object9.dLengthN = 0;
  @RBSData::FR.object9.rcsN = 0;
  @RBSData::FR.object9.snrN = 0;
  @RBSData::FR.object9.alpPiYawAngleN = 0;
  @RBSData::FR.object9.signalStrengthN = 0;
  @RBSData::FR.object10.objID = 0;
  @RBSData::FR.object10.classification = 0;
  @RBSData::FR.object10.radar_type = 0;
  @RBSData::FR.object10.dxN = 0;
  @RBSData::FR.object10.dyN = 0;
  @RBSData::FR.object10.dzN = 0;
  @RBSData::FR.object10.vxN = 0;
  @RBSData::FR.object10.vyN = 0;
  @RBSData::FR.object10.axN = 0;
  @RBSData::FR.object10.ayN = 0;
  @RBSData::FR.object10.dWidthN = 0;
  @RBSData::FR.object10.dLengthN = 0;
  @RBSData::FR.object10.rcsN = 0;
  @RBSData::FR.object10.snrN = 0;
  @RBSData::FR.object10.alpPiYawAngleN = 0;
  @RBSData::FR.object10.signalStrengthN = 0;
  @RBSData::FR.object11.objID = 0;
  @RBSData::FR.object11.classification = 0;
  @RBSData::FR.object11.radar_type = 0;
  @RBSData::FR.object11.dxN = 0;
  }
  if(init_count == 188)
  {
  @RBSData::FR.object11.dyN = 0;
  @RBSData::FR.object11.dzN = 0;
  @RBSData::FR.object11.vxN = 0;
  @RBSData::FR.object11.vyN = 0;
  @RBSData::FR.object11.axN = 0;
  @RBSData::FR.object11.ayN = 0;
  @RBSData::FR.object11.dWidthN = 0;
  @RBSData::FR.object11.dLengthN = 0;
  @RBSData::FR.object11.rcsN = 0;
  @RBSData::FR.object11.snrN = 0;
  @RBSData::FR.object11.alpPiYawAngleN = 0;
  @RBSData::FR.object11.signalStrengthN = 0;
  @RBSData::FR.object12.objID = 0;
  @RBSData::FR.object12.classification = 0;
  @RBSData::FR.object12.radar_type = 0;
  @RBSData::FR.object12.dxN = 0;
  @RBSData::FR.object12.dyN = 0;
  @RBSData::FR.object12.dzN = 0;
  @RBSData::FR.object12.vxN = 0;
  @RBSData::FR.object12.vyN = 0;
  @RBSData::FR.object12.axN = 0;
  @RBSData::FR.object12.ayN = 0;
  @RBSData::FR.object12.dWidthN = 0;
  @RBSData::FR.object12.dLengthN = 0;
  @RBSData::FR.object12.rcsN = 0;
  }
  if(init_count == 189)
  {
  @RBSData::FR.object12.snrN = 0;
  @RBSData::FR.object12.alpPiYawAngleN = 0;
  @RBSData::FR.object12.signalStrengthN = 0;
  @RBSData::FR.object13.objID = 0;
  @RBSData::FR.object13.classification = 0;
  @RBSData::FR.object13.radar_type = 0;
  @RBSData::FR.object13.dxN = 0;
  @RBSData::FR.object13.dyN = 0;
  @RBSData::FR.object13.dzN = 0;
  @RBSData::FR.object13.vxN = 0;
  @RBSData::FR.object13.vyN = 0;
  @RBSData::FR.object13.axN = 0;
  @RBSData::FR.object13.ayN = 0;
  @RBSData::FR.object13.dWidthN = 0;
  @RBSData::FR.object13.dLengthN = 0;
  @RBSData::FR.object13.rcsN = 0;
  @RBSData::FR.object13.snrN = 0;
  @RBSData::FR.object13.alpPiYawAngleN = 0;
  @RBSData::FR.object13.signalStrengthN = 0;
  @RBSData::FR.object14.objID = 0;
  @RBSData::FR.object14.classification = 0;
  @RBSData::FR.object14.radar_type = 0;
  @RBSData::FR.object14.dxN = 0;
  @RBSData::FR.object14.dyN = 0;
  @RBSData::FR.object14.dzN = 0;
  }
  if(init_count == 190)
  {
  @RBSData::FR.object14.vxN = 0;
  @RBSData::FR.object14.vyN = 0;
  @RBSData::FR.object14.axN = 0;
  @RBSData::FR.object14.ayN = 0;
  @RBSData::FR.object14.dWidthN = 0;
  @RBSData::FR.object14.dLengthN = 0;
  @RBSData::FR.object14.rcsN = 0;
  @RBSData::FR.object14.snrN = 0;
  @RBSData::FR.object14.alpPiYawAngleN = 0;
  @RBSData::FR.object14.signalStrengthN = 0;
  @RBSData::FR.object15.objID = 0;
  @RBSData::FR.object15.classification = 0;
  @RBSData::FR.object15.radar_type = 0;
  @RBSData::FR.object15.dxN = 0;
  @RBSData::FR.object15.dyN = 0;
  @RBSData::FR.object15.dzN = 0;
  @RBSData::FR.object15.vxN = 0;
  @RBSData::FR.object15.vyN = 0;
  @RBSData::FR.object15.axN = 0;
  @RBSData::FR.object15.ayN = 0;
  @RBSData::FR.object15.dWidthN = 0;
  @RBSData::FR.object15.dLengthN = 0;
  @RBSData::FR.object15.rcsN = 0;
  @RBSData::FR.object15.snrN = 0;
  @RBSData::FR.object15.alpPiYawAngleN = 0;
  }
  if(init_count == 191)
  {
  @RBSData::FR.object15.signalStrengthN = 0;
  @RBSData::FR.object16.objID = 0;
  @RBSData::FR.object16.classification = 0;
  @RBSData::FR.object16.radar_type = 0;
  @RBSData::FR.object16.dxN = 0;
  @RBSData::FR.object16.dyN = 0;
  @RBSData::FR.object16.dzN = 0;
  @RBSData::FR.object16.vxN = 0;
  @RBSData::FR.object16.vyN = 0;
  @RBSData::FR.object16.axN = 0;
  @RBSData::FR.object16.ayN = 0;
  @RBSData::FR.object16.dWidthN = 0;
  @RBSData::FR.object16.dLengthN = 0;
  @RBSData::FR.object16.rcsN = 0;
  @RBSData::FR.object16.snrN = 0;
  @RBSData::FR.object16.alpPiYawAngleN = 0;
  @RBSData::FR.object16.signalStrengthN = 0;
  @RBSData::FR.object17.objID = 0;
  @RBSData::FR.object17.classification = 0;
  @RBSData::FR.object17.radar_type = 0;
  @RBSData::FR.object17.dxN = 0;
  @RBSData::FR.object17.dyN = 0;
  @RBSData::FR.object17.dzN = 0;
  @RBSData::FR.object17.vxN = 0;
  @RBSData::FR.object17.vyN = 0;
  }
  if(init_count == 192)
  {
  @RBSData::FR.object17.axN = 0;
  @RBSData::FR.object17.ayN = 0;
  @RBSData::FR.object17.dWidthN = 0;
  @RBSData::FR.object17.dLengthN = 0;
  @RBSData::FR.object17.rcsN = 0;
  @RBSData::FR.object17.snrN = 0;
  @RBSData::FR.object17.alpPiYawAngleN = 0;
  @RBSData::FR.object17.signalStrengthN = 0;
  @RBSData::FR.object18.objID = 0;
  @RBSData::FR.object18.classification = 0;
  @RBSData::FR.object18.radar_type = 0;
  @RBSData::FR.object18.dxN = 0;
  @RBSData::FR.object18.dyN = 0;
  @RBSData::FR.object18.dzN = 0;
  @RBSData::FR.object18.vxN = 0;
  @RBSData::FR.object18.vyN = 0;
  @RBSData::FR.object18.axN = 0;
  @RBSData::FR.object18.ayN = 0;
  @RBSData::FR.object18.dWidthN = 0;
  @RBSData::FR.object18.dLengthN = 0;
  @RBSData::FR.object18.rcsN = 0;
  @RBSData::FR.object18.snrN = 0;
  @RBSData::FR.object18.alpPiYawAngleN = 0;
  @RBSData::FR.object18.signalStrengthN = 0;
  @RBSData::FR.object19.objID = 0;
  }
  if(init_count == 193)
  {
  @RBSData::FR.object19.classification = 0;
  @RBSData::FR.object19.radar_type = 0;
  @RBSData::FR.object19.dxN = 0;
  @RBSData::FR.object19.dyN = 0;
  @RBSData::FR.object19.dzN = 0;
  @RBSData::FR.object19.vxN = 0;
  @RBSData::FR.object19.vyN = 0;
  @RBSData::FR.object19.axN = 0;
  @RBSData::FR.object19.ayN = 0;
  @RBSData::FR.object19.dWidthN = 0;
  @RBSData::FR.object19.dLengthN = 0;
  @RBSData::FR.object19.rcsN = 0;
  @RBSData::FR.object19.snrN = 0;
  @RBSData::FR.object19.alpPiYawAngleN = 0;
  @RBSData::FR.object19.signalStrengthN = 0;
  @RBSData::FR.object20.objID = 0;
  @RBSData::FR.object20.classification = 0;
  @RBSData::FR.object20.radar_type = 0;
  @RBSData::FR.object20.dxN = 0;
  @RBSData::FR.object20.dyN = 0;
  @RBSData::FR.object20.dzN = 0;
  @RBSData::FR.object20.vxN = 0;
  @RBSData::FR.object20.vyN = 0;
  @RBSData::FR.object20.axN = 0;
  @RBSData::FR.object20.ayN = 0;
  }
  if(init_count == 194)
  {
  @RBSData::FR.object20.dWidthN = 0;
  @RBSData::FR.object20.dLengthN = 0;
  @RBSData::FR.object20.rcsN = 0;
  @RBSData::FR.object20.snrN = 0;
  @RBSData::FR.object20.alpPiYawAngleN = 0;
  @RBSData::FR.object20.signalStrengthN = 0;
  @RBSData::FR.object21.objID = 0;
  @RBSData::FR.object21.classification = 0;
  @RBSData::FR.object21.radar_type = 0;
  @RBSData::FR.object21.dxN = 0;
  @RBSData::FR.object21.dyN = 0;
  @RBSData::FR.object21.dzN = 0;
  @RBSData::FR.object21.vxN = 0;
  @RBSData::FR.object21.vyN = 0;
  @RBSData::FR.object21.axN = 0;
  @RBSData::FR.object21.ayN = 0;
  @RBSData::FR.object21.dWidthN = 0;
  @RBSData::FR.object21.dLengthN = 0;
  @RBSData::FR.object21.rcsN = 0;
  @RBSData::FR.object21.snrN = 0;
  @RBSData::FR.object21.alpPiYawAngleN = 0;
  @RBSData::FR.object21.signalStrengthN = 0;
  @RBSData::FR.object22.objID = 0;
  @RBSData::FR.object22.classification = 0;
  @RBSData::FR.object22.radar_type = 0;
  }
  if(init_count == 195)
  {
  @RBSData::FR.object22.dxN = 0;
  @RBSData::FR.object22.dyN = 0;
  @RBSData::FR.object22.dzN = 0;
  @RBSData::FR.object22.vxN = 0;
  @RBSData::FR.object22.vyN = 0;
  @RBSData::FR.object22.axN = 0;
  @RBSData::FR.object22.ayN = 0;
  @RBSData::FR.object22.dWidthN = 0;
  @RBSData::FR.object22.dLengthN = 0;
  @RBSData::FR.object22.rcsN = 0;
  @RBSData::FR.object22.snrN = 0;
  @RBSData::FR.object22.alpPiYawAngleN = 0;
  @RBSData::FR.object22.signalStrengthN = 0;
  @RBSData::FR.object23.objID = 0;
  @RBSData::FR.object23.classification = 0;
  @RBSData::FR.object23.radar_type = 0;
  @RBSData::FR.object23.dxN = 0;
  @RBSData::FR.object23.dyN = 0;
  @RBSData::FR.object23.dzN = 0;
  @RBSData::FR.object23.vxN = 0;
  @RBSData::FR.object23.vyN = 0;
  @RBSData::FR.object23.axN = 0;
  @RBSData::FR.object23.ayN = 0;
  @RBSData::FR.object23.dWidthN = 0;
  @RBSData::FR.object23.dLengthN = 0;
  }
  if(init_count == 196)
  {
  @RBSData::FR.object23.rcsN = 0;
  @RBSData::FR.object23.snrN = 0;
  @RBSData::FR.object23.alpPiYawAngleN = 0;
  @RBSData::FR.object23.signalStrengthN = 0;
  @RBSData::FR.object24.objID = 0;
  @RBSData::FR.object24.classification = 0;
  @RBSData::FR.object24.radar_type = 0;
  @RBSData::FR.object24.dxN = 0;
  @RBSData::FR.object24.dyN = 0;
  @RBSData::FR.object24.dzN = 0;
  @RBSData::FR.object24.vxN = 0;
  @RBSData::FR.object24.vyN = 0;
  @RBSData::FR.object24.axN = 0;
  @RBSData::FR.object24.ayN = 0;
  @RBSData::FR.object24.dWidthN = 0;
  @RBSData::FR.object24.dLengthN = 0;
  @RBSData::FR.object24.rcsN = 0;
  @RBSData::FR.object24.snrN = 0;
  @RBSData::FR.object24.alpPiYawAngleN = 0;
  @RBSData::FR.object24.signalStrengthN = 0;
  @RBSData::FR.object25.objID = 0;
  @RBSData::FR.object25.classification = 0;
  @RBSData::FR.object25.radar_type = 0;
  @RBSData::FR.object25.dxN = 0;
  @RBSData::FR.object25.dyN = 0;
  }
  if(init_count == 197)
  {
  @RBSData::FR.object25.dzN = 0;
  @RBSData::FR.object25.vxN = 0;
  @RBSData::FR.object25.vyN = 0;
  @RBSData::FR.object25.axN = 0;
  @RBSData::FR.object25.ayN = 0;
  @RBSData::FR.object25.dWidthN = 0;
  @RBSData::FR.object25.dLengthN = 0;
  @RBSData::FR.object25.rcsN = 0;
  @RBSData::FR.object25.snrN = 0;
  @RBSData::FR.object25.alpPiYawAngleN = 0;
  @RBSData::FR.object25.signalStrengthN = 0;
  @RBSData::FR.object26.objID = 0;
  @RBSData::FR.object26.classification = 0;
  @RBSData::FR.object26.radar_type = 0;
  @RBSData::FR.object26.dxN = 0;
  @RBSData::FR.object26.dyN = 0;
  @RBSData::FR.object26.dzN = 0;
  @RBSData::FR.object26.vxN = 0;
  @RBSData::FR.object26.vyN = 0;
  @RBSData::FR.object26.axN = 0;
  @RBSData::FR.object26.ayN = 0;
  @RBSData::FR.object26.dWidthN = 0;
  @RBSData::FR.object26.dLengthN = 0;
  @RBSData::FR.object26.rcsN = 0;
  @RBSData::FR.object26.snrN = 0;
  }
  if(init_count == 198)
  {
  @RBSData::FR.object26.alpPiYawAngleN = 0;
  @RBSData::FR.object26.signalStrengthN = 0;
  @RBSData::FR.object27.objID = 0;
  @RBSData::FR.object27.classification = 0;
  @RBSData::FR.object27.radar_type = 0;
  @RBSData::FR.object27.dxN = 0;
  @RBSData::FR.object27.dyN = 0;
  @RBSData::FR.object27.dzN = 0;
  @RBSData::FR.object27.vxN = 0;
  @RBSData::FR.object27.vyN = 0;
  @RBSData::FR.object27.axN = 0;
  @RBSData::FR.object27.ayN = 0;
  @RBSData::FR.object27.dWidthN = 0;
  @RBSData::FR.object27.dLengthN = 0;
  @RBSData::FR.object27.rcsN = 0;
  @RBSData::FR.object27.snrN = 0;
  @RBSData::FR.object27.alpPiYawAngleN = 0;
  @RBSData::FR.object27.signalStrengthN = 0;
  @RBSData::FR.object28.objID = 0;
  @RBSData::FR.object28.classification = 0;
  @RBSData::FR.object28.radar_type = 0;
  @RBSData::FR.object28.dxN = 0;
  @RBSData::FR.object28.dyN = 0;
  @RBSData::FR.object28.dzN = 0;
  @RBSData::FR.object28.vxN = 0;
  }
  if(init_count == 199)
  {
  @RBSData::FR.object28.vyN = 0;
  @RBSData::FR.object28.axN = 0;
  @RBSData::FR.object28.ayN = 0;
  @RBSData::FR.object28.dWidthN = 0;
  @RBSData::FR.object28.dLengthN = 0;
  @RBSData::FR.object28.rcsN = 0;
  @RBSData::FR.object28.snrN = 0;
  @RBSData::FR.object28.alpPiYawAngleN = 0;
  @RBSData::FR.object28.signalStrengthN = 0;
  @RBSData::FR.object29.objID = 0;
  @RBSData::FR.object29.classification = 0;
  @RBSData::FR.object29.radar_type = 0;
  @RBSData::FR.object29.dxN = 0;
  @RBSData::FR.object29.dyN = 0;
  @RBSData::FR.object29.dzN = 0;
  @RBSData::FR.object29.vxN = 0;
  @RBSData::FR.object29.vyN = 0;
  @RBSData::FR.object29.axN = 0;
  @RBSData::FR.object29.ayN = 0;
  @RBSData::FR.object29.dWidthN = 0;
  @RBSData::FR.object29.dLengthN = 0;
  @RBSData::FR.object29.rcsN = 0;
  @RBSData::FR.object29.snrN = 0;
  @RBSData::FR.object29.alpPiYawAngleN = 0;
  @RBSData::FR.object29.signalStrengthN = 0;
  }
  if(init_count == 200)
  {
  @RBSData::FR.object30.objID = 0;
  @RBSData::FR.object30.classification = 0;
  @RBSData::FR.object30.radar_type = 0;
  @RBSData::FR.object30.dxN = 0;
  @RBSData::FR.object30.dyN = 0;
  @RBSData::FR.object30.dzN = 0;
  @RBSData::FR.object30.vxN = 0;
  @RBSData::FR.object30.vyN = 0;
  @RBSData::FR.object30.axN = 0;
  @RBSData::FR.object30.ayN = 0;
  @RBSData::FR.object30.dWidthN = 0;
  @RBSData::FR.object30.dLengthN = 0;
  @RBSData::FR.object30.rcsN = 0;
  @RBSData::FR.object30.snrN = 0;
  @RBSData::FR.object30.alpPiYawAngleN = 0;
  @RBSData::FR.object30.signalStrengthN = 0;
  @RBSData::FR.object31.objID = 0;
  @RBSData::FR.object31.classification = 0;
  @RBSData::FR.object31.radar_type = 0;
  @RBSData::FR.object31.dxN = 0;
  @RBSData::FR.object31.dyN = 0;
  @RBSData::FR.object31.dzN = 0;
  @RBSData::FR.object31.vxN = 0;
  @RBSData::FR.object31.vyN = 0;
  @RBSData::FR.object31.axN = 0;
  }
  if(init_count == 201)
  {
  @RBSData::FR.object31.ayN = 0;
  @RBSData::FR.object31.dWidthN = 0;
  @RBSData::FR.object31.dLengthN = 0;
  @RBSData::FR.object31.rcsN = 0;
  @RBSData::FR.object31.snrN = 0;
  @RBSData::FR.object31.alpPiYawAngleN = 0;
  @RBSData::FR.object31.signalStrengthN = 0;
  @RBSData::FR.object32.objID = 0;
  @RBSData::FR.object32.classification = 0;
  @RBSData::FR.object32.radar_type = 0;
  @RBSData::FR.object32.dxN = 0;
  @RBSData::FR.object32.dyN = 0;
  @RBSData::FR.object32.dzN = 0;
  @RBSData::FR.object32.vxN = 0;
  @RBSData::FR.object32.vyN = 0;
  @RBSData::FR.object32.axN = 0;
  @RBSData::FR.object32.ayN = 0;
  @RBSData::FR.object32.dWidthN = 0;
  @RBSData::FR.object32.dLengthN = 0;
  @RBSData::FR.object32.rcsN = 0;
  @RBSData::FR.object32.snrN = 0;
  @RBSData::FR.object32.alpPiYawAngleN = 0;
  @RBSData::FR.object32.signalStrengthN = 0;
  @RBSData::FR.object33.objID = 0;
  @RBSData::FR.object33.classification = 0;
  }
  if(init_count == 202)
  {
  @RBSData::FR.object33.radar_type = 0;
  @RBSData::FR.object33.dxN = 0;
  @RBSData::FR.object33.dyN = 0;
  @RBSData::FR.object33.dzN = 0;
  @RBSData::FR.object33.vxN = 0;
  @RBSData::FR.object33.vyN = 0;
  @RBSData::FR.object33.axN = 0;
  @RBSData::FR.object33.ayN = 0;
  @RBSData::FR.object33.dWidthN = 0;
  @RBSData::FR.object33.dLengthN = 0;
  @RBSData::FR.object33.rcsN = 0;
  @RBSData::FR.object33.snrN = 0;
  @RBSData::FR.object33.alpPiYawAngleN = 0;
  @RBSData::FR.object33.signalStrengthN = 0;
  @RBSData::FR.object34.objID = 0;
  @RBSData::FR.object34.classification = 0;
  @RBSData::FR.object34.radar_type = 0;
  @RBSData::FR.object34.dxN = 0;
  @RBSData::FR.object34.dyN = 0;
  @RBSData::FR.object34.dzN = 0;
  @RBSData::FR.object34.vxN = 0;
  @RBSData::FR.object34.vyN = 0;
  @RBSData::FR.object34.axN = 0;
  @RBSData::FR.object34.ayN = 0;
  @RBSData::FR.object34.dWidthN = 0;
  }
  if(init_count == 203)
  {
  @RBSData::FR.object34.dLengthN = 0;
  @RBSData::FR.object34.rcsN = 0;
  @RBSData::FR.object34.snrN = 0;
  @RBSData::FR.object34.alpPiYawAngleN = 0;
  @RBSData::FR.object34.signalStrengthN = 0;
  @RBSData::FR.object35.objID = 0;
  @RBSData::FR.object35.classification = 0;
  @RBSData::FR.object35.radar_type = 0;
  @RBSData::FR.object35.dxN = 0;
  @RBSData::FR.object35.dyN = 0;
  @RBSData::FR.object35.dzN = 0;
  @RBSData::FR.object35.vxN = 0;
  @RBSData::FR.object35.vyN = 0;
  @RBSData::FR.object35.axN = 0;
  @RBSData::FR.object35.ayN = 0;
  @RBSData::FR.object35.dWidthN = 0;
  @RBSData::FR.object35.dLengthN = 0;
  @RBSData::FR.object35.rcsN = 0;
  @RBSData::FR.object35.snrN = 0;
  @RBSData::FR.object35.alpPiYawAngleN = 0;
  @RBSData::FR.object35.signalStrengthN = 0;
  @RBSData::FR.object36.objID = 0;
  @RBSData::FR.object36.classification = 0;
  @RBSData::FR.object36.radar_type = 0;
  @RBSData::FR.object36.dxN = 0;
  }
  if(init_count == 204)
  {
  @RBSData::FR.object36.dyN = 0;
  @RBSData::FR.object36.dzN = 0;
  @RBSData::FR.object36.vxN = 0;
  @RBSData::FR.object36.vyN = 0;
  @RBSData::FR.object36.axN = 0;
  @RBSData::FR.object36.ayN = 0;
  @RBSData::FR.object36.dWidthN = 0;
  @RBSData::FR.object36.dLengthN = 0;
  @RBSData::FR.object36.rcsN = 0;
  @RBSData::FR.object36.snrN = 0;
  @RBSData::FR.object36.alpPiYawAngleN = 0;
  @RBSData::FR.object36.signalStrengthN = 0;
  @RBSData::FR.object37.objID = 0;
  @RBSData::FR.object37.classification = 0;
  @RBSData::FR.object37.radar_type = 0;
  @RBSData::FR.object37.dxN = 0;
  @RBSData::FR.object37.dyN = 0;
  @RBSData::FR.object37.dzN = 0;
  @RBSData::FR.object37.vxN = 0;
  @RBSData::FR.object37.vyN = 0;
  @RBSData::FR.object37.axN = 0;
  @RBSData::FR.object37.ayN = 0;
  @RBSData::FR.object37.dWidthN = 0;
  @RBSData::FR.object37.dLengthN = 0;
  @RBSData::FR.object37.rcsN = 0;
  }
  if(init_count == 205)
  {
  @RBSData::FR.object37.snrN = 0;
  @RBSData::FR.object37.alpPiYawAngleN = 0;
  @RBSData::FR.object37.signalStrengthN = 0;
  @RBSData::FR.object38.objID = 0;
  @RBSData::FR.object38.classification = 0;
  @RBSData::FR.object38.radar_type = 0;
  @RBSData::FR.object38.dxN = 0;
  @RBSData::FR.object38.dyN = 0;
  @RBSData::FR.object38.dzN = 0;
  @RBSData::FR.object38.vxN = 0;
  @RBSData::FR.object38.vyN = 0;
  @RBSData::FR.object38.axN = 0;
  @RBSData::FR.object38.ayN = 0;
  @RBSData::FR.object38.dWidthN = 0;
  @RBSData::FR.object38.dLengthN = 0;
  @RBSData::FR.object38.rcsN = 0;
  @RBSData::FR.object38.snrN = 0;
  @RBSData::FR.object38.alpPiYawAngleN = 0;
  @RBSData::FR.object38.signalStrengthN = 0;
  @RBSData::FR.object39.objID = 0;
  @RBSData::FR.object39.classification = 0;
  @RBSData::FR.object39.radar_type = 0;
  @RBSData::FR.object39.dxN = 0;
  @RBSData::FR.object39.dyN = 0;
  @RBSData::FR.object39.dzN = 0;
  }
  if(init_count == 206)
  {
  @RBSData::FR.object39.vxN = 0;
  @RBSData::FR.object39.vyN = 0;
  @RBSData::FR.object39.axN = 0;
  @RBSData::FR.object39.ayN = 0;
  @RBSData::FR.object39.dWidthN = 0;
  @RBSData::FR.object39.dLengthN = 0;
  @RBSData::FR.object39.rcsN = 0;
  @RBSData::FR.object39.snrN = 0;
  @RBSData::FR.object39.alpPiYawAngleN = 0;
  @RBSData::FR.object39.signalStrengthN = 0;
  @RBSData::RL.mountPosX = 0;
  @RBSData::RL.mountPosY = 0;
  @RBSData::RL.mountPosZ = 0;
  @RBSData::RL.sensorBlocked = 0;
  @RBSData::RL.objectCount = 0;
  @RBSData::RL.object0.objID = 0;
  @RBSData::RL.object0.classification = 0;
  @RBSData::RL.object0.radar_type = 0;
  @RBSData::RL.object0.dxN = 0;
  @RBSData::RL.object0.dyN = 0;
  @RBSData::RL.object0.dzN = 0;
  @RBSData::RL.object0.vxN = 0;
  @RBSData::RL.object0.vyN = 0;
  @RBSData::RL.object0.axN = 0;
  @RBSData::RL.object0.ayN = 0;
  }
  if(init_count == 207)
  {
  @RBSData::RL.object0.dWidthN = 0;
  @RBSData::RL.object0.dLengthN = 0;
  @RBSData::RL.object0.rcsN = 0;
  @RBSData::RL.object0.snrN = 0;
  @RBSData::RL.object0.alpPiYawAngleN = 0;
  @RBSData::RL.object0.signalStrengthN = 0;
  @RBSData::RL.object1.objID = 0;
  @RBSData::RL.object1.classification = 0;
  @RBSData::RL.object1.radar_type = 0;
  @RBSData::RL.object1.dxN = 0;
  @RBSData::RL.object1.dyN = 0;
  @RBSData::RL.object1.dzN = 0;
  @RBSData::RL.object1.vxN = 0;
  @RBSData::RL.object1.vyN = 0;
  @RBSData::RL.object1.axN = 0;
  @RBSData::RL.object1.ayN = 0;
  @RBSData::RL.object1.dWidthN = 0;
  @RBSData::RL.object1.dLengthN = 0;
  @RBSData::RL.object1.rcsN = 0;
  @RBSData::RL.object1.snrN = 0;
  @RBSData::RL.object1.alpPiYawAngleN = 0;
  @RBSData::RL.object1.signalStrengthN = 0;
  @RBSData::RL.object2.objID = 0;
  @RBSData::RL.object2.classification = 0;
  @RBSData::RL.object2.radar_type = 0;
  }
  if(init_count == 208)
  {
  @RBSData::RL.object2.dxN = 0;
  @RBSData::RL.object2.dyN = 0;
  @RBSData::RL.object2.dzN = 0;
  @RBSData::RL.object2.vxN = 0;
  @RBSData::RL.object2.vyN = 0;
  @RBSData::RL.object2.axN = 0;
  @RBSData::RL.object2.ayN = 0;
  @RBSData::RL.object2.dWidthN = 0;
  @RBSData::RL.object2.dLengthN = 0;
  @RBSData::RL.object2.rcsN = 0;
  @RBSData::RL.object2.snrN = 0;
  @RBSData::RL.object2.alpPiYawAngleN = 0;
  @RBSData::RL.object2.signalStrengthN = 0;
  @RBSData::RL.object3.objID = 0;
  @RBSData::RL.object3.classification = 0;
  @RBSData::RL.object3.radar_type = 0;
  @RBSData::RL.object3.dxN = 0;
  @RBSData::RL.object3.dyN = 0;
  @RBSData::RL.object3.dzN = 0;
  @RBSData::RL.object3.vxN = 0;
  @RBSData::RL.object3.vyN = 0;
  @RBSData::RL.object3.axN = 0;
  @RBSData::RL.object3.ayN = 0;
  @RBSData::RL.object3.dWidthN = 0;
  @RBSData::RL.object3.dLengthN = 0;
  }
  if(init_count == 209)
  {
  @RBSData::RL.object3.rcsN = 0;
  @RBSData::RL.object3.snrN = 0;
  @RBSData::RL.object3.alpPiYawAngleN = 0;
  @RBSData::RL.object3.signalStrengthN = 0;
  @RBSData::RL.object4.objID = 0;
  @RBSData::RL.object4.classification = 0;
  @RBSData::RL.object4.radar_type = 0;
  @RBSData::RL.object4.dxN = 0;
  @RBSData::RL.object4.dyN = 0;
  @RBSData::RL.object4.dzN = 0;
  @RBSData::RL.object4.vxN = 0;
  @RBSData::RL.object4.vyN = 0;
  @RBSData::RL.object4.axN = 0;
  @RBSData::RL.object4.ayN = 0;
  @RBSData::RL.object4.dWidthN = 0;
  @RBSData::RL.object4.dLengthN = 0;
  @RBSData::RL.object4.rcsN = 0;
  @RBSData::RL.object4.snrN = 0;
  @RBSData::RL.object4.alpPiYawAngleN = 0;
  @RBSData::RL.object4.signalStrengthN = 0;
  @RBSData::RL.object5.objID = 0;
  @RBSData::RL.object5.classification = 0;
  @RBSData::RL.object5.radar_type = 0;
  @RBSData::RL.object5.dxN = 0;
  @RBSData::RL.object5.dyN = 0;
  }
  if(init_count == 210)
  {
  @RBSData::RL.object5.dzN = 0;
  @RBSData::RL.object5.vxN = 0;
  @RBSData::RL.object5.vyN = 0;
  @RBSData::RL.object5.axN = 0;
  @RBSData::RL.object5.ayN = 0;
  @RBSData::RL.object5.dWidthN = 0;
  @RBSData::RL.object5.dLengthN = 0;
  @RBSData::RL.object5.rcsN = 0;
  @RBSData::RL.object5.snrN = 0;
  @RBSData::RL.object5.alpPiYawAngleN = 0;
  @RBSData::RL.object5.signalStrengthN = 0;
  @RBSData::RL.object6.objID = 0;
  @RBSData::RL.object6.classification = 0;
  @RBSData::RL.object6.radar_type = 0;
  @RBSData::RL.object6.dxN = 0;
  @RBSData::RL.object6.dyN = 0;
  @RBSData::RL.object6.dzN = 0;
  @RBSData::RL.object6.vxN = 0;
  @RBSData::RL.object6.vyN = 0;
  @RBSData::RL.object6.axN = 0;
  @RBSData::RL.object6.ayN = 0;
  @RBSData::RL.object6.dWidthN = 0;
  @RBSData::RL.object6.dLengthN = 0;
  @RBSData::RL.object6.rcsN = 0;
  @RBSData::RL.object6.snrN = 0;
  }
  if(init_count == 211)
  {
  @RBSData::RL.object6.alpPiYawAngleN = 0;
  @RBSData::RL.object6.signalStrengthN = 0;
  @RBSData::RL.object7.objID = 0;
  @RBSData::RL.object7.classification = 0;
  @RBSData::RL.object7.radar_type = 0;
  @RBSData::RL.object7.dxN = 0;
  @RBSData::RL.object7.dyN = 0;
  @RBSData::RL.object7.dzN = 0;
  @RBSData::RL.object7.vxN = 0;
  @RBSData::RL.object7.vyN = 0;
  @RBSData::RL.object7.axN = 0;
  @RBSData::RL.object7.ayN = 0;
  @RBSData::RL.object7.dWidthN = 0;
  @RBSData::RL.object7.dLengthN = 0;
  @RBSData::RL.object7.rcsN = 0;
  @RBSData::RL.object7.snrN = 0;
  @RBSData::RL.object7.alpPiYawAngleN = 0;
  @RBSData::RL.object7.signalStrengthN = 0;
  @RBSData::RL.object8.objID = 0;
  @RBSData::RL.object8.classification = 0;
  @RBSData::RL.object8.radar_type = 0;
  @RBSData::RL.object8.dxN = 0;
  @RBSData::RL.object8.dyN = 0;
  @RBSData::RL.object8.dzN = 0;
  @RBSData::RL.object8.vxN = 0;
  }
  if(init_count == 212)
  {
  @RBSData::RL.object8.vyN = 0;
  @RBSData::RL.object8.axN = 0;
  @RBSData::RL.object8.ayN = 0;
  @RBSData::RL.object8.dWidthN = 0;
  @RBSData::RL.object8.dLengthN = 0;
  @RBSData::RL.object8.rcsN = 0;
  @RBSData::RL.object8.snrN = 0;
  @RBSData::RL.object8.alpPiYawAngleN = 0;
  @RBSData::RL.object8.signalStrengthN = 0;
  @RBSData::RL.object9.objID = 0;
  @RBSData::RL.object9.classification = 0;
  @RBSData::RL.object9.radar_type = 0;
  @RBSData::RL.object9.dxN = 0;
  @RBSData::RL.object9.dyN = 0;
  @RBSData::RL.object9.dzN = 0;
  @RBSData::RL.object9.vxN = 0;
  @RBSData::RL.object9.vyN = 0;
  @RBSData::RL.object9.axN = 0;
  @RBSData::RL.object9.ayN = 0;
  @RBSData::RL.object9.dWidthN = 0;
  @RBSData::RL.object9.dLengthN = 0;
  @RBSData::RL.object9.rcsN = 0;
  @RBSData::RL.object9.snrN = 0;
  @RBSData::RL.object9.alpPiYawAngleN = 0;
  @RBSData::RL.object9.signalStrengthN = 0;
  }
  if(init_count == 213)
  {
  @RBSData::RL.object10.objID = 0;
  @RBSData::RL.object10.classification = 0;
  @RBSData::RL.object10.radar_type = 0;
  @RBSData::RL.object10.dxN = 0;
  @RBSData::RL.object10.dyN = 0;
  @RBSData::RL.object10.dzN = 0;
  @RBSData::RL.object10.vxN = 0;
  @RBSData::RL.object10.vyN = 0;
  @RBSData::RL.object10.axN = 0;
  @RBSData::RL.object10.ayN = 0;
  @RBSData::RL.object10.dWidthN = 0;
  @RBSData::RL.object10.dLengthN = 0;
  @RBSData::RL.object10.rcsN = 0;
  @RBSData::RL.object10.snrN = 0;
  @RBSData::RL.object10.alpPiYawAngleN = 0;
  @RBSData::RL.object10.signalStrengthN = 0;
  @RBSData::RL.object11.objID = 0;
  @RBSData::RL.object11.classification = 0;
  @RBSData::RL.object11.radar_type = 0;
  @RBSData::RL.object11.dxN = 0;
  @RBSData::RL.object11.dyN = 0;
  @RBSData::RL.object11.dzN = 0;
  @RBSData::RL.object11.vxN = 0;
  @RBSData::RL.object11.vyN = 0;
  @RBSData::RL.object11.axN = 0;
  }
  if(init_count == 214)
  {
  @RBSData::RL.object11.ayN = 0;
  @RBSData::RL.object11.dWidthN = 0;
  @RBSData::RL.object11.dLengthN = 0;
  @RBSData::RL.object11.rcsN = 0;
  @RBSData::RL.object11.snrN = 0;
  @RBSData::RL.object11.alpPiYawAngleN = 0;
  @RBSData::RL.object11.signalStrengthN = 0;
  @RBSData::RL.object12.objID = 0;
  @RBSData::RL.object12.classification = 0;
  @RBSData::RL.object12.radar_type = 0;
  @RBSData::RL.object12.dxN = 0;
  @RBSData::RL.object12.dyN = 0;
  @RBSData::RL.object12.dzN = 0;
  @RBSData::RL.object12.vxN = 0;
  @RBSData::RL.object12.vyN = 0;
  @RBSData::RL.object12.axN = 0;
  @RBSData::RL.object12.ayN = 0;
  @RBSData::RL.object12.dWidthN = 0;
  @RBSData::RL.object12.dLengthN = 0;
  @RBSData::RL.object12.rcsN = 0;
  @RBSData::RL.object12.snrN = 0;
  @RBSData::RL.object12.alpPiYawAngleN = 0;
  @RBSData::RL.object12.signalStrengthN = 0;
  @RBSData::RL.object13.objID = 0;
  @RBSData::RL.object13.classification = 0;
  }
  if(init_count == 215)
  {
  @RBSData::RL.object13.radar_type = 0;
  @RBSData::RL.object13.dxN = 0;
  @RBSData::RL.object13.dyN = 0;
  @RBSData::RL.object13.dzN = 0;
  @RBSData::RL.object13.vxN = 0;
  @RBSData::RL.object13.vyN = 0;
  @RBSData::RL.object13.axN = 0;
  @RBSData::RL.object13.ayN = 0;
  @RBSData::RL.object13.dWidthN = 0;
  @RBSData::RL.object13.dLengthN = 0;
  @RBSData::RL.object13.rcsN = 0;
  @RBSData::RL.object13.snrN = 0;
  @RBSData::RL.object13.alpPiYawAngleN = 0;
  @RBSData::RL.object13.signalStrengthN = 0;
  @RBSData::RL.object14.objID = 0;
  @RBSData::RL.object14.classification = 0;
  @RBSData::RL.object14.radar_type = 0;
  @RBSData::RL.object14.dxN = 0;
  @RBSData::RL.object14.dyN = 0;
  @RBSData::RL.object14.dzN = 0;
  @RBSData::RL.object14.vxN = 0;
  @RBSData::RL.object14.vyN = 0;
  @RBSData::RL.object14.axN = 0;
  @RBSData::RL.object14.ayN = 0;
  @RBSData::RL.object14.dWidthN = 0;
  }
  if(init_count == 216)
  {
  @RBSData::RL.object14.dLengthN = 0;
  @RBSData::RL.object14.rcsN = 0;
  @RBSData::RL.object14.snrN = 0;
  @RBSData::RL.object14.alpPiYawAngleN = 0;
  @RBSData::RL.object14.signalStrengthN = 0;
  @RBSData::RL.object15.objID = 0;
  @RBSData::RL.object15.classification = 0;
  @RBSData::RL.object15.radar_type = 0;
  @RBSData::RL.object15.dxN = 0;
  @RBSData::RL.object15.dyN = 0;
  @RBSData::RL.object15.dzN = 0;
  @RBSData::RL.object15.vxN = 0;
  @RBSData::RL.object15.vyN = 0;
  @RBSData::RL.object15.axN = 0;
  @RBSData::RL.object15.ayN = 0;
  @RBSData::RL.object15.dWidthN = 0;
  @RBSData::RL.object15.dLengthN = 0;
  @RBSData::RL.object15.rcsN = 0;
  @RBSData::RL.object15.snrN = 0;
  @RBSData::RL.object15.alpPiYawAngleN = 0;
  @RBSData::RL.object15.signalStrengthN = 0;
  @RBSData::RL.object16.objID = 0;
  @RBSData::RL.object16.classification = 0;
  @RBSData::RL.object16.radar_type = 0;
  @RBSData::RL.object16.dxN = 0;
  }
  if(init_count == 217)
  {
  @RBSData::RL.object16.dyN = 0;
  @RBSData::RL.object16.dzN = 0;
  @RBSData::RL.object16.vxN = 0;
  @RBSData::RL.object16.vyN = 0;
  @RBSData::RL.object16.axN = 0;
  @RBSData::RL.object16.ayN = 0;
  @RBSData::RL.object16.dWidthN = 0;
  @RBSData::RL.object16.dLengthN = 0;
  @RBSData::RL.object16.rcsN = 0;
  @RBSData::RL.object16.snrN = 0;
  @RBSData::RL.object16.alpPiYawAngleN = 0;
  @RBSData::RL.object16.signalStrengthN = 0;
  @RBSData::RL.object17.objID = 0;
  @RBSData::RL.object17.classification = 0;
  @RBSData::RL.object17.radar_type = 0;
  @RBSData::RL.object17.dxN = 0;
  @RBSData::RL.object17.dyN = 0;
  @RBSData::RL.object17.dzN = 0;
  @RBSData::RL.object17.vxN = 0;
  @RBSData::RL.object17.vyN = 0;
  @RBSData::RL.object17.axN = 0;
  @RBSData::RL.object17.ayN = 0;
  @RBSData::RL.object17.dWidthN = 0;
  @RBSData::RL.object17.dLengthN = 0;
  @RBSData::RL.object17.rcsN = 0;
  }
  if(init_count == 218)
  {
  @RBSData::RL.object17.snrN = 0;
  @RBSData::RL.object17.alpPiYawAngleN = 0;
  @RBSData::RL.object17.signalStrengthN = 0;
  @RBSData::RL.object18.objID = 0;
  @RBSData::RL.object18.classification = 0;
  @RBSData::RL.object18.radar_type = 0;
  @RBSData::RL.object18.dxN = 0;
  @RBSData::RL.object18.dyN = 0;
  @RBSData::RL.object18.dzN = 0;
  @RBSData::RL.object18.vxN = 0;
  @RBSData::RL.object18.vyN = 0;
  @RBSData::RL.object18.axN = 0;
  @RBSData::RL.object18.ayN = 0;
  @RBSData::RL.object18.dWidthN = 0;
  @RBSData::RL.object18.dLengthN = 0;
  @RBSData::RL.object18.rcsN = 0;
  @RBSData::RL.object18.snrN = 0;
  @RBSData::RL.object18.alpPiYawAngleN = 0;
  @RBSData::RL.object18.signalStrengthN = 0;
  @RBSData::RL.object19.objID = 0;
  @RBSData::RL.object19.classification = 0;
  @RBSData::RL.object19.radar_type = 0;
  @RBSData::RL.object19.dxN = 0;
  @RBSData::RL.object19.dyN = 0;
  @RBSData::RL.object19.dzN = 0;
  }
  if(init_count == 219)
  {
  @RBSData::RL.object19.vxN = 0;
  @RBSData::RL.object19.vyN = 0;
  @RBSData::RL.object19.axN = 0;
  @RBSData::RL.object19.ayN = 0;
  @RBSData::RL.object19.dWidthN = 0;
  @RBSData::RL.object19.dLengthN = 0;
  @RBSData::RL.object19.rcsN = 0;
  @RBSData::RL.object19.snrN = 0;
  @RBSData::RL.object19.alpPiYawAngleN = 0;
  @RBSData::RL.object19.signalStrengthN = 0;
  @RBSData::RL.object20.objID = 0;
  @RBSData::RL.object20.classification = 0;
  @RBSData::RL.object20.radar_type = 0;
  @RBSData::RL.object20.dxN = 0;
  @RBSData::RL.object20.dyN = 0;
  @RBSData::RL.object20.dzN = 0;
  @RBSData::RL.object20.vxN = 0;
  @RBSData::RL.object20.vyN = 0;
  @RBSData::RL.object20.axN = 0;
  @RBSData::RL.object20.ayN = 0;
  @RBSData::RL.object20.dWidthN = 0;
  @RBSData::RL.object20.dLengthN = 0;
  @RBSData::RL.object20.rcsN = 0;
  @RBSData::RL.object20.snrN = 0;
  @RBSData::RL.object20.alpPiYawAngleN = 0;
  }
  if(init_count == 220)
  {
  @RBSData::RL.object20.signalStrengthN = 0;
  @RBSData::RL.object21.objID = 0;
  @RBSData::RL.object21.classification = 0;
  @RBSData::RL.object21.radar_type = 0;
  @RBSData::RL.object21.dxN = 0;
  @RBSData::RL.object21.dyN = 0;
  @RBSData::RL.object21.dzN = 0;
  @RBSData::RL.object21.vxN = 0;
  @RBSData::RL.object21.vyN = 0;
  @RBSData::RL.object21.axN = 0;
  @RBSData::RL.object21.ayN = 0;
  @RBSData::RL.object21.dWidthN = 0;
  @RBSData::RL.object21.dLengthN = 0;
  @RBSData::RL.object21.rcsN = 0;
  @RBSData::RL.object21.snrN = 0;
  @RBSData::RL.object21.alpPiYawAngleN = 0;
  @RBSData::RL.object21.signalStrengthN = 0;
  @RBSData::RL.object22.objID = 0;
  @RBSData::RL.object22.classification = 0;
  @RBSData::RL.object22.radar_type = 0;
  @RBSData::RL.object22.dxN = 0;
  @RBSData::RL.object22.dyN = 0;
  @RBSData::RL.object22.dzN = 0;
  @RBSData::RL.object22.vxN = 0;
  @RBSData::RL.object22.vyN = 0;
  }
  if(init_count == 221)
  {
  @RBSData::RL.object22.axN = 0;
  @RBSData::RL.object22.ayN = 0;
  @RBSData::RL.object22.dWidthN = 0;
  @RBSData::RL.object22.dLengthN = 0;
  @RBSData::RL.object22.rcsN = 0;
  @RBSData::RL.object22.snrN = 0;
  @RBSData::RL.object22.alpPiYawAngleN = 0;
  @RBSData::RL.object22.signalStrengthN = 0;
  @RBSData::RL.object23.objID = 0;
  @RBSData::RL.object23.classification = 0;
  @RBSData::RL.object23.radar_type = 0;
  @RBSData::RL.object23.dxN = 0;
  @RBSData::RL.object23.dyN = 0;
  @RBSData::RL.object23.dzN = 0;
  @RBSData::RL.object23.vxN = 0;
  @RBSData::RL.object23.vyN = 0;
  @RBSData::RL.object23.axN = 0;
  @RBSData::RL.object23.ayN = 0;
  @RBSData::RL.object23.dWidthN = 0;
  @RBSData::RL.object23.dLengthN = 0;
  @RBSData::RL.object23.rcsN = 0;
  @RBSData::RL.object23.snrN = 0;
  @RBSData::RL.object23.alpPiYawAngleN = 0;
  @RBSData::RL.object23.signalStrengthN = 0;
  @RBSData::RL.object24.objID = 0;
  }
  if(init_count == 222)
  {
  @RBSData::RL.object24.classification = 0;
  @RBSData::RL.object24.radar_type = 0;
  @RBSData::RL.object24.dxN = 0;
  @RBSData::RL.object24.dyN = 0;
  @RBSData::RL.object24.dzN = 0;
  @RBSData::RL.object24.vxN = 0;
  @RBSData::RL.object24.vyN = 0;
  @RBSData::RL.object24.axN = 0;
  @RBSData::RL.object24.ayN = 0;
  @RBSData::RL.object24.dWidthN = 0;
  @RBSData::RL.object24.dLengthN = 0;
  @RBSData::RL.object24.rcsN = 0;
  @RBSData::RL.object24.snrN = 0;
  @RBSData::RL.object24.alpPiYawAngleN = 0;
  @RBSData::RL.object24.signalStrengthN = 0;
  @RBSData::RL.object25.objID = 0;
  @RBSData::RL.object25.classification = 0;
  @RBSData::RL.object25.radar_type = 0;
  @RBSData::RL.object25.dxN = 0;
  @RBSData::RL.object25.dyN = 0;
  @RBSData::RL.object25.dzN = 0;
  @RBSData::RL.object25.vxN = 0;
  @RBSData::RL.object25.vyN = 0;
  @RBSData::RL.object25.axN = 0;
  @RBSData::RL.object25.ayN = 0;
  }
  if(init_count == 223)
  {
  @RBSData::RL.object25.dWidthN = 0;
  @RBSData::RL.object25.dLengthN = 0;
  @RBSData::RL.object25.rcsN = 0;
  @RBSData::RL.object25.snrN = 0;
  @RBSData::RL.object25.alpPiYawAngleN = 0;
  @RBSData::RL.object25.signalStrengthN = 0;
  @RBSData::RL.object26.objID = 0;
  @RBSData::RL.object26.classification = 0;
  @RBSData::RL.object26.radar_type = 0;
  @RBSData::RL.object26.dxN = 0;
  @RBSData::RL.object26.dyN = 0;
  @RBSData::RL.object26.dzN = 0;
  @RBSData::RL.object26.vxN = 0;
  @RBSData::RL.object26.vyN = 0;
  @RBSData::RL.object26.axN = 0;
  @RBSData::RL.object26.ayN = 0;
  @RBSData::RL.object26.dWidthN = 0;
  @RBSData::RL.object26.dLengthN = 0;
  @RBSData::RL.object26.rcsN = 0;
  @RBSData::RL.object26.snrN = 0;
  @RBSData::RL.object26.alpPiYawAngleN = 0;
  @RBSData::RL.object26.signalStrengthN = 0;
  @RBSData::RL.object27.objID = 0;
  @RBSData::RL.object27.classification = 0;
  @RBSData::RL.object27.radar_type = 0;
  }
  if(init_count == 224)
  {
  @RBSData::RL.object27.dxN = 0;
  @RBSData::RL.object27.dyN = 0;
  @RBSData::RL.object27.dzN = 0;
  @RBSData::RL.object27.vxN = 0;
  @RBSData::RL.object27.vyN = 0;
  @RBSData::RL.object27.axN = 0;
  @RBSData::RL.object27.ayN = 0;
  @RBSData::RL.object27.dWidthN = 0;
  @RBSData::RL.object27.dLengthN = 0;
  @RBSData::RL.object27.rcsN = 0;
  @RBSData::RL.object27.snrN = 0;
  @RBSData::RL.object27.alpPiYawAngleN = 0;
  @RBSData::RL.object27.signalStrengthN = 0;
  @RBSData::RL.object28.objID = 0;
  @RBSData::RL.object28.classification = 0;
  @RBSData::RL.object28.radar_type = 0;
  @RBSData::RL.object28.dxN = 0;
  @RBSData::RL.object28.dyN = 0;
  @RBSData::RL.object28.dzN = 0;
  @RBSData::RL.object28.vxN = 0;
  @RBSData::RL.object28.vyN = 0;
  @RBSData::RL.object28.axN = 0;
  @RBSData::RL.object28.ayN = 0;
  @RBSData::RL.object28.dWidthN = 0;
  @RBSData::RL.object28.dLengthN = 0;
  }
  if(init_count == 225)
  {
  @RBSData::RL.object28.rcsN = 0;
  @RBSData::RL.object28.snrN = 0;
  @RBSData::RL.object28.alpPiYawAngleN = 0;
  @RBSData::RL.object28.signalStrengthN = 0;
  @RBSData::RL.object29.objID = 0;
  @RBSData::RL.object29.classification = 0;
  @RBSData::RL.object29.radar_type = 0;
  @RBSData::RL.object29.dxN = 0;
  @RBSData::RL.object29.dyN = 0;
  @RBSData::RL.object29.dzN = 0;
  @RBSData::RL.object29.vxN = 0;
  @RBSData::RL.object29.vyN = 0;
  @RBSData::RL.object29.axN = 0;
  @RBSData::RL.object29.ayN = 0;
  @RBSData::RL.object29.dWidthN = 0;
  @RBSData::RL.object29.dLengthN = 0;
  @RBSData::RL.object29.rcsN = 0;
  @RBSData::RL.object29.snrN = 0;
  @RBSData::RL.object29.alpPiYawAngleN = 0;
  @RBSData::RL.object29.signalStrengthN = 0;
  @RBSData::RL.object30.objID = 0;
  @RBSData::RL.object30.classification = 0;
  @RBSData::RL.object30.radar_type = 0;
  @RBSData::RL.object30.dxN = 0;
  @RBSData::RL.object30.dyN = 0;
  }
  if(init_count == 226)
  {
  @RBSData::RL.object30.dzN = 0;
  @RBSData::RL.object30.vxN = 0;
  @RBSData::RL.object30.vyN = 0;
  @RBSData::RL.object30.axN = 0;
  @RBSData::RL.object30.ayN = 0;
  @RBSData::RL.object30.dWidthN = 0;
  @RBSData::RL.object30.dLengthN = 0;
  @RBSData::RL.object30.rcsN = 0;
  @RBSData::RL.object30.snrN = 0;
  @RBSData::RL.object30.alpPiYawAngleN = 0;
  @RBSData::RL.object30.signalStrengthN = 0;
  @RBSData::RL.object31.objID = 0;
  @RBSData::RL.object31.classification = 0;
  @RBSData::RL.object31.radar_type = 0;
  @RBSData::RL.object31.dxN = 0;
  @RBSData::RL.object31.dyN = 0;
  @RBSData::RL.object31.dzN = 0;
  @RBSData::RL.object31.vxN = 0;
  @RBSData::RL.object31.vyN = 0;
  @RBSData::RL.object31.axN = 0;
  @RBSData::RL.object31.ayN = 0;
  @RBSData::RL.object31.dWidthN = 0;
  @RBSData::RL.object31.dLengthN = 0;
  @RBSData::RL.object31.rcsN = 0;
  @RBSData::RL.object31.snrN = 0;
  }
  if(init_count == 227)
  {
  @RBSData::RL.object31.alpPiYawAngleN = 0;
  @RBSData::RL.object31.signalStrengthN = 0;
  @RBSData::RL.object32.objID = 0;
  @RBSData::RL.object32.classification = 0;
  @RBSData::RL.object32.radar_type = 0;
  @RBSData::RL.object32.dxN = 0;
  @RBSData::RL.object32.dyN = 0;
  @RBSData::RL.object32.dzN = 0;
  @RBSData::RL.object32.vxN = 0;
  @RBSData::RL.object32.vyN = 0;
  @RBSData::RL.object32.axN = 0;
  @RBSData::RL.object32.ayN = 0;
  @RBSData::RL.object32.dWidthN = 0;
  @RBSData::RL.object32.dLengthN = 0;
  @RBSData::RL.object32.rcsN = 0;
  @RBSData::RL.object32.snrN = 0;
  @RBSData::RL.object32.alpPiYawAngleN = 0;
  @RBSData::RL.object32.signalStrengthN = 0;
  @RBSData::RL.object33.objID = 0;
  @RBSData::RL.object33.classification = 0;
  @RBSData::RL.object33.radar_type = 0;
  @RBSData::RL.object33.dxN = 0;
  @RBSData::RL.object33.dyN = 0;
  @RBSData::RL.object33.dzN = 0;
  @RBSData::RL.object33.vxN = 0;
  }
  if(init_count == 228)
  {
  @RBSData::RL.object33.vyN = 0;
  @RBSData::RL.object33.axN = 0;
  @RBSData::RL.object33.ayN = 0;
  @RBSData::RL.object33.dWidthN = 0;
  @RBSData::RL.object33.dLengthN = 0;
  @RBSData::RL.object33.rcsN = 0;
  @RBSData::RL.object33.snrN = 0;
  @RBSData::RL.object33.alpPiYawAngleN = 0;
  @RBSData::RL.object33.signalStrengthN = 0;
  @RBSData::RL.object34.objID = 0;
  @RBSData::RL.object34.classification = 0;
  @RBSData::RL.object34.radar_type = 0;
  @RBSData::RL.object34.dxN = 0;
  @RBSData::RL.object34.dyN = 0;
  @RBSData::RL.object34.dzN = 0;
  @RBSData::RL.object34.vxN = 0;
  @RBSData::RL.object34.vyN = 0;
  @RBSData::RL.object34.axN = 0;
  @RBSData::RL.object34.ayN = 0;
  @RBSData::RL.object34.dWidthN = 0;
  @RBSData::RL.object34.dLengthN = 0;
  @RBSData::RL.object34.rcsN = 0;
  @RBSData::RL.object34.snrN = 0;
  @RBSData::RL.object34.alpPiYawAngleN = 0;
  @RBSData::RL.object34.signalStrengthN = 0;
  }
  if(init_count == 229)
  {
  @RBSData::RL.object35.objID = 0;
  @RBSData::RL.object35.classification = 0;
  @RBSData::RL.object35.radar_type = 0;
  @RBSData::RL.object35.dxN = 0;
  @RBSData::RL.object35.dyN = 0;
  @RBSData::RL.object35.dzN = 0;
  @RBSData::RL.object35.vxN = 0;
  @RBSData::RL.object35.vyN = 0;
  @RBSData::RL.object35.axN = 0;
  @RBSData::RL.object35.ayN = 0;
  @RBSData::RL.object35.dWidthN = 0;
  @RBSData::RL.object35.dLengthN = 0;
  @RBSData::RL.object35.rcsN = 0;
  @RBSData::RL.object35.snrN = 0;
  @RBSData::RL.object35.alpPiYawAngleN = 0;
  @RBSData::RL.object35.signalStrengthN = 0;
  @RBSData::RL.object36.objID = 0;
  @RBSData::RL.object36.classification = 0;
  @RBSData::RL.object36.radar_type = 0;
  @RBSData::RL.object36.dxN = 0;
  @RBSData::RL.object36.dyN = 0;
  @RBSData::RL.object36.dzN = 0;
  @RBSData::RL.object36.vxN = 0;
  @RBSData::RL.object36.vyN = 0;
  @RBSData::RL.object36.axN = 0;
  }
  if(init_count == 230)
  {
  @RBSData::RL.object36.ayN = 0;
  @RBSData::RL.object36.dWidthN = 0;
  @RBSData::RL.object36.dLengthN = 0;
  @RBSData::RL.object36.rcsN = 0;
  @RBSData::RL.object36.snrN = 0;
  @RBSData::RL.object36.alpPiYawAngleN = 0;
  @RBSData::RL.object36.signalStrengthN = 0;
  @RBSData::RL.object37.objID = 0;
  @RBSData::RL.object37.classification = 0;
  @RBSData::RL.object37.radar_type = 0;
  @RBSData::RL.object37.dxN = 0;
  @RBSData::RL.object37.dyN = 0;
  @RBSData::RL.object37.dzN = 0;
  @RBSData::RL.object37.vxN = 0;
  @RBSData::RL.object37.vyN = 0;
  @RBSData::RL.object37.axN = 0;
  @RBSData::RL.object37.ayN = 0;
  @RBSData::RL.object37.dWidthN = 0;
  @RBSData::RL.object37.dLengthN = 0;
  @RBSData::RL.object37.rcsN = 0;
  @RBSData::RL.object37.snrN = 0;
  @RBSData::RL.object37.alpPiYawAngleN = 0;
  @RBSData::RL.object37.signalStrengthN = 0;
  @RBSData::RL.object38.objID = 0;
  @RBSData::RL.object38.classification = 0;
  }
  if(init_count == 231)
  {
  @RBSData::RL.object38.radar_type = 0;
  @RBSData::RL.object38.dxN = 0;
  @RBSData::RL.object38.dyN = 0;
  @RBSData::RL.object38.dzN = 0;
  @RBSData::RL.object38.vxN = 0;
  @RBSData::RL.object38.vyN = 0;
  @RBSData::RL.object38.axN = 0;
  @RBSData::RL.object38.ayN = 0;
  @RBSData::RL.object38.dWidthN = 0;
  @RBSData::RL.object38.dLengthN = 0;
  @RBSData::RL.object38.rcsN = 0;
  @RBSData::RL.object38.snrN = 0;
  @RBSData::RL.object38.alpPiYawAngleN = 0;
  @RBSData::RL.object38.signalStrengthN = 0;
  @RBSData::RL.object39.objID = 0;
  @RBSData::RL.object39.classification = 0;
  @RBSData::RL.object39.radar_type = 0;
  @RBSData::RL.object39.dxN = 0;
  @RBSData::RL.object39.dyN = 0;
  @RBSData::RL.object39.dzN = 0;
  @RBSData::RL.object39.vxN = 0;
  @RBSData::RL.object39.vyN = 0;
  @RBSData::RL.object39.axN = 0;
  @RBSData::RL.object39.ayN = 0;
  @RBSData::RL.object39.dWidthN = 0;
  }
  if(init_count == 232)
  {
  @RBSData::RL.object39.dLengthN = 0;
  @RBSData::RL.object39.rcsN = 0;
  @RBSData::RL.object39.snrN = 0;
  @RBSData::RL.object39.alpPiYawAngleN = 0;
  @RBSData::RL.object39.signalStrengthN = 0;
  @RBSData::RR.mountPosX = 0;
  @RBSData::RR.mountPosY = 0;
  @RBSData::RR.mountPosZ = 0;
  @RBSData::RR.sensorBlocked = 0;
  @RBSData::RR.objectCount = 0;
  @RBSData::RR.object0.objID = 0;
  @RBSData::RR.object0.classification = 0;
  @RBSData::RR.object0.radar_type = 0;
  @RBSData::RR.object0.dxN = 0;
  @RBSData::RR.object0.dyN = 0;
  @RBSData::RR.object0.dzN = 0;
  @RBSData::RR.object0.vxN = 0;
  @RBSData::RR.object0.vyN = 0;
  @RBSData::RR.object0.axN = 0;
  @RBSData::RR.object0.ayN = 0;
  @RBSData::RR.object0.dWidthN = 0;
  @RBSData::RR.object0.dLengthN = 0;
  @RBSData::RR.object0.rcsN = 0;
  @RBSData::RR.object0.snrN = 0;
  @RBSData::RR.object0.alpPiYawAngleN = 0;
  }
  if(init_count == 233)
  {
  @RBSData::RR.object0.signalStrengthN = 0;
  @RBSData::RR.object1.objID = 0;
  @RBSData::RR.object1.classification = 0;
  @RBSData::RR.object1.radar_type = 0;
  @RBSData::RR.object1.dxN = 0;
  @RBSData::RR.object1.dyN = 0;
  @RBSData::RR.object1.dzN = 0;
  @RBSData::RR.object1.vxN = 0;
  @RBSData::RR.object1.vyN = 0;
  @RBSData::RR.object1.axN = 0;
  @RBSData::RR.object1.ayN = 0;
  @RBSData::RR.object1.dWidthN = 0;
  @RBSData::RR.object1.dLengthN = 0;
  @RBSData::RR.object1.rcsN = 0;
  @RBSData::RR.object1.snrN = 0;
  @RBSData::RR.object1.alpPiYawAngleN = 0;
  @RBSData::RR.object1.signalStrengthN = 0;
  @RBSData::RR.object2.objID = 0;
  @RBSData::RR.object2.classification = 0;
  @RBSData::RR.object2.radar_type = 0;
  @RBSData::RR.object2.dxN = 0;
  @RBSData::RR.object2.dyN = 0;
  @RBSData::RR.object2.dzN = 0;
  @RBSData::RR.object2.vxN = 0;
  @RBSData::RR.object2.vyN = 0;
  }
  if(init_count == 234)
  {
  @RBSData::RR.object2.axN = 0;
  @RBSData::RR.object2.ayN = 0;
  @RBSData::RR.object2.dWidthN = 0;
  @RBSData::RR.object2.dLengthN = 0;
  @RBSData::RR.object2.rcsN = 0;
  @RBSData::RR.object2.snrN = 0;
  @RBSData::RR.object2.alpPiYawAngleN = 0;
  @RBSData::RR.object2.signalStrengthN = 0;
  @RBSData::RR.object3.objID = 0;
  @RBSData::RR.object3.classification = 0;
  @RBSData::RR.object3.radar_type = 0;
  @RBSData::RR.object3.dxN = 0;
  @RBSData::RR.object3.dyN = 0;
  @RBSData::RR.object3.dzN = 0;
  @RBSData::RR.object3.vxN = 0;
  @RBSData::RR.object3.vyN = 0;
  @RBSData::RR.object3.axN = 0;
  @RBSData::RR.object3.ayN = 0;
  @RBSData::RR.object3.dWidthN = 0;
  @RBSData::RR.object3.dLengthN = 0;
  @RBSData::RR.object3.rcsN = 0;
  @RBSData::RR.object3.snrN = 0;
  @RBSData::RR.object3.alpPiYawAngleN = 0;
  @RBSData::RR.object3.signalStrengthN = 0;
  @RBSData::RR.object4.objID = 0;
  }
  if(init_count == 235)
  {
  @RBSData::RR.object4.classification = 0;
  @RBSData::RR.object4.radar_type = 0;
  @RBSData::RR.object4.dxN = 0;
  @RBSData::RR.object4.dyN = 0;
  @RBSData::RR.object4.dzN = 0;
  @RBSData::RR.object4.vxN = 0;
  @RBSData::RR.object4.vyN = 0;
  @RBSData::RR.object4.axN = 0;
  @RBSData::RR.object4.ayN = 0;
  @RBSData::RR.object4.dWidthN = 0;
  @RBSData::RR.object4.dLengthN = 0;
  @RBSData::RR.object4.rcsN = 0;
  @RBSData::RR.object4.snrN = 0;
  @RBSData::RR.object4.alpPiYawAngleN = 0;
  @RBSData::RR.object4.signalStrengthN = 0;
  @RBSData::RR.object5.objID = 0;
  @RBSData::RR.object5.classification = 0;
  @RBSData::RR.object5.radar_type = 0;
  @RBSData::RR.object5.dxN = 0;
  @RBSData::RR.object5.dyN = 0;
  @RBSData::RR.object5.dzN = 0;
  @RBSData::RR.object5.vxN = 0;
  @RBSData::RR.object5.vyN = 0;
  @RBSData::RR.object5.axN = 0;
  @RBSData::RR.object5.ayN = 0;
  }
  if(init_count == 236)
  {
  @RBSData::RR.object5.dWidthN = 0;
  @RBSData::RR.object5.dLengthN = 0;
  @RBSData::RR.object5.rcsN = 0;
  @RBSData::RR.object5.snrN = 0;
  @RBSData::RR.object5.alpPiYawAngleN = 0;
  @RBSData::RR.object5.signalStrengthN = 0;
  @RBSData::RR.object6.objID = 0;
  @RBSData::RR.object6.classification = 0;
  @RBSData::RR.object6.radar_type = 0;
  @RBSData::RR.object6.dxN = 0;
  @RBSData::RR.object6.dyN = 0;
  @RBSData::RR.object6.dzN = 0;
  @RBSData::RR.object6.vxN = 0;
  @RBSData::RR.object6.vyN = 0;
  @RBSData::RR.object6.axN = 0;
  @RBSData::RR.object6.ayN = 0;
  @RBSData::RR.object6.dWidthN = 0;
  @RBSData::RR.object6.dLengthN = 0;
  @RBSData::RR.object6.rcsN = 0;
  @RBSData::RR.object6.snrN = 0;
  @RBSData::RR.object6.alpPiYawAngleN = 0;
  @RBSData::RR.object6.signalStrengthN = 0;
  @RBSData::RR.object7.objID = 0;
  @RBSData::RR.object7.classification = 0;
  @RBSData::RR.object7.radar_type = 0;
  }
  if(init_count == 237)
  {
  @RBSData::RR.object7.dxN = 0;
  @RBSData::RR.object7.dyN = 0;
  @RBSData::RR.object7.dzN = 0;
  @RBSData::RR.object7.vxN = 0;
  @RBSData::RR.object7.vyN = 0;
  @RBSData::RR.object7.axN = 0;
  @RBSData::RR.object7.ayN = 0;
  @RBSData::RR.object7.dWidthN = 0;
  @RBSData::RR.object7.dLengthN = 0;
  @RBSData::RR.object7.rcsN = 0;
  @RBSData::RR.object7.snrN = 0;
  @RBSData::RR.object7.alpPiYawAngleN = 0;
  @RBSData::RR.object7.signalStrengthN = 0;
  @RBSData::RR.object8.objID = 0;
  @RBSData::RR.object8.classification = 0;
  @RBSData::RR.object8.radar_type = 0;
  @RBSData::RR.object8.dxN = 0;
  @RBSData::RR.object8.dyN = 0;
  @RBSData::RR.object8.dzN = 0;
  @RBSData::RR.object8.vxN = 0;
  @RBSData::RR.object8.vyN = 0;
  @RBSData::RR.object8.axN = 0;
  @RBSData::RR.object8.ayN = 0;
  @RBSData::RR.object8.dWidthN = 0;
  @RBSData::RR.object8.dLengthN = 0;
  }
  if(init_count == 238)
  {
  @RBSData::RR.object8.rcsN = 0;
  @RBSData::RR.object8.snrN = 0;
  @RBSData::RR.object8.alpPiYawAngleN = 0;
  @RBSData::RR.object8.signalStrengthN = 0;
  @RBSData::RR.object9.objID = 0;
  @RBSData::RR.object9.classification = 0;
  @RBSData::RR.object9.radar_type = 0;
  @RBSData::RR.object9.dxN = 0;
  @RBSData::RR.object9.dyN = 0;
  @RBSData::RR.object9.dzN = 0;
  @RBSData::RR.object9.vxN = 0;
  @RBSData::RR.object9.vyN = 0;
  @RBSData::RR.object9.axN = 0;
  @RBSData::RR.object9.ayN = 0;
  @RBSData::RR.object9.dWidthN = 0;
  @RBSData::RR.object9.dLengthN = 0;
  @RBSData::RR.object9.rcsN = 0;
  @RBSData::RR.object9.snrN = 0;
  @RBSData::RR.object9.alpPiYawAngleN = 0;
  @RBSData::RR.object9.signalStrengthN = 0;
  @RBSData::RR.object10.objID = 0;
  @RBSData::RR.object10.classification = 0;
  @RBSData::RR.object10.radar_type = 0;
  @RBSData::RR.object10.dxN = 0;
  @RBSData::RR.object10.dyN = 0;
  }
  if(init_count == 239)
  {
  @RBSData::RR.object10.dzN = 0;
  @RBSData::RR.object10.vxN = 0;
  @RBSData::RR.object10.vyN = 0;
  @RBSData::RR.object10.axN = 0;
  @RBSData::RR.object10.ayN = 0;
  @RBSData::RR.object10.dWidthN = 0;
  @RBSData::RR.object10.dLengthN = 0;
  @RBSData::RR.object10.rcsN = 0;
  @RBSData::RR.object10.snrN = 0;
  @RBSData::RR.object10.alpPiYawAngleN = 0;
  @RBSData::RR.object10.signalStrengthN = 0;
  @RBSData::RR.object11.objID = 0;
  @RBSData::RR.object11.classification = 0;
  @RBSData::RR.object11.radar_type = 0;
  @RBSData::RR.object11.dxN = 0;
  @RBSData::RR.object11.dyN = 0;
  @RBSData::RR.object11.dzN = 0;
  @RBSData::RR.object11.vxN = 0;
  @RBSData::RR.object11.vyN = 0;
  @RBSData::RR.object11.axN = 0;
  @RBSData::RR.object11.ayN = 0;
  @RBSData::RR.object11.dWidthN = 0;
  @RBSData::RR.object11.dLengthN = 0;
  @RBSData::RR.object11.rcsN = 0;
  @RBSData::RR.object11.snrN = 0;
  }
  if(init_count == 240)
  {
  @RBSData::RR.object11.alpPiYawAngleN = 0;
  @RBSData::RR.object11.signalStrengthN = 0;
  @RBSData::RR.object12.objID = 0;
  @RBSData::RR.object12.classification = 0;
  @RBSData::RR.object12.radar_type = 0;
  @RBSData::RR.object12.dxN = 0;
  @RBSData::RR.object12.dyN = 0;
  @RBSData::RR.object12.dzN = 0;
  @RBSData::RR.object12.vxN = 0;
  @RBSData::RR.object12.vyN = 0;
  @RBSData::RR.object12.axN = 0;
  @RBSData::RR.object12.ayN = 0;
  @RBSData::RR.object12.dWidthN = 0;
  @RBSData::RR.object12.dLengthN = 0;
  @RBSData::RR.object12.rcsN = 0;
  @RBSData::RR.object12.snrN = 0;
  @RBSData::RR.object12.alpPiYawAngleN = 0;
  @RBSData::RR.object12.signalStrengthN = 0;
  @RBSData::RR.object13.objID = 0;
  @RBSData::RR.object13.classification = 0;
  @RBSData::RR.object13.radar_type = 0;
  @RBSData::RR.object13.dxN = 0;
  @RBSData::RR.object13.dyN = 0;
  @RBSData::RR.object13.dzN = 0;
  @RBSData::RR.object13.vxN = 0;
  }
  if(init_count == 241)
  {
  @RBSData::RR.object13.vyN = 0;
  @RBSData::RR.object13.axN = 0;
  @RBSData::RR.object13.ayN = 0;
  @RBSData::RR.object13.dWidthN = 0;
  @RBSData::RR.object13.dLengthN = 0;
  @RBSData::RR.object13.rcsN = 0;
  @RBSData::RR.object13.snrN = 0;
  @RBSData::RR.object13.alpPiYawAngleN = 0;
  @RBSData::RR.object13.signalStrengthN = 0;
  @RBSData::RR.object14.objID = 0;
  @RBSData::RR.object14.classification = 0;
  @RBSData::RR.object14.radar_type = 0;
  @RBSData::RR.object14.dxN = 0;
  @RBSData::RR.object14.dyN = 0;
  @RBSData::RR.object14.dzN = 0;
  @RBSData::RR.object14.vxN = 0;
  @RBSData::RR.object14.vyN = 0;
  @RBSData::RR.object14.axN = 0;
  @RBSData::RR.object14.ayN = 0;
  @RBSData::RR.object14.dWidthN = 0;
  @RBSData::RR.object14.dLengthN = 0;
  @RBSData::RR.object14.rcsN = 0;
  @RBSData::RR.object14.snrN = 0;
  @RBSData::RR.object14.alpPiYawAngleN = 0;
  @RBSData::RR.object14.signalStrengthN = 0;
  }
  if(init_count == 242)
  {
  @RBSData::RR.object15.objID = 0;
  @RBSData::RR.object15.classification = 0;
  @RBSData::RR.object15.radar_type = 0;
  @RBSData::RR.object15.dxN = 0;
  @RBSData::RR.object15.dyN = 0;
  @RBSData::RR.object15.dzN = 0;
  @RBSData::RR.object15.vxN = 0;
  @RBSData::RR.object15.vyN = 0;
  @RBSData::RR.object15.axN = 0;
  @RBSData::RR.object15.ayN = 0;
  @RBSData::RR.object15.dWidthN = 0;
  @RBSData::RR.object15.dLengthN = 0;
  @RBSData::RR.object15.rcsN = 0;
  @RBSData::RR.object15.snrN = 0;
  @RBSData::RR.object15.alpPiYawAngleN = 0;
  @RBSData::RR.object15.signalStrengthN = 0;
  @RBSData::RR.object16.objID = 0;
  @RBSData::RR.object16.classification = 0;
  @RBSData::RR.object16.radar_type = 0;
  @RBSData::RR.object16.dxN = 0;
  @RBSData::RR.object16.dyN = 0;
  @RBSData::RR.object16.dzN = 0;
  @RBSData::RR.object16.vxN = 0;
  @RBSData::RR.object16.vyN = 0;
  @RBSData::RR.object16.axN = 0;
  }
  if(init_count == 243)
  {
  @RBSData::RR.object16.ayN = 0;
  @RBSData::RR.object16.dWidthN = 0;
  @RBSData::RR.object16.dLengthN = 0;
  @RBSData::RR.object16.rcsN = 0;
  @RBSData::RR.object16.snrN = 0;
  @RBSData::RR.object16.alpPiYawAngleN = 0;
  @RBSData::RR.object16.signalStrengthN = 0;
  @RBSData::RR.object17.objID = 0;
  @RBSData::RR.object17.classification = 0;
  @RBSData::RR.object17.radar_type = 0;
  @RBSData::RR.object17.dxN = 0;
  @RBSData::RR.object17.dyN = 0;
  @RBSData::RR.object17.dzN = 0;
  @RBSData::RR.object17.vxN = 0;
  @RBSData::RR.object17.vyN = 0;
  @RBSData::RR.object17.axN = 0;
  @RBSData::RR.object17.ayN = 0;
  @RBSData::RR.object17.dWidthN = 0;
  @RBSData::RR.object17.dLengthN = 0;
  @RBSData::RR.object17.rcsN = 0;
  @RBSData::RR.object17.snrN = 0;
  @RBSData::RR.object17.alpPiYawAngleN = 0;
  @RBSData::RR.object17.signalStrengthN = 0;
  @RBSData::RR.object18.objID = 0;
  @RBSData::RR.object18.classification = 0;
  }
  if(init_count == 244)
  {
  @RBSData::RR.object18.radar_type = 0;
  @RBSData::RR.object18.dxN = 0;
  @RBSData::RR.object18.dyN = 0;
  @RBSData::RR.object18.dzN = 0;
  @RBSData::RR.object18.vxN = 0;
  @RBSData::RR.object18.vyN = 0;
  @RBSData::RR.object18.axN = 0;
  @RBSData::RR.object18.ayN = 0;
  @RBSData::RR.object18.dWidthN = 0;
  @RBSData::RR.object18.dLengthN = 0;
  @RBSData::RR.object18.rcsN = 0;
  @RBSData::RR.object18.snrN = 0;
  @RBSData::RR.object18.alpPiYawAngleN = 0;
  @RBSData::RR.object18.signalStrengthN = 0;
  @RBSData::RR.object19.objID = 0;
  @RBSData::RR.object19.classification = 0;
  @RBSData::RR.object19.radar_type = 0;
  @RBSData::RR.object19.dxN = 0;
  @RBSData::RR.object19.dyN = 0;
  @RBSData::RR.object19.dzN = 0;
  @RBSData::RR.object19.vxN = 0;
  @RBSData::RR.object19.vyN = 0;
  @RBSData::RR.object19.axN = 0;
  @RBSData::RR.object19.ayN = 0;
  @RBSData::RR.object19.dWidthN = 0;
  }
  if(init_count == 245)
  {
  @RBSData::RR.object19.dLengthN = 0;
  @RBSData::RR.object19.rcsN = 0;
  @RBSData::RR.object19.snrN = 0;
  @RBSData::RR.object19.alpPiYawAngleN = 0;
  @RBSData::RR.object19.signalStrengthN = 0;
  @RBSData::RR.object20.objID = 0;
  @RBSData::RR.object20.classification = 0;
  @RBSData::RR.object20.radar_type = 0;
  @RBSData::RR.object20.dxN = 0;
  @RBSData::RR.object20.dyN = 0;
  @RBSData::RR.object20.dzN = 0;
  @RBSData::RR.object20.vxN = 0;
  @RBSData::RR.object20.vyN = 0;
  @RBSData::RR.object20.axN = 0;
  @RBSData::RR.object20.ayN = 0;
  @RBSData::RR.object20.dWidthN = 0;
  @RBSData::RR.object20.dLengthN = 0;
  @RBSData::RR.object20.rcsN = 0;
  @RBSData::RR.object20.snrN = 0;
  @RBSData::RR.object20.alpPiYawAngleN = 0;
  @RBSData::RR.object20.signalStrengthN = 0;
  @RBSData::RR.object21.objID = 0;
  @RBSData::RR.object21.classification = 0;
  @RBSData::RR.object21.radar_type = 0;
  @RBSData::RR.object21.dxN = 0;
  }
  if(init_count == 246)
  {
  @RBSData::RR.object21.dyN = 0;
  @RBSData::RR.object21.dzN = 0;
  @RBSData::RR.object21.vxN = 0;
  @RBSData::RR.object21.vyN = 0;
  @RBSData::RR.object21.axN = 0;
  @RBSData::RR.object21.ayN = 0;
  @RBSData::RR.object21.dWidthN = 0;
  @RBSData::RR.object21.dLengthN = 0;
  @RBSData::RR.object21.rcsN = 0;
  @RBSData::RR.object21.snrN = 0;
  @RBSData::RR.object21.alpPiYawAngleN = 0;
  @RBSData::RR.object21.signalStrengthN = 0;
  @RBSData::RR.object22.objID = 0;
  @RBSData::RR.object22.classification = 0;
  @RBSData::RR.object22.radar_type = 0;
  @RBSData::RR.object22.dxN = 0;
  @RBSData::RR.object22.dyN = 0;
  @RBSData::RR.object22.dzN = 0;
  @RBSData::RR.object22.vxN = 0;
  @RBSData::RR.object22.vyN = 0;
  @RBSData::RR.object22.axN = 0;
  @RBSData::RR.object22.ayN = 0;
  @RBSData::RR.object22.dWidthN = 0;
  @RBSData::RR.object22.dLengthN = 0;
  @RBSData::RR.object22.rcsN = 0;
  }
  if(init_count == 247)
  {
  @RBSData::RR.object22.snrN = 0;
  @RBSData::RR.object22.alpPiYawAngleN = 0;
  @RBSData::RR.object22.signalStrengthN = 0;
  @RBSData::RR.object23.objID = 0;
  @RBSData::RR.object23.classification = 0;
  @RBSData::RR.object23.radar_type = 0;
  @RBSData::RR.object23.dxN = 0;
  @RBSData::RR.object23.dyN = 0;
  @RBSData::RR.object23.dzN = 0;
  @RBSData::RR.object23.vxN = 0;
  @RBSData::RR.object23.vyN = 0;
  @RBSData::RR.object23.axN = 0;
  @RBSData::RR.object23.ayN = 0;
  @RBSData::RR.object23.dWidthN = 0;
  @RBSData::RR.object23.dLengthN = 0;
  @RBSData::RR.object23.rcsN = 0;
  @RBSData::RR.object23.snrN = 0;
  @RBSData::RR.object23.alpPiYawAngleN = 0;
  @RBSData::RR.object23.signalStrengthN = 0;
  @RBSData::RR.object24.objID = 0;
  @RBSData::RR.object24.classification = 0;
  @RBSData::RR.object24.radar_type = 0;
  @RBSData::RR.object24.dxN = 0;
  @RBSData::RR.object24.dyN = 0;
  @RBSData::RR.object24.dzN = 0;
  }
  if(init_count == 248)
  {
  @RBSData::RR.object24.vxN = 0;
  @RBSData::RR.object24.vyN = 0;
  @RBSData::RR.object24.axN = 0;
  @RBSData::RR.object24.ayN = 0;
  @RBSData::RR.object24.dWidthN = 0;
  @RBSData::RR.object24.dLengthN = 0;
  @RBSData::RR.object24.rcsN = 0;
  @RBSData::RR.object24.snrN = 0;
  @RBSData::RR.object24.alpPiYawAngleN = 0;
  @RBSData::RR.object24.signalStrengthN = 0;
  @RBSData::RR.object25.objID = 0;
  @RBSData::RR.object25.classification = 0;
  @RBSData::RR.object25.radar_type = 0;
  @RBSData::RR.object25.dxN = 0;
  @RBSData::RR.object25.dyN = 0;
  @RBSData::RR.object25.dzN = 0;
  @RBSData::RR.object25.vxN = 0;
  @RBSData::RR.object25.vyN = 0;
  @RBSData::RR.object25.axN = 0;
  @RBSData::RR.object25.ayN = 0;
  @RBSData::RR.object25.dWidthN = 0;
  @RBSData::RR.object25.dLengthN = 0;
  @RBSData::RR.object25.rcsN = 0;
  @RBSData::RR.object25.snrN = 0;
  @RBSData::RR.object25.alpPiYawAngleN = 0;
  }
  if(init_count == 249)
  {
  @RBSData::RR.object25.signalStrengthN = 0;
  @RBSData::RR.object26.objID = 0;
  @RBSData::RR.object26.classification = 0;
  @RBSData::RR.object26.radar_type = 0;
  @RBSData::RR.object26.dxN = 0;
  @RBSData::RR.object26.dyN = 0;
  @RBSData::RR.object26.dzN = 0;
  @RBSData::RR.object26.vxN = 0;
  @RBSData::RR.object26.vyN = 0;
  @RBSData::RR.object26.axN = 0;
  @RBSData::RR.object26.ayN = 0;
  @RBSData::RR.object26.dWidthN = 0;
  @RBSData::RR.object26.dLengthN = 0;
  @RBSData::RR.object26.rcsN = 0;
  @RBSData::RR.object26.snrN = 0;
  @RBSData::RR.object26.alpPiYawAngleN = 0;
  @RBSData::RR.object26.signalStrengthN = 0;
  @RBSData::RR.object27.objID = 0;
  @RBSData::RR.object27.classification = 0;
  @RBSData::RR.object27.radar_type = 0;
  @RBSData::RR.object27.dxN = 0;
  @RBSData::RR.object27.dyN = 0;
  @RBSData::RR.object27.dzN = 0;
  @RBSData::RR.object27.vxN = 0;
  @RBSData::RR.object27.vyN = 0;
  }
  if(init_count == 250)
  {
  @RBSData::RR.object27.axN = 0;
  @RBSData::RR.object27.ayN = 0;
  @RBSData::RR.object27.dWidthN = 0;
  @RBSData::RR.object27.dLengthN = 0;
  @RBSData::RR.object27.rcsN = 0;
  @RBSData::RR.object27.snrN = 0;
  @RBSData::RR.object27.alpPiYawAngleN = 0;
  @RBSData::RR.object27.signalStrengthN = 0;
  @RBSData::RR.object28.objID = 0;
  @RBSData::RR.object28.classification = 0;
  @RBSData::RR.object28.radar_type = 0;
  @RBSData::RR.object28.dxN = 0;
  @RBSData::RR.object28.dyN = 0;
  @RBSData::RR.object28.dzN = 0;
  @RBSData::RR.object28.vxN = 0;
  @RBSData::RR.object28.vyN = 0;
  @RBSData::RR.object28.axN = 0;
  @RBSData::RR.object28.ayN = 0;
  @RBSData::RR.object28.dWidthN = 0;
  @RBSData::RR.object28.dLengthN = 0;
  @RBSData::RR.object28.rcsN = 0;
  @RBSData::RR.object28.snrN = 0;
  @RBSData::RR.object28.alpPiYawAngleN = 0;
  @RBSData::RR.object28.signalStrengthN = 0;
  @RBSData::RR.object29.objID = 0;
  }
  if(init_count == 251)
  {
  @RBSData::RR.object29.classification = 0;
  @RBSData::RR.object29.radar_type = 0;
  @RBSData::RR.object29.dxN = 0;
  @RBSData::RR.object29.dyN = 0;
  @RBSData::RR.object29.dzN = 0;
  @RBSData::RR.object29.vxN = 0;
  @RBSData::RR.object29.vyN = 0;
  @RBSData::RR.object29.axN = 0;
  @RBSData::RR.object29.ayN = 0;
  @RBSData::RR.object29.dWidthN = 0;
  @RBSData::RR.object29.dLengthN = 0;
  @RBSData::RR.object29.rcsN = 0;
  @RBSData::RR.object29.snrN = 0;
  @RBSData::RR.object29.alpPiYawAngleN = 0;
  @RBSData::RR.object29.signalStrengthN = 0;
  @RBSData::RR.object30.objID = 0;
  @RBSData::RR.object30.classification = 0;
  @RBSData::RR.object30.radar_type = 0;
  @RBSData::RR.object30.dxN = 0;
  @RBSData::RR.object30.dyN = 0;
  @RBSData::RR.object30.dzN = 0;
  @RBSData::RR.object30.vxN = 0;
  @RBSData::RR.object30.vyN = 0;
  @RBSData::RR.object30.axN = 0;
  @RBSData::RR.object30.ayN = 0;
  }
  if(init_count == 252)
  {
  @RBSData::RR.object30.dWidthN = 0;
  @RBSData::RR.object30.dLengthN = 0;
  @RBSData::RR.object30.rcsN = 0;
  @RBSData::RR.object30.snrN = 0;
  @RBSData::RR.object30.alpPiYawAngleN = 0;
  @RBSData::RR.object30.signalStrengthN = 0;
  @RBSData::RR.object31.objID = 0;
  @RBSData::RR.object31.classification = 0;
  @RBSData::RR.object31.radar_type = 0;
  @RBSData::RR.object31.dxN = 0;
  @RBSData::RR.object31.dyN = 0;
  @RBSData::RR.object31.dzN = 0;
  @RBSData::RR.object31.vxN = 0;
  @RBSData::RR.object31.vyN = 0;
  @RBSData::RR.object31.axN = 0;
  @RBSData::RR.object31.ayN = 0;
  @RBSData::RR.object31.dWidthN = 0;
  @RBSData::RR.object31.dLengthN = 0;
  @RBSData::RR.object31.rcsN = 0;
  @RBSData::RR.object31.snrN = 0;
  @RBSData::RR.object31.alpPiYawAngleN = 0;
  @RBSData::RR.object31.signalStrengthN = 0;
  @RBSData::RR.object32.objID = 0;
  @RBSData::RR.object32.classification = 0;
  @RBSData::RR.object32.radar_type = 0;
  }
  if(init_count == 253)
  {
  @RBSData::RR.object32.dxN = 0;
  @RBSData::RR.object32.dyN = 0;
  @RBSData::RR.object32.dzN = 0;
  @RBSData::RR.object32.vxN = 0;
  @RBSData::RR.object32.vyN = 0;
  @RBSData::RR.object32.axN = 0;
  @RBSData::RR.object32.ayN = 0;
  @RBSData::RR.object32.dWidthN = 0;
  @RBSData::RR.object32.dLengthN = 0;
  @RBSData::RR.object32.rcsN = 0;
  @RBSData::RR.object32.snrN = 0;
  @RBSData::RR.object32.alpPiYawAngleN = 0;
  @RBSData::RR.object32.signalStrengthN = 0;
  @RBSData::RR.object33.objID = 0;
  @RBSData::RR.object33.classification = 0;
  @RBSData::RR.object33.radar_type = 0;
  @RBSData::RR.object33.dxN = 0;
  @RBSData::RR.object33.dyN = 0;
  @RBSData::RR.object33.dzN = 0;
  @RBSData::RR.object33.vxN = 0;
  @RBSData::RR.object33.vyN = 0;
  @RBSData::RR.object33.axN = 0;
  @RBSData::RR.object33.ayN = 0;
  @RBSData::RR.object33.dWidthN = 0;
  @RBSData::RR.object33.dLengthN = 0;
  }
  if(init_count == 254)
  {
  @RBSData::RR.object33.rcsN = 0;
  @RBSData::RR.object33.snrN = 0;
  @RBSData::RR.object33.alpPiYawAngleN = 0;
  @RBSData::RR.object33.signalStrengthN = 0;
  @RBSData::RR.object34.objID = 0;
  @RBSData::RR.object34.classification = 0;
  @RBSData::RR.object34.radar_type = 0;
  @RBSData::RR.object34.dxN = 0;
  @RBSData::RR.object34.dyN = 0;
  @RBSData::RR.object34.dzN = 0;
  @RBSData::RR.object34.vxN = 0;
  @RBSData::RR.object34.vyN = 0;
  @RBSData::RR.object34.axN = 0;
  @RBSData::RR.object34.ayN = 0;
  @RBSData::RR.object34.dWidthN = 0;
  @RBSData::RR.object34.dLengthN = 0;
  @RBSData::RR.object34.rcsN = 0;
  @RBSData::RR.object34.snrN = 0;
  @RBSData::RR.object34.alpPiYawAngleN = 0;
  @RBSData::RR.object34.signalStrengthN = 0;
  @RBSData::RR.object35.objID = 0;
  @RBSData::RR.object35.classification = 0;
  @RBSData::RR.object35.radar_type = 0;
  @RBSData::RR.object35.dxN = 0;
  @RBSData::RR.object35.dyN = 0;
  }
  if(init_count == 255)
  {
  @RBSData::RR.object35.dzN = 0;
  @RBSData::RR.object35.vxN = 0;
  @RBSData::RR.object35.vyN = 0;
  @RBSData::RR.object35.axN = 0;
  @RBSData::RR.object35.ayN = 0;
  @RBSData::RR.object35.dWidthN = 0;
  @RBSData::RR.object35.dLengthN = 0;
  @RBSData::RR.object35.rcsN = 0;
  @RBSData::RR.object35.snrN = 0;
  @RBSData::RR.object35.alpPiYawAngleN = 0;
  @RBSData::RR.object35.signalStrengthN = 0;
  @RBSData::RR.object36.objID = 0;
  @RBSData::RR.object36.classification = 0;
  @RBSData::RR.object36.radar_type = 0;
  @RBSData::RR.object36.dxN = 0;
  @RBSData::RR.object36.dyN = 0;
  @RBSData::RR.object36.dzN = 0;
  @RBSData::RR.object36.vxN = 0;
  @RBSData::RR.object36.vyN = 0;
  @RBSData::RR.object36.axN = 0;
  @RBSData::RR.object36.ayN = 0;
  @RBSData::RR.object36.dWidthN = 0;
  @RBSData::RR.object36.dLengthN = 0;
  @RBSData::RR.object36.rcsN = 0;
  @RBSData::RR.object36.snrN = 0;
  }
  if(init_count == 256)
  {
  @RBSData::RR.object36.alpPiYawAngleN = 0;
  @RBSData::RR.object36.signalStrengthN = 0;
  @RBSData::RR.object37.objID = 0;
  @RBSData::RR.object37.classification = 0;
  @RBSData::RR.object37.radar_type = 0;
  @RBSData::RR.object37.dxN = 0;
  @RBSData::RR.object37.dyN = 0;
  @RBSData::RR.object37.dzN = 0;
  @RBSData::RR.object37.vxN = 0;
  @RBSData::RR.object37.vyN = 0;
  @RBSData::RR.object37.axN = 0;
  @RBSData::RR.object37.ayN = 0;
  @RBSData::RR.object37.dWidthN = 0;
  @RBSData::RR.object37.dLengthN = 0;
  @RBSData::RR.object37.rcsN = 0;
  @RBSData::RR.object37.snrN = 0;
  @RBSData::RR.object37.alpPiYawAngleN = 0;
  @RBSData::RR.object37.signalStrengthN = 0;
  @RBSData::RR.object38.objID = 0;
  @RBSData::RR.object38.classification = 0;
  @RBSData::RR.object38.radar_type = 0;
  @RBSData::RR.object38.dxN = 0;
  @RBSData::RR.object38.dyN = 0;
  @RBSData::RR.object38.dzN = 0;
  @RBSData::RR.object38.vxN = 0;
  }
  if(init_count == 257)
  {
  @RBSData::RR.object38.vyN = 0;
  @RBSData::RR.object38.axN = 0;
  @RBSData::RR.object38.ayN = 0;
  @RBSData::RR.object38.dWidthN = 0;
  @RBSData::RR.object38.dLengthN = 0;
  @RBSData::RR.object38.rcsN = 0;
  @RBSData::RR.object38.snrN = 0;
  @RBSData::RR.object38.alpPiYawAngleN = 0;
  @RBSData::RR.object38.signalStrengthN = 0;
  @RBSData::RR.object39.objID = 0;
  @RBSData::RR.object39.classification = 0;
  @RBSData::RR.object39.radar_type = 0;
  @RBSData::RR.object39.dxN = 0;
  @RBSData::RR.object39.dyN = 0;
  @RBSData::RR.object39.dzN = 0;
  @RBSData::RR.object39.vxN = 0;
  @RBSData::RR.object39.vyN = 0;
  @RBSData::RR.object39.axN = 0;
  @RBSData::RR.object39.ayN = 0;
  @RBSData::RR.object39.dWidthN = 0;
  @RBSData::RR.object39.dLengthN = 0;
  @RBSData::RR.object39.rcsN = 0;
  @RBSData::RR.object39.snrN = 0;
  @RBSData::RR.object39.alpPiYawAngleN = 0;
  @RBSData::RR.object39.signalStrengthN = 0;
  }
  if(init_count == 258)
  {
  }
  if(init_count == 259)
  {
  }
  if(init_count == 260)
  {
  }
  if(init_count == 261)
  {
  }
  if(init_count == 262)
  {
  }
  if(init_count == 263)
  {
  }
  if(init_count == 264)
  {
  }
  if(init_count == 265)
  {
  }
  if(init_count == 266)
  {
  }
  if(init_count == 267)
  {
  }
  if(init_count == 268)
  {
  }
  if(init_count == 269)
  {
  }
  if(init_count == 270)
  {
  }
  if(init_count == 271)
  {
  }
  if(init_count == 272)
  {
  }
  if(init_count == 273)
  {
  }
  if(init_count == 274)
  {
  }
  if(init_count == 275)
  {
  }
  if(init_count == 276)
  {
  }
  if(init_count == 277)
  {
  }
  if(init_count == 278)
  {
  }
  if(init_count == 279)
  {
  }
  if(init_count == 280)
  {
  }
  if(init_count == 281)
  {
  }
  if(init_count == 282)
  {
  }
  if(init_count == 283)
  {
  }
  if(init_count == 284)
  {
  }
  if(init_count == 285)
  {
  }
  if(init_count == 286)
  {
  }
  if(init_count == 287)
  {
  }
  if(init_count == 288)
  {
  }
  if(init_count == 289)
  {
  }
  if(init_count == 290)
  {
  }
  if(init_count == 291)
  {
  }
  if(init_count == 292)
  {
  }
  if(init_count == 293)
  {
  }
  if(init_count == 294)
  {
  }
  if(init_count == 295)
  {
  }
  if(init_count == 296)
  {
  }
  if(init_count == 297)
  {
  }
  if(init_count == 298)
  {
  }
  if(init_count == 299)
  {
  }
  if(init_count == 300)
  {
  }
  if(init_count == 301)
  {
  }
  if(init_count == 302)
  {
  }
  if(init_count == 303)
  {
  }
  if(init_count == 304)
  {
  }
  if(init_count == 305)
  {
  }
  if(init_count == 306)
  {
  }
  if(init_count == 307)
  {
  }
  if(init_count == 308)
  {
  }
  if(init_count == 309)
  {
  }
  if(init_count == 310)
  {
  }
  if(init_count == 311)
  {
  }
  if(init_count == 312)
  {
  }
  if(init_count == 313)
  {
  }
  if(init_count == 314)
  {
  }
  if(init_count == 315)
  {
  }
  if(init_count == 316)
  {
  }
  if(init_count == 317)
  {
  }
  if(init_count == 318)
  {
  }
  if(init_count == 319)
  {
  if (prestart_mode==0) init_count = 0;
  initFlag = 2;
  }
  init_count++;
}