/*@!Encoding:1252*/
/**
 * @file TrafficSign_FVideo_FDX.cin
 * @author ADAS_HIL_TEAM
 * @date 08-21-2023
 * @brief  Contains functions to receive Traffic Sign Video objects via FDX
 *
 * ################################################################
 * C O P Y R I G H T S
 * ----------------------------------------------------------------
 * Copyright (c) 2023 by Robert Bosch GmbH. All rights reserved.
 
 * The reproduction, distribution and utilization of this file as
 * well as the communication of its contents to others without express
 * authorization is prohibited. Offenders will be held liable for the
 * payment of damages. All rights reserved in the event of the grant
 * of a patent, utility model or design.
 *
 * ################################################################
*/

includes
{
}

variables
{
}

void f_TS_Video_Update_From_FDX(byte ts_id)
{
  // Not used function, kept for possible future design change
}