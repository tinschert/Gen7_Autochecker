/*@!Encoding:1252*/
/**
 * @file Degradation_Template.can
 * @author ADAS_HIL_TEAM
 * @date 08-21-2023
 * @brief  Handles the degradation failure injection mapping from FDX
 *
 * ################################################################
 * C O P Y R I G H T S
 * ----------------------------------------------------------------
 * Copyright (c) 2023 by Robert Bosch GmbH. All rights reserved.
 
 * The reproduction, distribution and utilization of this file as
 * well as the communication of its contents to others without express
 * authorization is prohibited. Offenders will be held liable for the
 * payment of damages. All rights reserved in the event of the grant
 * of a patent, utility model or design.
 *
 * ################################################################
*/

includes
{
}

variables
{
}

on start
{
}

/**
 * @brief: 
 * 
 * 
 */

on sysvar FDX_in_HIL_specific_input_triggers::FDX_in_hil_failure_injection
{
    switch (@FDX_in_HIL_specific_input_triggers::FDX_in_hil_failure_injection)
    {
        case 0: // No preconditions needed
            break;
        case 1: // User defined
            @Customer_Prj::hil_failure_injection_1 = 1;
            break;
        case 2: // User defined
            @Customer_Prj::hil_failure_injection_2 = 1;
            break;
        case 3: // User defined
            @Customer_Prj::hil_failure_injection_3 = 1;
            break;
        case 4: // User defined
            @Customer_Prj::hil_failure_injection_4 = 1;
            break;
        case 5: // User defined
            @Customer_Prj::hil_failure_injection_5 = 1;
            break;
        case 6: // User defined
            @Customer_Prj::hil_failure_injection_6 = 1;
            break;
        case 7: // User defined
            @Customer_Prj::hil_failure_injection_7 = 1;
            break;
        case 8: // User defined
            @Customer_Prj::hil_failure_injection_8 = 1;
            break;
        case 9: // User defined
            @Customer_Prj::hil_failure_injection_9 = 1;
            break;
        case 10: // User defined
            @Customer_Prj::hil_failure_injection_10 = 1;
            break;
        case 11: // User defined
            @Customer_Prj::hil_failure_injection_11 = 1;
            break;
        case 12: // User defined
            @Customer_Prj::hil_failure_injection_12 = 1;
            break;
        case 13: // User defined
            @Customer_Prj::hil_failure_injection_13 = 1;
            break;
        case 14: // User defined
            @Customer_Prj::hil_failure_injection_14 = 1;
            break;
        case 15: // User defined
            @Customer_Prj::hil_failure_injection_15 = 1;
            break;
        case 16: // User defined
            @Customer_Prj::hil_failure_injection_16 = 1;
            break;
        case 17: // User defined
            @Customer_Prj::hil_failure_injection_17 = 1;
            break;
        case 18: // User defined
            @Customer_Prj::hil_failure_injection_18 = 1;
            break;
        case 19: // User defined
            @Customer_Prj::hil_failure_injection_19 = 1;
            break;
        case 20: // User defined
            @Customer_Prj::hil_failure_injection_20 = 1;
            break;
        case 21: // User defined
            @Customer_Prj::hil_failure_injection_21 = 1;
            break;
        case 22: // User defined
            @Customer_Prj::hil_failure_injection_22 = 1;
            break;
        case 23: // User defined
            @Customer_Prj::hil_failure_injection_23 = 1;
            break;
        case 24: // User defined
            @Customer_Prj::hil_failure_injection_24 = 1;
            break;
        case 25: // User defined
            @Customer_Prj::hil_failure_injection_25 = 1;
            break;
        case 26: // User defined
            @Customer_Prj::hil_failure_injection_26 = 1;
            break;
        case 27: // User defined
            @Customer_Prj::hil_failure_injection_27 = 1;
            break;
        case 28: // User defined
            @Customer_Prj::hil_failure_injection_28 = 1;
            break;
        case 29: // User defined
            @Customer_Prj::hil_failure_injection_29 = 1;
            break;
        case 30: // User defined
            @Customer_Prj::hil_failure_injection_30 = 1;
            break;
        case 31: // User defined
            @Customer_Prj::hil_failure_injection_31 = 1;
            break;
        case 32: // User defined
            @Customer_Prj::hil_failure_injection_32 = 1;
            break;
        case 33: // User defined
            @Customer_Prj::hil_failure_injection_33 = 1;
            break;
        case 34: // User defined
            @Customer_Prj::hil_failure_injection_34 = 1;
            break;
        case 35: // User defined
            @Customer_Prj::hil_failure_injection_35 = 1;
            break;
        case 36: // User defined
            @Customer_Prj::hil_failure_injection_36 = 1;
            break;
        case 37: // User defined
            @Customer_Prj::hil_failure_injection_37 = 1;
            break;
        case 38: // User defined
            @Customer_Prj::hil_failure_injection_38 = 1;
            break;
        case 39: // User defined
            @Customer_Prj::hil_failure_injection_39 = 1;
            break;
        case 40: // User defined
            @Customer_Prj::hil_failure_injection_40 = 1;
            break;
        case 41: // User defined
            @Customer_Prj::hil_failure_injection_41 = 1;
            break;
        case 42: // User defined
            @Customer_Prj::hil_failure_injection_42 = 1;
            break;
        case 43: // User defined
            @Customer_Prj::hil_failure_injection_43 = 1;
            break;
        case 44: // User defined
            @Customer_Prj::hil_failure_injection_44 = 1;
            break;
        case 45: // User defined
            @Customer_Prj::hil_failure_injection_45 = 1;
            break;
        case 46: // User defined
            @Customer_Prj::hil_failure_injection_46 = 1;
            break;
        case 47: // User defined
            @Customer_Prj::hil_failure_injection_47 = 1;
            break;
        case 48: // User defined
            @Customer_Prj::hil_failure_injection_48 = 1;
            break;
        case 49: // User defined
            @Customer_Prj::hil_failure_injection_49 = 1;
            break;
        case 50: // User defined
            @Customer_Prj::hil_failure_injection_50 = 1;
            break;
        case 51: // User defined
            @Customer_Prj::hil_failure_injection_51 = 1;
            break;
        case 52: // User defined
            @Customer_Prj::hil_failure_injection_52 = 1;
            break;
        case 53: // User defined
            @Customer_Prj::hil_failure_injection_53 = 1;
            break;
        case 54: // User defined
            @Customer_Prj::hil_failure_injection_54 = 1;
            break;
        case 55: // User defined
            @Customer_Prj::hil_failure_injection_55 = 1;
            break;
        case 56: // User defined
            @Customer_Prj::hil_failure_injection_56 = 1;
            break;
        case 57: // User defined
            @Customer_Prj::hil_failure_injection_57 = 1;
            break;
        case 58: // User defined
            @Customer_Prj::hil_failure_injection_58 = 1;
            break;
        case 59: // User defined
            @Customer_Prj::hil_failure_injection_59 = 1;
            break;
        case 60: // User defined
            @Customer_Prj::hil_failure_injection_60 = 1;
            break;
        case 61: // User defined
            @Customer_Prj::hil_failure_injection_61 = 1;
            break;
        case 62: // User defined
            @Customer_Prj::hil_failure_injection_62 = 1;
            break;
        case 63: // User defined
            @Customer_Prj::hil_failure_injection_63 = 1;
            break;
        case 64: // User defined
            @Customer_Prj::hil_failure_injection_64 = 1;
            break;
        case 65: // User defined
            @Customer_Prj::hil_failure_injection_65 = 1;
            break;
        case 66: // User defined
            @Customer_Prj::hil_failure_injection_66 = 1;
            break;
        case 67: // User defined
            @Customer_Prj::hil_failure_injection_67 = 1;
            break;
        case 68: // User defined
            @Customer_Prj::hil_failure_injection_68 = 1;
            break;
        case 69: // User defined
            @Customer_Prj::hil_failure_injection_69 = 1;
            break;
        case 70: // User defined
            @Customer_Prj::hil_failure_injection_70 = 1;
            break;
        case 71: // User defined
            @Customer_Prj::hil_failure_injection_71 = 1;
            break;
        case 72: // User defined
            @Customer_Prj::hil_failure_injection_72 = 1;
            break;
        case 73: // User defined
            @Customer_Prj::hil_failure_injection_73 = 1;
            break;
        case 74: // User defined
            @Customer_Prj::hil_failure_injection_74 = 1;
            break;
        case 75: // User defined
            @Customer_Prj::hil_failure_injection_75 = 1;
            break;
        case 76: // User defined
            @Customer_Prj::hil_failure_injection_76 = 1;
            break;
        case 77: // User defined
            @Customer_Prj::hil_failure_injection_77 = 1;
            break;
        case 78: // User defined
            @Customer_Prj::hil_failure_injection_78 = 1;
            break;
        case 79: // User defined
            @Customer_Prj::hil_failure_injection_79 = 1;
            break;
        case 80: // User defined
            @Customer_Prj::hil_failure_injection_80 = 1;
            break;
        case 81: // User defined
            @Customer_Prj::hil_failure_injection_81 = 1;
            break;
        case 82: // User defined
            @Customer_Prj::hil_failure_injection_82 = 1;
            break;
        case 83: // User defined
            @Customer_Prj::hil_failure_injection_83 = 1;
            break;
        case 84: // User defined
            @Customer_Prj::hil_failure_injection_84 = 1;
            break;
        case 85: // User defined
            @Customer_Prj::hil_failure_injection_85 = 1;
            break;
        case 86: // User defined
            @Customer_Prj::hil_failure_injection_86 = 1;
            break;
        case 87: // User defined
            @Customer_Prj::hil_failure_injection_87 = 1;
            break;
        case 88: // User defined
            @Customer_Prj::hil_failure_injection_88 = 1;
            break;
        case 89: // User defined
            @Customer_Prj::hil_failure_injection_89 = 1;
            break;
        case 90: // User defined
            @Customer_Prj::hil_failure_injection_90 = 1;
            break;
        case 91: // User defined
            @Customer_Prj::hil_failure_injection_91 = 1;
            break;
        case 92: // User defined
            @Customer_Prj::hil_failure_injection_92 = 1;
            break;
        case 93: // User defined
            @Customer_Prj::hil_failure_injection_93 = 1;
            break;
        case 94: // User defined
            @Customer_Prj::hil_failure_injection_94 = 1;
            break;
        case 95: // User defined
            @Customer_Prj::hil_failure_injection_95 = 1;
            break;
        case 96: // User defined
            @Customer_Prj::hil_failure_injection_96 = 1;
            break;
        case 97: // User defined
            @Customer_Prj::hil_failure_injection_97 = 1;
            break;
        case 98: // User defined
            @Customer_Prj::hil_failure_injection_98 = 1;
            break;
        case 99: // User defined
            @Customer_Prj::hil_failure_injection_99 = 1;
            break;
        case 100: // User defined
            @Customer_Prj::hil_failure_injection_100 = 1;
            break;
        case 101: // User defined
            @Customer_Prj::hil_failure_injection_101 = 1;
            break;
        case 102: // User defined
            @Customer_Prj::hil_failure_injection_102 = 1;
            break;
        case 103: // User defined
            @Customer_Prj::hil_failure_injection_103 = 1;
            break;
        case 104: // User defined
            @Customer_Prj::hil_failure_injection_104 = 1;
            break;
        case 105: // User defined
            @Customer_Prj::hil_failure_injection_105 = 1;
            break;
        case 106: // User defined
            @Customer_Prj::hil_failure_injection_106 = 1;
            break;
        case 107: // User defined
            @Customer_Prj::hil_failure_injection_107 = 1;
            break;
        case 108: // User defined
            @Customer_Prj::hil_failure_injection_108 = 1;
            break;
        case 109: // User defined
            @Customer_Prj::hil_failure_injection_109 = 1;
            break;
        case 110: // User defined
            @Customer_Prj::hil_failure_injection_110 = 1;
            break;
        case 111: // User defined
            @Customer_Prj::hil_failure_injection_111 = 1;
            break;
        case 112: // User defined
            @Customer_Prj::hil_failure_injection_112 = 1;
            break;
        case 113: // User defined
            @Customer_Prj::hil_failure_injection_113 = 1;
            break;
        case 114: // User defined
            @Customer_Prj::hil_failure_injection_114 = 1;
            break;
        case 115: // User defined
            @Customer_Prj::hil_failure_injection_115 = 1;
            break;
        case 116: // User defined
            @Customer_Prj::hil_failure_injection_116 = 1;
            break;
        case 117: // User defined
            @Customer_Prj::hil_failure_injection_117 = 1;
            break;
        case 118: // User defined
            @Customer_Prj::hil_failure_injection_118 = 1;
            break;
        case 119: // User defined
            @Customer_Prj::hil_failure_injection_119 = 1;
            break;
        case 120: // User defined
            @Customer_Prj::hil_failure_injection_120 = 1;
            break;
        case 121: // User defined
            @Customer_Prj::hil_failure_injection_121 = 1;
            break;
        case 122: // User defined
            @Customer_Prj::hil_failure_injection_122 = 1;
            break;
        case 123: // User defined
            @Customer_Prj::hil_failure_injection_123 = 1;
            break;
        case 124: // User defined
            @Customer_Prj::hil_failure_injection_124 = 1;
            break;
        case 125: // User defined
            @Customer_Prj::hil_failure_injection_125 = 1;
            break;
        case 126: // User defined
            @Customer_Prj::hil_failure_injection_126 = 1;
            break;
        case 127: // User defined
            @Customer_Prj::hil_failure_injection_127 = 1;
            break;
        case 128: // User defined
            @Customer_Prj::hil_failure_injection_128 = 1;
            break;
        case 129: // User defined
            @Customer_Prj::hil_failure_injection_129 = 1;
            break;
        case 130: // User defined
            @Customer_Prj::hil_failure_injection_130 = 1;
            break;
        case 131: // User defined
            @Customer_Prj::hil_failure_injection_131 = 1;
            break;
        case 132: // User defined
            @Customer_Prj::hil_failure_injection_132 = 1;
            break;
        case 133: // User defined
            @Customer_Prj::hil_failure_injection_133 = 1;
            break;
        case 134: // User defined
            @Customer_Prj::hil_failure_injection_134 = 1;
            break;
        case 135: // User defined
            @Customer_Prj::hil_failure_injection_135 = 1;
            break;
        case 136: // User defined
            @Customer_Prj::hil_failure_injection_136 = 1;
            break;
        case 137: // User defined
            @Customer_Prj::hil_failure_injection_137 = 1;
            break;
        case 138: // User defined
            @Customer_Prj::hil_failure_injection_138 = 1;
            break;
        case 139: // User defined
            @Customer_Prj::hil_failure_injection_139 = 1;
            break;
        case 140: // User defined
            @Customer_Prj::hil_failure_injection_140 = 1;
            break;
        case 141: // User defined
            @Customer_Prj::hil_failure_injection_141 = 1;
            break;
        case 142: // User defined
            @Customer_Prj::hil_failure_injection_142 = 1;
            break;
        case 143: // User defined
            @Customer_Prj::hil_failure_injection_143 = 1;
            break;
        case 144: // User defined
            @Customer_Prj::hil_failure_injection_144 = 1;
            break;
        case 145: // User defined
            @Customer_Prj::hil_failure_injection_145 = 1;
            break;
        case 146: // User defined
            @Customer_Prj::hil_failure_injection_146 = 1;
            break;
        case 147: // User defined
            @Customer_Prj::hil_failure_injection_147 = 1;
            break;
        case 148: // User defined
            @Customer_Prj::hil_failure_injection_148 = 1;
            break;
        case 149: // User defined
            @Customer_Prj::hil_failure_injection_149 = 1;
            break;
        case 150: // User defined
            @Customer_Prj::hil_failure_injection_150 = 1;
            break;
        case 151: // User defined
            @Customer_Prj::hil_failure_injection_151 = 1;
            break;
        case 152: // User defined
            @Customer_Prj::hil_failure_injection_152 = 1;
            break;
        case 153: // User defined
            @Customer_Prj::hil_failure_injection_153 = 1;
            break;
        case 154: // User defined
            @Customer_Prj::hil_failure_injection_154 = 1;
            break;
        case 155: // User defined
            @Customer_Prj::hil_failure_injection_155 = 1;
            break;
        case 156: // User defined
            @Customer_Prj::hil_failure_injection_156 = 1;
            break;
        case 157: // User defined
            @Customer_Prj::hil_failure_injection_157 = 1;
            break;
        case 158: // User defined
            @Customer_Prj::hil_failure_injection_158 = 1;
            break;
        case 159: // User defined
            @Customer_Prj::hil_failure_injection_159 = 1;
            break;
        case 160: // User defined
            @Customer_Prj::hil_failure_injection_160 = 1;
            break;
        case 161: // User defined
            @Customer_Prj::hil_failure_injection_161 = 1;
            break;
        case 162: // User defined
            @Customer_Prj::hil_failure_injection_162 = 1;
            break;
        case 163: // User defined
            @Customer_Prj::hil_failure_injection_163 = 1;
            break;
        case 164: // User defined
            @Customer_Prj::hil_failure_injection_164 = 1;
            break;
        case 165: // User defined
            @Customer_Prj::hil_failure_injection_165 = 1;
            break;
        case 166: // User defined
            @Customer_Prj::hil_failure_injection_166 = 1;
            break;
        case 167: // User defined
            @Customer_Prj::hil_failure_injection_167 = 1;
            break;
        case 168: // User defined
            @Customer_Prj::hil_failure_injection_168 = 1;
            break;
        case 169: // User defined
            @Customer_Prj::hil_failure_injection_169 = 1;
            break;
        case 170: // User defined
            @Customer_Prj::hil_failure_injection_170 = 1;
            break;
        case 171: // User defined
            @Customer_Prj::hil_failure_injection_171 = 1;
            break;
        case 172: // User defined
            @Customer_Prj::hil_failure_injection_172 = 1;
            break;
        case 173: // User defined
            @Customer_Prj::hil_failure_injection_173 = 1;
            break;
        case 174: // User defined
            @Customer_Prj::hil_failure_injection_174 = 1;
            break;
        case 175: // User defined
            @Customer_Prj::hil_failure_injection_175 = 1;
            break;
        case 176: // User defined
            @Customer_Prj::hil_failure_injection_176 = 1;
            break;
        case 177: // User defined
            @Customer_Prj::hil_failure_injection_177 = 1;
            break;
        case 178: // User defined
            @Customer_Prj::hil_failure_injection_178 = 1;
            break;
        case 179: // User defined
            @Customer_Prj::hil_failure_injection_179 = 1;
            break;
        case 180: // User defined
            @Customer_Prj::hil_failure_injection_180 = 1;
            break;
        case 181: // User defined
            @Customer_Prj::hil_failure_injection_181 = 1;
            break;
        case 182: // User defined
            @Customer_Prj::hil_failure_injection_182 = 1;
            break;
        case 183: // User defined
            @Customer_Prj::hil_failure_injection_183 = 1;
            break;
        case 184: // User defined
            @Customer_Prj::hil_failure_injection_184 = 1;
            break;
        case 185: // User defined
            @Customer_Prj::hil_failure_injection_185 = 1;
            break;
        case 186: // User defined
            @Customer_Prj::hil_failure_injection_186 = 1;
            break;
        case 187: // User defined
            @Customer_Prj::hil_failure_injection_187 = 1;
            break;
        case 188: // User defined
            @Customer_Prj::hil_failure_injection_188 = 1;
            break;
        case 189: // User defined
            @Customer_Prj::hil_failure_injection_189 = 1;
            break;
        case 190: // User defined
            @Customer_Prj::hil_failure_injection_190 = 1;
            break;
        case 191: // User defined
            @Customer_Prj::hil_failure_injection_191 = 1;
            break;
        case 192: // User defined
            @Customer_Prj::hil_failure_injection_192 = 1;
            break;
        case 193: // User defined
            @Customer_Prj::hil_failure_injection_193 = 1;
            break;
        case 194: // User defined
            @Customer_Prj::hil_failure_injection_194 = 1;
            break;
        case 195: // User defined
            @Customer_Prj::hil_failure_injection_195 = 1;
            break;
        case 196: // User defined
            @Customer_Prj::hil_failure_injection_196 = 1;
            break;
        case 197: // User defined
            @Customer_Prj::hil_failure_injection_197 = 1;
            break;
        case 198: // User defined
            @Customer_Prj::hil_failure_injection_198 = 1;
            break;
        case 199: // User defined
            @Customer_Prj::hil_failure_injection_199 = 1;
            break;
        case 200: // User defined
            @Customer_Prj::hil_failure_injection_200 = 1;
            break;
        case 201: // User defined
            @Customer_Prj::hil_failure_injection_201 = 1;
            break;
        case 202: // User defined
            @Customer_Prj::hil_failure_injection_202 = 1;
            break;
        case 203: // User defined
            @Customer_Prj::hil_failure_injection_203 = 1;
            break;
        case 204: // User defined
            @Customer_Prj::hil_failure_injection_204 = 1;
            break;
        case 205: // User defined
            @Customer_Prj::hil_failure_injection_205 = 1;
            break;
        case 206: // User defined
            @Customer_Prj::hil_failure_injection_206 = 1;
            break;
        case 207: // User defined
            @Customer_Prj::hil_failure_injection_207 = 1;
            break;
        case 208: // User defined
            @Customer_Prj::hil_failure_injection_208 = 1;
            break;
        case 209: // User defined
            @Customer_Prj::hil_failure_injection_209 = 1;
            break;
        case 210: // User defined
            @Customer_Prj::hil_failure_injection_210 = 1;
            break;
        case 211: // User defined
            @Customer_Prj::hil_failure_injection_211 = 1;
            break;
        case 212: // User defined
            @Customer_Prj::hil_failure_injection_212 = 1;
            break;
        case 213: // User defined
            @Customer_Prj::hil_failure_injection_213 = 1;
            break;
        case 214: // User defined
            @Customer_Prj::hil_failure_injection_214 = 1;
            break;
        case 215: // User defined
            @Customer_Prj::hil_failure_injection_215 = 1;
            break;
        case 216: // User defined
            @Customer_Prj::hil_failure_injection_216 = 1;
            break;
        case 217: // User defined
            @Customer_Prj::hil_failure_injection_217 = 1;
            break;
        case 218: // User defined
            @Customer_Prj::hil_failure_injection_218 = 1;
            break;
        case 219: // User defined
            @Customer_Prj::hil_failure_injection_219 = 1;
            break;
        case 220: // User defined
            @Customer_Prj::hil_failure_injection_220 = 1;
            break;
        case 221: // User defined
            @Customer_Prj::hil_failure_injection_221 = 1;
            break;
        case 222: // User defined
            @Customer_Prj::hil_failure_injection_222 = 1;
            break;
        case 223: // User defined
            @Customer_Prj::hil_failure_injection_223 = 1;
            break;
        case 224: // User defined
            @Customer_Prj::hil_failure_injection_224 = 1;
            break;
        case 225: // User defined
            @Customer_Prj::hil_failure_injection_225 = 1;
            break;
        case 226: // User defined
            @Customer_Prj::hil_failure_injection_226 = 1;
            break;
        case 227: // User defined
            @Customer_Prj::hil_failure_injection_227 = 1;
            break;
        case 228: // User defined
            @Customer_Prj::hil_failure_injection_228 = 1;
            break;
        case 229: // User defined
            @Customer_Prj::hil_failure_injection_229 = 1;
            break;
        case 230: // User defined
            @Customer_Prj::hil_failure_injection_230 = 1;
            break;
        case 231: // User defined
            @Customer_Prj::hil_failure_injection_231 = 1;
            break;
        case 232: // User defined
            @Customer_Prj::hil_failure_injection_232 = 1;
            break;
        case 233: // User defined
            @Customer_Prj::hil_failure_injection_233 = 1;
            break;
        case 234: // User defined
            @Customer_Prj::hil_failure_injection_234 = 1;
            break;
        case 235: // User defined
            @Customer_Prj::hil_failure_injection_235 = 1;
            break;
        case 236: // User defined
            @Customer_Prj::hil_failure_injection_236 = 1;
            break;
        case 237: // User defined
            @Customer_Prj::hil_failure_injection_237 = 1;
            break;
        case 238: // User defined
            @Customer_Prj::hil_failure_injection_238 = 1;
            break;
        case 239: // User defined
            @Customer_Prj::hil_failure_injection_239 = 1;
            break;
        case 240: // User defined
            @Customer_Prj::hil_failure_injection_240 = 1;
            break;
        case 241: // User defined
            @Customer_Prj::hil_failure_injection_241 = 1;
            break;
        case 242: // User defined
            @Customer_Prj::hil_failure_injection_242 = 1;
            break;
        case 243: // User defined
            @Customer_Prj::hil_failure_injection_243 = 1;
            break;
        case 244: // User defined
            @Customer_Prj::hil_failure_injection_244 = 1;
            break;
        case 245: // User defined
            @Customer_Prj::hil_failure_injection_245 = 1;
            break;
        case 246: // User defined
            @Customer_Prj::hil_failure_injection_246 = 1;
            break;
        case 247: // User defined
            @Customer_Prj::hil_failure_injection_247 = 1;
            break;
        case 248: // User defined
            @Customer_Prj::hil_failure_injection_248 = 1;
            break;
        case 249: // User defined
            @Customer_Prj::hil_failure_injection_249 = 1;
            break;
        case 250: // User defined
            @Customer_Prj::hil_failure_injection_250 = 1;
            break;
        case 251: // User defined
            @Customer_Prj::hil_failure_injection_251 = 1;
            break;
        case 252: // User defined
            @Customer_Prj::hil_failure_injection_252 = 1;
            break;
        case 253: // User defined
            @Customer_Prj::hil_failure_injection_253 = 1;
            break;
        case 254: // User defined
            @Customer_Prj::hil_failure_injection_254 = 1;
            break;
        case 255: // User defined
            @Customer_Prj::hil_failure_injection_255 = 1;
            break;
        default: // No degradation needed
            break;
    }
}
