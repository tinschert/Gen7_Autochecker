/*@!Encoding:1252*/
/**
 * @file Road_Obj_FRadar_Bus.cin
 * @author ADAS_HIL_TEAM
 * @date 08-21-2023
 * @brief  Handles Front object creation into sys variables on Bus level
 *
 * ################################################################
 * C O P Y R I G H T S
 * ----------------------------------------------------------------
 * Copyright (c) 2023 by Robert Bosch GmbH. All rights reserved.
 
 * The reproduction, distribution and utilization of this file as
 * well as the communication of its contents to others without express
 * authorization is prohibited. Offenders will be held liable for the
 * payment of damages. All rights reserved in the event of the grant
 * of a patent, utility model or design.
 *
 * ################################################################
*/

includes
{
}

variables
{

}


void obj_sim_update_fradar_bus(byte object_id)
{
  //do nothing for PSA
}