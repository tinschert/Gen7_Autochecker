/*@!Encoding:1252*/
/**
 * @file Road_Obj_FVideo_Bus.cin
 * @author ADAS_HIL_TEAM
 * @date 08-21-2023
 * @brief  Handles Video object creation into sys variables on Bus level
 *
 * ################################################################
 * C O P Y R I G H T S
 * ----------------------------------------------------------------
 * Copyright (c) 2023 by Robert Bosch GmbH. All rights reserved.
 
 * The reproduction, distribution and utilization of this file as
 * well as the communication of its contents to others without express
 * authorization is prohibited. Offenders will be held liable for the
 * payment of damages. All rights reserved in the event of the grant
 * of a patent, utility model or design.
 *
 * ################################################################
*/

includes
{
}

variables
{
  double phiLeft = 0 ;
  double phiRight = 0 ;
  double phiMiddle[20];
  double phiMiddle_previous[20];
  double phiMiddle_vel[20];
  double dx_image_plane_crossing = 0;
  double tt_image_plane_crossing = 0;
  byte fvideo_obj_count = 0;
  byte closest_obj_id = 0;
  double fvideo_aeb_act_dx = 10.0;
}

void obj_sim_update_fvideo_bus(byte object_id)
{
  // Header values
  @FDP1_OBJ_DESC_1_CMF2_156::AEBAVAILABILITY_Rv = 0;
  @FDP1_OBJ_DESC_1_CMF2_156::CAMERA_EE_STATUS_Rv = 1;
  //@FDP1_OBJ_DESC_1_CMF2_156::CIPV_FCV_Rv = 3; //not found in R11
  
  @FDP1_OBJ_DESC_1_CMF2_156::DRIVING_SIDE_Rv = 1;
  @FDP1_OBJ_DESC_1_CMF2_156::FCAMERA_FRAME_COUNTER_Rv = 17;
  @FDP1_OBJ_DESC_1_CMF2_156::FRONT_CAMERA_STATUS_Rv = 0;
  @FDP1_OBJ_DESC_1_CMF2_156::VEH_PREFILL_ALERT_SCP_REQ_Rv = 0;
  @FDP1_OBJ_DESC_1_CMF2_156::VEH_FCW_ALERT_SCP_REQ_Rv = 0;
  @FDP1_OBJ_DESC_1_CMF2_156::VEH_AEB_ALERT_HEADON_ONCOM_Rv = 0;
  @FDP1_OBJ_DESC_1_CMF2_156::VEH_AEB_ALERT_SCP_Rv = 0;
  @FDP1_OBJ_DESC_1_CMF2_156::VEH_AEB_ALERT_TAP_Rv = 0;
// added new signals for R11
  @FDP1_OBJ_DESC_1_CMF2_156::HOT_ID_Rv = 0;
  @FDP1_OBJ_DESC_1_CMF2_156::SCP_ID_Rv = 0;
  @FDP1_OBJ_DESC_1_CMF2_156::SD_INV_TT_IPC_Rv = 0;
  @FDP1_OBJ_DESC_1_CMF2_156::TAP_ID_Rv = 0;

    // object ID of the closest object for AEB activation
  for(fvideo_obj_count = 1; fvideo_obj_count < (obj_max_allowed); fvideo_obj_count++)
  {
    if ((@Classe_Obj_Sim::obj_data.obj_dx[closest_obj_id] > 0 ) && (@Classe_Obj_Sim::obj_data.obj_dx[fvideo_obj_count] > 0))
    {
      if(@Classe_Obj_Sim::obj_data.obj_dx[closest_obj_id] < @Classe_Obj_Sim::obj_data.obj_dx[fvideo_obj_count] )
      {
        closest_obj_id = closest_obj_id;
      }
      else
      {
        closest_obj_id = fvideo_obj_count;
      }
    }
  }
  if (@Classe_Obj_Sim::obj_data.obj_dx[closest_obj_id] < fvideo_aeb_act_dx)
  {
    if (@Classe_Obj_Sim::obj_data.obj_relative_vx[closest_obj_id] < 0)
    {
      switch (@Classe_Obj_Sim::obj_data.obj_type[closest_obj_id])
      {
        case 0: //"Non-Obstacle"
          @FDP1_OBJ_DESC_1_CMF2_156::PED_CYC_AEB_ALERT_Rv = 0;
          @FDP1_OBJ_DESC_1_CMF2_156::PED_CYC_FCW_ALERT_Rv = 0;
          @FDP1_OBJ_DESC_1_CMF2_156::PED_CYC_PREFILL_ALERT_Rv = 0;
          @FDP1_OBJ_DESC_1_CMF2_156::VEH_PREFILL_ALERT_Rv = 0;
          @FDP1_OBJ_DESC_1_CMF2_156::VEH_FCW_ALERT_Rv = 0;
          @FDP1_OBJ_DESC_1_CMF2_156::VEH_AEB_ALERT_Rv = 0;
          @FDP1_OBJ_DESC_1_CMF2_156::PED_CYC_AEB_ALERT_CONF_Rv = 0;
          @FDP1_OBJ_DESC_1_CMF2_156::VEH_AEB_ALERT_CONF_Rv = 0;
          break;
        case 1: //"unknown"
          @FDP1_OBJ_DESC_1_CMF2_156::PED_CYC_AEB_ALERT_Rv = 0;
          @FDP1_OBJ_DESC_1_CMF2_156::PED_CYC_FCW_ALERT_Rv = 0;
          @FDP1_OBJ_DESC_1_CMF2_156::PED_CYC_PREFILL_ALERT_Rv = 0;
          @FDP1_OBJ_DESC_1_CMF2_156::VEH_PREFILL_ALERT_Rv = 0;
          @FDP1_OBJ_DESC_1_CMF2_156::VEH_FCW_ALERT_Rv = 0;
          @FDP1_OBJ_DESC_1_CMF2_156::VEH_AEB_ALERT_Rv = 0;
          @FDP1_OBJ_DESC_1_CMF2_156::PED_CYC_AEB_ALERT_CONF_Rv = 0;
          @FDP1_OBJ_DESC_1_CMF2_156::VEH_AEB_ALERT_CONF_Rv = 0;
          break;
        case 2: //"RoadSideBarrier"
          @FDP1_OBJ_DESC_1_CMF2_156::PED_CYC_AEB_ALERT_Rv = 0;
          @FDP1_OBJ_DESC_1_CMF2_156::PED_CYC_FCW_ALERT_Rv = 0;
          @FDP1_OBJ_DESC_1_CMF2_156::PED_CYC_PREFILL_ALERT_Rv = 0;
          @FDP1_OBJ_DESC_1_CMF2_156::VEH_PREFILL_ALERT_Rv = 0;
          @FDP1_OBJ_DESC_1_CMF2_156::VEH_FCW_ALERT_Rv = 0;
          @FDP1_OBJ_DESC_1_CMF2_156::VEH_AEB_ALERT_Rv = 0;
          @FDP1_OBJ_DESC_1_CMF2_156::PED_CYC_AEB_ALERT_CONF_Rv = 0;
          @FDP1_OBJ_DESC_1_CMF2_156::VEH_AEB_ALERT_CONF_Rv = 0;
          break;
        case 3: //"2Wheeler"
          @FDP1_OBJ_DESC_1_CMF2_156::PED_CYC_AEB_ALERT_Rv = 1;
          @FDP1_OBJ_DESC_1_CMF2_156::PED_CYC_FCW_ALERT_Rv = 0;
          @FDP1_OBJ_DESC_1_CMF2_156::PED_CYC_PREFILL_ALERT_Rv = 1;
          @FDP1_OBJ_DESC_1_CMF2_156::VEH_PREFILL_ALERT_Rv = 0;
          @FDP1_OBJ_DESC_1_CMF2_156::VEH_FCW_ALERT_Rv = 0;
          @FDP1_OBJ_DESC_1_CMF2_156::VEH_AEB_ALERT_Rv = 0;
          @FDP1_OBJ_DESC_1_CMF2_156::PED_CYC_AEB_ALERT_CONF_Rv = 0;
          @FDP1_OBJ_DESC_1_CMF2_156::VEH_AEB_ALERT_CONF_Rv = 1;
          break;
        case 4: //"Pedestrian"
          @FDP1_OBJ_DESC_1_CMF2_156::PED_CYC_AEB_ALERT_Rv = 1;
          @FDP1_OBJ_DESC_1_CMF2_156::PED_CYC_FCW_ALERT_Rv = 0;
          @FDP1_OBJ_DESC_1_CMF2_156::PED_CYC_PREFILL_ALERT_Rv = 1;
          @FDP1_OBJ_DESC_1_CMF2_156::VEH_PREFILL_ALERT_Rv = 0;
          @FDP1_OBJ_DESC_1_CMF2_156::VEH_FCW_ALERT_Rv = 0;
          @FDP1_OBJ_DESC_1_CMF2_156::VEH_AEB_ALERT_Rv = 0;
          @FDP1_OBJ_DESC_1_CMF2_156::PED_CYC_AEB_ALERT_CONF_Rv = 1;
          @FDP1_OBJ_DESC_1_CMF2_156::VEH_AEB_ALERT_CONF_Rv = 0;
          break;
        case 5: //"Truck"
          @FDP1_OBJ_DESC_1_CMF2_156::PED_CYC_AEB_ALERT_Rv = 0;
          @FDP1_OBJ_DESC_1_CMF2_156::PED_CYC_FCW_ALERT_Rv = 0;
          @FDP1_OBJ_DESC_1_CMF2_156::PED_CYC_PREFILL_ALERT_Rv = 0;
          @FDP1_OBJ_DESC_1_CMF2_156::VEH_PREFILL_ALERT_Rv = 1;
          @FDP1_OBJ_DESC_1_CMF2_156::VEH_FCW_ALERT_Rv = 0;
          @FDP1_OBJ_DESC_1_CMF2_156::VEH_AEB_ALERT_Rv = 1;
          @FDP1_OBJ_DESC_1_CMF2_156::PED_CYC_AEB_ALERT_CONF_Rv = 0;
          @FDP1_OBJ_DESC_1_CMF2_156::VEH_AEB_ALERT_CONF_Rv = 1;
          break;
        case 6: //"PassengerCar"
          @FDP1_OBJ_DESC_1_CMF2_156::PED_CYC_AEB_ALERT_Rv = 0;
          @FDP1_OBJ_DESC_1_CMF2_156::PED_CYC_FCW_ALERT_Rv = 0;
          @FDP1_OBJ_DESC_1_CMF2_156::PED_CYC_PREFILL_ALERT_Rv = 0;
          @FDP1_OBJ_DESC_1_CMF2_156::VEH_PREFILL_ALERT_Rv = 1;
          @FDP1_OBJ_DESC_1_CMF2_156::VEH_FCW_ALERT_Rv = 0;
          @FDP1_OBJ_DESC_1_CMF2_156::VEH_AEB_ALERT_Rv = 1;
          @FDP1_OBJ_DESC_1_CMF2_156::PED_CYC_AEB_ALERT_CONF_Rv = 0;
          @FDP1_OBJ_DESC_1_CMF2_156::VEH_AEB_ALERT_CONF_Rv = 1;
          break;
      }
    }
    else
    {
      @FDP1_OBJ_DESC_1_CMF2_156::PED_CYC_AEB_ALERT_Rv = 0;
      @FDP1_OBJ_DESC_1_CMF2_156::PED_CYC_FCW_ALERT_Rv = 0;
      @FDP1_OBJ_DESC_1_CMF2_156::PED_CYC_PREFILL_ALERT_Rv = 0;
      @FDP1_OBJ_DESC_1_CMF2_156::VEH_PREFILL_ALERT_Rv = 0;
      @FDP1_OBJ_DESC_1_CMF2_156::VEH_FCW_ALERT_Rv = 0;
      @FDP1_OBJ_DESC_1_CMF2_156::VEH_AEB_ALERT_Rv = 0;
      @FDP1_OBJ_DESC_1_CMF2_156::PED_CYC_AEB_ALERT_CONF_Rv = 0;
      @FDP1_OBJ_DESC_1_CMF2_156::VEH_AEB_ALERT_CONF_Rv = 0;
    }
  }
  switch (@Classe_Obj_Sim::obj_data.obj_id[object_id])
  {
    case 0: //"Object-0"
      // Object Constant values
      @FDP1_OBJ_DESC_1_CMF2_156::CAM_OBJ_ACQUISITION_TYPE_Rv = 1;
      @FDP1_OBJ_DESC_1_CMF2_156::CAM_OBJ_BRK_INDIC_STATE_Rv = 2;
      @FDP1_OBJ_DESC_1_CMF2_156::CAM_OBJ_LENGTH_2_Rv = 10;
      @FDP1_OBJ_DESC_1_CMF2_156::CAM_OBJ_TURN_INDIC_STATE_Rv = 1;
      @FDP1_OBJ_DESC_1_CMF2_156::CAM_PROB_EXIST_PHYS_OBJ_Rv = 100;
      @FDP1_OBJ_DESC_1_CMF2_156::CAM_PROB_OBJ_CLASS_Rv = 100;
      @FDP1_OBJ_DESC_1_CMF2_156::CAM_VAR_OBJ_ANGLE_VELO_2_Rv = 0;
      @FDP1_OBJ_DESC_1_CMF2_156::CAM_VAR_OBJ_L_EDGE_VIEW_2_Rv = 0;
      @FDP1_OBJ_DESC_1_CMF2_156::CAM_VAR_OBJ_LAT_DIST_2_Rv = 0;
      @FDP1_OBJ_DESC_1_CMF2_156::CAM_VAR_OBJ_LENGTH_2_Rv = 0;
      @FDP1_OBJ_DESC_1_CMF2_156::CAM_VAR_OBJ_LONGI_DIST_2_Rv = 0;
      @FDP1_OBJ_DESC_1_CMF2_156::CAM_VAR_OBJ_R_EDGE_VIEW_2_Rv = 0;
      @FDP1_OBJ_DESC_1_CMF2_156::CAM_VAR_OBJ_YAW_ANGLE_2_Rv = 0;
      @FDP1_OBJ_DESC_1_CMF2_156::CAM_YAW_ANGLE_2_Rv = 0;
      @FDP1_OBJ_DESC_1_CMF2_156::OBJ_CAM_LANE_POS_Rv = 0;
      @FDP1_OBJ_DESC_1_CMF2_156::OBJ_CAM_MOTION_STATUS_2_Rv = 1;
      @FDP1_OBJ_DESC_1_CMF2_156::OBJ_CAM_REFERENCE_POINT_Rv = 2;
      @FDP1_OBJ_DESC_1_CMF2_156::OBJ_CAM_STD_DIST_EDGE_VIEW_2_Rv = 0;
      @FDP1_OBJ_DESC_1_CMF2_156::OBJ_CAM_VHL_DIST_EDGE_VIEW_2_Rv = 0;


      // Object dynamic values conversion to raw
      @FDP1_OBJ_DESC_1_CMF2_156::CAM_OBJ_LONGI_DIST_2_Rv = (@Classe_Obj_Sim::obj_data.obj_dx[0] - 3.5) * 10;
      @FDP1_OBJ_DESC_1_CMF2_156::CAM_OBJ_LAT_DIST_2_Rv = @Classe_Obj_Sim::obj_data.obj_dy[0] * 20;
      @FDP1_OBJ_DESC_1_CMF2_156::CAM_OBJ_RELAT_VELO_LONGI_2_Rv = (@Classe_Obj_Sim::obj_data.obj_relative_vx[0] * 10) + 1280;
      @FDP1_OBJ_DESC_1_CMF2_156::CAM_OBJ_RELAT_VELO_LAT_2_Rv = @Classe_Obj_Sim::obj_data.obj_relative_vy[0] * 10;

      // calculation of angle view of the object
      if ((@Classe_Obj_Sim::obj_data.obj_dx[object_id]) > 0.0)
      {
        phiLeft = arctan((@Classe_Obj_Sim::obj_data.obj_dy[object_id] + (@Classe_Obj_Sim::obj_data.obj_width[object_id]/2)) /@Classe_Obj_Sim::obj_data.obj_dx[object_id]);
        phiRight = arctan((@Classe_Obj_Sim::obj_data.obj_dy[object_id] - (@Classe_Obj_Sim::obj_data.obj_width[object_id]/2)) /@Classe_Obj_Sim::obj_data.obj_dx[object_id]);


        if ((phiLeft!=0)&&(phiRight!=0))
        {
          @Classe_Obj_Sim::obj_data.obj_phileft[object_id]= (phiLeft)/0.001;
          @Classe_Obj_Sim::obj_data.obj_phiright[object_id] = (phiRight)/0.001;
        }
          @FDP1_OBJ_DESC_1_CMF2_156::CAM_VHL_RIGHT_EDGE_VIEW_2_Rv = @Classe_Obj_Sim::obj_data.obj_phileft[object_id];
          @FDP1_OBJ_DESC_1_CMF2_156::CAM_VHL_LEFT_EDGE_VIEW_2_Rv = @Classe_Obj_Sim::obj_data.obj_phiright[object_id];
      }

      // calculate the angle velocity based on the delta middle angle and the simulation time in miliseconds
      if (@Classe_Obj_Sim::obj_data.obj_dx[object_id] > 0.0)
      {
        phiMiddle[object_id] = arctan(@Classe_Obj_Sim::obj_data.obj_dy[object_id] / @Classe_Obj_Sim::obj_data.obj_dx[object_id]);
        phiMiddle_vel[object_id] = (phiMiddle[object_id] - phiMiddle_previous[object_id]) / (@Vehicle_Model::simulation_cycle_time * 0.001);
        phiMiddle_previous[object_id] = phiMiddle[object_id];
        @FDP1_OBJ_DESC_1_CMF2_156::CAM_OBJ_ANGLE_VELOCITY_2_Rv = (phiMiddle_vel[object_id]) / 0.002;
      }
      else
      {
        @FDP1_OBJ_DESC_1_CMF2_156::CAM_OBJ_ANGLE_VELOCITY_2_Rv = 0;
      }

      //Image plane crossing time to collision
      dx_image_plane_crossing = @Classe_Obj_Sim::obj_data.obj_dx[object_id] - 3.5;
      if ((dx_image_plane_crossing > 0) && (@Classe_Obj_Sim::obj_data.obj_relative_vx[object_id] != 0))
      {
        // time to collision to image plane in seconds
        tt_image_plane_crossing = @Classe_Obj_Sim::obj_data.obj_relative_vx[object_id] / dx_image_plane_crossing;
        @FDP1_OBJ_DESC_1_CMF2_156::INV_TT_IPC_Rv = -tt_image_plane_crossing * 64;
      }
      else
      {
        @FDP1_OBJ_DESC_1_CMF2_156::INV_TT_IPC_Rv = 8 * 64;
      }


      @FDP1_OBJ_DESC_1_CMF2_156::HANDLE_TRACKED_OBJ_2_Rv = object_id + 1;

        //object classification
      switch (@Classe_Obj_Sim::obj_data.obj_type[0])
      {
        case 0: //"Non-Obstacle"
          @FDP1_OBJ_DESC_1_CMF2_156::CAM_OBJ_CLASS_Rv = 6;
          break;

        case 1: //"unknown"
          @FDP1_OBJ_DESC_1_CMF2_156::CAM_OBJ_CLASS_Rv = 0;
          break;

        case 2: //"RoadSideBarrier"
          @FDP1_OBJ_DESC_1_CMF2_156::CAM_OBJ_CLASS_Rv = 6;
          break;

        case 3: //"2Wheeler"
          @FDP1_OBJ_DESC_1_CMF2_156::CAM_OBJ_CLASS_Rv = 4;
          break;

        case 4: //"Pedestrian"
          @FDP1_OBJ_DESC_1_CMF2_156::CAM_OBJ_CLASS_Rv = 5;
          break;

        case 5: //"Truck"
          @FDP1_OBJ_DESC_1_CMF2_156::CAM_OBJ_CLASS_Rv = 1;
          break;

        case 6: //"PassengerCar"
          @FDP1_OBJ_DESC_1_CMF2_156::CAM_OBJ_CLASS_Rv = 2;
          break;
      }
      break;

    case 1: //"Object-1"
      // Object Constant values
      @FDP1_OBJ_DESC_2_CMF2_1A7::OBJ2_OBJA_CAM_OBJ_ACQUISITION_TYPE_Rv = 1;
      @FDP1_OBJ_DESC_2_CMF2_1A7::OBJ2_OBJA_CAM_OBJ_BRK_INDIC_STATE_Rv = 2;
      @FDP1_OBJ_DESC_2_CMF2_1A7::OBJ2_OBJA_CAM_OBJ_LENGTH_2_Rv = 10;
      @FDP1_OBJ_DESC_2_CMF2_1A7::OBJ2_OBJA_CAM_OBJ_TURN_INDIC_STATE_Rv = 1;
      @FDP1_OBJ_DESC_2_CMF2_1A7::OBJ2_OBJA_CAM_PROB_EXIST_PHYS_OBJ_Rv = 100;
      @FDP1_OBJ_DESC_2_CMF2_1A7::OBJ2_OBJA_CAM_PROB_OBJ_CLASS_Rv = 100;
      @FDP1_OBJ_DESC_2_CMF2_1A7::OBJ2_OBJA_CAM_VAR_OBJ_ANGLE_VELO_2_Rv = 0;
      @FDP1_OBJ_DESC_2_CMF2_1A7::OBJ2_OBJA_CAM_VAR_OBJ_L_EDGE_VIEW_2_Rv = 0;
      @FDP1_OBJ_DESC_2_CMF2_1A7::OBJ2_OBJA_CAM_VAR_OBJ_LAT_DIST_2_Rv = 0;
      @FDP1_OBJ_DESC_2_CMF2_1A7::OBJ2_OBJA_CAM_VAR_OBJ_LENGTH_2_Rv = 0;
      @FDP1_OBJ_DESC_2_CMF2_1A7::OBJ2_OBJA_CAM_VAR_OBJ_LONGI_DIST_2_Rv = 0;
      @FDP1_OBJ_DESC_2_CMF2_1A7::OBJ2_OBJA_CAM_VAR_OBJ_R_EDGE_VIEW_2_Rv = 0;
      @FDP1_OBJ_DESC_2_CMF2_1A7::OBJ2_OBJA_CAM_VAR_OBJ_YAW_ANGLE_2_Rv = 0;
      @FDP1_OBJ_DESC_2_CMF2_1A7::OBJ2_OBJA_CAM_YAW_ANGLE_2_Rv = 0;
      @FDP1_OBJ_DESC_2_CMF2_1A7::OBJ2_OBJA_CAM_LANE_POS_Rv = 0;
      @FDP1_OBJ_DESC_2_CMF2_1A7::OBJ2_OBJA_CAM_MOTION_STATUS_2_Rv = 1;
      @FDP1_OBJ_DESC_2_CMF2_1A7::OBJ2_OBJA_CAM_REFERENCE_POINT_Rv = 2;
      @FDP1_OBJ_DESC_2_CMF2_1A7::OBJ2_OBJA_CAM_STD_DIST_EDGE_VIEW_2_Rv = 0;
      @FDP1_OBJ_DESC_2_CMF2_1A7::OBJ2_OBJA_CAM_VHL_DIST_EDGE_VIEW_2_Rv = 0;


      // Object dynamic values conversion to raw
      @FDP1_OBJ_DESC_2_CMF2_1A7::OBJ2_OBJA_CAM_OBJ_LONGI_DIST_2_Rv = (@Classe_Obj_Sim::obj_data.obj_dx[1] - 3.5) * 10;
      @FDP1_OBJ_DESC_2_CMF2_1A7::OBJ2_OBJA_CAM_OBJ_LAT_DIST_2_Rv = @Classe_Obj_Sim::obj_data.obj_dy[1] * 20;
      @FDP1_OBJ_DESC_2_CMF2_1A7::OBJ2_OBJA_CAM_OBJ_RELAT_VELO_LONGI_2_Rv = (@Classe_Obj_Sim::obj_data.obj_relative_vx[1] * 10) + 1280;
      @FDP1_OBJ_DESC_2_CMF2_1A7::OBJ2_OBJA_CAM_OBJ_RELAT_VELO_LAT_2_Rv = @Classe_Obj_Sim::obj_data.obj_relative_vy[1] * 10;

      // calculation of angle view of the object
      if ((@Classe_Obj_Sim::obj_data.obj_dx[object_id]) > 0.0)
      {
        phiLeft = arctan((@Classe_Obj_Sim::obj_data.obj_dy[object_id] + (@Classe_Obj_Sim::obj_data.obj_width[object_id]/2)) /@Classe_Obj_Sim::obj_data.obj_dx[object_id]);
        phiRight = arctan((@Classe_Obj_Sim::obj_data.obj_dy[object_id] - (@Classe_Obj_Sim::obj_data.obj_width[object_id]/2)) /@Classe_Obj_Sim::obj_data.obj_dx[object_id]);


        if ((phiLeft!=0)&&(phiRight!=0))
        {
          @Classe_Obj_Sim::obj_data.obj_phileft[object_id]= (phiLeft)/0.001;
          @Classe_Obj_Sim::obj_data.obj_phiright[object_id] = (phiRight)/0.001;
        }
          @FDP1_OBJ_DESC_2_CMF2_1A7::OBJ2_OBJA_CAM_VHL_RIGHT_EDGE_VIEW_2_Rv = @Classe_Obj_Sim::obj_data.obj_phileft[object_id];
          @FDP1_OBJ_DESC_2_CMF2_1A7::OBJ2_OBJA_CAM_VHL_LEFT_EDGE_VIEW_2_Rv = @Classe_Obj_Sim::obj_data.obj_phiright[object_id];
      }

      // calculate the angle velocity based on the delta middle angle and the simulation time in miliseconds
      if (@Classe_Obj_Sim::obj_data.obj_dx[object_id] > 0.0)
      {
        phiMiddle[object_id] = arctan(@Classe_Obj_Sim::obj_data.obj_dy[object_id] / @Classe_Obj_Sim::obj_data.obj_dx[object_id]);
        phiMiddle_vel[object_id] = (phiMiddle[object_id] - phiMiddle_previous[object_id]) / (@Vehicle_Model::simulation_cycle_time * 0.001);
        phiMiddle_previous[object_id] = phiMiddle[object_id];
        @FDP1_OBJ_DESC_2_CMF2_1A7::OBJ2_OBJA_CAM_OBJ_ANGLE_VELOCITY_2_Rv = (phiMiddle_vel[object_id]) / 0.002;
      }
      else
      {
        @FDP1_OBJ_DESC_2_CMF2_1A7::OBJ2_OBJA_CAM_OBJ_ANGLE_VELOCITY_2_Rv = 0;
      }

      //Image plane crossing time to collision
      dx_image_plane_crossing = @Classe_Obj_Sim::obj_data.obj_dx[object_id] - 3.5;
      if ((dx_image_plane_crossing > 0) && (@Classe_Obj_Sim::obj_data.obj_relative_vx[object_id] != 0))
      {
        // time to collision to image plane in seconds
        tt_image_plane_crossing = @Classe_Obj_Sim::obj_data.obj_relative_vx[object_id] / dx_image_plane_crossing;
        @FDP1_OBJ_DESC_2_CMF2_1A7::OBJ2_OBJA_INV_TT_IPC_Rv = -tt_image_plane_crossing * 64;
      }
      else
      {
        @FDP1_OBJ_DESC_2_CMF2_1A7::OBJ2_OBJA_INV_TT_IPC_Rv = 8 * 64;
      }


      @FDP1_OBJ_DESC_2_CMF2_1A7::OBJ2_OBJA_HANDLE_TRACKED_OBJ_2_Rv = object_id + 1;

        //object classification
      switch (@Classe_Obj_Sim::obj_data.obj_type[1])
      {
        case 0: //"Non-Obstacle"
          @FDP1_OBJ_DESC_2_CMF2_1A7::OBJ2_OBJA_CAM_OBJ_CLASS_Rv = 6;
          break;

        case 1: //"unknown"
          @FDP1_OBJ_DESC_2_CMF2_1A7::OBJ2_OBJA_CAM_OBJ_CLASS_Rv = 0;
          break;

        case 2: //"RoadSideBarrier"
          @FDP1_OBJ_DESC_2_CMF2_1A7::OBJ2_OBJA_CAM_OBJ_CLASS_Rv = 6;
          break;

        case 3: //"2Wheeler"
          @FDP1_OBJ_DESC_2_CMF2_1A7::OBJ2_OBJA_CAM_OBJ_CLASS_Rv = 4;
          break;

        case 4: //"Pedestrian"
          @FDP1_OBJ_DESC_2_CMF2_1A7::OBJ2_OBJA_CAM_OBJ_CLASS_Rv = 5;
          break;

        case 5: //"Truck"
          @FDP1_OBJ_DESC_2_CMF2_1A7::OBJ2_OBJA_CAM_OBJ_CLASS_Rv = 1;
          break;

        case 6: //"PassengerCar"
          @FDP1_OBJ_DESC_2_CMF2_1A7::OBJ2_OBJA_CAM_OBJ_CLASS_Rv = 2;
          break;
      }
      break;

    case 2: //"Object-2"
      // Object Constant values
      @FDP1_OBJ_DESC_2_CMF2_1A7::OBJ2_OBJB_CAM_OBJ_ACQUISITION_TYPE_Rv = 1;
      @FDP1_OBJ_DESC_2_CMF2_1A7::OBJ2_OBJB_CAM_OBJ_BRK_INDIC_STATE_Rv = 2;
      @FDP1_OBJ_DESC_2_CMF2_1A7::OBJ2_OBJB_CAM_OBJ_LENGTH_2_Rv = 10;
      @FDP1_OBJ_DESC_2_CMF2_1A7::OBJ2_OBJB_CAM_OBJ_TURN_INDIC_STATE_Rv = 1;
      @FDP1_OBJ_DESC_2_CMF2_1A7::OBJ2_OBJB_CAM_PROB_EXIST_PHYS_OBJ_Rv = 100;
      @FDP1_OBJ_DESC_2_CMF2_1A7::OBJ2_OBJB_CAM_PROB_OBJ_CLASS_Rv = 100;
      @FDP1_OBJ_DESC_2_CMF2_1A7::OBJ2_OBJB_CAM_VAR_OBJ_ANGLE_VELO_2_Rv = 0;
      @FDP1_OBJ_DESC_2_CMF2_1A7::OBJ2_OBJB_CAM_VAR_OBJ_L_EDGE_VIEW_2_Rv = 0;
      @FDP1_OBJ_DESC_2_CMF2_1A7::OBJ2_OBJB_CAM_VAR_OBJ_LAT_DIST_2_Rv = 0;
      @FDP1_OBJ_DESC_2_CMF2_1A7::OBJ2_OBJB_CAM_VAR_OBJ_LENGTH_2_Rv = 0;
      @FDP1_OBJ_DESC_2_CMF2_1A7::OBJ2_OBJB_CAM_VAR_OBJ_LONGI_DIST_2_Rv = 0;
      @FDP1_OBJ_DESC_2_CMF2_1A7::OBJ2_OBJB_CAM_VAR_OBJ_R_EDGE_VIEW_2_Rv = 0;
      @FDP1_OBJ_DESC_2_CMF2_1A7::OBJ2_OBJB_CAM_VAR_OBJ_YAW_ANGLE_2_Rv = 0;
      @FDP1_OBJ_DESC_2_CMF2_1A7::OBJ2_OBJB_CAM_YAW_ANGLE_2_Rv = 0;
      @FDP1_OBJ_DESC_2_CMF2_1A7::OBJ2_OBJB_CAM_LANE_POS_Rv = 0;
      @FDP1_OBJ_DESC_2_CMF2_1A7::OBJ2_OBJB_CAM_MOTION_STATUS_2_Rv = 1;
      @FDP1_OBJ_DESC_2_CMF2_1A7::OBJ2_OBJB_CAM_REFERENCE_POINT_Rv = 2;
      @FDP1_OBJ_DESC_2_CMF2_1A7::OBJ2_OBJB_CAM_STD_DIST_EDGE_VIEW_2_Rv = 0;
      @FDP1_OBJ_DESC_2_CMF2_1A7::OBJ2_OBJB_CAM_VHL_DIST_EDGE_VIEW_2_Rv = 0;


      // Object dynamic values conversion to raw
      @FDP1_OBJ_DESC_2_CMF2_1A7::OBJ2_OBJB_CAM_OBJ_LONGI_DIST_2_Rv = (@Classe_Obj_Sim::obj_data.obj_dx[2] - 3.5) * 10;
      @FDP1_OBJ_DESC_2_CMF2_1A7::OBJ2_OBJB_CAM_OBJ_LAT_DIST_2_Rv = @Classe_Obj_Sim::obj_data.obj_dy[2] * 20;
      @FDP1_OBJ_DESC_2_CMF2_1A7::OBJ2_OBJB_CAM_OBJ_RELAT_VELO_LONGI_2_Rv = (@Classe_Obj_Sim::obj_data.obj_relative_vx[2] * 10) + 1280;
      @FDP1_OBJ_DESC_2_CMF2_1A7::OBJ2_OBJB_CAM_OBJ_RELAT_VELO_LAT_2_Rv = @Classe_Obj_Sim::obj_data.obj_relative_vy[2] * 10;

      // calculation of angle view of the object
      if ((@Classe_Obj_Sim::obj_data.obj_dx[object_id]) > 0.0)
      {
        phiLeft = arctan((@Classe_Obj_Sim::obj_data.obj_dy[object_id] + (@Classe_Obj_Sim::obj_data.obj_width[object_id]/2)) /@Classe_Obj_Sim::obj_data.obj_dx[object_id]);
        phiRight = arctan((@Classe_Obj_Sim::obj_data.obj_dy[object_id] - (@Classe_Obj_Sim::obj_data.obj_width[object_id]/2)) /@Classe_Obj_Sim::obj_data.obj_dx[object_id]);


        if ((phiLeft!=0)&&(phiRight!=0))
        {
          @Classe_Obj_Sim::obj_data.obj_phileft[object_id]= (phiLeft)/0.001;
          @Classe_Obj_Sim::obj_data.obj_phiright[object_id] = (phiRight)/0.001;
        }
          @FDP1_OBJ_DESC_2_CMF2_1A7::OBJ2_OBJB_CAM_VHL_RIGHT_EDGE_VIEW_2_Rv = @Classe_Obj_Sim::obj_data.obj_phileft[object_id];
          @FDP1_OBJ_DESC_2_CMF2_1A7::OBJ2_OBJB_CAM_VHL_LEFT_EDGE_VIEW_2_Rv = @Classe_Obj_Sim::obj_data.obj_phiright[object_id];
      }

      // calculate the angle velocity based on the delta middle angle and the simulation time in miliseconds
      if (@Classe_Obj_Sim::obj_data.obj_dx[object_id] > 0.0)
      {
        phiMiddle[object_id] = arctan(@Classe_Obj_Sim::obj_data.obj_dy[object_id] / @Classe_Obj_Sim::obj_data.obj_dx[object_id]);
        phiMiddle_vel[object_id] = (phiMiddle[object_id] - phiMiddle_previous[object_id]) / (@Vehicle_Model::simulation_cycle_time * 0.001);
        phiMiddle_previous[object_id] = phiMiddle[object_id];
        @FDP1_OBJ_DESC_2_CMF2_1A7::OBJ2_OBJB_CAM_OBJ_ANGLE_VELOCITY_2_Rv = (phiMiddle_vel[object_id]) / 0.002;
      }
      else
      {
        @FDP1_OBJ_DESC_2_CMF2_1A7::OBJ2_OBJB_CAM_OBJ_ANGLE_VELOCITY_2_Rv = 0;
      }

      //Image plane crossing time to collision
      dx_image_plane_crossing = @Classe_Obj_Sim::obj_data.obj_dx[object_id] - 3.5;
      if ((dx_image_plane_crossing > 0) && (@Classe_Obj_Sim::obj_data.obj_relative_vx[object_id] != 0))
      {
        // time to collision to image plane in seconds
        tt_image_plane_crossing = @Classe_Obj_Sim::obj_data.obj_relative_vx[object_id] / dx_image_plane_crossing;
        @FDP1_OBJ_DESC_2_CMF2_1A7::OBJ2_OBJB_INV_TT_IPC_Rv = -tt_image_plane_crossing * 64;
      }
      else
      {
        @FDP1_OBJ_DESC_2_CMF2_1A7::OBJ2_OBJB_INV_TT_IPC_Rv = 8 * 64;
      }


      @FDP1_OBJ_DESC_2_CMF2_1A7::OBJ2_OBJB_HANDLE_TRACKED_OBJ_2_Rv = object_id + 1;

        //object classification
      switch (@Classe_Obj_Sim::obj_data.obj_type[2])
      {
        case 0: //"Non-Obstacle"
          @FDP1_OBJ_DESC_2_CMF2_1A7::OBJ2_OBJB_CAM_OBJ_CLASS_Rv = 6;
          break;

        case 1: //"unknown"
          @FDP1_OBJ_DESC_2_CMF2_1A7::OBJ2_OBJB_CAM_OBJ_CLASS_Rv = 0;
          break;

        case 2: //"RoadSideBarrier"
          @FDP1_OBJ_DESC_2_CMF2_1A7::OBJ2_OBJB_CAM_OBJ_CLASS_Rv = 6;
          break;

        case 3: //"2Wheeler"
          @FDP1_OBJ_DESC_2_CMF2_1A7::OBJ2_OBJB_CAM_OBJ_CLASS_Rv = 4;
          break;

        case 4: //"Pedestrian"
          @FDP1_OBJ_DESC_2_CMF2_1A7::OBJ2_OBJB_CAM_OBJ_CLASS_Rv = 5;
          break;

        case 5: //"Truck"
          @FDP1_OBJ_DESC_2_CMF2_1A7::OBJ2_OBJB_CAM_OBJ_CLASS_Rv = 1;
          break;

        case 6: //"PassengerCar"
          @FDP1_OBJ_DESC_2_CMF2_1A7::OBJ2_OBJB_CAM_OBJ_CLASS_Rv = 2;
          break;
      }
      break;

    case 3: //"Object-3"
      // Object Constant values
      @FDP1_OBJ_DESC_3_CMF2_1A8::OBJ3_OBJA_CAM_OBJ_ACQUISITION_TYPE_Rv = 1;
      @FDP1_OBJ_DESC_3_CMF2_1A8::OBJ3_OBJA_CAM_OBJ_BRK_INDIC_STATE_Rv = 2;
      @FDP1_OBJ_DESC_3_CMF2_1A8::OBJ3_OBJA_CAM_OBJ_LENGTH_2_Rv = 10;
      @FDP1_OBJ_DESC_3_CMF2_1A8::OBJ3_OBJA_CAM_OBJ_TURN_INDIC_STATE_Rv = 1;
      @FDP1_OBJ_DESC_3_CMF2_1A8::OBJ3_OBJA_CAM_PROB_EXIST_PHYS_OBJ_Rv = 100;
      @FDP1_OBJ_DESC_3_CMF2_1A8::OBJ3_OBJA_CAM_PROB_OBJ_CLASS_Rv = 100;
      @FDP1_OBJ_DESC_3_CMF2_1A8::OBJ3_OBJA_CAM_VAR_OBJ_ANGLE_VELO_2_Rv = 0;
      @FDP1_OBJ_DESC_3_CMF2_1A8::OBJ3_OBJA_CAM_VAR_OBJ_L_EDGE_VIEW_2_Rv = 0;
      @FDP1_OBJ_DESC_3_CMF2_1A8::OBJ3_OBJA_CAM_VAR_OBJ_LAT_DIST_2_Rv = 0;
      @FDP1_OBJ_DESC_3_CMF2_1A8::OBJ3_OBJA_CAM_VAR_OBJ_LENGTH_2_Rv = 0;
      @FDP1_OBJ_DESC_3_CMF2_1A8::OBJ3_OBJA_CAM_VAR_OBJ_LONGI_DIST_2_Rv = 0;
      @FDP1_OBJ_DESC_3_CMF2_1A8::OBJ3_OBJA_CAM_VAR_OBJ_R_EDGE_VIEW_2_Rv = 0;
      @FDP1_OBJ_DESC_3_CMF2_1A8::OBJ3_OBJA_CAM_VAR_OBJ_YAW_ANGLE_2_Rv = 0;
      @FDP1_OBJ_DESC_3_CMF2_1A8::OBJ3_OBJA_CAM_YAW_ANGLE_2_Rv = 0;
      @FDP1_OBJ_DESC_3_CMF2_1A8::OBJ3_OBJA_CAM_LANE_POS_Rv = 0;
      @FDP1_OBJ_DESC_3_CMF2_1A8::OBJ3_OBJA_CAM_MOTION_STATUS_2_Rv = 1;
      @FDP1_OBJ_DESC_3_CMF2_1A8::OBJ3_OBJA_CAM_REFERENCE_POINT_Rv = 2;
      @FDP1_OBJ_DESC_3_CMF2_1A8::OBJ3_OBJA_CAM_STD_DIST_EDGE_VIEW_2_Rv = 0;
      @FDP1_OBJ_DESC_3_CMF2_1A8::OBJ3_OBJA_CAM_VHL_DIST_EDGE_VIEW_2_Rv = 0;


      // Object dynamic values conversion to raw
      @FDP1_OBJ_DESC_3_CMF2_1A8::OBJ3_OBJA_CAM_OBJ_LONGI_DIST_2_Rv = (@Classe_Obj_Sim::obj_data.obj_dx[3] - 3.5) * 10;
      @FDP1_OBJ_DESC_3_CMF2_1A8::OBJ3_OBJA_CAM_OBJ_LAT_DIST_2_Rv = @Classe_Obj_Sim::obj_data.obj_dy[3] * 20;
      @FDP1_OBJ_DESC_3_CMF2_1A8::OBJ3_OBJA_CAM_OBJ_RELAT_VELO_LONGI_2_Rv = (@Classe_Obj_Sim::obj_data.obj_relative_vx[3] * 10) + 1280;
      @FDP1_OBJ_DESC_3_CMF2_1A8::OBJ3_OBJA_CAM_OBJ_RELAT_VELO_LAT_2_Rv = @Classe_Obj_Sim::obj_data.obj_relative_vy[3] * 10;

      // calculation of angle view of the object
      if ((@Classe_Obj_Sim::obj_data.obj_dx[object_id]) > 0.0)
      {
        phiLeft = arctan((@Classe_Obj_Sim::obj_data.obj_dy[object_id] + (@Classe_Obj_Sim::obj_data.obj_width[object_id]/2)) /@Classe_Obj_Sim::obj_data.obj_dx[object_id]);
        phiRight = arctan((@Classe_Obj_Sim::obj_data.obj_dy[object_id] - (@Classe_Obj_Sim::obj_data.obj_width[object_id]/2)) /@Classe_Obj_Sim::obj_data.obj_dx[object_id]);


        if ((phiLeft!=0)&&(phiRight!=0))
        {
          @Classe_Obj_Sim::obj_data.obj_phileft[object_id]= (phiLeft)/0.001;
          @Classe_Obj_Sim::obj_data.obj_phiright[object_id] = (phiRight)/0.001;
        }
          @FDP1_OBJ_DESC_3_CMF2_1A8::OBJ3_OBJA_CAM_VHL_RIGHT_EDGE_VIEW_2_Rv = @Classe_Obj_Sim::obj_data.obj_phileft[object_id];
          @FDP1_OBJ_DESC_3_CMF2_1A8::OBJ3_OBJA_CAM_VHL_LEFT_EDGE_VIEW_2_Rv = @Classe_Obj_Sim::obj_data.obj_phiright[object_id];
      }

      // calculate the angle velocity based on the delta middle angle and the simulation time in miliseconds
      if (@Classe_Obj_Sim::obj_data.obj_dx[object_id] > 0.0)
      {
        phiMiddle[object_id] = arctan(@Classe_Obj_Sim::obj_data.obj_dy[object_id] / @Classe_Obj_Sim::obj_data.obj_dx[object_id]);
        phiMiddle_vel[object_id] = (phiMiddle[object_id] - phiMiddle_previous[object_id]) / (@Vehicle_Model::simulation_cycle_time * 0.001);
        phiMiddle_previous[object_id] = phiMiddle[object_id];
        @FDP1_OBJ_DESC_3_CMF2_1A8::OBJ3_OBJA_CAM_OBJ_ANGLE_VELOCITY_2_Rv = (phiMiddle_vel[object_id]) / 0.002;
      }
      else
      {
        @FDP1_OBJ_DESC_3_CMF2_1A8::OBJ3_OBJA_CAM_OBJ_ANGLE_VELOCITY_2_Rv = 0;
      }

      //Image plane crossing time to collision
      dx_image_plane_crossing = @Classe_Obj_Sim::obj_data.obj_dx[object_id] - 3.5;
      if ((dx_image_plane_crossing > 0) && (@Classe_Obj_Sim::obj_data.obj_relative_vx[object_id] != 0))
      {
        // time to collision to image plane in seconds
        tt_image_plane_crossing = @Classe_Obj_Sim::obj_data.obj_relative_vx[object_id] / dx_image_plane_crossing;
        @FDP1_OBJ_DESC_3_CMF2_1A8::OBJ3_OBJA_INV_TT_IPC_Rv = -tt_image_plane_crossing * 64;
      }
      else
      {
        @FDP1_OBJ_DESC_3_CMF2_1A8::OBJ3_OBJA_INV_TT_IPC_Rv = 8 * 64;
      }


      @FDP1_OBJ_DESC_3_CMF2_1A8::OBJ3_OBJA_HANDLE_TRACKED_OBJ_2_Rv = object_id + 1;

        //object classification
      switch (@Classe_Obj_Sim::obj_data.obj_type[3])
      {
        case 0: //"Non-Obstacle"
          @FDP1_OBJ_DESC_3_CMF2_1A8::OBJ3_OBJA_CAM_OBJ_CLASS_Rv = 6;
          break;

        case 1: //"unknown"
          @FDP1_OBJ_DESC_3_CMF2_1A8::OBJ3_OBJA_CAM_OBJ_CLASS_Rv = 0;
          break;

        case 2: //"RoadSideBarrier"
          @FDP1_OBJ_DESC_3_CMF2_1A8::OBJ3_OBJA_CAM_OBJ_CLASS_Rv = 6;
          break;

        case 3: //"2Wheeler"
          @FDP1_OBJ_DESC_3_CMF2_1A8::OBJ3_OBJA_CAM_OBJ_CLASS_Rv = 4;
          break;

        case 4: //"Pedestrian"
          @FDP1_OBJ_DESC_3_CMF2_1A8::OBJ3_OBJA_CAM_OBJ_CLASS_Rv = 5;
          break;

        case 5: //"Truck"
          @FDP1_OBJ_DESC_3_CMF2_1A8::OBJ3_OBJA_CAM_OBJ_CLASS_Rv = 1;
          break;

        case 6: //"PassengerCar"
          @FDP1_OBJ_DESC_3_CMF2_1A8::OBJ3_OBJA_CAM_OBJ_CLASS_Rv = 2;
          break;
      }
      break;

    case 4: //"Object-4"
      // Object Constant values
      @FDP1_OBJ_DESC_3_CMF2_1A8::OBJ3_OBJB_CAM_OBJ_ACQUISITION_TYPE_Rv = 1;
      @FDP1_OBJ_DESC_3_CMF2_1A8::OBJ3_OBJB_CAM_OBJ_BRK_INDIC_STATE_Rv = 2;
      @FDP1_OBJ_DESC_3_CMF2_1A8::OBJ3_OBJB_CAM_OBJ_LENGTH_2_Rv = 10;
      @FDP1_OBJ_DESC_3_CMF2_1A8::OBJ3_OBJB_CAM_OBJ_TURN_INDIC_STATE_Rv = 1;
      @FDP1_OBJ_DESC_3_CMF2_1A8::OBJ3_OBJB_CAM_PROB_EXIST_PHYS_OBJ_Rv = 100;
      @FDP1_OBJ_DESC_3_CMF2_1A8::OBJ3_OBJB_CAM_PROB_OBJ_CLASS_Rv = 100;
      @FDP1_OBJ_DESC_3_CMF2_1A8::OBJ3_OBJB_CAM_VAR_OBJ_ANGLE_VELO_2_Rv = 0;
      @FDP1_OBJ_DESC_3_CMF2_1A8::OBJ3_OBJB_CAM_VAR_OBJ_L_EDGE_VIEW_2_Rv = 0;
      @FDP1_OBJ_DESC_3_CMF2_1A8::OBJ3_OBJB_CAM_VAR_OBJ_LAT_DIST_2_Rv = 0;
      @FDP1_OBJ_DESC_3_CMF2_1A8::OBJ3_OBJB_CAM_VAR_OBJ_LENGTH_2_Rv = 0;
      @FDP1_OBJ_DESC_3_CMF2_1A8::OBJ3_OBJB_CAM_VAR_OBJ_LONGI_DIST_2_Rv = 0;
      @FDP1_OBJ_DESC_3_CMF2_1A8::OBJ3_OBJB_CAM_VAR_OBJ_R_EDGE_VIEW_2_Rv = 0;
      @FDP1_OBJ_DESC_3_CMF2_1A8::OBJ3_OBJB_CAM_VAR_OBJ_YAW_ANGLE_2_Rv = 0;
      @FDP1_OBJ_DESC_3_CMF2_1A8::OBJ3_OBJB_CAM_YAW_ANGLE_2_Rv = 0;
      @FDP1_OBJ_DESC_3_CMF2_1A8::OBJ3_OBJB_CAM_LANE_POS_Rv = 0;
      @FDP1_OBJ_DESC_3_CMF2_1A8::OBJ3_OBJB_CAM_MOTION_STATUS_2_Rv = 1;
      @FDP1_OBJ_DESC_3_CMF2_1A8::OBJ3_OBJB_CAM_REFERENCE_POINT_Rv = 2;
      @FDP1_OBJ_DESC_3_CMF2_1A8::OBJ3_OBJB_CAM_STD_DIST_EDGE_VIEW_2_Rv = 0;
      @FDP1_OBJ_DESC_3_CMF2_1A8::OBJ3_OBJB_CAM_VHL_DIST_EDGE_VIEW_2_Rv = 0;


      // Object dynamic values conversion to raw
      @FDP1_OBJ_DESC_3_CMF2_1A8::OBJ3_OBJB_CAM_OBJ_LONGI_DIST_2_Rv = (@Classe_Obj_Sim::obj_data.obj_dx[4] - 3.5) * 10;
      @FDP1_OBJ_DESC_3_CMF2_1A8::OBJ3_OBJB_CAM_OBJ_LAT_DIST_2_Rv = @Classe_Obj_Sim::obj_data.obj_dy[4] * 20;
      @FDP1_OBJ_DESC_3_CMF2_1A8::OBJ3_OBJB_CAM_OBJ_RELAT_VELO_LONGI_2_Rv = (@Classe_Obj_Sim::obj_data.obj_relative_vx[4] * 10) + 1280;
      @FDP1_OBJ_DESC_3_CMF2_1A8::OBJ3_OBJB_CAM_OBJ_RELAT_VELO_LAT_2_Rv = @Classe_Obj_Sim::obj_data.obj_relative_vy[4] * 10;

      // calculation of angle view of the object
      if ((@Classe_Obj_Sim::obj_data.obj_dx[object_id]) > 0.0)
      {
        phiLeft = arctan((@Classe_Obj_Sim::obj_data.obj_dy[object_id] + (@Classe_Obj_Sim::obj_data.obj_width[object_id]/2)) /@Classe_Obj_Sim::obj_data.obj_dx[object_id]);
        phiRight = arctan((@Classe_Obj_Sim::obj_data.obj_dy[object_id] - (@Classe_Obj_Sim::obj_data.obj_width[object_id]/2)) /@Classe_Obj_Sim::obj_data.obj_dx[object_id]);


        if ((phiLeft!=0)&&(phiRight!=0))
        {
          @Classe_Obj_Sim::obj_data.obj_phileft[object_id]= (phiLeft)/0.001;
          @Classe_Obj_Sim::obj_data.obj_phiright[object_id] = (phiRight)/0.001;
        }
          @FDP1_OBJ_DESC_3_CMF2_1A8::OBJ3_OBJB_CAM_VHL_RIGHT_EDGE_VIEW_2_Rv = @Classe_Obj_Sim::obj_data.obj_phileft[object_id];
          @FDP1_OBJ_DESC_3_CMF2_1A8::OBJ3_OBJB_CAM_VHL_LEFT_EDGE_VIEW_2_Rv = @Classe_Obj_Sim::obj_data.obj_phiright[object_id];
      }

      // calculate the angle velocity based on the delta middle angle and the simulation time in miliseconds
      if (@Classe_Obj_Sim::obj_data.obj_dx[object_id] > 0.0)
      {
        phiMiddle[object_id] = arctan(@Classe_Obj_Sim::obj_data.obj_dy[object_id] / @Classe_Obj_Sim::obj_data.obj_dx[object_id]);
        phiMiddle_vel[object_id] = (phiMiddle[object_id] - phiMiddle_previous[object_id]) / (@Vehicle_Model::simulation_cycle_time * 0.001);
        phiMiddle_previous[object_id] = phiMiddle[object_id];
        @FDP1_OBJ_DESC_3_CMF2_1A8::OBJ3_OBJB_CAM_OBJ_ANGLE_VELOCITY_2_Rv = (phiMiddle_vel[object_id]) / 0.002;
      }
      else
      {
        @FDP1_OBJ_DESC_3_CMF2_1A8::OBJ3_OBJB_CAM_OBJ_ANGLE_VELOCITY_2_Rv = 0;
      }

      //Image plane crossing time to collision
      dx_image_plane_crossing = @Classe_Obj_Sim::obj_data.obj_dx[object_id] - 3.5;
      if ((dx_image_plane_crossing > 0) && (@Classe_Obj_Sim::obj_data.obj_relative_vx[object_id] != 0))
      {
        // time to collision to image plane in seconds
        tt_image_plane_crossing = @Classe_Obj_Sim::obj_data.obj_relative_vx[object_id] / dx_image_plane_crossing;
        @FDP1_OBJ_DESC_3_CMF2_1A8::OBJ3_OBJB_INV_TT_IPC_Rv = -tt_image_plane_crossing * 64;
      }
      else
      {
        @FDP1_OBJ_DESC_3_CMF2_1A8::OBJ3_OBJB_INV_TT_IPC_Rv = 8 * 64;
      }


      @FDP1_OBJ_DESC_3_CMF2_1A8::OBJ3_OBJB_HANDLE_TRACKED_OBJ_2_Rv = object_id + 1;

        //object classification
      switch (@Classe_Obj_Sim::obj_data.obj_type[4])
      {
        case 0: //"Non-Obstacle"
          @FDP1_OBJ_DESC_3_CMF2_1A8::OBJ3_OBJB_CAM_OBJ_CLASS_Rv = 6;
          break;

        case 1: //"unknown"
          @FDP1_OBJ_DESC_3_CMF2_1A8::OBJ3_OBJB_CAM_OBJ_CLASS_Rv = 0;
          break;

        case 2: //"RoadSideBarrier"
          @FDP1_OBJ_DESC_3_CMF2_1A8::OBJ3_OBJB_CAM_OBJ_CLASS_Rv = 6;
          break;

        case 3: //"2Wheeler"
          @FDP1_OBJ_DESC_3_CMF2_1A8::OBJ3_OBJB_CAM_OBJ_CLASS_Rv = 4;
          break;

        case 4: //"Pedestrian"
          @FDP1_OBJ_DESC_3_CMF2_1A8::OBJ3_OBJB_CAM_OBJ_CLASS_Rv = 5;
          break;

        case 5: //"Truck"
          @FDP1_OBJ_DESC_3_CMF2_1A8::OBJ3_OBJB_CAM_OBJ_CLASS_Rv = 1;
          break;

        case 6: //"PassengerCar"
          @FDP1_OBJ_DESC_3_CMF2_1A8::OBJ3_OBJB_CAM_OBJ_CLASS_Rv = 2;
          break;
      }
      break;

    case 5: //"Object-5"
      // Object Constant values
      @FDP1_OBJ_DESC_4_CMF2_1A9::OBJ4_OBJA_CAM_OBJ_ACQUISITION_TYPE_Rv = 1;
      @FDP1_OBJ_DESC_4_CMF2_1A9::OBJ4_OBJA_CAM_OBJ_BRK_INDIC_STATE_Rv = 2;
      @FDP1_OBJ_DESC_4_CMF2_1A9::OBJ4_OBJA_CAM_OBJ_LENGTH_2_Rv = 10;
      @FDP1_OBJ_DESC_4_CMF2_1A9::OBJ4_OBJA_CAM_OBJ_TURN_INDIC_STATE_Rv = 1;
      @FDP1_OBJ_DESC_4_CMF2_1A9::OBJ4_OBJA_CAM_PROB_EXIST_PHYS_OBJ_Rv = 100;
      @FDP1_OBJ_DESC_4_CMF2_1A9::OBJ4_OBJA_CAM_PROB_OBJ_CLASS_Rv = 100;
      @FDP1_OBJ_DESC_4_CMF2_1A9::OBJ4_OBJA_CAM_VAR_OBJ_ANGLE_VELO_2_Rv = 0;
      @FDP1_OBJ_DESC_4_CMF2_1A9::OBJ4_OBJA_CAM_VAR_OBJ_L_EDGE_VIEW_2_Rv = 0;
      @FDP1_OBJ_DESC_4_CMF2_1A9::OBJ4_OBJA_CAM_VAR_OBJ_LAT_DIST_2_Rv = 0;
      @FDP1_OBJ_DESC_4_CMF2_1A9::OBJ4_OBJA_CAM_VAR_OBJ_LENGTH_2_Rv = 0;
      @FDP1_OBJ_DESC_4_CMF2_1A9::OBJ4_OBJA_CAM_VAR_OBJ_LONGI_DIST_2_Rv = 0;
      @FDP1_OBJ_DESC_4_CMF2_1A9::OBJ4_OBJA_CAM_VAR_OBJ_R_EDGE_VIEW_2_Rv = 0;
      @FDP1_OBJ_DESC_4_CMF2_1A9::OBJ4_OBJA_CAM_VAR_OBJ_YAW_ANGLE_2_Rv = 0;
      @FDP1_OBJ_DESC_4_CMF2_1A9::OBJ4_OBJA_CAM_YAW_ANGLE_2_Rv = 0;
      @FDP1_OBJ_DESC_4_CMF2_1A9::OBJ4_OBJA_CAM_LANE_POS_Rv = 0;
      @FDP1_OBJ_DESC_4_CMF2_1A9::OBJ4_OBJA_CAM_MOTION_STATUS_2_Rv = 1;
      @FDP1_OBJ_DESC_4_CMF2_1A9::OBJ4_OBJA_CAM_REFERENCE_POINT_Rv = 2;
      @FDP1_OBJ_DESC_4_CMF2_1A9::OBJ4_OBJA_CAM_STD_DIST_EDGE_VIEW_2_Rv = 0;
      @FDP1_OBJ_DESC_4_CMF2_1A9::OBJ4_OBJA_CAM_VHL_DIST_EDGE_VIEW_2_Rv = 0;


      // Object dynamic values conversion to raw
      @FDP1_OBJ_DESC_4_CMF2_1A9::OBJ4_OBJA_CAM_OBJ_LONGI_DIST_2_Rv = (@Classe_Obj_Sim::obj_data.obj_dx[5] - 3.5) * 10;
      @FDP1_OBJ_DESC_4_CMF2_1A9::OBJ4_OBJA_CAM_OBJ_LAT_DIST_2_Rv = @Classe_Obj_Sim::obj_data.obj_dy[5] * 20;
      @FDP1_OBJ_DESC_4_CMF2_1A9::OBJ4_OBJA_CAM_OBJ_RELAT_VELO_LONGI_2_Rv = (@Classe_Obj_Sim::obj_data.obj_relative_vx[5] * 10) + 1280;
      @FDP1_OBJ_DESC_4_CMF2_1A9::OBJ4_OBJA_CAM_OBJ_RELAT_VELO_LAT_2_Rv = @Classe_Obj_Sim::obj_data.obj_relative_vy[5] * 10;

      // calculation of angle view of the object
      if ((@Classe_Obj_Sim::obj_data.obj_dx[object_id]) > 0.0)
      {
        phiLeft = arctan((@Classe_Obj_Sim::obj_data.obj_dy[object_id] + (@Classe_Obj_Sim::obj_data.obj_width[object_id]/2)) /@Classe_Obj_Sim::obj_data.obj_dx[object_id]);
        phiRight = arctan((@Classe_Obj_Sim::obj_data.obj_dy[object_id] - (@Classe_Obj_Sim::obj_data.obj_width[object_id]/2)) /@Classe_Obj_Sim::obj_data.obj_dx[object_id]);


        if ((phiLeft!=0)&&(phiRight!=0))
        {
          @Classe_Obj_Sim::obj_data.obj_phileft[object_id]= (phiLeft)/0.001;
          @Classe_Obj_Sim::obj_data.obj_phiright[object_id] = (phiRight)/0.001;
        }
          @FDP1_OBJ_DESC_4_CMF2_1A9::OBJ4_OBJA_CAM_VHL_RIGHT_EDGE_VIEW_2_Rv = @Classe_Obj_Sim::obj_data.obj_phileft[object_id];
          @FDP1_OBJ_DESC_4_CMF2_1A9::OBJ4_OBJA_CAM_VHL_LEFT_EDGE_VIEW_2_Rv = @Classe_Obj_Sim::obj_data.obj_phiright[object_id];
      }

      // calculate the angle velocity based on the delta middle angle and the simulation time in miliseconds
      if (@Classe_Obj_Sim::obj_data.obj_dx[object_id] > 0.0)
      {
        phiMiddle[object_id] = arctan(@Classe_Obj_Sim::obj_data.obj_dy[object_id] / @Classe_Obj_Sim::obj_data.obj_dx[object_id]);
        phiMiddle_vel[object_id] = (phiMiddle[object_id] - phiMiddle_previous[object_id]) / (@Vehicle_Model::simulation_cycle_time * 0.001);
        phiMiddle_previous[object_id] = phiMiddle[object_id];
        @FDP1_OBJ_DESC_4_CMF2_1A9::OBJ4_OBJA_CAM_OBJ_ANGLE_VELOCITY_2_Rv = (phiMiddle_vel[object_id]) / 0.002;
      }
      else
      {
        @FDP1_OBJ_DESC_4_CMF2_1A9::OBJ4_OBJA_CAM_OBJ_ANGLE_VELOCITY_2_Rv = 0;
      }

      //Image plane crossing time to collision
      dx_image_plane_crossing = @Classe_Obj_Sim::obj_data.obj_dx[object_id] - 3.5;
      if ((dx_image_plane_crossing > 0) && (@Classe_Obj_Sim::obj_data.obj_relative_vx[object_id] != 0))
      {
        // time to collision to image plane in seconds
        tt_image_plane_crossing = @Classe_Obj_Sim::obj_data.obj_relative_vx[object_id] / dx_image_plane_crossing;
        @FDP1_OBJ_DESC_4_CMF2_1A9::OBJ4_OBJA_INV_TT_IPC_Rv = -tt_image_plane_crossing * 64;
      }
      else
      {
        @FDP1_OBJ_DESC_4_CMF2_1A9::OBJ4_OBJA_INV_TT_IPC_Rv = 8 * 64;
      }


      @FDP1_OBJ_DESC_4_CMF2_1A9::OBJ4_OBJA_HANDLE_TRACKED_OBJ_2_Rv = object_id + 1;

        //object classification
      switch (@Classe_Obj_Sim::obj_data.obj_type[5])
      {
        case 0: //"Non-Obstacle"
          @FDP1_OBJ_DESC_4_CMF2_1A9::OBJ4_OBJA_CAM_OBJ_CLASS_Rv = 6;
          break;

        case 1: //"unknown"
          @FDP1_OBJ_DESC_4_CMF2_1A9::OBJ4_OBJA_CAM_OBJ_CLASS_Rv = 0;
          break;

        case 2: //"RoadSideBarrier"
          @FDP1_OBJ_DESC_4_CMF2_1A9::OBJ4_OBJA_CAM_OBJ_CLASS_Rv = 6;
          break;

        case 3: //"2Wheeler"
          @FDP1_OBJ_DESC_4_CMF2_1A9::OBJ4_OBJA_CAM_OBJ_CLASS_Rv = 4;
          break;

        case 4: //"Pedestrian"
          @FDP1_OBJ_DESC_4_CMF2_1A9::OBJ4_OBJA_CAM_OBJ_CLASS_Rv = 5;
          break;

        case 5: //"Truck"
          @FDP1_OBJ_DESC_4_CMF2_1A9::OBJ4_OBJA_CAM_OBJ_CLASS_Rv = 1;
          break;

        case 6: //"PassengerCar"
          @FDP1_OBJ_DESC_4_CMF2_1A9::OBJ4_OBJA_CAM_OBJ_CLASS_Rv = 2;
          break;
      }
      break;

    case 6: //"Object-6"
      // Object Constant values
      @FDP1_OBJ_DESC_4_CMF2_1A9::OBJ4_OBJB_CAM_OBJ_ACQUISITION_TYPE_Rv = 1;
      @FDP1_OBJ_DESC_4_CMF2_1A9::OBJ4_OBJB_CAM_OBJ_BRK_INDIC_STATE_Rv = 2;
      @FDP1_OBJ_DESC_4_CMF2_1A9::OBJ4_OBJB_CAM_OBJ_LENGTH_2_Rv = 10;
      @FDP1_OBJ_DESC_4_CMF2_1A9::OBJ4_OBJB_CAM_OBJ_TURN_INDIC_STATE_Rv = 1;
      @FDP1_OBJ_DESC_4_CMF2_1A9::OBJ4_OBJB_CAM_PROB_EXIST_PHYS_OBJ_Rv = 100;
      @FDP1_OBJ_DESC_4_CMF2_1A9::OBJ4_OBJB_CAM_PROB_OBJ_CLASS_Rv = 100;
      @FDP1_OBJ_DESC_4_CMF2_1A9::OBJ4_OBJB_CAM_VAR_OBJ_ANGLE_VELO_2_Rv = 0;
      @FDP1_OBJ_DESC_4_CMF2_1A9::OBJ4_OBJB_CAM_VAR_OBJ_L_EDGE_VIEW_2_Rv = 0;
      @FDP1_OBJ_DESC_4_CMF2_1A9::OBJ4_OBJB_CAM_VAR_OBJ_LAT_DIST_2_Rv = 0;
      @FDP1_OBJ_DESC_4_CMF2_1A9::OBJ4_OBJB_CAM_VAR_OBJ_LENGTH_2_Rv = 0;
      @FDP1_OBJ_DESC_4_CMF2_1A9::OBJ4_OBJB_CAM_VAR_OBJ_LONGI_DIST_2_Rv = 0;
      @FDP1_OBJ_DESC_4_CMF2_1A9::OBJ4_OBJB_CAM_VAR_OBJ_R_EDGE_VIEW_2_Rv = 0;
      @FDP1_OBJ_DESC_4_CMF2_1A9::OBJ4_OBJB_CAM_VAR_OBJ_YAW_ANGLE_2_Rv = 0;
      @FDP1_OBJ_DESC_4_CMF2_1A9::OBJ4_OBJB_CAM_YAW_ANGLE_2_Rv = 0;
      @FDP1_OBJ_DESC_4_CMF2_1A9::OBJ4_OBJB_CAM_LANE_POS_Rv = 0;
      @FDP1_OBJ_DESC_4_CMF2_1A9::OBJ4_OBJB_CAM_MOTION_STATUS_2_Rv = 1;
      @FDP1_OBJ_DESC_4_CMF2_1A9::OBJ4_OBJB_CAM_REFERENCE_POINT_Rv = 2;
      @FDP1_OBJ_DESC_4_CMF2_1A9::OBJ4_OBJB_CAM_STD_DIST_EDGE_VIEW_2_Rv = 0;
      @FDP1_OBJ_DESC_4_CMF2_1A9::OBJ4_OBJB_CAM_VHL_DIST_EDGE_VIEW_2_Rv = 0;


      // Object dynamic values conversion to raw
      @FDP1_OBJ_DESC_4_CMF2_1A9::OBJ4_OBJB_CAM_OBJ_LONGI_DIST_2_Rv = (@Classe_Obj_Sim::obj_data.obj_dx[6] - 3.5) * 10;
      @FDP1_OBJ_DESC_4_CMF2_1A9::OBJ4_OBJB_CAM_OBJ_LAT_DIST_2_Rv = @Classe_Obj_Sim::obj_data.obj_dy[6] * 20;
      @FDP1_OBJ_DESC_4_CMF2_1A9::OBJ4_OBJB_CAM_OBJ_RELAT_VELO_LONGI_2_Rv = (@Classe_Obj_Sim::obj_data.obj_relative_vx[6] * 10) + 1280;
      @FDP1_OBJ_DESC_4_CMF2_1A9::OBJ4_OBJB_CAM_OBJ_RELAT_VELO_LAT_2_Rv = @Classe_Obj_Sim::obj_data.obj_relative_vy[6] * 10;

      // calculation of angle view of the object
      if ((@Classe_Obj_Sim::obj_data.obj_dx[object_id]) > 0.0)
      {
        phiLeft = arctan((@Classe_Obj_Sim::obj_data.obj_dy[object_id] + (@Classe_Obj_Sim::obj_data.obj_width[object_id]/2)) /@Classe_Obj_Sim::obj_data.obj_dx[object_id]);
        phiRight = arctan((@Classe_Obj_Sim::obj_data.obj_dy[object_id] - (@Classe_Obj_Sim::obj_data.obj_width[object_id]/2)) /@Classe_Obj_Sim::obj_data.obj_dx[object_id]);


        if ((phiLeft!=0)&&(phiRight!=0))
        {
          @Classe_Obj_Sim::obj_data.obj_phileft[object_id]= (phiLeft)/0.001;
          @Classe_Obj_Sim::obj_data.obj_phiright[object_id] = (phiRight)/0.001;
        }
          @FDP1_OBJ_DESC_4_CMF2_1A9::OBJ4_OBJB_CAM_VHL_RIGHT_EDGE_VIEW_2_Rv = @Classe_Obj_Sim::obj_data.obj_phileft[object_id];
          @FDP1_OBJ_DESC_4_CMF2_1A9::OBJ4_OBJB_CAM_VHL_LEFT_EDGE_VIEW_2_Rv = @Classe_Obj_Sim::obj_data.obj_phiright[object_id];
      }

      // calculate the angle velocity based on the delta middle angle and the simulation time in miliseconds
      if (@Classe_Obj_Sim::obj_data.obj_dx[object_id] > 0.0)
      {
        phiMiddle[object_id] = arctan(@Classe_Obj_Sim::obj_data.obj_dy[object_id] / @Classe_Obj_Sim::obj_data.obj_dx[object_id]);
        phiMiddle_vel[object_id] = (phiMiddle[object_id] - phiMiddle_previous[object_id]) / (@Vehicle_Model::simulation_cycle_time * 0.001);
        phiMiddle_previous[object_id] = phiMiddle[object_id];
        @FDP1_OBJ_DESC_4_CMF2_1A9::OBJ4_OBJB_CAM_OBJ_ANGLE_VELOCITY_2_Rv = (phiMiddle_vel[object_id]) / 0.002;
      }
      else
      {
        @FDP1_OBJ_DESC_4_CMF2_1A9::OBJ4_OBJB_CAM_OBJ_ANGLE_VELOCITY_2_Rv = 0;
      }

      //Image plane crossing time to collision
      dx_image_plane_crossing = @Classe_Obj_Sim::obj_data.obj_dx[object_id] - 3.5;
      if ((dx_image_plane_crossing > 0) && (@Classe_Obj_Sim::obj_data.obj_relative_vx[object_id] != 0))
      {
        // time to collision to image plane in seconds
        tt_image_plane_crossing = @Classe_Obj_Sim::obj_data.obj_relative_vx[object_id] / dx_image_plane_crossing;
        @FDP1_OBJ_DESC_4_CMF2_1A9::OBJ4_OBJB_INV_TT_IPC_Rv = -tt_image_plane_crossing * 64;
      }
      else
      {
        @FDP1_OBJ_DESC_4_CMF2_1A9::OBJ4_OBJB_INV_TT_IPC_Rv = 8 * 64;
      }


      @FDP1_OBJ_DESC_4_CMF2_1A9::OBJ4_OBJB_HANDLE_TRACKED_OBJ_2_Rv = object_id + 1;

        //object classification
      switch (@Classe_Obj_Sim::obj_data.obj_type[6])
      {
        case 0: //"Non-Obstacle"
          @FDP1_OBJ_DESC_4_CMF2_1A9::OBJ4_OBJB_CAM_OBJ_CLASS_Rv = 6;
          break;

        case 1: //"unknown"
          @FDP1_OBJ_DESC_4_CMF2_1A9::OBJ4_OBJB_CAM_OBJ_CLASS_Rv = 0;
          break;

        case 2: //"RoadSideBarrier"
          @FDP1_OBJ_DESC_4_CMF2_1A9::OBJ4_OBJB_CAM_OBJ_CLASS_Rv = 6;
          break;

        case 3: //"2Wheeler"
          @FDP1_OBJ_DESC_4_CMF2_1A9::OBJ4_OBJB_CAM_OBJ_CLASS_Rv = 4;
          break;

        case 4: //"Pedestrian"
          @FDP1_OBJ_DESC_4_CMF2_1A9::OBJ4_OBJB_CAM_OBJ_CLASS_Rv = 5;
          break;

        case 5: //"Truck"
          @FDP1_OBJ_DESC_4_CMF2_1A9::OBJ4_OBJB_CAM_OBJ_CLASS_Rv = 1;
          break;

        case 6: //"PassengerCar"
          @FDP1_OBJ_DESC_4_CMF2_1A9::OBJ4_OBJB_CAM_OBJ_CLASS_Rv = 2;
          break;
      }
      break;

    case 7: //"Object-7"
      // Object Constant values
      @FDP1_OBJ_DESC_5_CMF2_1AA::OBJ5_OBJA_CAM_OBJ_ACQUISITION_TYPE_Rv = 1;
      @FDP1_OBJ_DESC_5_CMF2_1AA::OBJ5_OBJA_CAM_OBJ_BRK_INDIC_STATE_Rv = 2;
      @FDP1_OBJ_DESC_5_CMF2_1AA::OBJ5_OBJA_CAM_OBJ_LENGTH_2_Rv = 10;
      @FDP1_OBJ_DESC_5_CMF2_1AA::OBJ5_OBJA_CAM_OBJ_TURN_INDIC_STATE_Rv = 1;
      @FDP1_OBJ_DESC_5_CMF2_1AA::OBJ5_OBJA_CAM_PROB_EXIST_PHYS_OBJ_Rv = 100;
      @FDP1_OBJ_DESC_5_CMF2_1AA::OBJ5_OBJA_CAM_PROB_OBJ_CLASS_Rv = 100;
      @FDP1_OBJ_DESC_5_CMF2_1AA::OBJ5_OBJA_CAM_VAR_OBJ_ANGLE_VELO_2_Rv = 0;
      @FDP1_OBJ_DESC_5_CMF2_1AA::OBJ5_OBJA_CAM_VAR_OBJ_L_EDGE_VIEW_2_Rv = 0;
      @FDP1_OBJ_DESC_5_CMF2_1AA::OBJ5_OBJA_CAM_VAR_OBJ_LAT_DIST_2_Rv = 0;
      @FDP1_OBJ_DESC_5_CMF2_1AA::OBJ5_OBJA_CAM_VAR_OBJ_LENGTH_2_Rv = 0;
      @FDP1_OBJ_DESC_5_CMF2_1AA::OBJ5_OBJA_CAM_VAR_OBJ_LONGI_DIST_2_Rv = 0;
      @FDP1_OBJ_DESC_5_CMF2_1AA::OBJ5_OBJA_CAM_VAR_OBJ_R_EDGE_VIEW_2_Rv = 0;
      @FDP1_OBJ_DESC_5_CMF2_1AA::OBJ5_OBJA_CAM_VAR_OBJ_YAW_ANGLE_2_Rv = 0;
      @FDP1_OBJ_DESC_5_CMF2_1AA::OBJ5_OBJA_CAM_YAW_ANGLE_2_Rv = 0;
      @FDP1_OBJ_DESC_5_CMF2_1AA::OBJ5_OBJA_CAM_LANE_POS_Rv = 0;
      @FDP1_OBJ_DESC_5_CMF2_1AA::OBJ5_OBJA_CAM_MOTION_STATUS_2_Rv = 1;
      @FDP1_OBJ_DESC_5_CMF2_1AA::OBJ5_OBJA_CAM_REFERENCE_POINT_Rv = 2;
      @FDP1_OBJ_DESC_5_CMF2_1AA::OBJ5_OBJA_CAM_STD_DIST_EDGE_VIEW_2_Rv = 0;
      @FDP1_OBJ_DESC_5_CMF2_1AA::OBJ5_OBJA_CAM_VHL_DIST_EDGE_VIEW_2_Rv = 0;


      // Object dynamic values conversion to raw
      @FDP1_OBJ_DESC_5_CMF2_1AA::OBJ5_OBJA_CAM_OBJ_LONGI_DIST_2_Rv = (@Classe_Obj_Sim::obj_data.obj_dx[7] - 3.5) * 10;
      @FDP1_OBJ_DESC_5_CMF2_1AA::OBJ5_OBJA_CAM_OBJ_LAT_DIST_2_Rv = @Classe_Obj_Sim::obj_data.obj_dy[7] * 20;
      @FDP1_OBJ_DESC_5_CMF2_1AA::OBJ5_OBJA_CAM_OBJ_RELAT_VELO_LONGI_2_Rv = (@Classe_Obj_Sim::obj_data.obj_relative_vx[7] * 10) + 1280;
      @FDP1_OBJ_DESC_5_CMF2_1AA::OBJ5_OBJA_CAM_OBJ_RELAT_VELO_LAT_2_Rv = @Classe_Obj_Sim::obj_data.obj_relative_vy[7] * 10;

      // calculation of angle view of the object
      if ((@Classe_Obj_Sim::obj_data.obj_dx[object_id]) > 0.0)
      {
        phiLeft = arctan((@Classe_Obj_Sim::obj_data.obj_dy[object_id] + (@Classe_Obj_Sim::obj_data.obj_width[object_id]/2)) /@Classe_Obj_Sim::obj_data.obj_dx[object_id]);
        phiRight = arctan((@Classe_Obj_Sim::obj_data.obj_dy[object_id] - (@Classe_Obj_Sim::obj_data.obj_width[object_id]/2)) /@Classe_Obj_Sim::obj_data.obj_dx[object_id]);


        if ((phiLeft!=0)&&(phiRight!=0))
        {
          @Classe_Obj_Sim::obj_data.obj_phileft[object_id]= (phiLeft)/0.001;
          @Classe_Obj_Sim::obj_data.obj_phiright[object_id] = (phiRight)/0.001;
        }
          @FDP1_OBJ_DESC_5_CMF2_1AA::OBJ5_OBJA_CAM_VHL_RIGHT_EDGE_VIEW_2_Rv = @Classe_Obj_Sim::obj_data.obj_phileft[object_id];
          @FDP1_OBJ_DESC_5_CMF2_1AA::OBJ5_OBJA_CAM_VHL_LEFT_EDGE_VIEW_2_Rv = @Classe_Obj_Sim::obj_data.obj_phiright[object_id];
      }

      // calculate the angle velocity based on the delta middle angle and the simulation time in miliseconds
      if (@Classe_Obj_Sim::obj_data.obj_dx[object_id] > 0.0)
      {
        phiMiddle[object_id] = arctan(@Classe_Obj_Sim::obj_data.obj_dy[object_id] / @Classe_Obj_Sim::obj_data.obj_dx[object_id]);
        phiMiddle_vel[object_id] = (phiMiddle[object_id] - phiMiddle_previous[object_id]) / (@Vehicle_Model::simulation_cycle_time * 0.001);
        phiMiddle_previous[object_id] = phiMiddle[object_id];
        @FDP1_OBJ_DESC_5_CMF2_1AA::OBJ5_OBJA_CAM_OBJ_ANGLE_VELOCITY_2_Rv = (phiMiddle_vel[object_id]) / 0.002;
      }
      else
      {
        @FDP1_OBJ_DESC_5_CMF2_1AA::OBJ5_OBJA_CAM_OBJ_ANGLE_VELOCITY_2_Rv = 0;
      }

      //Image plane crossing time to collision
      dx_image_plane_crossing = @Classe_Obj_Sim::obj_data.obj_dx[object_id] - 3.5;
      if ((dx_image_plane_crossing > 0) && (@Classe_Obj_Sim::obj_data.obj_relative_vx[object_id] != 0))
      {
        // time to collision to image plane in seconds
        tt_image_plane_crossing = @Classe_Obj_Sim::obj_data.obj_relative_vx[object_id] / dx_image_plane_crossing;
        @FDP1_OBJ_DESC_5_CMF2_1AA::OBJ5_OBJA_INV_TT_IPC_Rv = -tt_image_plane_crossing * 64;
      }
      else
      {
        @FDP1_OBJ_DESC_5_CMF2_1AA::OBJ5_OBJA_INV_TT_IPC_Rv = 8 * 64;
      }


      @FDP1_OBJ_DESC_5_CMF2_1AA::OBJ5_OBJA_HANDLE_TRACKED_OBJ_2_Rv = object_id + 1;

        //object classification
      switch (@Classe_Obj_Sim::obj_data.obj_type[7])
      {
        case 0: //"Non-Obstacle"
          @FDP1_OBJ_DESC_5_CMF2_1AA::OBJ5_OBJA_CAM_OBJ_CLASS_Rv = 6;
          break;

        case 1: //"unknown"
          @FDP1_OBJ_DESC_5_CMF2_1AA::OBJ5_OBJA_CAM_OBJ_CLASS_Rv = 0;
          break;

        case 2: //"RoadSideBarrier"
          @FDP1_OBJ_DESC_5_CMF2_1AA::OBJ5_OBJA_CAM_OBJ_CLASS_Rv = 6;
          break;

        case 3: //"2Wheeler"
          @FDP1_OBJ_DESC_5_CMF2_1AA::OBJ5_OBJA_CAM_OBJ_CLASS_Rv = 4;
          break;

        case 4: //"Pedestrian"
          @FDP1_OBJ_DESC_5_CMF2_1AA::OBJ5_OBJA_CAM_OBJ_CLASS_Rv = 5;
          break;

        case 5: //"Truck"
          @FDP1_OBJ_DESC_5_CMF2_1AA::OBJ5_OBJA_CAM_OBJ_CLASS_Rv = 1;
          break;

        case 6: //"PassengerCar"
          @FDP1_OBJ_DESC_5_CMF2_1AA::OBJ5_OBJA_CAM_OBJ_CLASS_Rv = 2;
          break;
      }
      break;

    case 8: //"Object-8"
      // Object Constant values
      @FDP1_OBJ_DESC_5_CMF2_1AA::OBJ5_OBJB_CAM_OBJ_ACQUISITION_TYPE_Rv = 1;
      @FDP1_OBJ_DESC_5_CMF2_1AA::OBJ5_OBJB_CAM_OBJ_BRK_INDIC_STATE_Rv = 2;
      @FDP1_OBJ_DESC_5_CMF2_1AA::OBJ5_OBJB_CAM_OBJ_LENGTH_2_Rv = 10;
      @FDP1_OBJ_DESC_5_CMF2_1AA::OBJ5_OBJB_CAM_OBJ_TURN_INDIC_STATE_Rv = 1;
      @FDP1_OBJ_DESC_5_CMF2_1AA::OBJ5_OBJB_CAM_PROB_EXIST_PHYS_OBJ_Rv = 100;
      @FDP1_OBJ_DESC_5_CMF2_1AA::OBJ5_OBJB_CAM_PROB_OBJ_CLASS_Rv = 100;
      @FDP1_OBJ_DESC_5_CMF2_1AA::OBJ5_OBJB_CAM_VAR_OBJ_ANGLE_VELO_2_Rv = 0;
      @FDP1_OBJ_DESC_5_CMF2_1AA::OBJ5_OBJB_CAM_VAR_OBJ_L_EDGE_VIEW_2_Rv = 0;
      @FDP1_OBJ_DESC_5_CMF2_1AA::OBJ5_OBJB_CAM_VAR_OBJ_LAT_DIST_2_Rv = 0;
      @FDP1_OBJ_DESC_5_CMF2_1AA::OBJ5_OBJB_CAM_VAR_OBJ_LENGTH_2_Rv = 0;
      @FDP1_OBJ_DESC_5_CMF2_1AA::OBJ5_OBJB_CAM_VAR_OBJ_LONGI_DIST_2_Rv = 0;
      @FDP1_OBJ_DESC_5_CMF2_1AA::OBJ5_OBJB_CAM_VAR_OBJ_R_EDGE_VIEW_2_Rv = 0;
      @FDP1_OBJ_DESC_5_CMF2_1AA::OBJ5_OBJB_CAM_VAR_OBJ_YAW_ANGLE_2_Rv = 0;
      @FDP1_OBJ_DESC_5_CMF2_1AA::OBJ5_OBJB_CAM_YAW_ANGLE_2_Rv = 0;
      @FDP1_OBJ_DESC_5_CMF2_1AA::OBJ5_OBJB_CAM_LANE_POS_Rv = 0;
      @FDP1_OBJ_DESC_5_CMF2_1AA::OBJ5_OBJB_CAM_MOTION_STATUS_2_Rv = 1;
      @FDP1_OBJ_DESC_5_CMF2_1AA::OBJ5_OBJB_CAM_REFERENCE_POINT_Rv = 2;
      @FDP1_OBJ_DESC_5_CMF2_1AA::OBJ5_OBJB_CAM_STD_DIST_EDGE_VIEW_2_Rv = 0;
      @FDP1_OBJ_DESC_5_CMF2_1AA::OBJ5_OBJB_CAM_VHL_DIST_EDGE_VIEW_2_Rv = 0;


      // Object dynamic values conversion to raw
      @FDP1_OBJ_DESC_5_CMF2_1AA::OBJ5_OBJB_CAM_OBJ_LONGI_DIST_2_Rv = (@Classe_Obj_Sim::obj_data.obj_dx[8] - 3.5) * 10;
      @FDP1_OBJ_DESC_5_CMF2_1AA::OBJ5_OBJB_CAM_OBJ_LAT_DIST_2_Rv = @Classe_Obj_Sim::obj_data.obj_dy[8] * 20;
      @FDP1_OBJ_DESC_5_CMF2_1AA::OBJ5_OBJB_CAM_OBJ_RELAT_VELO_LONGI_2_Rv = (@Classe_Obj_Sim::obj_data.obj_relative_vx[8] * 10) + 1280;
      @FDP1_OBJ_DESC_5_CMF2_1AA::OBJ5_OBJB_CAM_OBJ_RELAT_VELO_LAT_2_Rv = @Classe_Obj_Sim::obj_data.obj_relative_vy[8] * 10;

      // calculation of angle view of the object
      if ((@Classe_Obj_Sim::obj_data.obj_dx[object_id]) > 0.0)
      {
        phiLeft = arctan((@Classe_Obj_Sim::obj_data.obj_dy[object_id] + (@Classe_Obj_Sim::obj_data.obj_width[object_id]/2)) /@Classe_Obj_Sim::obj_data.obj_dx[object_id]);
        phiRight = arctan((@Classe_Obj_Sim::obj_data.obj_dy[object_id] - (@Classe_Obj_Sim::obj_data.obj_width[object_id]/2)) /@Classe_Obj_Sim::obj_data.obj_dx[object_id]);


        if ((phiLeft!=0)&&(phiRight!=0))
        {
          @Classe_Obj_Sim::obj_data.obj_phileft[object_id]= (phiLeft)/0.001;
          @Classe_Obj_Sim::obj_data.obj_phiright[object_id] = (phiRight)/0.001;
        }
          @FDP1_OBJ_DESC_5_CMF2_1AA::OBJ5_OBJB_CAM_VHL_RIGHT_EDGE_VIEW_2_Rv = @Classe_Obj_Sim::obj_data.obj_phileft[object_id];
          @FDP1_OBJ_DESC_5_CMF2_1AA::OBJ5_OBJB_CAM_VHL_LEFT_EDGE_VIEW_2_Rv = @Classe_Obj_Sim::obj_data.obj_phiright[object_id];
      }

      // calculate the angle velocity based on the delta middle angle and the simulation time in miliseconds
      if (@Classe_Obj_Sim::obj_data.obj_dx[object_id] > 0.0)
      {
        phiMiddle[object_id] = arctan(@Classe_Obj_Sim::obj_data.obj_dy[object_id] / @Classe_Obj_Sim::obj_data.obj_dx[object_id]);
        phiMiddle_vel[object_id] = (phiMiddle[object_id] - phiMiddle_previous[object_id]) / (@Vehicle_Model::simulation_cycle_time * 0.001);
        phiMiddle_previous[object_id] = phiMiddle[object_id];
        @FDP1_OBJ_DESC_5_CMF2_1AA::OBJ5_OBJB_CAM_OBJ_ANGLE_VELOCITY_2_Rv = (phiMiddle_vel[object_id]) / 0.002;
      }
      else
      {
        @FDP1_OBJ_DESC_5_CMF2_1AA::OBJ5_OBJB_CAM_OBJ_ANGLE_VELOCITY_2_Rv = 0;
      }

      //Image plane crossing time to collision
      dx_image_plane_crossing = @Classe_Obj_Sim::obj_data.obj_dx[object_id] - 3.5;
      if ((dx_image_plane_crossing > 0) && (@Classe_Obj_Sim::obj_data.obj_relative_vx[object_id] != 0))
      {
        // time to collision to image plane in seconds
        tt_image_plane_crossing = @Classe_Obj_Sim::obj_data.obj_relative_vx[object_id] / dx_image_plane_crossing;
        @FDP1_OBJ_DESC_5_CMF2_1AA::OBJ5_OBJB_INV_TT_IPC_Rv = -tt_image_plane_crossing * 64;
      }
      else
      {
        @FDP1_OBJ_DESC_5_CMF2_1AA::OBJ5_OBJB_INV_TT_IPC_Rv = 8 * 64;
      }


      @FDP1_OBJ_DESC_5_CMF2_1AA::OBJ5_OBJB_HANDLE_TRACKED_OBJ_2_Rv = object_id + 1;

        //object classification
      switch (@Classe_Obj_Sim::obj_data.obj_type[8])
      {
        case 0: //"Non-Obstacle"
          @FDP1_OBJ_DESC_5_CMF2_1AA::OBJ5_OBJB_CAM_OBJ_CLASS_Rv = 6;
          break;

        case 1: //"unknown"
          @FDP1_OBJ_DESC_5_CMF2_1AA::OBJ5_OBJB_CAM_OBJ_CLASS_Rv = 0;
          break;

        case 2: //"RoadSideBarrier"
          @FDP1_OBJ_DESC_5_CMF2_1AA::OBJ5_OBJB_CAM_OBJ_CLASS_Rv = 6;
          break;

        case 3: //"2Wheeler"
          @FDP1_OBJ_DESC_5_CMF2_1AA::OBJ5_OBJB_CAM_OBJ_CLASS_Rv = 4;
          break;

        case 4: //"Pedestrian"
          @FDP1_OBJ_DESC_5_CMF2_1AA::OBJ5_OBJB_CAM_OBJ_CLASS_Rv = 5;
          break;

        case 5: //"Truck"
          @FDP1_OBJ_DESC_5_CMF2_1AA::OBJ5_OBJB_CAM_OBJ_CLASS_Rv = 1;
          break;

        case 6: //"PassengerCar"
          @FDP1_OBJ_DESC_5_CMF2_1AA::OBJ5_OBJB_CAM_OBJ_CLASS_Rv = 2;
          break;
      }
      break;
  }
}