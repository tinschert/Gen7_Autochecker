/*@!Encoding:1252*/
/**
 * @file Road_Obj_FRadar_FDX.cin
 * @author ADAS_HIL_TEAM
 * @date 08-21-2023
 * @brief  Handles Radar object injection into XCP
 *
 * ################################################################
 * C O P Y R I G H T S
 * ----------------------------------------------------------------
 * Copyright (c) 2023 by Robert Bosch GmbH. All rights reserved.
 
 * The reproduction, distribution and utilization of this file as
 * well as the communication of its contents to others without express
 * authorization is prohibited. Offenders will be held liable for the
 * payment of damages. All rights reserved in the event of the grant
 * of a patent, utility model or design.
 *
 * ################################################################
*/

includes
{
}

variables
{
  /*
Integers in form of
byte (unsigned, 1 Byte)
word (unsigned, 2 Byte)
dword (unsigned, 4 Byte)
int (signed, 2 Byte)
long (signed, 4 Byte)
int64(signed, 8 Byte)
qword(unsigned, 8 Byte)
Individual character
char (1 Byte)
Floating point numbers
float (8 Byte)
double (8 Byte)
*/  
}

void obj_sim_update_fradar_fdx(byte object_id)
{
  //header
@sysvar::XCP::RadarFC::_g_PER_Hil_ObjBypassingRunnable_ObjBypassingRunnable_m_pad_radarObjPort_par_out_local::TChangeableMemPool::_::_::_m_arrayPool::_0_::_elem::_m_alignment::_m_alpAzimuthAngOffsetN = -1146;
@sysvar::XCP::RadarFC::_g_PER_Hil_ObjBypassingRunnable_ObjBypassingRunnable_m_pad_radarObjPort_par_out_local::TChangeableMemPool::_::_::_m_arrayPool::_0_::_elem::_m_alignment::_m_alpMountAngleN = 0;
@sysvar::XCP::RadarFC::_g_PER_Hil_ObjBypassingRunnable_ObjBypassingRunnable_m_pad_radarObjPort_par_out_local::TChangeableMemPool::_::_::_m_arrayPool::_0_::_elem::_m_alignment::_m_dLongitudinalOffsetRearAxisN = 455;
@sysvar::XCP::RadarFC::_g_PER_Hil_ObjBypassingRunnable_ObjBypassingRunnable_m_pad_radarObjPort_par_out_local::TChangeableMemPool::_::_::_m_arrayPool::_0_::_elem::_m_alignment::_m_dMountElevationN = 20;
@sysvar::XCP::RadarFC::_g_PER_Hil_ObjBypassingRunnable_ObjBypassingRunnable_m_pad_radarObjPort_par_out_local::TChangeableMemPool::_::_::_m_arrayPool::_0_::_elem::_m_alignment::_m_dMountOffsetN = 0;

  switch (object_id)
  {
    case 0: //"Object-0"
    //constant
  @sysvar::XCP::RadarFC::_g_PER_Hil_ObjBypassingRunnable_ObjBypassingRunnable_m_pad_radarObjPort_par_out_local::TChangeableMemPool::_::_::_m_arrayPool::_0_::_elem::_m_objectInformation::_0_::_Valid_b = 1;
  @sysvar::XCP::RadarFC::_g_PER_Hil_ObjBypassingRunnable_ObjBypassingRunnable_m_pad_radarObjPort_par_out_local::TChangeableMemPool::_::_::_m_arrayPool::_0_::_elem::_m_objectInformation::_0_::_m_HandleN = 1;
  @sysvar::XCP::RadarFC::_g_PER_Hil_ObjBypassingRunnable_ObjBypassingRunnable_m_pad_radarObjPort_par_out_local::TChangeableMemPool::_::_::_m_arrayPool::_0_::_elem::_m_objectInformation::_0_::_m_alpPiVarYawAngleN = 0;
  @sysvar::XCP::RadarFC::_g_PER_Hil_ObjBypassingRunnable_ObjBypassingRunnable_m_pad_radarObjPort_par_out_local::TChangeableMemPool::_::_::_m_arrayPool::_0_::_elem::_m_objectInformation::_0_::_m_alpPiYawAngleN = 0;
  @sysvar::XCP::RadarFC::_g_PER_Hil_ObjBypassingRunnable_ObjBypassingRunnable_m_pad_radarObjPort_par_out_local::TChangeableMemPool::_::_::_m_arrayPool::_0_::_elem::_m_objectInformation::_0_::_m_varAxN = 0;
  @sysvar::XCP::RadarFC::_g_PER_Hil_ObjBypassingRunnable_ObjBypassingRunnable_m_pad_radarObjPort_par_out_local::TChangeableMemPool::_::_::_m_arrayPool::_0_::_elem::_m_objectInformation::_0_::_m_varAyN = 0;
  @sysvar::XCP::RadarFC::_g_PER_Hil_ObjBypassingRunnable_ObjBypassingRunnable_m_pad_radarObjPort_par_out_local::TChangeableMemPool::_::_::_m_arrayPool::_0_::_elem::_m_objectInformation::_0_::_m_varVxN = 0;
  @sysvar::XCP::RadarFC::_g_PER_Hil_ObjBypassingRunnable_ObjBypassingRunnable_m_pad_radarObjPort_par_out_local::TChangeableMemPool::_::_::_m_arrayPool::_0_::_elem::_m_objectInformation::_0_::_m_varVyN = 0;
  @sysvar::XCP::RadarFC::_g_PER_Hil_ObjBypassingRunnable_ObjBypassingRunnable_m_pad_radarObjPort_par_out_local::TChangeableMemPool::_::_::_m_arrayPool::_0_::_elem::_m_objectInformation::_0_::_m_varDxN = 0;
  @sysvar::XCP::RadarFC::_g_PER_Hil_ObjBypassingRunnable_ObjBypassingRunnable_m_pad_radarObjPort_par_out_local::TChangeableMemPool::_::_::_m_arrayPool::_0_::_elem::_m_objectInformation::_0_::_m_varDyN = 0;
  @sysvar::XCP::RadarFC::_g_PER_Hil_ObjBypassingRunnable_ObjBypassingRunnable_m_pad_radarObjPort_par_out_local::TChangeableMemPool::_::_::_m_arrayPool::_0_::_elem::_m_objectInformation::_0_::_m_dVarLengthN = 0;
  @sysvar::XCP::RadarFC::_g_PER_Hil_ObjBypassingRunnable_ObjBypassingRunnable_m_pad_radarObjPort_par_out_local::TChangeableMemPool::_::_::_m_arrayPool::_0_::_elem::_m_objectInformation::_0_::_m_dVarWidthN = 0;
  @sysvar::XCP::RadarFC::_g_PER_Hil_ObjBypassingRunnable_ObjBypassingRunnable_m_pad_radarObjPort_par_out_local::TChangeableMemPool::_::_::_m_arrayPool::_0_::_elem::_m_objectInformation::_0_::_m_wExistProbN = 64880;
  @sysvar::XCP::RadarFC::_g_PER_Hil_ObjBypassingRunnable_ObjBypassingRunnable_m_pad_radarObjPort_par_out_local::TChangeableMemPool::_::_::_m_arrayPool::_0_::_elem::_m_objectInformation::_0_::_m_isObjectAsil = 1;
  @sysvar::XCP::RadarFC::_g_PER_Hil_ObjBypassingRunnable_ObjBypassingRunnable_m_pad_radarObjPort_par_out_local::TChangeableMemPool::_::_::_m_arrayPool::_0_::_elem::_m_objectInformation::_0_::_m_dLengthN = 128;

      //target movement

  @sysvar::XCP::RadarFC::_g_PER_Hil_ObjBypassingRunnable_ObjBypassingRunnable_m_pad_radarObjPort_par_out_local::TChangeableMemPool::_::_::_m_arrayPool::_0_::_elem::_m_objectInformation::_0_::_m_dxN = @FDX_in_HIL_specific_FRadar_Obj::FDX_in_FRadar_0_m_dxN;
  @sysvar::XCP::RadarFC::_g_PER_Hil_ObjBypassingRunnable_ObjBypassingRunnable_m_pad_radarObjPort_par_out_local::TChangeableMemPool::_::_::_m_arrayPool::_0_::_elem::_m_objectInformation::_0_::_m_dyN = @FDX_in_HIL_specific_FRadar_Obj::FDX_in_FRadar_0_m_dyN;
  @sysvar::XCP::RadarFC::_g_PER_Hil_ObjBypassingRunnable_ObjBypassingRunnable_m_pad_radarObjPort_par_out_local::TChangeableMemPool::_::_::_m_arrayPool::_0_::_elem::_m_objectInformation::_0_::_m_dzN = @FDX_in_HIL_specific_FRadar_Obj::FDX_in_FRadar_0_m_dzN;
  @sysvar::XCP::RadarFC::_g_PER_Hil_ObjBypassingRunnable_ObjBypassingRunnable_m_pad_radarObjPort_par_out_local::TChangeableMemPool::_::_::_m_arrayPool::_0_::_elem::_m_objectInformation::_0_::_m_vxN = @FDX_in_HIL_specific_FRadar_Obj::FDX_in_FRadar_0_m_vxN;
  @sysvar::XCP::RadarFC::_g_PER_Hil_ObjBypassingRunnable_ObjBypassingRunnable_m_pad_radarObjPort_par_out_local::TChangeableMemPool::_::_::_m_arrayPool::_0_::_elem::_m_objectInformation::_0_::_m_vyN = @FDX_in_HIL_specific_FRadar_Obj::FDX_in_FRadar_0_m_vyN;
  @sysvar::XCP::RadarFC::_g_PER_Hil_ObjBypassingRunnable_ObjBypassingRunnable_m_pad_radarObjPort_par_out_local::TChangeableMemPool::_::_::_m_arrayPool::_0_::_elem::_m_objectInformation::_0_::_m_axN = @FDX_in_HIL_specific_FRadar_Obj::FDX_in_FRadar_0_m_axN;
  @sysvar::XCP::RadarFC::_g_PER_Hil_ObjBypassingRunnable_ObjBypassingRunnable_m_pad_radarObjPort_par_out_local::TChangeableMemPool::_::_::_m_arrayPool::_0_::_elem::_m_objectInformation::_0_::_m_ayN = @FDX_in_HIL_specific_FRadar_Obj::FDX_in_FRadar_0_m_ayN;
  @sysvar::XCP::RadarFC::_g_PER_Hil_ObjBypassingRunnable_ObjBypassingRunnable_m_pad_radarObjPort_par_out_local::TChangeableMemPool::_::_::_m_arrayPool::_0_::_elem::_m_objectInformation::_0_::_m_dLengthN = @FDX_in_HIL_specific_FRadar_Obj::FDX_in_FRadar_0_m_dLengthN;
  @sysvar::XCP::RadarFC::_g_PER_Hil_ObjBypassingRunnable_ObjBypassingRunnable_m_pad_radarObjPort_par_out_local::TChangeableMemPool::_::_::_m_arrayPool::_0_::_elem::_m_objectInformation::_0_::_m_dWidthN = @FDX_in_HIL_specific_FRadar_Obj::FDX_in_FRadar_0_m_dWidthN;
  @sysvar::XCP::RadarFC::_g_PER_Hil_ObjBypassingRunnable_ObjBypassingRunnable_m_pad_radarObjPort_par_out_local::TChangeableMemPool::_::_::_m_arrayPool::_0_::_elem::_m_objectInformation::_0_::_m_alpPiYawAngleN = @FDX_in_HIL_specific_FRadar_Obj::FDX_in_FRadar_0_m_alpPiYawAngleN;

      //target object moving or not
      if (abs(@FDX_in_HIL_specific_FRadar_Obj::FDX_in_FRadar_0_m_vxN) != 0)
      {
    @sysvar::XCP::RadarFC::_g_PER_Hil_ObjBypassingRunnable_ObjBypassingRunnable_m_pad_radarObjPort_par_out_local::TChangeableMemPool::_::_::_m_arrayPool::_0_::_elem::_m_objectInformation::_0_::_m_prob1HasBeenObservedMovingN = 126;
    @sysvar::XCP::RadarFC::_g_PER_Hil_ObjBypassingRunnable_ObjBypassingRunnable_m_pad_radarObjPort_par_out_local::TChangeableMemPool::_::_::_m_arrayPool::_0_::_elem::_m_objectInformation::_0_::_m_prob1MovingN = 126;
      }
      else
      {
    @sysvar::XCP::RadarFC::_g_PER_Hil_ObjBypassingRunnable_ObjBypassingRunnable_m_pad_radarObjPort_par_out_local::TChangeableMemPool::_::_::_m_arrayPool::_0_::_elem::_m_objectInformation::_0_::_m_prob1HasBeenObservedMovingN = 0;
    @sysvar::XCP::RadarFC::_g_PER_Hil_ObjBypassingRunnable_ObjBypassingRunnable_m_pad_radarObjPort_par_out_local::TChangeableMemPool::_::_::_m_arrayPool::_0_::_elem::_m_objectInformation::_0_::_m_prob1MovingN = 0;
      }

      //object classification
    switch (@FDX_in_HIL_specific_FRadar_Obj::FDX_in_FRadar_0_Sensed_Object_Classification)
    {
      case 0: //"unknown"
      @sysvar::XCP::RadarFC::_g_PER_Hil_ObjBypassingRunnable_ObjBypassingRunnable_m_pad_radarObjPort_par_out_local::TChangeableMemPool::_::_::_m_arrayPool::_0_::_elem::_m_objectInformation::_0_::_m_perObjectType::_m_prob1ObstacleN = 0;
      @sysvar::XCP::RadarFC::_g_PER_Hil_ObjBypassingRunnable_ObjBypassingRunnable_m_pad_radarObjPort_par_out_local::TChangeableMemPool::_::_::_m_arrayPool::_0_::_elem::_m_objectInformation::_0_::_m_perObjectType::_m_prob1NonObstacleN = 0;
      @sysvar::XCP::RadarFC::_g_PER_Hil_ObjBypassingRunnable_ObjBypassingRunnable_m_pad_radarObjPort_par_out_local::TChangeableMemPool::_::_::_m_arrayPool::_0_::_elem::_m_objectInformation::_0_::_m_perObjectType::_m_prob1UnknownN = 128;
      @sysvar::XCP::RadarFC::_g_PER_Hil_ObjBypassingRunnable_ObjBypassingRunnable_m_pad_radarObjPort_par_out_local::TChangeableMemPool::_::_::_m_arrayPool::_0_::_elem::_m_objectInformation::_0_::_m_perObjectType::_m_prob1MobileN = 0;
      @sysvar::XCP::RadarFC::_g_PER_Hil_ObjBypassingRunnable_ObjBypassingRunnable_m_pad_radarObjPort_par_out_local::TChangeableMemPool::_::_::_m_arrayPool::_0_::_elem::_m_objectInformation::_0_::_m_perObjectType::_m_prob1StationaryN = 0;
      @sysvar::XCP::RadarFC::_g_PER_Hil_ObjBypassingRunnable_ObjBypassingRunnable_m_pad_radarObjPort_par_out_local::TChangeableMemPool::_::_::_m_arrayPool::_0_::_elem::_m_objectInformation::_0_::_m_perObjectType::_m_prob1ObstUnknownN = 128;
      @sysvar::XCP::RadarFC::_g_PER_Hil_ObjBypassingRunnable_ObjBypassingRunnable_m_pad_radarObjPort_par_out_local::TChangeableMemPool::_::_::_m_arrayPool::_0_::_elem::_m_objectInformation::_0_::_m_perObjectType::_m_prob1FourPlusWheelerN = 0;
      @sysvar::XCP::RadarFC::_g_PER_Hil_ObjBypassingRunnable_ObjBypassingRunnable_m_pad_radarObjPort_par_out_local::TChangeableMemPool::_::_::_m_arrayPool::_0_::_elem::_m_objectInformation::_0_::_m_perObjectType::_m_prob1TwoWheelerN = 0;
      @sysvar::XCP::RadarFC::_g_PER_Hil_ObjBypassingRunnable_ObjBypassingRunnable_m_pad_radarObjPort_par_out_local::TChangeableMemPool::_::_::_m_arrayPool::_0_::_elem::_m_objectInformation::_0_::_m_perObjectType::_m_prob1PedestrianN = 0;
      @sysvar::XCP::RadarFC::_g_PER_Hil_ObjBypassingRunnable_ObjBypassingRunnable_m_pad_radarObjPort_par_out_local::TChangeableMemPool::_::_::_m_arrayPool::_0_::_elem::_m_objectInformation::_0_::_m_perObjectType::_m_prob1MovUnknownN = 128;
      @sysvar::XCP::RadarFC::_g_PER_Hil_ObjBypassingRunnable_ObjBypassingRunnable_m_pad_radarObjPort_par_out_local::TChangeableMemPool::_::_::_m_arrayPool::_0_::_elem::_m_objectInformation::_0_::_m_perObjectType::_m_prob1RoadsideBarrierN = 0;
      @sysvar::XCP::RadarFC::_g_PER_Hil_ObjBypassingRunnable_ObjBypassingRunnable_m_pad_radarObjPort_par_out_local::TChangeableMemPool::_::_::_m_arrayPool::_0_::_elem::_m_objectInformation::_0_::_m_perObjectType::_m_prob1StatUnknownN = 128;
      @sysvar::XCP::RadarFC::_g_PER_Hil_ObjBypassingRunnable_ObjBypassingRunnable_m_pad_radarObjPort_par_out_local::TChangeableMemPool::_::_::_m_arrayPool::_0_::_elem::_m_objectInformation::_0_::_m_perObjectType::_m_prob1PassengerCarN = 0;
      @sysvar::XCP::RadarFC::_g_PER_Hil_ObjBypassingRunnable_ObjBypassingRunnable_m_pad_radarObjPort_par_out_local::TChangeableMemPool::_::_::_m_arrayPool::_0_::_elem::_m_objectInformation::_0_::_m_perObjectType::_m_prob1TruckN = 0;
      @sysvar::XCP::RadarFC::_g_PER_Hil_ObjBypassingRunnable_ObjBypassingRunnable_m_pad_radarObjPort_par_out_local::TChangeableMemPool::_::_::_m_arrayPool::_0_::_elem::_m_objectInformation::_0_::_m_perObjectType::_m_prob1FourWheelUnknownN = 128;
      @sysvar::XCP::RadarFC::_g_PER_Hil_ObjBypassingRunnable_ObjBypassingRunnable_m_pad_radarObjPort_par_out_local::TChangeableMemPool::_::_::_m_arrayPool::_0_::_elem::_m_objectInformation::_0_::_m_dWidthN = 256;
          break;

      case 1: //"Pedestrian"
      @sysvar::XCP::RadarFC::_g_PER_Hil_ObjBypassingRunnable_ObjBypassingRunnable_m_pad_radarObjPort_par_out_local::TChangeableMemPool::_::_::_m_arrayPool::_0_::_elem::_m_objectInformation::_0_::_m_perObjectType::_m_prob1ObstacleN = 128;
      @sysvar::XCP::RadarFC::_g_PER_Hil_ObjBypassingRunnable_ObjBypassingRunnable_m_pad_radarObjPort_par_out_local::TChangeableMemPool::_::_::_m_arrayPool::_0_::_elem::_m_objectInformation::_0_::_m_perObjectType::_m_prob1NonObstacleN = 0;
      @sysvar::XCP::RadarFC::_g_PER_Hil_ObjBypassingRunnable_ObjBypassingRunnable_m_pad_radarObjPort_par_out_local::TChangeableMemPool::_::_::_m_arrayPool::_0_::_elem::_m_objectInformation::_0_::_m_perObjectType::_m_prob1UnknownN = 0;
      @sysvar::XCP::RadarFC::_g_PER_Hil_ObjBypassingRunnable_ObjBypassingRunnable_m_pad_radarObjPort_par_out_local::TChangeableMemPool::_::_::_m_arrayPool::_0_::_elem::_m_objectInformation::_0_::_m_perObjectType::_m_prob1MobileN = 128;
      @sysvar::XCP::RadarFC::_g_PER_Hil_ObjBypassingRunnable_ObjBypassingRunnable_m_pad_radarObjPort_par_out_local::TChangeableMemPool::_::_::_m_arrayPool::_0_::_elem::_m_objectInformation::_0_::_m_perObjectType::_m_prob1StationaryN = 0;
      @sysvar::XCP::RadarFC::_g_PER_Hil_ObjBypassingRunnable_ObjBypassingRunnable_m_pad_radarObjPort_par_out_local::TChangeableMemPool::_::_::_m_arrayPool::_0_::_elem::_m_objectInformation::_0_::_m_perObjectType::_m_prob1ObstUnknownN = 0;
      @sysvar::XCP::RadarFC::_g_PER_Hil_ObjBypassingRunnable_ObjBypassingRunnable_m_pad_radarObjPort_par_out_local::TChangeableMemPool::_::_::_m_arrayPool::_0_::_elem::_m_objectInformation::_0_::_m_perObjectType::_m_prob1FourPlusWheelerN = 0;
      @sysvar::XCP::RadarFC::_g_PER_Hil_ObjBypassingRunnable_ObjBypassingRunnable_m_pad_radarObjPort_par_out_local::TChangeableMemPool::_::_::_m_arrayPool::_0_::_elem::_m_objectInformation::_0_::_m_perObjectType::_m_prob1TwoWheelerN = 0;
      @sysvar::XCP::RadarFC::_g_PER_Hil_ObjBypassingRunnable_ObjBypassingRunnable_m_pad_radarObjPort_par_out_local::TChangeableMemPool::_::_::_m_arrayPool::_0_::_elem::_m_objectInformation::_0_::_m_perObjectType::_m_prob1PedestrianN = 128;
      @sysvar::XCP::RadarFC::_g_PER_Hil_ObjBypassingRunnable_ObjBypassingRunnable_m_pad_radarObjPort_par_out_local::TChangeableMemPool::_::_::_m_arrayPool::_0_::_elem::_m_objectInformation::_0_::_m_perObjectType::_m_prob1MovUnknownN = 0;
      @sysvar::XCP::RadarFC::_g_PER_Hil_ObjBypassingRunnable_ObjBypassingRunnable_m_pad_radarObjPort_par_out_local::TChangeableMemPool::_::_::_m_arrayPool::_0_::_elem::_m_objectInformation::_0_::_m_perObjectType::_m_prob1RoadsideBarrierN = 0;
      @sysvar::XCP::RadarFC::_g_PER_Hil_ObjBypassingRunnable_ObjBypassingRunnable_m_pad_radarObjPort_par_out_local::TChangeableMemPool::_::_::_m_arrayPool::_0_::_elem::_m_objectInformation::_0_::_m_perObjectType::_m_prob1StatUnknownN = 128;
      @sysvar::XCP::RadarFC::_g_PER_Hil_ObjBypassingRunnable_ObjBypassingRunnable_m_pad_radarObjPort_par_out_local::TChangeableMemPool::_::_::_m_arrayPool::_0_::_elem::_m_objectInformation::_0_::_m_perObjectType::_m_prob1PassengerCarN = 0;
      @sysvar::XCP::RadarFC::_g_PER_Hil_ObjBypassingRunnable_ObjBypassingRunnable_m_pad_radarObjPort_par_out_local::TChangeableMemPool::_::_::_m_arrayPool::_0_::_elem::_m_objectInformation::_0_::_m_perObjectType::_m_prob1TruckN = 0;
      @sysvar::XCP::RadarFC::_g_PER_Hil_ObjBypassingRunnable_ObjBypassingRunnable_m_pad_radarObjPort_par_out_local::TChangeableMemPool::_::_::_m_arrayPool::_0_::_elem::_m_objectInformation::_0_::_m_perObjectType::_m_prob1FourWheelUnknownN = 128;
      @sysvar::XCP::RadarFC::_g_PER_Hil_ObjBypassingRunnable_ObjBypassingRunnable_m_pad_radarObjPort_par_out_local::TChangeableMemPool::_::_::_m_arrayPool::_0_::_elem::_m_objectInformation::_0_::_m_dWidthN = 64;
          break;

      case 2: //"2Wheeler::Cloe-> Bike"
      @sysvar::XCP::RadarFC::_g_PER_Hil_ObjBypassingRunnable_ObjBypassingRunnable_m_pad_radarObjPort_par_out_local::TChangeableMemPool::_::_::_m_arrayPool::_0_::_elem::_m_objectInformation::_0_::_m_perObjectType::_m_prob1ObstacleN = 128;
      @sysvar::XCP::RadarFC::_g_PER_Hil_ObjBypassingRunnable_ObjBypassingRunnable_m_pad_radarObjPort_par_out_local::TChangeableMemPool::_::_::_m_arrayPool::_0_::_elem::_m_objectInformation::_0_::_m_perObjectType::_m_prob1NonObstacleN = 0;
      @sysvar::XCP::RadarFC::_g_PER_Hil_ObjBypassingRunnable_ObjBypassingRunnable_m_pad_radarObjPort_par_out_local::TChangeableMemPool::_::_::_m_arrayPool::_0_::_elem::_m_objectInformation::_0_::_m_perObjectType::_m_prob1UnknownN = 0;
      @sysvar::XCP::RadarFC::_g_PER_Hil_ObjBypassingRunnable_ObjBypassingRunnable_m_pad_radarObjPort_par_out_local::TChangeableMemPool::_::_::_m_arrayPool::_0_::_elem::_m_objectInformation::_0_::_m_perObjectType::_m_prob1MobileN = 128;
      @sysvar::XCP::RadarFC::_g_PER_Hil_ObjBypassingRunnable_ObjBypassingRunnable_m_pad_radarObjPort_par_out_local::TChangeableMemPool::_::_::_m_arrayPool::_0_::_elem::_m_objectInformation::_0_::_m_perObjectType::_m_prob1StationaryN = 0;
      @sysvar::XCP::RadarFC::_g_PER_Hil_ObjBypassingRunnable_ObjBypassingRunnable_m_pad_radarObjPort_par_out_local::TChangeableMemPool::_::_::_m_arrayPool::_0_::_elem::_m_objectInformation::_0_::_m_perObjectType::_m_prob1ObstUnknownN = 0;
      @sysvar::XCP::RadarFC::_g_PER_Hil_ObjBypassingRunnable_ObjBypassingRunnable_m_pad_radarObjPort_par_out_local::TChangeableMemPool::_::_::_m_arrayPool::_0_::_elem::_m_objectInformation::_0_::_m_perObjectType::_m_prob1FourPlusWheelerN = 0;
      @sysvar::XCP::RadarFC::_g_PER_Hil_ObjBypassingRunnable_ObjBypassingRunnable_m_pad_radarObjPort_par_out_local::TChangeableMemPool::_::_::_m_arrayPool::_0_::_elem::_m_objectInformation::_0_::_m_perObjectType::_m_prob1TwoWheelerN = 128;
      @sysvar::XCP::RadarFC::_g_PER_Hil_ObjBypassingRunnable_ObjBypassingRunnable_m_pad_radarObjPort_par_out_local::TChangeableMemPool::_::_::_m_arrayPool::_0_::_elem::_m_objectInformation::_0_::_m_perObjectType::_m_prob1PedestrianN = 0;
      @sysvar::XCP::RadarFC::_g_PER_Hil_ObjBypassingRunnable_ObjBypassingRunnable_m_pad_radarObjPort_par_out_local::TChangeableMemPool::_::_::_m_arrayPool::_0_::_elem::_m_objectInformation::_0_::_m_perObjectType::_m_prob1MovUnknownN = 0;
      @sysvar::XCP::RadarFC::_g_PER_Hil_ObjBypassingRunnable_ObjBypassingRunnable_m_pad_radarObjPort_par_out_local::TChangeableMemPool::_::_::_m_arrayPool::_0_::_elem::_m_objectInformation::_0_::_m_perObjectType::_m_prob1RoadsideBarrierN = 0;
      @sysvar::XCP::RadarFC::_g_PER_Hil_ObjBypassingRunnable_ObjBypassingRunnable_m_pad_radarObjPort_par_out_local::TChangeableMemPool::_::_::_m_arrayPool::_0_::_elem::_m_objectInformation::_0_::_m_perObjectType::_m_prob1StatUnknownN = 128;
      @sysvar::XCP::RadarFC::_g_PER_Hil_ObjBypassingRunnable_ObjBypassingRunnable_m_pad_radarObjPort_par_out_local::TChangeableMemPool::_::_::_m_arrayPool::_0_::_elem::_m_objectInformation::_0_::_m_perObjectType::_m_prob1PassengerCarN = 0;
      @sysvar::XCP::RadarFC::_g_PER_Hil_ObjBypassingRunnable_ObjBypassingRunnable_m_pad_radarObjPort_par_out_local::TChangeableMemPool::_::_::_m_arrayPool::_0_::_elem::_m_objectInformation::_0_::_m_perObjectType::_m_prob1TruckN = 0;
      @sysvar::XCP::RadarFC::_g_PER_Hil_ObjBypassingRunnable_ObjBypassingRunnable_m_pad_radarObjPort_par_out_local::TChangeableMemPool::_::_::_m_arrayPool::_0_::_elem::_m_objectInformation::_0_::_m_perObjectType::_m_prob1FourWheelUnknownN = 128;
      @sysvar::XCP::RadarFC::_g_PER_Hil_ObjBypassingRunnable_ObjBypassingRunnable_m_pad_radarObjPort_par_out_local::TChangeableMemPool::_::_::_m_arrayPool::_0_::_elem::_m_objectInformation::_0_::_m_dWidthN = 64;
          break;

      case 3: //"2Wheeler::Cloe-> Motorbike"
      @sysvar::XCP::RadarFC::_g_PER_Hil_ObjBypassingRunnable_ObjBypassingRunnable_m_pad_radarObjPort_par_out_local::TChangeableMemPool::_::_::_m_arrayPool::_0_::_elem::_m_objectInformation::_0_::_m_perObjectType::_m_prob1ObstacleN = 128;
      @sysvar::XCP::RadarFC::_g_PER_Hil_ObjBypassingRunnable_ObjBypassingRunnable_m_pad_radarObjPort_par_out_local::TChangeableMemPool::_::_::_m_arrayPool::_0_::_elem::_m_objectInformation::_0_::_m_perObjectType::_m_prob1NonObstacleN = 0;
      @sysvar::XCP::RadarFC::_g_PER_Hil_ObjBypassingRunnable_ObjBypassingRunnable_m_pad_radarObjPort_par_out_local::TChangeableMemPool::_::_::_m_arrayPool::_0_::_elem::_m_objectInformation::_0_::_m_perObjectType::_m_prob1UnknownN = 0;
      @sysvar::XCP::RadarFC::_g_PER_Hil_ObjBypassingRunnable_ObjBypassingRunnable_m_pad_radarObjPort_par_out_local::TChangeableMemPool::_::_::_m_arrayPool::_0_::_elem::_m_objectInformation::_0_::_m_perObjectType::_m_prob1MobileN = 128;
      @sysvar::XCP::RadarFC::_g_PER_Hil_ObjBypassingRunnable_ObjBypassingRunnable_m_pad_radarObjPort_par_out_local::TChangeableMemPool::_::_::_m_arrayPool::_0_::_elem::_m_objectInformation::_0_::_m_perObjectType::_m_prob1StationaryN = 0;
      @sysvar::XCP::RadarFC::_g_PER_Hil_ObjBypassingRunnable_ObjBypassingRunnable_m_pad_radarObjPort_par_out_local::TChangeableMemPool::_::_::_m_arrayPool::_0_::_elem::_m_objectInformation::_0_::_m_perObjectType::_m_prob1ObstUnknownN = 0;
      @sysvar::XCP::RadarFC::_g_PER_Hil_ObjBypassingRunnable_ObjBypassingRunnable_m_pad_radarObjPort_par_out_local::TChangeableMemPool::_::_::_m_arrayPool::_0_::_elem::_m_objectInformation::_0_::_m_perObjectType::_m_prob1FourPlusWheelerN = 0;
      @sysvar::XCP::RadarFC::_g_PER_Hil_ObjBypassingRunnable_ObjBypassingRunnable_m_pad_radarObjPort_par_out_local::TChangeableMemPool::_::_::_m_arrayPool::_0_::_elem::_m_objectInformation::_0_::_m_perObjectType::_m_prob1TwoWheelerN = 128;
      @sysvar::XCP::RadarFC::_g_PER_Hil_ObjBypassingRunnable_ObjBypassingRunnable_m_pad_radarObjPort_par_out_local::TChangeableMemPool::_::_::_m_arrayPool::_0_::_elem::_m_objectInformation::_0_::_m_perObjectType::_m_prob1PedestrianN = 0;
      @sysvar::XCP::RadarFC::_g_PER_Hil_ObjBypassingRunnable_ObjBypassingRunnable_m_pad_radarObjPort_par_out_local::TChangeableMemPool::_::_::_m_arrayPool::_0_::_elem::_m_objectInformation::_0_::_m_perObjectType::_m_prob1MovUnknownN = 0;
      @sysvar::XCP::RadarFC::_g_PER_Hil_ObjBypassingRunnable_ObjBypassingRunnable_m_pad_radarObjPort_par_out_local::TChangeableMemPool::_::_::_m_arrayPool::_0_::_elem::_m_objectInformation::_0_::_m_perObjectType::_m_prob1RoadsideBarrierN = 0;
      @sysvar::XCP::RadarFC::_g_PER_Hil_ObjBypassingRunnable_ObjBypassingRunnable_m_pad_radarObjPort_par_out_local::TChangeableMemPool::_::_::_m_arrayPool::_0_::_elem::_m_objectInformation::_0_::_m_perObjectType::_m_prob1StatUnknownN = 128;
      @sysvar::XCP::RadarFC::_g_PER_Hil_ObjBypassingRunnable_ObjBypassingRunnable_m_pad_radarObjPort_par_out_local::TChangeableMemPool::_::_::_m_arrayPool::_0_::_elem::_m_objectInformation::_0_::_m_perObjectType::_m_prob1PassengerCarN = 0;
      @sysvar::XCP::RadarFC::_g_PER_Hil_ObjBypassingRunnable_ObjBypassingRunnable_m_pad_radarObjPort_par_out_local::TChangeableMemPool::_::_::_m_arrayPool::_0_::_elem::_m_objectInformation::_0_::_m_perObjectType::_m_prob1TruckN = 0;
      @sysvar::XCP::RadarFC::_g_PER_Hil_ObjBypassingRunnable_ObjBypassingRunnable_m_pad_radarObjPort_par_out_local::TChangeableMemPool::_::_::_m_arrayPool::_0_::_elem::_m_objectInformation::_0_::_m_perObjectType::_m_prob1FourWheelUnknownN = 128;
      @sysvar::XCP::RadarFC::_g_PER_Hil_ObjBypassingRunnable_ObjBypassingRunnable_m_pad_radarObjPort_par_out_local::TChangeableMemPool::_::_::_m_arrayPool::_0_::_elem::_m_objectInformation::_0_::_m_dWidthN = 64;
          break;

      case 4: //"PassengerCar"
      @sysvar::XCP::RadarFC::_g_PER_Hil_ObjBypassingRunnable_ObjBypassingRunnable_m_pad_radarObjPort_par_out_local::TChangeableMemPool::_::_::_m_arrayPool::_0_::_elem::_m_objectInformation::_0_::_m_perObjectType::_m_prob1ObstacleN = 128;
      @sysvar::XCP::RadarFC::_g_PER_Hil_ObjBypassingRunnable_ObjBypassingRunnable_m_pad_radarObjPort_par_out_local::TChangeableMemPool::_::_::_m_arrayPool::_0_::_elem::_m_objectInformation::_0_::_m_perObjectType::_m_prob1NonObstacleN = 0;
      @sysvar::XCP::RadarFC::_g_PER_Hil_ObjBypassingRunnable_ObjBypassingRunnable_m_pad_radarObjPort_par_out_local::TChangeableMemPool::_::_::_m_arrayPool::_0_::_elem::_m_objectInformation::_0_::_m_perObjectType::_m_prob1UnknownN = 0;
      @sysvar::XCP::RadarFC::_g_PER_Hil_ObjBypassingRunnable_ObjBypassingRunnable_m_pad_radarObjPort_par_out_local::TChangeableMemPool::_::_::_m_arrayPool::_0_::_elem::_m_objectInformation::_0_::_m_perObjectType::_m_prob1MobileN = 128;
      @sysvar::XCP::RadarFC::_g_PER_Hil_ObjBypassingRunnable_ObjBypassingRunnable_m_pad_radarObjPort_par_out_local::TChangeableMemPool::_::_::_m_arrayPool::_0_::_elem::_m_objectInformation::_0_::_m_perObjectType::_m_prob1StationaryN = 0;
      @sysvar::XCP::RadarFC::_g_PER_Hil_ObjBypassingRunnable_ObjBypassingRunnable_m_pad_radarObjPort_par_out_local::TChangeableMemPool::_::_::_m_arrayPool::_0_::_elem::_m_objectInformation::_0_::_m_perObjectType::_m_prob1ObstUnknownN = 0;
      @sysvar::XCP::RadarFC::_g_PER_Hil_ObjBypassingRunnable_ObjBypassingRunnable_m_pad_radarObjPort_par_out_local::TChangeableMemPool::_::_::_m_arrayPool::_0_::_elem::_m_objectInformation::_0_::_m_perObjectType::_m_prob1FourPlusWheelerN = 128;
      @sysvar::XCP::RadarFC::_g_PER_Hil_ObjBypassingRunnable_ObjBypassingRunnable_m_pad_radarObjPort_par_out_local::TChangeableMemPool::_::_::_m_arrayPool::_0_::_elem::_m_objectInformation::_0_::_m_perObjectType::_m_prob1TwoWheelerN = 0;
      @sysvar::XCP::RadarFC::_g_PER_Hil_ObjBypassingRunnable_ObjBypassingRunnable_m_pad_radarObjPort_par_out_local::TChangeableMemPool::_::_::_m_arrayPool::_0_::_elem::_m_objectInformation::_0_::_m_perObjectType::_m_prob1PedestrianN = 0;
      @sysvar::XCP::RadarFC::_g_PER_Hil_ObjBypassingRunnable_ObjBypassingRunnable_m_pad_radarObjPort_par_out_local::TChangeableMemPool::_::_::_m_arrayPool::_0_::_elem::_m_objectInformation::_0_::_m_perObjectType::_m_prob1MovUnknownN = 0;
      @sysvar::XCP::RadarFC::_g_PER_Hil_ObjBypassingRunnable_ObjBypassingRunnable_m_pad_radarObjPort_par_out_local::TChangeableMemPool::_::_::_m_arrayPool::_0_::_elem::_m_objectInformation::_0_::_m_perObjectType::_m_prob1RoadsideBarrierN = 0;
      @sysvar::XCP::RadarFC::_g_PER_Hil_ObjBypassingRunnable_ObjBypassingRunnable_m_pad_radarObjPort_par_out_local::TChangeableMemPool::_::_::_m_arrayPool::_0_::_elem::_m_objectInformation::_0_::_m_perObjectType::_m_prob1StatUnknownN = 128;
      @sysvar::XCP::RadarFC::_g_PER_Hil_ObjBypassingRunnable_ObjBypassingRunnable_m_pad_radarObjPort_par_out_local::TChangeableMemPool::_::_::_m_arrayPool::_0_::_elem::_m_objectInformation::_0_::_m_perObjectType::_m_prob1PassengerCarN = 128;
      @sysvar::XCP::RadarFC::_g_PER_Hil_ObjBypassingRunnable_ObjBypassingRunnable_m_pad_radarObjPort_par_out_local::TChangeableMemPool::_::_::_m_arrayPool::_0_::_elem::_m_objectInformation::_0_::_m_perObjectType::_m_prob1TruckN = 0;
      @sysvar::XCP::RadarFC::_g_PER_Hil_ObjBypassingRunnable_ObjBypassingRunnable_m_pad_radarObjPort_par_out_local::TChangeableMemPool::_::_::_m_arrayPool::_0_::_elem::_m_objectInformation::_0_::_m_perObjectType::_m_prob1FourWheelUnknownN = 0;
      @sysvar::XCP::RadarFC::_g_PER_Hil_ObjBypassingRunnable_ObjBypassingRunnable_m_pad_radarObjPort_par_out_local::TChangeableMemPool::_::_::_m_arrayPool::_0_::_elem::_m_objectInformation::_0_::_m_dWidthN = 256;
          break;

      case 5: //"Truck"
      @sysvar::XCP::RadarFC::_g_PER_Hil_ObjBypassingRunnable_ObjBypassingRunnable_m_pad_radarObjPort_par_out_local::TChangeableMemPool::_::_::_m_arrayPool::_0_::_elem::_m_objectInformation::_0_::_m_perObjectType::_m_prob1ObstacleN = 128;
      @sysvar::XCP::RadarFC::_g_PER_Hil_ObjBypassingRunnable_ObjBypassingRunnable_m_pad_radarObjPort_par_out_local::TChangeableMemPool::_::_::_m_arrayPool::_0_::_elem::_m_objectInformation::_0_::_m_perObjectType::_m_prob1NonObstacleN = 0;
      @sysvar::XCP::RadarFC::_g_PER_Hil_ObjBypassingRunnable_ObjBypassingRunnable_m_pad_radarObjPort_par_out_local::TChangeableMemPool::_::_::_m_arrayPool::_0_::_elem::_m_objectInformation::_0_::_m_perObjectType::_m_prob1UnknownN = 0;
      @sysvar::XCP::RadarFC::_g_PER_Hil_ObjBypassingRunnable_ObjBypassingRunnable_m_pad_radarObjPort_par_out_local::TChangeableMemPool::_::_::_m_arrayPool::_0_::_elem::_m_objectInformation::_0_::_m_perObjectType::_m_prob1MobileN = 128;
      @sysvar::XCP::RadarFC::_g_PER_Hil_ObjBypassingRunnable_ObjBypassingRunnable_m_pad_radarObjPort_par_out_local::TChangeableMemPool::_::_::_m_arrayPool::_0_::_elem::_m_objectInformation::_0_::_m_perObjectType::_m_prob1StationaryN = 0;
      @sysvar::XCP::RadarFC::_g_PER_Hil_ObjBypassingRunnable_ObjBypassingRunnable_m_pad_radarObjPort_par_out_local::TChangeableMemPool::_::_::_m_arrayPool::_0_::_elem::_m_objectInformation::_0_::_m_perObjectType::_m_prob1ObstUnknownN = 0;
      @sysvar::XCP::RadarFC::_g_PER_Hil_ObjBypassingRunnable_ObjBypassingRunnable_m_pad_radarObjPort_par_out_local::TChangeableMemPool::_::_::_m_arrayPool::_0_::_elem::_m_objectInformation::_0_::_m_perObjectType::_m_prob1FourPlusWheelerN = 128;
      @sysvar::XCP::RadarFC::_g_PER_Hil_ObjBypassingRunnable_ObjBypassingRunnable_m_pad_radarObjPort_par_out_local::TChangeableMemPool::_::_::_m_arrayPool::_0_::_elem::_m_objectInformation::_0_::_m_perObjectType::_m_prob1TwoWheelerN = 0;
      @sysvar::XCP::RadarFC::_g_PER_Hil_ObjBypassingRunnable_ObjBypassingRunnable_m_pad_radarObjPort_par_out_local::TChangeableMemPool::_::_::_m_arrayPool::_0_::_elem::_m_objectInformation::_0_::_m_perObjectType::_m_prob1PedestrianN = 0;
      @sysvar::XCP::RadarFC::_g_PER_Hil_ObjBypassingRunnable_ObjBypassingRunnable_m_pad_radarObjPort_par_out_local::TChangeableMemPool::_::_::_m_arrayPool::_0_::_elem::_m_objectInformation::_0_::_m_perObjectType::_m_prob1MovUnknownN = 0;
      @sysvar::XCP::RadarFC::_g_PER_Hil_ObjBypassingRunnable_ObjBypassingRunnable_m_pad_radarObjPort_par_out_local::TChangeableMemPool::_::_::_m_arrayPool::_0_::_elem::_m_objectInformation::_0_::_m_perObjectType::_m_prob1RoadsideBarrierN = 0;
      @sysvar::XCP::RadarFC::_g_PER_Hil_ObjBypassingRunnable_ObjBypassingRunnable_m_pad_radarObjPort_par_out_local::TChangeableMemPool::_::_::_m_arrayPool::_0_::_elem::_m_objectInformation::_0_::_m_perObjectType::_m_prob1StatUnknownN = 128;
      @sysvar::XCP::RadarFC::_g_PER_Hil_ObjBypassingRunnable_ObjBypassingRunnable_m_pad_radarObjPort_par_out_local::TChangeableMemPool::_::_::_m_arrayPool::_0_::_elem::_m_objectInformation::_0_::_m_perObjectType::_m_prob1PassengerCarN = 0;
      @sysvar::XCP::RadarFC::_g_PER_Hil_ObjBypassingRunnable_ObjBypassingRunnable_m_pad_radarObjPort_par_out_local::TChangeableMemPool::_::_::_m_arrayPool::_0_::_elem::_m_objectInformation::_0_::_m_perObjectType::_m_prob1TruckN = 128;
      @sysvar::XCP::RadarFC::_g_PER_Hil_ObjBypassingRunnable_ObjBypassingRunnable_m_pad_radarObjPort_par_out_local::TChangeableMemPool::_::_::_m_arrayPool::_0_::_elem::_m_objectInformation::_0_::_m_perObjectType::_m_prob1FourWheelUnknownN = 0;
      @sysvar::XCP::RadarFC::_g_PER_Hil_ObjBypassingRunnable_ObjBypassingRunnable_m_pad_radarObjPort_par_out_local::TChangeableMemPool::_::_::_m_arrayPool::_0_::_elem::_m_objectInformation::_0_::_m_dWidthN = 256;
          break;

      case 6: //"Non-Obstacle::Cloe->Trailer"
      @sysvar::XCP::RadarFC::_g_PER_Hil_ObjBypassingRunnable_ObjBypassingRunnable_m_pad_radarObjPort_par_out_local::TChangeableMemPool::_::_::_m_arrayPool::_0_::_elem::_m_objectInformation::_0_::_m_perObjectType::_m_prob1ObstacleN = 0;
      @sysvar::XCP::RadarFC::_g_PER_Hil_ObjBypassingRunnable_ObjBypassingRunnable_m_pad_radarObjPort_par_out_local::TChangeableMemPool::_::_::_m_arrayPool::_0_::_elem::_m_objectInformation::_0_::_m_perObjectType::_m_prob1NonObstacleN = 128;
      @sysvar::XCP::RadarFC::_g_PER_Hil_ObjBypassingRunnable_ObjBypassingRunnable_m_pad_radarObjPort_par_out_local::TChangeableMemPool::_::_::_m_arrayPool::_0_::_elem::_m_objectInformation::_0_::_m_perObjectType::_m_prob1UnknownN = 0;
      @sysvar::XCP::RadarFC::_g_PER_Hil_ObjBypassingRunnable_ObjBypassingRunnable_m_pad_radarObjPort_par_out_local::TChangeableMemPool::_::_::_m_arrayPool::_0_::_elem::_m_objectInformation::_0_::_m_perObjectType::_m_prob1MobileN = 128;
      @sysvar::XCP::RadarFC::_g_PER_Hil_ObjBypassingRunnable_ObjBypassingRunnable_m_pad_radarObjPort_par_out_local::TChangeableMemPool::_::_::_m_arrayPool::_0_::_elem::_m_objectInformation::_0_::_m_perObjectType::_m_prob1StationaryN = 0;
      @sysvar::XCP::RadarFC::_g_PER_Hil_ObjBypassingRunnable_ObjBypassingRunnable_m_pad_radarObjPort_par_out_local::TChangeableMemPool::_::_::_m_arrayPool::_0_::_elem::_m_objectInformation::_0_::_m_perObjectType::_m_prob1ObstUnknownN = 0;
      @sysvar::XCP::RadarFC::_g_PER_Hil_ObjBypassingRunnable_ObjBypassingRunnable_m_pad_radarObjPort_par_out_local::TChangeableMemPool::_::_::_m_arrayPool::_0_::_elem::_m_objectInformation::_0_::_m_perObjectType::_m_prob1FourPlusWheelerN = 0;
      @sysvar::XCP::RadarFC::_g_PER_Hil_ObjBypassingRunnable_ObjBypassingRunnable_m_pad_radarObjPort_par_out_local::TChangeableMemPool::_::_::_m_arrayPool::_0_::_elem::_m_objectInformation::_0_::_m_perObjectType::_m_prob1TwoWheelerN = 0;
      @sysvar::XCP::RadarFC::_g_PER_Hil_ObjBypassingRunnable_ObjBypassingRunnable_m_pad_radarObjPort_par_out_local::TChangeableMemPool::_::_::_m_arrayPool::_0_::_elem::_m_objectInformation::_0_::_m_perObjectType::_m_prob1PedestrianN = 0;
      @sysvar::XCP::RadarFC::_g_PER_Hil_ObjBypassingRunnable_ObjBypassingRunnable_m_pad_radarObjPort_par_out_local::TChangeableMemPool::_::_::_m_arrayPool::_0_::_elem::_m_objectInformation::_0_::_m_perObjectType::_m_prob1MovUnknownN = 128;
      @sysvar::XCP::RadarFC::_g_PER_Hil_ObjBypassingRunnable_ObjBypassingRunnable_m_pad_radarObjPort_par_out_local::TChangeableMemPool::_::_::_m_arrayPool::_0_::_elem::_m_objectInformation::_0_::_m_perObjectType::_m_prob1RoadsideBarrierN = 0;
      @sysvar::XCP::RadarFC::_g_PER_Hil_ObjBypassingRunnable_ObjBypassingRunnable_m_pad_radarObjPort_par_out_local::TChangeableMemPool::_::_::_m_arrayPool::_0_::_elem::_m_objectInformation::_0_::_m_perObjectType::_m_prob1StatUnknownN = 128;
      @sysvar::XCP::RadarFC::_g_PER_Hil_ObjBypassingRunnable_ObjBypassingRunnable_m_pad_radarObjPort_par_out_local::TChangeableMemPool::_::_::_m_arrayPool::_0_::_elem::_m_objectInformation::_0_::_m_perObjectType::_m_prob1PassengerCarN = 0;
      @sysvar::XCP::RadarFC::_g_PER_Hil_ObjBypassingRunnable_ObjBypassingRunnable_m_pad_radarObjPort_par_out_local::TChangeableMemPool::_::_::_m_arrayPool::_0_::_elem::_m_objectInformation::_0_::_m_perObjectType::_m_prob1TruckN = 0;
      @sysvar::XCP::RadarFC::_g_PER_Hil_ObjBypassingRunnable_ObjBypassingRunnable_m_pad_radarObjPort_par_out_local::TChangeableMemPool::_::_::_m_arrayPool::_0_::_elem::_m_objectInformation::_0_::_m_perObjectType::_m_prob1FourWheelUnknownN = 128;
      @sysvar::XCP::RadarFC::_g_PER_Hil_ObjBypassingRunnable_ObjBypassingRunnable_m_pad_radarObjPort_par_out_local::TChangeableMemPool::_::_::_m_arrayPool::_0_::_elem::_m_objectInformation::_0_::_m_dWidthN = 256;
          break;

      case 7: //"RoadSideBarrier"
      @sysvar::XCP::RadarFC::_g_PER_Hil_ObjBypassingRunnable_ObjBypassingRunnable_m_pad_radarObjPort_par_out_local::TChangeableMemPool::_::_::_m_arrayPool::_0_::_elem::_m_objectInformation::_0_::_m_perObjectType::_m_prob1ObstacleN = 128;
      @sysvar::XCP::RadarFC::_g_PER_Hil_ObjBypassingRunnable_ObjBypassingRunnable_m_pad_radarObjPort_par_out_local::TChangeableMemPool::_::_::_m_arrayPool::_0_::_elem::_m_objectInformation::_0_::_m_perObjectType::_m_prob1NonObstacleN = 0;
      @sysvar::XCP::RadarFC::_g_PER_Hil_ObjBypassingRunnable_ObjBypassingRunnable_m_pad_radarObjPort_par_out_local::TChangeableMemPool::_::_::_m_arrayPool::_0_::_elem::_m_objectInformation::_0_::_m_perObjectType::_m_prob1UnknownN = 0;
      @sysvar::XCP::RadarFC::_g_PER_Hil_ObjBypassingRunnable_ObjBypassingRunnable_m_pad_radarObjPort_par_out_local::TChangeableMemPool::_::_::_m_arrayPool::_0_::_elem::_m_objectInformation::_0_::_m_perObjectType::_m_prob1MobileN = 0;
      @sysvar::XCP::RadarFC::_g_PER_Hil_ObjBypassingRunnable_ObjBypassingRunnable_m_pad_radarObjPort_par_out_local::TChangeableMemPool::_::_::_m_arrayPool::_0_::_elem::_m_objectInformation::_0_::_m_perObjectType::_m_prob1StationaryN = 128;
      @sysvar::XCP::RadarFC::_g_PER_Hil_ObjBypassingRunnable_ObjBypassingRunnable_m_pad_radarObjPort_par_out_local::TChangeableMemPool::_::_::_m_arrayPool::_0_::_elem::_m_objectInformation::_0_::_m_perObjectType::_m_prob1ObstUnknownN = 0;
      @sysvar::XCP::RadarFC::_g_PER_Hil_ObjBypassingRunnable_ObjBypassingRunnable_m_pad_radarObjPort_par_out_local::TChangeableMemPool::_::_::_m_arrayPool::_0_::_elem::_m_objectInformation::_0_::_m_perObjectType::_m_prob1FourPlusWheelerN = 0;
      @sysvar::XCP::RadarFC::_g_PER_Hil_ObjBypassingRunnable_ObjBypassingRunnable_m_pad_radarObjPort_par_out_local::TChangeableMemPool::_::_::_m_arrayPool::_0_::_elem::_m_objectInformation::_0_::_m_perObjectType::_m_prob1TwoWheelerN = 0;
      @sysvar::XCP::RadarFC::_g_PER_Hil_ObjBypassingRunnable_ObjBypassingRunnable_m_pad_radarObjPort_par_out_local::TChangeableMemPool::_::_::_m_arrayPool::_0_::_elem::_m_objectInformation::_0_::_m_perObjectType::_m_prob1PedestrianN = 0;
      @sysvar::XCP::RadarFC::_g_PER_Hil_ObjBypassingRunnable_ObjBypassingRunnable_m_pad_radarObjPort_par_out_local::TChangeableMemPool::_::_::_m_arrayPool::_0_::_elem::_m_objectInformation::_0_::_m_perObjectType::_m_prob1MovUnknownN = 128;
      @sysvar::XCP::RadarFC::_g_PER_Hil_ObjBypassingRunnable_ObjBypassingRunnable_m_pad_radarObjPort_par_out_local::TChangeableMemPool::_::_::_m_arrayPool::_0_::_elem::_m_objectInformation::_0_::_m_perObjectType::_m_prob1RoadsideBarrierN = 128;
      @sysvar::XCP::RadarFC::_g_PER_Hil_ObjBypassingRunnable_ObjBypassingRunnable_m_pad_radarObjPort_par_out_local::TChangeableMemPool::_::_::_m_arrayPool::_0_::_elem::_m_objectInformation::_0_::_m_perObjectType::_m_prob1StatUnknownN = 0;
      @sysvar::XCP::RadarFC::_g_PER_Hil_ObjBypassingRunnable_ObjBypassingRunnable_m_pad_radarObjPort_par_out_local::TChangeableMemPool::_::_::_m_arrayPool::_0_::_elem::_m_objectInformation::_0_::_m_perObjectType::_m_prob1PassengerCarN = 0;
      @sysvar::XCP::RadarFC::_g_PER_Hil_ObjBypassingRunnable_ObjBypassingRunnable_m_pad_radarObjPort_par_out_local::TChangeableMemPool::_::_::_m_arrayPool::_0_::_elem::_m_objectInformation::_0_::_m_perObjectType::_m_prob1TruckN = 0;
      @sysvar::XCP::RadarFC::_g_PER_Hil_ObjBypassingRunnable_ObjBypassingRunnable_m_pad_radarObjPort_par_out_local::TChangeableMemPool::_::_::_m_arrayPool::_0_::_elem::_m_objectInformation::_0_::_m_perObjectType::_m_prob1FourWheelUnknownN = 128;
      @sysvar::XCP::RadarFC::_g_PER_Hil_ObjBypassingRunnable_ObjBypassingRunnable_m_pad_radarObjPort_par_out_local::TChangeableMemPool::_::_::_m_arrayPool::_0_::_elem::_m_objectInformation::_0_::_m_dWidthN = 256;
          break;
      }
      break;

    case 1: //"Object-1"
    //constant
  @sysvar::XCP::RadarFC::_g_PER_Hil_ObjBypassingRunnable_ObjBypassingRunnable_m_pad_radarObjPort_par_out_local::TChangeableMemPool::_::_::_m_arrayPool::_0_::_elem::_m_objectInformation::_1_::_Valid_b = 1;
  @sysvar::XCP::RadarFC::_g_PER_Hil_ObjBypassingRunnable_ObjBypassingRunnable_m_pad_radarObjPort_par_out_local::TChangeableMemPool::_::_::_m_arrayPool::_0_::_elem::_m_objectInformation::_1_::_m_HandleN = 1;
  @sysvar::XCP::RadarFC::_g_PER_Hil_ObjBypassingRunnable_ObjBypassingRunnable_m_pad_radarObjPort_par_out_local::TChangeableMemPool::_::_::_m_arrayPool::_0_::_elem::_m_objectInformation::_1_::_m_alpPiVarYawAngleN = 0;
  @sysvar::XCP::RadarFC::_g_PER_Hil_ObjBypassingRunnable_ObjBypassingRunnable_m_pad_radarObjPort_par_out_local::TChangeableMemPool::_::_::_m_arrayPool::_0_::_elem::_m_objectInformation::_1_::_m_alpPiYawAngleN = 0;
  @sysvar::XCP::RadarFC::_g_PER_Hil_ObjBypassingRunnable_ObjBypassingRunnable_m_pad_radarObjPort_par_out_local::TChangeableMemPool::_::_::_m_arrayPool::_0_::_elem::_m_objectInformation::_1_::_m_varAxN = 0;
  @sysvar::XCP::RadarFC::_g_PER_Hil_ObjBypassingRunnable_ObjBypassingRunnable_m_pad_radarObjPort_par_out_local::TChangeableMemPool::_::_::_m_arrayPool::_0_::_elem::_m_objectInformation::_1_::_m_varAyN = 0;
  @sysvar::XCP::RadarFC::_g_PER_Hil_ObjBypassingRunnable_ObjBypassingRunnable_m_pad_radarObjPort_par_out_local::TChangeableMemPool::_::_::_m_arrayPool::_0_::_elem::_m_objectInformation::_1_::_m_varVxN = 0;
  @sysvar::XCP::RadarFC::_g_PER_Hil_ObjBypassingRunnable_ObjBypassingRunnable_m_pad_radarObjPort_par_out_local::TChangeableMemPool::_::_::_m_arrayPool::_0_::_elem::_m_objectInformation::_1_::_m_varVyN = 0;
  @sysvar::XCP::RadarFC::_g_PER_Hil_ObjBypassingRunnable_ObjBypassingRunnable_m_pad_radarObjPort_par_out_local::TChangeableMemPool::_::_::_m_arrayPool::_0_::_elem::_m_objectInformation::_1_::_m_varDxN = 0;
  @sysvar::XCP::RadarFC::_g_PER_Hil_ObjBypassingRunnable_ObjBypassingRunnable_m_pad_radarObjPort_par_out_local::TChangeableMemPool::_::_::_m_arrayPool::_0_::_elem::_m_objectInformation::_1_::_m_varDyN = 0;
  @sysvar::XCP::RadarFC::_g_PER_Hil_ObjBypassingRunnable_ObjBypassingRunnable_m_pad_radarObjPort_par_out_local::TChangeableMemPool::_::_::_m_arrayPool::_0_::_elem::_m_objectInformation::_1_::_m_dVarLengthN = 0;
  @sysvar::XCP::RadarFC::_g_PER_Hil_ObjBypassingRunnable_ObjBypassingRunnable_m_pad_radarObjPort_par_out_local::TChangeableMemPool::_::_::_m_arrayPool::_0_::_elem::_m_objectInformation::_1_::_m_dVarWidthN = 0;
  @sysvar::XCP::RadarFC::_g_PER_Hil_ObjBypassingRunnable_ObjBypassingRunnable_m_pad_radarObjPort_par_out_local::TChangeableMemPool::_::_::_m_arrayPool::_0_::_elem::_m_objectInformation::_1_::_m_wExistProbN = 64880;
  @sysvar::XCP::RadarFC::_g_PER_Hil_ObjBypassingRunnable_ObjBypassingRunnable_m_pad_radarObjPort_par_out_local::TChangeableMemPool::_::_::_m_arrayPool::_0_::_elem::_m_objectInformation::_1_::_m_isObjectAsil = 1;
  @sysvar::XCP::RadarFC::_g_PER_Hil_ObjBypassingRunnable_ObjBypassingRunnable_m_pad_radarObjPort_par_out_local::TChangeableMemPool::_::_::_m_arrayPool::_0_::_elem::_m_objectInformation::_1_::_m_dLengthN = 128;

      //target movement

  @sysvar::XCP::RadarFC::_g_PER_Hil_ObjBypassingRunnable_ObjBypassingRunnable_m_pad_radarObjPort_par_out_local::TChangeableMemPool::_::_::_m_arrayPool::_0_::_elem::_m_objectInformation::_1_::_m_dxN = @FDX_in_HIL_specific_FRadar_Obj::FDX_in_FRadar_1_m_dxN;
  @sysvar::XCP::RadarFC::_g_PER_Hil_ObjBypassingRunnable_ObjBypassingRunnable_m_pad_radarObjPort_par_out_local::TChangeableMemPool::_::_::_m_arrayPool::_0_::_elem::_m_objectInformation::_1_::_m_dyN = @FDX_in_HIL_specific_FRadar_Obj::FDX_in_FRadar_1_m_dyN;
  @sysvar::XCP::RadarFC::_g_PER_Hil_ObjBypassingRunnable_ObjBypassingRunnable_m_pad_radarObjPort_par_out_local::TChangeableMemPool::_::_::_m_arrayPool::_0_::_elem::_m_objectInformation::_1_::_m_dzN = @FDX_in_HIL_specific_FRadar_Obj::FDX_in_FRadar_1_m_dzN;
  @sysvar::XCP::RadarFC::_g_PER_Hil_ObjBypassingRunnable_ObjBypassingRunnable_m_pad_radarObjPort_par_out_local::TChangeableMemPool::_::_::_m_arrayPool::_0_::_elem::_m_objectInformation::_1_::_m_vxN = @FDX_in_HIL_specific_FRadar_Obj::FDX_in_FRadar_1_m_vxN;
  @sysvar::XCP::RadarFC::_g_PER_Hil_ObjBypassingRunnable_ObjBypassingRunnable_m_pad_radarObjPort_par_out_local::TChangeableMemPool::_::_::_m_arrayPool::_0_::_elem::_m_objectInformation::_1_::_m_vyN = @FDX_in_HIL_specific_FRadar_Obj::FDX_in_FRadar_1_m_vyN;
  @sysvar::XCP::RadarFC::_g_PER_Hil_ObjBypassingRunnable_ObjBypassingRunnable_m_pad_radarObjPort_par_out_local::TChangeableMemPool::_::_::_m_arrayPool::_0_::_elem::_m_objectInformation::_1_::_m_axN = @FDX_in_HIL_specific_FRadar_Obj::FDX_in_FRadar_1_m_axN;
  @sysvar::XCP::RadarFC::_g_PER_Hil_ObjBypassingRunnable_ObjBypassingRunnable_m_pad_radarObjPort_par_out_local::TChangeableMemPool::_::_::_m_arrayPool::_0_::_elem::_m_objectInformation::_1_::_m_ayN = @FDX_in_HIL_specific_FRadar_Obj::FDX_in_FRadar_1_m_ayN;
  @sysvar::XCP::RadarFC::_g_PER_Hil_ObjBypassingRunnable_ObjBypassingRunnable_m_pad_radarObjPort_par_out_local::TChangeableMemPool::_::_::_m_arrayPool::_0_::_elem::_m_objectInformation::_1_::_m_dLengthN = @FDX_in_HIL_specific_FRadar_Obj::FDX_in_FRadar_1_m_dLengthN;
  @sysvar::XCP::RadarFC::_g_PER_Hil_ObjBypassingRunnable_ObjBypassingRunnable_m_pad_radarObjPort_par_out_local::TChangeableMemPool::_::_::_m_arrayPool::_0_::_elem::_m_objectInformation::_1_::_m_dWidthN = @FDX_in_HIL_specific_FRadar_Obj::FDX_in_FRadar_1_m_dWidthN;
  @sysvar::XCP::RadarFC::_g_PER_Hil_ObjBypassingRunnable_ObjBypassingRunnable_m_pad_radarObjPort_par_out_local::TChangeableMemPool::_::_::_m_arrayPool::_0_::_elem::_m_objectInformation::_1_::_m_alpPiYawAngleN = @FDX_in_HIL_specific_FRadar_Obj::FDX_in_FRadar_1_m_alpPiYawAngleN;

      //target object moving or not
      if (abs(@FDX_in_HIL_specific_FRadar_Obj::FDX_in_FRadar_1_m_vxN) != 0)
      {
    @sysvar::XCP::RadarFC::_g_PER_Hil_ObjBypassingRunnable_ObjBypassingRunnable_m_pad_radarObjPort_par_out_local::TChangeableMemPool::_::_::_m_arrayPool::_0_::_elem::_m_objectInformation::_1_::_m_prob1HasBeenObservedMovingN = 126;
    @sysvar::XCP::RadarFC::_g_PER_Hil_ObjBypassingRunnable_ObjBypassingRunnable_m_pad_radarObjPort_par_out_local::TChangeableMemPool::_::_::_m_arrayPool::_0_::_elem::_m_objectInformation::_1_::_m_prob1MovingN = 126;
      }
      else
      {
    @sysvar::XCP::RadarFC::_g_PER_Hil_ObjBypassingRunnable_ObjBypassingRunnable_m_pad_radarObjPort_par_out_local::TChangeableMemPool::_::_::_m_arrayPool::_0_::_elem::_m_objectInformation::_1_::_m_prob1HasBeenObservedMovingN = 0;
    @sysvar::XCP::RadarFC::_g_PER_Hil_ObjBypassingRunnable_ObjBypassingRunnable_m_pad_radarObjPort_par_out_local::TChangeableMemPool::_::_::_m_arrayPool::_0_::_elem::_m_objectInformation::_1_::_m_prob1MovingN = 0;
      }

      //object classification
    switch (@FDX_in_HIL_specific_FRadar_Obj::FDX_in_FRadar_1_Sensed_Object_Classification)
    {
      case 0: //"unknown"
      @sysvar::XCP::RadarFC::_g_PER_Hil_ObjBypassingRunnable_ObjBypassingRunnable_m_pad_radarObjPort_par_out_local::TChangeableMemPool::_::_::_m_arrayPool::_0_::_elem::_m_objectInformation::_1_::_m_perObjectType::_m_prob1ObstacleN = 0;
      @sysvar::XCP::RadarFC::_g_PER_Hil_ObjBypassingRunnable_ObjBypassingRunnable_m_pad_radarObjPort_par_out_local::TChangeableMemPool::_::_::_m_arrayPool::_0_::_elem::_m_objectInformation::_1_::_m_perObjectType::_m_prob1NonObstacleN = 0;
      @sysvar::XCP::RadarFC::_g_PER_Hil_ObjBypassingRunnable_ObjBypassingRunnable_m_pad_radarObjPort_par_out_local::TChangeableMemPool::_::_::_m_arrayPool::_0_::_elem::_m_objectInformation::_1_::_m_perObjectType::_m_prob1UnknownN = 128;
      @sysvar::XCP::RadarFC::_g_PER_Hil_ObjBypassingRunnable_ObjBypassingRunnable_m_pad_radarObjPort_par_out_local::TChangeableMemPool::_::_::_m_arrayPool::_0_::_elem::_m_objectInformation::_1_::_m_perObjectType::_m_prob1MobileN = 0;
      @sysvar::XCP::RadarFC::_g_PER_Hil_ObjBypassingRunnable_ObjBypassingRunnable_m_pad_radarObjPort_par_out_local::TChangeableMemPool::_::_::_m_arrayPool::_0_::_elem::_m_objectInformation::_1_::_m_perObjectType::_m_prob1StationaryN = 0;
      @sysvar::XCP::RadarFC::_g_PER_Hil_ObjBypassingRunnable_ObjBypassingRunnable_m_pad_radarObjPort_par_out_local::TChangeableMemPool::_::_::_m_arrayPool::_0_::_elem::_m_objectInformation::_1_::_m_perObjectType::_m_prob1ObstUnknownN = 128;
      @sysvar::XCP::RadarFC::_g_PER_Hil_ObjBypassingRunnable_ObjBypassingRunnable_m_pad_radarObjPort_par_out_local::TChangeableMemPool::_::_::_m_arrayPool::_0_::_elem::_m_objectInformation::_1_::_m_perObjectType::_m_prob1FourPlusWheelerN = 0;
      @sysvar::XCP::RadarFC::_g_PER_Hil_ObjBypassingRunnable_ObjBypassingRunnable_m_pad_radarObjPort_par_out_local::TChangeableMemPool::_::_::_m_arrayPool::_0_::_elem::_m_objectInformation::_1_::_m_perObjectType::_m_prob1TwoWheelerN = 0;
      @sysvar::XCP::RadarFC::_g_PER_Hil_ObjBypassingRunnable_ObjBypassingRunnable_m_pad_radarObjPort_par_out_local::TChangeableMemPool::_::_::_m_arrayPool::_0_::_elem::_m_objectInformation::_1_::_m_perObjectType::_m_prob1PedestrianN = 0;
      @sysvar::XCP::RadarFC::_g_PER_Hil_ObjBypassingRunnable_ObjBypassingRunnable_m_pad_radarObjPort_par_out_local::TChangeableMemPool::_::_::_m_arrayPool::_0_::_elem::_m_objectInformation::_1_::_m_perObjectType::_m_prob1MovUnknownN = 128;
      @sysvar::XCP::RadarFC::_g_PER_Hil_ObjBypassingRunnable_ObjBypassingRunnable_m_pad_radarObjPort_par_out_local::TChangeableMemPool::_::_::_m_arrayPool::_0_::_elem::_m_objectInformation::_1_::_m_perObjectType::_m_prob1RoadsideBarrierN = 0;
      @sysvar::XCP::RadarFC::_g_PER_Hil_ObjBypassingRunnable_ObjBypassingRunnable_m_pad_radarObjPort_par_out_local::TChangeableMemPool::_::_::_m_arrayPool::_0_::_elem::_m_objectInformation::_1_::_m_perObjectType::_m_prob1StatUnknownN = 128;
      @sysvar::XCP::RadarFC::_g_PER_Hil_ObjBypassingRunnable_ObjBypassingRunnable_m_pad_radarObjPort_par_out_local::TChangeableMemPool::_::_::_m_arrayPool::_0_::_elem::_m_objectInformation::_1_::_m_perObjectType::_m_prob1PassengerCarN = 0;
      @sysvar::XCP::RadarFC::_g_PER_Hil_ObjBypassingRunnable_ObjBypassingRunnable_m_pad_radarObjPort_par_out_local::TChangeableMemPool::_::_::_m_arrayPool::_0_::_elem::_m_objectInformation::_1_::_m_perObjectType::_m_prob1TruckN = 0;
      @sysvar::XCP::RadarFC::_g_PER_Hil_ObjBypassingRunnable_ObjBypassingRunnable_m_pad_radarObjPort_par_out_local::TChangeableMemPool::_::_::_m_arrayPool::_0_::_elem::_m_objectInformation::_1_::_m_perObjectType::_m_prob1FourWheelUnknownN = 128;
      @sysvar::XCP::RadarFC::_g_PER_Hil_ObjBypassingRunnable_ObjBypassingRunnable_m_pad_radarObjPort_par_out_local::TChangeableMemPool::_::_::_m_arrayPool::_0_::_elem::_m_objectInformation::_1_::_m_dWidthN = 256;
          break;

      case 1: //"Pedestrian"
      @sysvar::XCP::RadarFC::_g_PER_Hil_ObjBypassingRunnable_ObjBypassingRunnable_m_pad_radarObjPort_par_out_local::TChangeableMemPool::_::_::_m_arrayPool::_0_::_elem::_m_objectInformation::_1_::_m_perObjectType::_m_prob1ObstacleN = 128;
      @sysvar::XCP::RadarFC::_g_PER_Hil_ObjBypassingRunnable_ObjBypassingRunnable_m_pad_radarObjPort_par_out_local::TChangeableMemPool::_::_::_m_arrayPool::_0_::_elem::_m_objectInformation::_1_::_m_perObjectType::_m_prob1NonObstacleN = 0;
      @sysvar::XCP::RadarFC::_g_PER_Hil_ObjBypassingRunnable_ObjBypassingRunnable_m_pad_radarObjPort_par_out_local::TChangeableMemPool::_::_::_m_arrayPool::_0_::_elem::_m_objectInformation::_1_::_m_perObjectType::_m_prob1UnknownN = 0;
      @sysvar::XCP::RadarFC::_g_PER_Hil_ObjBypassingRunnable_ObjBypassingRunnable_m_pad_radarObjPort_par_out_local::TChangeableMemPool::_::_::_m_arrayPool::_0_::_elem::_m_objectInformation::_1_::_m_perObjectType::_m_prob1MobileN = 128;
      @sysvar::XCP::RadarFC::_g_PER_Hil_ObjBypassingRunnable_ObjBypassingRunnable_m_pad_radarObjPort_par_out_local::TChangeableMemPool::_::_::_m_arrayPool::_0_::_elem::_m_objectInformation::_1_::_m_perObjectType::_m_prob1StationaryN = 0;
      @sysvar::XCP::RadarFC::_g_PER_Hil_ObjBypassingRunnable_ObjBypassingRunnable_m_pad_radarObjPort_par_out_local::TChangeableMemPool::_::_::_m_arrayPool::_0_::_elem::_m_objectInformation::_1_::_m_perObjectType::_m_prob1ObstUnknownN = 0;
      @sysvar::XCP::RadarFC::_g_PER_Hil_ObjBypassingRunnable_ObjBypassingRunnable_m_pad_radarObjPort_par_out_local::TChangeableMemPool::_::_::_m_arrayPool::_0_::_elem::_m_objectInformation::_1_::_m_perObjectType::_m_prob1FourPlusWheelerN = 0;
      @sysvar::XCP::RadarFC::_g_PER_Hil_ObjBypassingRunnable_ObjBypassingRunnable_m_pad_radarObjPort_par_out_local::TChangeableMemPool::_::_::_m_arrayPool::_0_::_elem::_m_objectInformation::_1_::_m_perObjectType::_m_prob1TwoWheelerN = 0;
      @sysvar::XCP::RadarFC::_g_PER_Hil_ObjBypassingRunnable_ObjBypassingRunnable_m_pad_radarObjPort_par_out_local::TChangeableMemPool::_::_::_m_arrayPool::_0_::_elem::_m_objectInformation::_1_::_m_perObjectType::_m_prob1PedestrianN = 128;
      @sysvar::XCP::RadarFC::_g_PER_Hil_ObjBypassingRunnable_ObjBypassingRunnable_m_pad_radarObjPort_par_out_local::TChangeableMemPool::_::_::_m_arrayPool::_0_::_elem::_m_objectInformation::_1_::_m_perObjectType::_m_prob1MovUnknownN = 0;
      @sysvar::XCP::RadarFC::_g_PER_Hil_ObjBypassingRunnable_ObjBypassingRunnable_m_pad_radarObjPort_par_out_local::TChangeableMemPool::_::_::_m_arrayPool::_0_::_elem::_m_objectInformation::_1_::_m_perObjectType::_m_prob1RoadsideBarrierN = 0;
      @sysvar::XCP::RadarFC::_g_PER_Hil_ObjBypassingRunnable_ObjBypassingRunnable_m_pad_radarObjPort_par_out_local::TChangeableMemPool::_::_::_m_arrayPool::_0_::_elem::_m_objectInformation::_1_::_m_perObjectType::_m_prob1StatUnknownN = 128;
      @sysvar::XCP::RadarFC::_g_PER_Hil_ObjBypassingRunnable_ObjBypassingRunnable_m_pad_radarObjPort_par_out_local::TChangeableMemPool::_::_::_m_arrayPool::_0_::_elem::_m_objectInformation::_1_::_m_perObjectType::_m_prob1PassengerCarN = 0;
      @sysvar::XCP::RadarFC::_g_PER_Hil_ObjBypassingRunnable_ObjBypassingRunnable_m_pad_radarObjPort_par_out_local::TChangeableMemPool::_::_::_m_arrayPool::_0_::_elem::_m_objectInformation::_1_::_m_perObjectType::_m_prob1TruckN = 0;
      @sysvar::XCP::RadarFC::_g_PER_Hil_ObjBypassingRunnable_ObjBypassingRunnable_m_pad_radarObjPort_par_out_local::TChangeableMemPool::_::_::_m_arrayPool::_0_::_elem::_m_objectInformation::_1_::_m_perObjectType::_m_prob1FourWheelUnknownN = 128;
      @sysvar::XCP::RadarFC::_g_PER_Hil_ObjBypassingRunnable_ObjBypassingRunnable_m_pad_radarObjPort_par_out_local::TChangeableMemPool::_::_::_m_arrayPool::_0_::_elem::_m_objectInformation::_1_::_m_dWidthN = 64;
          break;

      case 2: //"2Wheeler::Cloe-> Bike"
      @sysvar::XCP::RadarFC::_g_PER_Hil_ObjBypassingRunnable_ObjBypassingRunnable_m_pad_radarObjPort_par_out_local::TChangeableMemPool::_::_::_m_arrayPool::_0_::_elem::_m_objectInformation::_1_::_m_perObjectType::_m_prob1ObstacleN = 128;
      @sysvar::XCP::RadarFC::_g_PER_Hil_ObjBypassingRunnable_ObjBypassingRunnable_m_pad_radarObjPort_par_out_local::TChangeableMemPool::_::_::_m_arrayPool::_0_::_elem::_m_objectInformation::_1_::_m_perObjectType::_m_prob1NonObstacleN = 0;
      @sysvar::XCP::RadarFC::_g_PER_Hil_ObjBypassingRunnable_ObjBypassingRunnable_m_pad_radarObjPort_par_out_local::TChangeableMemPool::_::_::_m_arrayPool::_0_::_elem::_m_objectInformation::_1_::_m_perObjectType::_m_prob1UnknownN = 0;
      @sysvar::XCP::RadarFC::_g_PER_Hil_ObjBypassingRunnable_ObjBypassingRunnable_m_pad_radarObjPort_par_out_local::TChangeableMemPool::_::_::_m_arrayPool::_0_::_elem::_m_objectInformation::_1_::_m_perObjectType::_m_prob1MobileN = 128;
      @sysvar::XCP::RadarFC::_g_PER_Hil_ObjBypassingRunnable_ObjBypassingRunnable_m_pad_radarObjPort_par_out_local::TChangeableMemPool::_::_::_m_arrayPool::_0_::_elem::_m_objectInformation::_1_::_m_perObjectType::_m_prob1StationaryN = 0;
      @sysvar::XCP::RadarFC::_g_PER_Hil_ObjBypassingRunnable_ObjBypassingRunnable_m_pad_radarObjPort_par_out_local::TChangeableMemPool::_::_::_m_arrayPool::_0_::_elem::_m_objectInformation::_1_::_m_perObjectType::_m_prob1ObstUnknownN = 0;
      @sysvar::XCP::RadarFC::_g_PER_Hil_ObjBypassingRunnable_ObjBypassingRunnable_m_pad_radarObjPort_par_out_local::TChangeableMemPool::_::_::_m_arrayPool::_0_::_elem::_m_objectInformation::_1_::_m_perObjectType::_m_prob1FourPlusWheelerN = 0;
      @sysvar::XCP::RadarFC::_g_PER_Hil_ObjBypassingRunnable_ObjBypassingRunnable_m_pad_radarObjPort_par_out_local::TChangeableMemPool::_::_::_m_arrayPool::_0_::_elem::_m_objectInformation::_1_::_m_perObjectType::_m_prob1TwoWheelerN = 128;
      @sysvar::XCP::RadarFC::_g_PER_Hil_ObjBypassingRunnable_ObjBypassingRunnable_m_pad_radarObjPort_par_out_local::TChangeableMemPool::_::_::_m_arrayPool::_0_::_elem::_m_objectInformation::_1_::_m_perObjectType::_m_prob1PedestrianN = 0;
      @sysvar::XCP::RadarFC::_g_PER_Hil_ObjBypassingRunnable_ObjBypassingRunnable_m_pad_radarObjPort_par_out_local::TChangeableMemPool::_::_::_m_arrayPool::_0_::_elem::_m_objectInformation::_1_::_m_perObjectType::_m_prob1MovUnknownN = 0;
      @sysvar::XCP::RadarFC::_g_PER_Hil_ObjBypassingRunnable_ObjBypassingRunnable_m_pad_radarObjPort_par_out_local::TChangeableMemPool::_::_::_m_arrayPool::_0_::_elem::_m_objectInformation::_1_::_m_perObjectType::_m_prob1RoadsideBarrierN = 0;
      @sysvar::XCP::RadarFC::_g_PER_Hil_ObjBypassingRunnable_ObjBypassingRunnable_m_pad_radarObjPort_par_out_local::TChangeableMemPool::_::_::_m_arrayPool::_0_::_elem::_m_objectInformation::_1_::_m_perObjectType::_m_prob1StatUnknownN = 128;
      @sysvar::XCP::RadarFC::_g_PER_Hil_ObjBypassingRunnable_ObjBypassingRunnable_m_pad_radarObjPort_par_out_local::TChangeableMemPool::_::_::_m_arrayPool::_0_::_elem::_m_objectInformation::_1_::_m_perObjectType::_m_prob1PassengerCarN = 0;
      @sysvar::XCP::RadarFC::_g_PER_Hil_ObjBypassingRunnable_ObjBypassingRunnable_m_pad_radarObjPort_par_out_local::TChangeableMemPool::_::_::_m_arrayPool::_0_::_elem::_m_objectInformation::_1_::_m_perObjectType::_m_prob1TruckN = 0;
      @sysvar::XCP::RadarFC::_g_PER_Hil_ObjBypassingRunnable_ObjBypassingRunnable_m_pad_radarObjPort_par_out_local::TChangeableMemPool::_::_::_m_arrayPool::_0_::_elem::_m_objectInformation::_1_::_m_perObjectType::_m_prob1FourWheelUnknownN = 128;
      @sysvar::XCP::RadarFC::_g_PER_Hil_ObjBypassingRunnable_ObjBypassingRunnable_m_pad_radarObjPort_par_out_local::TChangeableMemPool::_::_::_m_arrayPool::_0_::_elem::_m_objectInformation::_1_::_m_dWidthN = 64;
          break;

      case 3: //"2Wheeler::Cloe-> Motorbike"
      @sysvar::XCP::RadarFC::_g_PER_Hil_ObjBypassingRunnable_ObjBypassingRunnable_m_pad_radarObjPort_par_out_local::TChangeableMemPool::_::_::_m_arrayPool::_0_::_elem::_m_objectInformation::_1_::_m_perObjectType::_m_prob1ObstacleN = 128;
      @sysvar::XCP::RadarFC::_g_PER_Hil_ObjBypassingRunnable_ObjBypassingRunnable_m_pad_radarObjPort_par_out_local::TChangeableMemPool::_::_::_m_arrayPool::_0_::_elem::_m_objectInformation::_1_::_m_perObjectType::_m_prob1NonObstacleN = 0;
      @sysvar::XCP::RadarFC::_g_PER_Hil_ObjBypassingRunnable_ObjBypassingRunnable_m_pad_radarObjPort_par_out_local::TChangeableMemPool::_::_::_m_arrayPool::_0_::_elem::_m_objectInformation::_1_::_m_perObjectType::_m_prob1UnknownN = 0;
      @sysvar::XCP::RadarFC::_g_PER_Hil_ObjBypassingRunnable_ObjBypassingRunnable_m_pad_radarObjPort_par_out_local::TChangeableMemPool::_::_::_m_arrayPool::_0_::_elem::_m_objectInformation::_1_::_m_perObjectType::_m_prob1MobileN = 128;
      @sysvar::XCP::RadarFC::_g_PER_Hil_ObjBypassingRunnable_ObjBypassingRunnable_m_pad_radarObjPort_par_out_local::TChangeableMemPool::_::_::_m_arrayPool::_0_::_elem::_m_objectInformation::_1_::_m_perObjectType::_m_prob1StationaryN = 0;
      @sysvar::XCP::RadarFC::_g_PER_Hil_ObjBypassingRunnable_ObjBypassingRunnable_m_pad_radarObjPort_par_out_local::TChangeableMemPool::_::_::_m_arrayPool::_0_::_elem::_m_objectInformation::_1_::_m_perObjectType::_m_prob1ObstUnknownN = 0;
      @sysvar::XCP::RadarFC::_g_PER_Hil_ObjBypassingRunnable_ObjBypassingRunnable_m_pad_radarObjPort_par_out_local::TChangeableMemPool::_::_::_m_arrayPool::_0_::_elem::_m_objectInformation::_1_::_m_perObjectType::_m_prob1FourPlusWheelerN = 0;
      @sysvar::XCP::RadarFC::_g_PER_Hil_ObjBypassingRunnable_ObjBypassingRunnable_m_pad_radarObjPort_par_out_local::TChangeableMemPool::_::_::_m_arrayPool::_0_::_elem::_m_objectInformation::_1_::_m_perObjectType::_m_prob1TwoWheelerN = 128;
      @sysvar::XCP::RadarFC::_g_PER_Hil_ObjBypassingRunnable_ObjBypassingRunnable_m_pad_radarObjPort_par_out_local::TChangeableMemPool::_::_::_m_arrayPool::_0_::_elem::_m_objectInformation::_1_::_m_perObjectType::_m_prob1PedestrianN = 0;
      @sysvar::XCP::RadarFC::_g_PER_Hil_ObjBypassingRunnable_ObjBypassingRunnable_m_pad_radarObjPort_par_out_local::TChangeableMemPool::_::_::_m_arrayPool::_0_::_elem::_m_objectInformation::_1_::_m_perObjectType::_m_prob1MovUnknownN = 0;
      @sysvar::XCP::RadarFC::_g_PER_Hil_ObjBypassingRunnable_ObjBypassingRunnable_m_pad_radarObjPort_par_out_local::TChangeableMemPool::_::_::_m_arrayPool::_0_::_elem::_m_objectInformation::_1_::_m_perObjectType::_m_prob1RoadsideBarrierN = 0;
      @sysvar::XCP::RadarFC::_g_PER_Hil_ObjBypassingRunnable_ObjBypassingRunnable_m_pad_radarObjPort_par_out_local::TChangeableMemPool::_::_::_m_arrayPool::_0_::_elem::_m_objectInformation::_1_::_m_perObjectType::_m_prob1StatUnknownN = 128;
      @sysvar::XCP::RadarFC::_g_PER_Hil_ObjBypassingRunnable_ObjBypassingRunnable_m_pad_radarObjPort_par_out_local::TChangeableMemPool::_::_::_m_arrayPool::_0_::_elem::_m_objectInformation::_1_::_m_perObjectType::_m_prob1PassengerCarN = 0;
      @sysvar::XCP::RadarFC::_g_PER_Hil_ObjBypassingRunnable_ObjBypassingRunnable_m_pad_radarObjPort_par_out_local::TChangeableMemPool::_::_::_m_arrayPool::_0_::_elem::_m_objectInformation::_1_::_m_perObjectType::_m_prob1TruckN = 0;
      @sysvar::XCP::RadarFC::_g_PER_Hil_ObjBypassingRunnable_ObjBypassingRunnable_m_pad_radarObjPort_par_out_local::TChangeableMemPool::_::_::_m_arrayPool::_0_::_elem::_m_objectInformation::_1_::_m_perObjectType::_m_prob1FourWheelUnknownN = 128;
      @sysvar::XCP::RadarFC::_g_PER_Hil_ObjBypassingRunnable_ObjBypassingRunnable_m_pad_radarObjPort_par_out_local::TChangeableMemPool::_::_::_m_arrayPool::_0_::_elem::_m_objectInformation::_1_::_m_dWidthN = 64;
          break;

      case 4: //"PassengerCar"
      @sysvar::XCP::RadarFC::_g_PER_Hil_ObjBypassingRunnable_ObjBypassingRunnable_m_pad_radarObjPort_par_out_local::TChangeableMemPool::_::_::_m_arrayPool::_0_::_elem::_m_objectInformation::_1_::_m_perObjectType::_m_prob1ObstacleN = 128;
      @sysvar::XCP::RadarFC::_g_PER_Hil_ObjBypassingRunnable_ObjBypassingRunnable_m_pad_radarObjPort_par_out_local::TChangeableMemPool::_::_::_m_arrayPool::_0_::_elem::_m_objectInformation::_1_::_m_perObjectType::_m_prob1NonObstacleN = 0;
      @sysvar::XCP::RadarFC::_g_PER_Hil_ObjBypassingRunnable_ObjBypassingRunnable_m_pad_radarObjPort_par_out_local::TChangeableMemPool::_::_::_m_arrayPool::_0_::_elem::_m_objectInformation::_1_::_m_perObjectType::_m_prob1UnknownN = 0;
      @sysvar::XCP::RadarFC::_g_PER_Hil_ObjBypassingRunnable_ObjBypassingRunnable_m_pad_radarObjPort_par_out_local::TChangeableMemPool::_::_::_m_arrayPool::_0_::_elem::_m_objectInformation::_1_::_m_perObjectType::_m_prob1MobileN = 128;
      @sysvar::XCP::RadarFC::_g_PER_Hil_ObjBypassingRunnable_ObjBypassingRunnable_m_pad_radarObjPort_par_out_local::TChangeableMemPool::_::_::_m_arrayPool::_0_::_elem::_m_objectInformation::_1_::_m_perObjectType::_m_prob1StationaryN = 0;
      @sysvar::XCP::RadarFC::_g_PER_Hil_ObjBypassingRunnable_ObjBypassingRunnable_m_pad_radarObjPort_par_out_local::TChangeableMemPool::_::_::_m_arrayPool::_0_::_elem::_m_objectInformation::_1_::_m_perObjectType::_m_prob1ObstUnknownN = 0;
      @sysvar::XCP::RadarFC::_g_PER_Hil_ObjBypassingRunnable_ObjBypassingRunnable_m_pad_radarObjPort_par_out_local::TChangeableMemPool::_::_::_m_arrayPool::_0_::_elem::_m_objectInformation::_1_::_m_perObjectType::_m_prob1FourPlusWheelerN = 128;
      @sysvar::XCP::RadarFC::_g_PER_Hil_ObjBypassingRunnable_ObjBypassingRunnable_m_pad_radarObjPort_par_out_local::TChangeableMemPool::_::_::_m_arrayPool::_0_::_elem::_m_objectInformation::_1_::_m_perObjectType::_m_prob1TwoWheelerN = 0;
      @sysvar::XCP::RadarFC::_g_PER_Hil_ObjBypassingRunnable_ObjBypassingRunnable_m_pad_radarObjPort_par_out_local::TChangeableMemPool::_::_::_m_arrayPool::_0_::_elem::_m_objectInformation::_1_::_m_perObjectType::_m_prob1PedestrianN = 0;
      @sysvar::XCP::RadarFC::_g_PER_Hil_ObjBypassingRunnable_ObjBypassingRunnable_m_pad_radarObjPort_par_out_local::TChangeableMemPool::_::_::_m_arrayPool::_0_::_elem::_m_objectInformation::_1_::_m_perObjectType::_m_prob1MovUnknownN = 0;
      @sysvar::XCP::RadarFC::_g_PER_Hil_ObjBypassingRunnable_ObjBypassingRunnable_m_pad_radarObjPort_par_out_local::TChangeableMemPool::_::_::_m_arrayPool::_0_::_elem::_m_objectInformation::_1_::_m_perObjectType::_m_prob1RoadsideBarrierN = 0;
      @sysvar::XCP::RadarFC::_g_PER_Hil_ObjBypassingRunnable_ObjBypassingRunnable_m_pad_radarObjPort_par_out_local::TChangeableMemPool::_::_::_m_arrayPool::_0_::_elem::_m_objectInformation::_1_::_m_perObjectType::_m_prob1StatUnknownN = 128;
      @sysvar::XCP::RadarFC::_g_PER_Hil_ObjBypassingRunnable_ObjBypassingRunnable_m_pad_radarObjPort_par_out_local::TChangeableMemPool::_::_::_m_arrayPool::_0_::_elem::_m_objectInformation::_1_::_m_perObjectType::_m_prob1PassengerCarN = 128;
      @sysvar::XCP::RadarFC::_g_PER_Hil_ObjBypassingRunnable_ObjBypassingRunnable_m_pad_radarObjPort_par_out_local::TChangeableMemPool::_::_::_m_arrayPool::_0_::_elem::_m_objectInformation::_1_::_m_perObjectType::_m_prob1TruckN = 0;
      @sysvar::XCP::RadarFC::_g_PER_Hil_ObjBypassingRunnable_ObjBypassingRunnable_m_pad_radarObjPort_par_out_local::TChangeableMemPool::_::_::_m_arrayPool::_0_::_elem::_m_objectInformation::_1_::_m_perObjectType::_m_prob1FourWheelUnknownN = 0;
      @sysvar::XCP::RadarFC::_g_PER_Hil_ObjBypassingRunnable_ObjBypassingRunnable_m_pad_radarObjPort_par_out_local::TChangeableMemPool::_::_::_m_arrayPool::_0_::_elem::_m_objectInformation::_1_::_m_dWidthN = 256;
          break;

      case 5: //"Truck"
      @sysvar::XCP::RadarFC::_g_PER_Hil_ObjBypassingRunnable_ObjBypassingRunnable_m_pad_radarObjPort_par_out_local::TChangeableMemPool::_::_::_m_arrayPool::_0_::_elem::_m_objectInformation::_1_::_m_perObjectType::_m_prob1ObstacleN = 128;
      @sysvar::XCP::RadarFC::_g_PER_Hil_ObjBypassingRunnable_ObjBypassingRunnable_m_pad_radarObjPort_par_out_local::TChangeableMemPool::_::_::_m_arrayPool::_0_::_elem::_m_objectInformation::_1_::_m_perObjectType::_m_prob1NonObstacleN = 0;
      @sysvar::XCP::RadarFC::_g_PER_Hil_ObjBypassingRunnable_ObjBypassingRunnable_m_pad_radarObjPort_par_out_local::TChangeableMemPool::_::_::_m_arrayPool::_0_::_elem::_m_objectInformation::_1_::_m_perObjectType::_m_prob1UnknownN = 0;
      @sysvar::XCP::RadarFC::_g_PER_Hil_ObjBypassingRunnable_ObjBypassingRunnable_m_pad_radarObjPort_par_out_local::TChangeableMemPool::_::_::_m_arrayPool::_0_::_elem::_m_objectInformation::_1_::_m_perObjectType::_m_prob1MobileN = 128;
      @sysvar::XCP::RadarFC::_g_PER_Hil_ObjBypassingRunnable_ObjBypassingRunnable_m_pad_radarObjPort_par_out_local::TChangeableMemPool::_::_::_m_arrayPool::_0_::_elem::_m_objectInformation::_1_::_m_perObjectType::_m_prob1StationaryN = 0;
      @sysvar::XCP::RadarFC::_g_PER_Hil_ObjBypassingRunnable_ObjBypassingRunnable_m_pad_radarObjPort_par_out_local::TChangeableMemPool::_::_::_m_arrayPool::_0_::_elem::_m_objectInformation::_1_::_m_perObjectType::_m_prob1ObstUnknownN = 0;
      @sysvar::XCP::RadarFC::_g_PER_Hil_ObjBypassingRunnable_ObjBypassingRunnable_m_pad_radarObjPort_par_out_local::TChangeableMemPool::_::_::_m_arrayPool::_0_::_elem::_m_objectInformation::_1_::_m_perObjectType::_m_prob1FourPlusWheelerN = 128;
      @sysvar::XCP::RadarFC::_g_PER_Hil_ObjBypassingRunnable_ObjBypassingRunnable_m_pad_radarObjPort_par_out_local::TChangeableMemPool::_::_::_m_arrayPool::_0_::_elem::_m_objectInformation::_1_::_m_perObjectType::_m_prob1TwoWheelerN = 0;
      @sysvar::XCP::RadarFC::_g_PER_Hil_ObjBypassingRunnable_ObjBypassingRunnable_m_pad_radarObjPort_par_out_local::TChangeableMemPool::_::_::_m_arrayPool::_0_::_elem::_m_objectInformation::_1_::_m_perObjectType::_m_prob1PedestrianN = 0;
      @sysvar::XCP::RadarFC::_g_PER_Hil_ObjBypassingRunnable_ObjBypassingRunnable_m_pad_radarObjPort_par_out_local::TChangeableMemPool::_::_::_m_arrayPool::_0_::_elem::_m_objectInformation::_1_::_m_perObjectType::_m_prob1MovUnknownN = 0;
      @sysvar::XCP::RadarFC::_g_PER_Hil_ObjBypassingRunnable_ObjBypassingRunnable_m_pad_radarObjPort_par_out_local::TChangeableMemPool::_::_::_m_arrayPool::_0_::_elem::_m_objectInformation::_1_::_m_perObjectType::_m_prob1RoadsideBarrierN = 0;
      @sysvar::XCP::RadarFC::_g_PER_Hil_ObjBypassingRunnable_ObjBypassingRunnable_m_pad_radarObjPort_par_out_local::TChangeableMemPool::_::_::_m_arrayPool::_0_::_elem::_m_objectInformation::_1_::_m_perObjectType::_m_prob1StatUnknownN = 128;
      @sysvar::XCP::RadarFC::_g_PER_Hil_ObjBypassingRunnable_ObjBypassingRunnable_m_pad_radarObjPort_par_out_local::TChangeableMemPool::_::_::_m_arrayPool::_0_::_elem::_m_objectInformation::_1_::_m_perObjectType::_m_prob1PassengerCarN = 0;
      @sysvar::XCP::RadarFC::_g_PER_Hil_ObjBypassingRunnable_ObjBypassingRunnable_m_pad_radarObjPort_par_out_local::TChangeableMemPool::_::_::_m_arrayPool::_0_::_elem::_m_objectInformation::_1_::_m_perObjectType::_m_prob1TruckN = 128;
      @sysvar::XCP::RadarFC::_g_PER_Hil_ObjBypassingRunnable_ObjBypassingRunnable_m_pad_radarObjPort_par_out_local::TChangeableMemPool::_::_::_m_arrayPool::_0_::_elem::_m_objectInformation::_1_::_m_perObjectType::_m_prob1FourWheelUnknownN = 0;
      @sysvar::XCP::RadarFC::_g_PER_Hil_ObjBypassingRunnable_ObjBypassingRunnable_m_pad_radarObjPort_par_out_local::TChangeableMemPool::_::_::_m_arrayPool::_0_::_elem::_m_objectInformation::_1_::_m_dWidthN = 256;
          break;

      case 6: //"Non-Obstacle::Cloe->Trailer"
      @sysvar::XCP::RadarFC::_g_PER_Hil_ObjBypassingRunnable_ObjBypassingRunnable_m_pad_radarObjPort_par_out_local::TChangeableMemPool::_::_::_m_arrayPool::_0_::_elem::_m_objectInformation::_1_::_m_perObjectType::_m_prob1ObstacleN = 0;
      @sysvar::XCP::RadarFC::_g_PER_Hil_ObjBypassingRunnable_ObjBypassingRunnable_m_pad_radarObjPort_par_out_local::TChangeableMemPool::_::_::_m_arrayPool::_0_::_elem::_m_objectInformation::_1_::_m_perObjectType::_m_prob1NonObstacleN = 128;
      @sysvar::XCP::RadarFC::_g_PER_Hil_ObjBypassingRunnable_ObjBypassingRunnable_m_pad_radarObjPort_par_out_local::TChangeableMemPool::_::_::_m_arrayPool::_0_::_elem::_m_objectInformation::_1_::_m_perObjectType::_m_prob1UnknownN = 0;
      @sysvar::XCP::RadarFC::_g_PER_Hil_ObjBypassingRunnable_ObjBypassingRunnable_m_pad_radarObjPort_par_out_local::TChangeableMemPool::_::_::_m_arrayPool::_0_::_elem::_m_objectInformation::_1_::_m_perObjectType::_m_prob1MobileN = 128;
      @sysvar::XCP::RadarFC::_g_PER_Hil_ObjBypassingRunnable_ObjBypassingRunnable_m_pad_radarObjPort_par_out_local::TChangeableMemPool::_::_::_m_arrayPool::_0_::_elem::_m_objectInformation::_1_::_m_perObjectType::_m_prob1StationaryN = 0;
      @sysvar::XCP::RadarFC::_g_PER_Hil_ObjBypassingRunnable_ObjBypassingRunnable_m_pad_radarObjPort_par_out_local::TChangeableMemPool::_::_::_m_arrayPool::_0_::_elem::_m_objectInformation::_1_::_m_perObjectType::_m_prob1ObstUnknownN = 0;
      @sysvar::XCP::RadarFC::_g_PER_Hil_ObjBypassingRunnable_ObjBypassingRunnable_m_pad_radarObjPort_par_out_local::TChangeableMemPool::_::_::_m_arrayPool::_0_::_elem::_m_objectInformation::_1_::_m_perObjectType::_m_prob1FourPlusWheelerN = 0;
      @sysvar::XCP::RadarFC::_g_PER_Hil_ObjBypassingRunnable_ObjBypassingRunnable_m_pad_radarObjPort_par_out_local::TChangeableMemPool::_::_::_m_arrayPool::_0_::_elem::_m_objectInformation::_1_::_m_perObjectType::_m_prob1TwoWheelerN = 0;
      @sysvar::XCP::RadarFC::_g_PER_Hil_ObjBypassingRunnable_ObjBypassingRunnable_m_pad_radarObjPort_par_out_local::TChangeableMemPool::_::_::_m_arrayPool::_0_::_elem::_m_objectInformation::_1_::_m_perObjectType::_m_prob1PedestrianN = 0;
      @sysvar::XCP::RadarFC::_g_PER_Hil_ObjBypassingRunnable_ObjBypassingRunnable_m_pad_radarObjPort_par_out_local::TChangeableMemPool::_::_::_m_arrayPool::_0_::_elem::_m_objectInformation::_1_::_m_perObjectType::_m_prob1MovUnknownN = 128;
      @sysvar::XCP::RadarFC::_g_PER_Hil_ObjBypassingRunnable_ObjBypassingRunnable_m_pad_radarObjPort_par_out_local::TChangeableMemPool::_::_::_m_arrayPool::_0_::_elem::_m_objectInformation::_1_::_m_perObjectType::_m_prob1RoadsideBarrierN = 0;
      @sysvar::XCP::RadarFC::_g_PER_Hil_ObjBypassingRunnable_ObjBypassingRunnable_m_pad_radarObjPort_par_out_local::TChangeableMemPool::_::_::_m_arrayPool::_0_::_elem::_m_objectInformation::_1_::_m_perObjectType::_m_prob1StatUnknownN = 128;
      @sysvar::XCP::RadarFC::_g_PER_Hil_ObjBypassingRunnable_ObjBypassingRunnable_m_pad_radarObjPort_par_out_local::TChangeableMemPool::_::_::_m_arrayPool::_0_::_elem::_m_objectInformation::_1_::_m_perObjectType::_m_prob1PassengerCarN = 0;
      @sysvar::XCP::RadarFC::_g_PER_Hil_ObjBypassingRunnable_ObjBypassingRunnable_m_pad_radarObjPort_par_out_local::TChangeableMemPool::_::_::_m_arrayPool::_0_::_elem::_m_objectInformation::_1_::_m_perObjectType::_m_prob1TruckN = 0;
      @sysvar::XCP::RadarFC::_g_PER_Hil_ObjBypassingRunnable_ObjBypassingRunnable_m_pad_radarObjPort_par_out_local::TChangeableMemPool::_::_::_m_arrayPool::_0_::_elem::_m_objectInformation::_1_::_m_perObjectType::_m_prob1FourWheelUnknownN = 128;
      @sysvar::XCP::RadarFC::_g_PER_Hil_ObjBypassingRunnable_ObjBypassingRunnable_m_pad_radarObjPort_par_out_local::TChangeableMemPool::_::_::_m_arrayPool::_0_::_elem::_m_objectInformation::_1_::_m_dWidthN = 256;
          break;

      case 7: //"RoadSideBarrier"
      @sysvar::XCP::RadarFC::_g_PER_Hil_ObjBypassingRunnable_ObjBypassingRunnable_m_pad_radarObjPort_par_out_local::TChangeableMemPool::_::_::_m_arrayPool::_0_::_elem::_m_objectInformation::_1_::_m_perObjectType::_m_prob1ObstacleN = 128;
      @sysvar::XCP::RadarFC::_g_PER_Hil_ObjBypassingRunnable_ObjBypassingRunnable_m_pad_radarObjPort_par_out_local::TChangeableMemPool::_::_::_m_arrayPool::_0_::_elem::_m_objectInformation::_1_::_m_perObjectType::_m_prob1NonObstacleN = 0;
      @sysvar::XCP::RadarFC::_g_PER_Hil_ObjBypassingRunnable_ObjBypassingRunnable_m_pad_radarObjPort_par_out_local::TChangeableMemPool::_::_::_m_arrayPool::_0_::_elem::_m_objectInformation::_1_::_m_perObjectType::_m_prob1UnknownN = 0;
      @sysvar::XCP::RadarFC::_g_PER_Hil_ObjBypassingRunnable_ObjBypassingRunnable_m_pad_radarObjPort_par_out_local::TChangeableMemPool::_::_::_m_arrayPool::_0_::_elem::_m_objectInformation::_1_::_m_perObjectType::_m_prob1MobileN = 0;
      @sysvar::XCP::RadarFC::_g_PER_Hil_ObjBypassingRunnable_ObjBypassingRunnable_m_pad_radarObjPort_par_out_local::TChangeableMemPool::_::_::_m_arrayPool::_0_::_elem::_m_objectInformation::_1_::_m_perObjectType::_m_prob1StationaryN = 128;
      @sysvar::XCP::RadarFC::_g_PER_Hil_ObjBypassingRunnable_ObjBypassingRunnable_m_pad_radarObjPort_par_out_local::TChangeableMemPool::_::_::_m_arrayPool::_0_::_elem::_m_objectInformation::_1_::_m_perObjectType::_m_prob1ObstUnknownN = 0;
      @sysvar::XCP::RadarFC::_g_PER_Hil_ObjBypassingRunnable_ObjBypassingRunnable_m_pad_radarObjPort_par_out_local::TChangeableMemPool::_::_::_m_arrayPool::_0_::_elem::_m_objectInformation::_1_::_m_perObjectType::_m_prob1FourPlusWheelerN = 0;
      @sysvar::XCP::RadarFC::_g_PER_Hil_ObjBypassingRunnable_ObjBypassingRunnable_m_pad_radarObjPort_par_out_local::TChangeableMemPool::_::_::_m_arrayPool::_0_::_elem::_m_objectInformation::_1_::_m_perObjectType::_m_prob1TwoWheelerN = 0;
      @sysvar::XCP::RadarFC::_g_PER_Hil_ObjBypassingRunnable_ObjBypassingRunnable_m_pad_radarObjPort_par_out_local::TChangeableMemPool::_::_::_m_arrayPool::_0_::_elem::_m_objectInformation::_1_::_m_perObjectType::_m_prob1PedestrianN = 0;
      @sysvar::XCP::RadarFC::_g_PER_Hil_ObjBypassingRunnable_ObjBypassingRunnable_m_pad_radarObjPort_par_out_local::TChangeableMemPool::_::_::_m_arrayPool::_0_::_elem::_m_objectInformation::_1_::_m_perObjectType::_m_prob1MovUnknownN = 128;
      @sysvar::XCP::RadarFC::_g_PER_Hil_ObjBypassingRunnable_ObjBypassingRunnable_m_pad_radarObjPort_par_out_local::TChangeableMemPool::_::_::_m_arrayPool::_0_::_elem::_m_objectInformation::_1_::_m_perObjectType::_m_prob1RoadsideBarrierN = 128;
      @sysvar::XCP::RadarFC::_g_PER_Hil_ObjBypassingRunnable_ObjBypassingRunnable_m_pad_radarObjPort_par_out_local::TChangeableMemPool::_::_::_m_arrayPool::_0_::_elem::_m_objectInformation::_1_::_m_perObjectType::_m_prob1StatUnknownN = 0;
      @sysvar::XCP::RadarFC::_g_PER_Hil_ObjBypassingRunnable_ObjBypassingRunnable_m_pad_radarObjPort_par_out_local::TChangeableMemPool::_::_::_m_arrayPool::_0_::_elem::_m_objectInformation::_1_::_m_perObjectType::_m_prob1PassengerCarN = 0;
      @sysvar::XCP::RadarFC::_g_PER_Hil_ObjBypassingRunnable_ObjBypassingRunnable_m_pad_radarObjPort_par_out_local::TChangeableMemPool::_::_::_m_arrayPool::_0_::_elem::_m_objectInformation::_1_::_m_perObjectType::_m_prob1TruckN = 0;
      @sysvar::XCP::RadarFC::_g_PER_Hil_ObjBypassingRunnable_ObjBypassingRunnable_m_pad_radarObjPort_par_out_local::TChangeableMemPool::_::_::_m_arrayPool::_0_::_elem::_m_objectInformation::_1_::_m_perObjectType::_m_prob1FourWheelUnknownN = 128;
      @sysvar::XCP::RadarFC::_g_PER_Hil_ObjBypassingRunnable_ObjBypassingRunnable_m_pad_radarObjPort_par_out_local::TChangeableMemPool::_::_::_m_arrayPool::_0_::_elem::_m_objectInformation::_1_::_m_dWidthN = 256;
          break;
      }
      break;

    case 2: //"Object-2"
    //constant
  @sysvar::XCP::RadarFC::_g_PER_Hil_ObjBypassingRunnable_ObjBypassingRunnable_m_pad_radarObjPort_par_out_local::TChangeableMemPool::_::_::_m_arrayPool::_0_::_elem::_m_objectInformation::_2_::_Valid_b = 1;
  @sysvar::XCP::RadarFC::_g_PER_Hil_ObjBypassingRunnable_ObjBypassingRunnable_m_pad_radarObjPort_par_out_local::TChangeableMemPool::_::_::_m_arrayPool::_0_::_elem::_m_objectInformation::_2_::_m_HandleN = 1;
  @sysvar::XCP::RadarFC::_g_PER_Hil_ObjBypassingRunnable_ObjBypassingRunnable_m_pad_radarObjPort_par_out_local::TChangeableMemPool::_::_::_m_arrayPool::_0_::_elem::_m_objectInformation::_2_::_m_alpPiVarYawAngleN = 0;
  @sysvar::XCP::RadarFC::_g_PER_Hil_ObjBypassingRunnable_ObjBypassingRunnable_m_pad_radarObjPort_par_out_local::TChangeableMemPool::_::_::_m_arrayPool::_0_::_elem::_m_objectInformation::_2_::_m_alpPiYawAngleN = 0;
  @sysvar::XCP::RadarFC::_g_PER_Hil_ObjBypassingRunnable_ObjBypassingRunnable_m_pad_radarObjPort_par_out_local::TChangeableMemPool::_::_::_m_arrayPool::_0_::_elem::_m_objectInformation::_2_::_m_varAxN = 0;
  @sysvar::XCP::RadarFC::_g_PER_Hil_ObjBypassingRunnable_ObjBypassingRunnable_m_pad_radarObjPort_par_out_local::TChangeableMemPool::_::_::_m_arrayPool::_0_::_elem::_m_objectInformation::_2_::_m_varAyN = 0;
  @sysvar::XCP::RadarFC::_g_PER_Hil_ObjBypassingRunnable_ObjBypassingRunnable_m_pad_radarObjPort_par_out_local::TChangeableMemPool::_::_::_m_arrayPool::_0_::_elem::_m_objectInformation::_2_::_m_varVxN = 0;
  @sysvar::XCP::RadarFC::_g_PER_Hil_ObjBypassingRunnable_ObjBypassingRunnable_m_pad_radarObjPort_par_out_local::TChangeableMemPool::_::_::_m_arrayPool::_0_::_elem::_m_objectInformation::_2_::_m_varVyN = 0;
  @sysvar::XCP::RadarFC::_g_PER_Hil_ObjBypassingRunnable_ObjBypassingRunnable_m_pad_radarObjPort_par_out_local::TChangeableMemPool::_::_::_m_arrayPool::_0_::_elem::_m_objectInformation::_2_::_m_varDxN = 0;
  @sysvar::XCP::RadarFC::_g_PER_Hil_ObjBypassingRunnable_ObjBypassingRunnable_m_pad_radarObjPort_par_out_local::TChangeableMemPool::_::_::_m_arrayPool::_0_::_elem::_m_objectInformation::_2_::_m_varDyN = 0;
  @sysvar::XCP::RadarFC::_g_PER_Hil_ObjBypassingRunnable_ObjBypassingRunnable_m_pad_radarObjPort_par_out_local::TChangeableMemPool::_::_::_m_arrayPool::_0_::_elem::_m_objectInformation::_2_::_m_dVarLengthN = 0;
  @sysvar::XCP::RadarFC::_g_PER_Hil_ObjBypassingRunnable_ObjBypassingRunnable_m_pad_radarObjPort_par_out_local::TChangeableMemPool::_::_::_m_arrayPool::_0_::_elem::_m_objectInformation::_2_::_m_dVarWidthN = 0;
  @sysvar::XCP::RadarFC::_g_PER_Hil_ObjBypassingRunnable_ObjBypassingRunnable_m_pad_radarObjPort_par_out_local::TChangeableMemPool::_::_::_m_arrayPool::_0_::_elem::_m_objectInformation::_2_::_m_wExistProbN = 64880;
  @sysvar::XCP::RadarFC::_g_PER_Hil_ObjBypassingRunnable_ObjBypassingRunnable_m_pad_radarObjPort_par_out_local::TChangeableMemPool::_::_::_m_arrayPool::_0_::_elem::_m_objectInformation::_2_::_m_isObjectAsil = 1;
  @sysvar::XCP::RadarFC::_g_PER_Hil_ObjBypassingRunnable_ObjBypassingRunnable_m_pad_radarObjPort_par_out_local::TChangeableMemPool::_::_::_m_arrayPool::_0_::_elem::_m_objectInformation::_2_::_m_dLengthN = 128;

      //target movement

  @sysvar::XCP::RadarFC::_g_PER_Hil_ObjBypassingRunnable_ObjBypassingRunnable_m_pad_radarObjPort_par_out_local::TChangeableMemPool::_::_::_m_arrayPool::_0_::_elem::_m_objectInformation::_2_::_m_dxN = @FDX_in_HIL_specific_FRadar_Obj::FDX_in_FRadar_2_m_dxN;
  @sysvar::XCP::RadarFC::_g_PER_Hil_ObjBypassingRunnable_ObjBypassingRunnable_m_pad_radarObjPort_par_out_local::TChangeableMemPool::_::_::_m_arrayPool::_0_::_elem::_m_objectInformation::_2_::_m_dyN = @FDX_in_HIL_specific_FRadar_Obj::FDX_in_FRadar_2_m_dyN;
  @sysvar::XCP::RadarFC::_g_PER_Hil_ObjBypassingRunnable_ObjBypassingRunnable_m_pad_radarObjPort_par_out_local::TChangeableMemPool::_::_::_m_arrayPool::_0_::_elem::_m_objectInformation::_2_::_m_dzN = @FDX_in_HIL_specific_FRadar_Obj::FDX_in_FRadar_2_m_dzN;
  @sysvar::XCP::RadarFC::_g_PER_Hil_ObjBypassingRunnable_ObjBypassingRunnable_m_pad_radarObjPort_par_out_local::TChangeableMemPool::_::_::_m_arrayPool::_0_::_elem::_m_objectInformation::_2_::_m_vxN = @FDX_in_HIL_specific_FRadar_Obj::FDX_in_FRadar_2_m_vxN;
  @sysvar::XCP::RadarFC::_g_PER_Hil_ObjBypassingRunnable_ObjBypassingRunnable_m_pad_radarObjPort_par_out_local::TChangeableMemPool::_::_::_m_arrayPool::_0_::_elem::_m_objectInformation::_2_::_m_vyN = @FDX_in_HIL_specific_FRadar_Obj::FDX_in_FRadar_2_m_vyN;
  @sysvar::XCP::RadarFC::_g_PER_Hil_ObjBypassingRunnable_ObjBypassingRunnable_m_pad_radarObjPort_par_out_local::TChangeableMemPool::_::_::_m_arrayPool::_0_::_elem::_m_objectInformation::_2_::_m_axN = @FDX_in_HIL_specific_FRadar_Obj::FDX_in_FRadar_2_m_axN;
  @sysvar::XCP::RadarFC::_g_PER_Hil_ObjBypassingRunnable_ObjBypassingRunnable_m_pad_radarObjPort_par_out_local::TChangeableMemPool::_::_::_m_arrayPool::_0_::_elem::_m_objectInformation::_2_::_m_ayN = @FDX_in_HIL_specific_FRadar_Obj::FDX_in_FRadar_2_m_ayN;
  @sysvar::XCP::RadarFC::_g_PER_Hil_ObjBypassingRunnable_ObjBypassingRunnable_m_pad_radarObjPort_par_out_local::TChangeableMemPool::_::_::_m_arrayPool::_0_::_elem::_m_objectInformation::_2_::_m_dLengthN = @FDX_in_HIL_specific_FRadar_Obj::FDX_in_FRadar_2_m_dLengthN;
  @sysvar::XCP::RadarFC::_g_PER_Hil_ObjBypassingRunnable_ObjBypassingRunnable_m_pad_radarObjPort_par_out_local::TChangeableMemPool::_::_::_m_arrayPool::_0_::_elem::_m_objectInformation::_2_::_m_dWidthN = @FDX_in_HIL_specific_FRadar_Obj::FDX_in_FRadar_2_m_dWidthN;
  @sysvar::XCP::RadarFC::_g_PER_Hil_ObjBypassingRunnable_ObjBypassingRunnable_m_pad_radarObjPort_par_out_local::TChangeableMemPool::_::_::_m_arrayPool::_0_::_elem::_m_objectInformation::_2_::_m_alpPiYawAngleN = @FDX_in_HIL_specific_FRadar_Obj::FDX_in_FRadar_2_m_alpPiYawAngleN;

      //target object moving or not
      if (abs(@FDX_in_HIL_specific_FRadar_Obj::FDX_in_FRadar_2_m_vxN) != 0)
      {
    @sysvar::XCP::RadarFC::_g_PER_Hil_ObjBypassingRunnable_ObjBypassingRunnable_m_pad_radarObjPort_par_out_local::TChangeableMemPool::_::_::_m_arrayPool::_0_::_elem::_m_objectInformation::_2_::_m_prob1HasBeenObservedMovingN = 126;
    @sysvar::XCP::RadarFC::_g_PER_Hil_ObjBypassingRunnable_ObjBypassingRunnable_m_pad_radarObjPort_par_out_local::TChangeableMemPool::_::_::_m_arrayPool::_0_::_elem::_m_objectInformation::_2_::_m_prob1MovingN = 126;
      }
      else
      {
    @sysvar::XCP::RadarFC::_g_PER_Hil_ObjBypassingRunnable_ObjBypassingRunnable_m_pad_radarObjPort_par_out_local::TChangeableMemPool::_::_::_m_arrayPool::_0_::_elem::_m_objectInformation::_2_::_m_prob1HasBeenObservedMovingN = 0;
    @sysvar::XCP::RadarFC::_g_PER_Hil_ObjBypassingRunnable_ObjBypassingRunnable_m_pad_radarObjPort_par_out_local::TChangeableMemPool::_::_::_m_arrayPool::_0_::_elem::_m_objectInformation::_2_::_m_prob1MovingN = 0;
      }

      //object classification
    switch (@FDX_in_HIL_specific_FRadar_Obj::FDX_in_FRadar_2_Sensed_Object_Classification)
    {
      case 0: //"unknown"
      @sysvar::XCP::RadarFC::_g_PER_Hil_ObjBypassingRunnable_ObjBypassingRunnable_m_pad_radarObjPort_par_out_local::TChangeableMemPool::_::_::_m_arrayPool::_0_::_elem::_m_objectInformation::_2_::_m_perObjectType::_m_prob1ObstacleN = 0;
      @sysvar::XCP::RadarFC::_g_PER_Hil_ObjBypassingRunnable_ObjBypassingRunnable_m_pad_radarObjPort_par_out_local::TChangeableMemPool::_::_::_m_arrayPool::_0_::_elem::_m_objectInformation::_2_::_m_perObjectType::_m_prob1NonObstacleN = 0;
      @sysvar::XCP::RadarFC::_g_PER_Hil_ObjBypassingRunnable_ObjBypassingRunnable_m_pad_radarObjPort_par_out_local::TChangeableMemPool::_::_::_m_arrayPool::_0_::_elem::_m_objectInformation::_2_::_m_perObjectType::_m_prob1UnknownN = 128;
      @sysvar::XCP::RadarFC::_g_PER_Hil_ObjBypassingRunnable_ObjBypassingRunnable_m_pad_radarObjPort_par_out_local::TChangeableMemPool::_::_::_m_arrayPool::_0_::_elem::_m_objectInformation::_2_::_m_perObjectType::_m_prob1MobileN = 0;
      @sysvar::XCP::RadarFC::_g_PER_Hil_ObjBypassingRunnable_ObjBypassingRunnable_m_pad_radarObjPort_par_out_local::TChangeableMemPool::_::_::_m_arrayPool::_0_::_elem::_m_objectInformation::_2_::_m_perObjectType::_m_prob1StationaryN = 0;
      @sysvar::XCP::RadarFC::_g_PER_Hil_ObjBypassingRunnable_ObjBypassingRunnable_m_pad_radarObjPort_par_out_local::TChangeableMemPool::_::_::_m_arrayPool::_0_::_elem::_m_objectInformation::_2_::_m_perObjectType::_m_prob1ObstUnknownN = 128;
      @sysvar::XCP::RadarFC::_g_PER_Hil_ObjBypassingRunnable_ObjBypassingRunnable_m_pad_radarObjPort_par_out_local::TChangeableMemPool::_::_::_m_arrayPool::_0_::_elem::_m_objectInformation::_2_::_m_perObjectType::_m_prob1FourPlusWheelerN = 0;
      @sysvar::XCP::RadarFC::_g_PER_Hil_ObjBypassingRunnable_ObjBypassingRunnable_m_pad_radarObjPort_par_out_local::TChangeableMemPool::_::_::_m_arrayPool::_0_::_elem::_m_objectInformation::_2_::_m_perObjectType::_m_prob1TwoWheelerN = 0;
      @sysvar::XCP::RadarFC::_g_PER_Hil_ObjBypassingRunnable_ObjBypassingRunnable_m_pad_radarObjPort_par_out_local::TChangeableMemPool::_::_::_m_arrayPool::_0_::_elem::_m_objectInformation::_2_::_m_perObjectType::_m_prob1PedestrianN = 0;
      @sysvar::XCP::RadarFC::_g_PER_Hil_ObjBypassingRunnable_ObjBypassingRunnable_m_pad_radarObjPort_par_out_local::TChangeableMemPool::_::_::_m_arrayPool::_0_::_elem::_m_objectInformation::_2_::_m_perObjectType::_m_prob1MovUnknownN = 128;
      @sysvar::XCP::RadarFC::_g_PER_Hil_ObjBypassingRunnable_ObjBypassingRunnable_m_pad_radarObjPort_par_out_local::TChangeableMemPool::_::_::_m_arrayPool::_0_::_elem::_m_objectInformation::_2_::_m_perObjectType::_m_prob1RoadsideBarrierN = 0;
      @sysvar::XCP::RadarFC::_g_PER_Hil_ObjBypassingRunnable_ObjBypassingRunnable_m_pad_radarObjPort_par_out_local::TChangeableMemPool::_::_::_m_arrayPool::_0_::_elem::_m_objectInformation::_2_::_m_perObjectType::_m_prob1StatUnknownN = 128;
      @sysvar::XCP::RadarFC::_g_PER_Hil_ObjBypassingRunnable_ObjBypassingRunnable_m_pad_radarObjPort_par_out_local::TChangeableMemPool::_::_::_m_arrayPool::_0_::_elem::_m_objectInformation::_2_::_m_perObjectType::_m_prob1PassengerCarN = 0;
      @sysvar::XCP::RadarFC::_g_PER_Hil_ObjBypassingRunnable_ObjBypassingRunnable_m_pad_radarObjPort_par_out_local::TChangeableMemPool::_::_::_m_arrayPool::_0_::_elem::_m_objectInformation::_2_::_m_perObjectType::_m_prob1TruckN = 0;
      @sysvar::XCP::RadarFC::_g_PER_Hil_ObjBypassingRunnable_ObjBypassingRunnable_m_pad_radarObjPort_par_out_local::TChangeableMemPool::_::_::_m_arrayPool::_0_::_elem::_m_objectInformation::_2_::_m_perObjectType::_m_prob1FourWheelUnknownN = 128;
      @sysvar::XCP::RadarFC::_g_PER_Hil_ObjBypassingRunnable_ObjBypassingRunnable_m_pad_radarObjPort_par_out_local::TChangeableMemPool::_::_::_m_arrayPool::_0_::_elem::_m_objectInformation::_2_::_m_dWidthN = 256;
          break;

      case 1: //"Pedestrian"
      @sysvar::XCP::RadarFC::_g_PER_Hil_ObjBypassingRunnable_ObjBypassingRunnable_m_pad_radarObjPort_par_out_local::TChangeableMemPool::_::_::_m_arrayPool::_0_::_elem::_m_objectInformation::_2_::_m_perObjectType::_m_prob1ObstacleN = 128;
      @sysvar::XCP::RadarFC::_g_PER_Hil_ObjBypassingRunnable_ObjBypassingRunnable_m_pad_radarObjPort_par_out_local::TChangeableMemPool::_::_::_m_arrayPool::_0_::_elem::_m_objectInformation::_2_::_m_perObjectType::_m_prob1NonObstacleN = 0;
      @sysvar::XCP::RadarFC::_g_PER_Hil_ObjBypassingRunnable_ObjBypassingRunnable_m_pad_radarObjPort_par_out_local::TChangeableMemPool::_::_::_m_arrayPool::_0_::_elem::_m_objectInformation::_2_::_m_perObjectType::_m_prob1UnknownN = 0;
      @sysvar::XCP::RadarFC::_g_PER_Hil_ObjBypassingRunnable_ObjBypassingRunnable_m_pad_radarObjPort_par_out_local::TChangeableMemPool::_::_::_m_arrayPool::_0_::_elem::_m_objectInformation::_2_::_m_perObjectType::_m_prob1MobileN = 128;
      @sysvar::XCP::RadarFC::_g_PER_Hil_ObjBypassingRunnable_ObjBypassingRunnable_m_pad_radarObjPort_par_out_local::TChangeableMemPool::_::_::_m_arrayPool::_0_::_elem::_m_objectInformation::_2_::_m_perObjectType::_m_prob1StationaryN = 0;
      @sysvar::XCP::RadarFC::_g_PER_Hil_ObjBypassingRunnable_ObjBypassingRunnable_m_pad_radarObjPort_par_out_local::TChangeableMemPool::_::_::_m_arrayPool::_0_::_elem::_m_objectInformation::_2_::_m_perObjectType::_m_prob1ObstUnknownN = 0;
      @sysvar::XCP::RadarFC::_g_PER_Hil_ObjBypassingRunnable_ObjBypassingRunnable_m_pad_radarObjPort_par_out_local::TChangeableMemPool::_::_::_m_arrayPool::_0_::_elem::_m_objectInformation::_2_::_m_perObjectType::_m_prob1FourPlusWheelerN = 0;
      @sysvar::XCP::RadarFC::_g_PER_Hil_ObjBypassingRunnable_ObjBypassingRunnable_m_pad_radarObjPort_par_out_local::TChangeableMemPool::_::_::_m_arrayPool::_0_::_elem::_m_objectInformation::_2_::_m_perObjectType::_m_prob1TwoWheelerN = 0;
      @sysvar::XCP::RadarFC::_g_PER_Hil_ObjBypassingRunnable_ObjBypassingRunnable_m_pad_radarObjPort_par_out_local::TChangeableMemPool::_::_::_m_arrayPool::_0_::_elem::_m_objectInformation::_2_::_m_perObjectType::_m_prob1PedestrianN = 128;
      @sysvar::XCP::RadarFC::_g_PER_Hil_ObjBypassingRunnable_ObjBypassingRunnable_m_pad_radarObjPort_par_out_local::TChangeableMemPool::_::_::_m_arrayPool::_0_::_elem::_m_objectInformation::_2_::_m_perObjectType::_m_prob1MovUnknownN = 0;
      @sysvar::XCP::RadarFC::_g_PER_Hil_ObjBypassingRunnable_ObjBypassingRunnable_m_pad_radarObjPort_par_out_local::TChangeableMemPool::_::_::_m_arrayPool::_0_::_elem::_m_objectInformation::_2_::_m_perObjectType::_m_prob1RoadsideBarrierN = 0;
      @sysvar::XCP::RadarFC::_g_PER_Hil_ObjBypassingRunnable_ObjBypassingRunnable_m_pad_radarObjPort_par_out_local::TChangeableMemPool::_::_::_m_arrayPool::_0_::_elem::_m_objectInformation::_2_::_m_perObjectType::_m_prob1StatUnknownN = 128;
      @sysvar::XCP::RadarFC::_g_PER_Hil_ObjBypassingRunnable_ObjBypassingRunnable_m_pad_radarObjPort_par_out_local::TChangeableMemPool::_::_::_m_arrayPool::_0_::_elem::_m_objectInformation::_2_::_m_perObjectType::_m_prob1PassengerCarN = 0;
      @sysvar::XCP::RadarFC::_g_PER_Hil_ObjBypassingRunnable_ObjBypassingRunnable_m_pad_radarObjPort_par_out_local::TChangeableMemPool::_::_::_m_arrayPool::_0_::_elem::_m_objectInformation::_2_::_m_perObjectType::_m_prob1TruckN = 0;
      @sysvar::XCP::RadarFC::_g_PER_Hil_ObjBypassingRunnable_ObjBypassingRunnable_m_pad_radarObjPort_par_out_local::TChangeableMemPool::_::_::_m_arrayPool::_0_::_elem::_m_objectInformation::_2_::_m_perObjectType::_m_prob1FourWheelUnknownN = 128;
      @sysvar::XCP::RadarFC::_g_PER_Hil_ObjBypassingRunnable_ObjBypassingRunnable_m_pad_radarObjPort_par_out_local::TChangeableMemPool::_::_::_m_arrayPool::_0_::_elem::_m_objectInformation::_2_::_m_dWidthN = 64;
          break;

      case 2: //"2Wheeler::Cloe-> Bike"
      @sysvar::XCP::RadarFC::_g_PER_Hil_ObjBypassingRunnable_ObjBypassingRunnable_m_pad_radarObjPort_par_out_local::TChangeableMemPool::_::_::_m_arrayPool::_0_::_elem::_m_objectInformation::_2_::_m_perObjectType::_m_prob1ObstacleN = 128;
      @sysvar::XCP::RadarFC::_g_PER_Hil_ObjBypassingRunnable_ObjBypassingRunnable_m_pad_radarObjPort_par_out_local::TChangeableMemPool::_::_::_m_arrayPool::_0_::_elem::_m_objectInformation::_2_::_m_perObjectType::_m_prob1NonObstacleN = 0;
      @sysvar::XCP::RadarFC::_g_PER_Hil_ObjBypassingRunnable_ObjBypassingRunnable_m_pad_radarObjPort_par_out_local::TChangeableMemPool::_::_::_m_arrayPool::_0_::_elem::_m_objectInformation::_2_::_m_perObjectType::_m_prob1UnknownN = 0;
      @sysvar::XCP::RadarFC::_g_PER_Hil_ObjBypassingRunnable_ObjBypassingRunnable_m_pad_radarObjPort_par_out_local::TChangeableMemPool::_::_::_m_arrayPool::_0_::_elem::_m_objectInformation::_2_::_m_perObjectType::_m_prob1MobileN = 128;
      @sysvar::XCP::RadarFC::_g_PER_Hil_ObjBypassingRunnable_ObjBypassingRunnable_m_pad_radarObjPort_par_out_local::TChangeableMemPool::_::_::_m_arrayPool::_0_::_elem::_m_objectInformation::_2_::_m_perObjectType::_m_prob1StationaryN = 0;
      @sysvar::XCP::RadarFC::_g_PER_Hil_ObjBypassingRunnable_ObjBypassingRunnable_m_pad_radarObjPort_par_out_local::TChangeableMemPool::_::_::_m_arrayPool::_0_::_elem::_m_objectInformation::_2_::_m_perObjectType::_m_prob1ObstUnknownN = 0;
      @sysvar::XCP::RadarFC::_g_PER_Hil_ObjBypassingRunnable_ObjBypassingRunnable_m_pad_radarObjPort_par_out_local::TChangeableMemPool::_::_::_m_arrayPool::_0_::_elem::_m_objectInformation::_2_::_m_perObjectType::_m_prob1FourPlusWheelerN = 0;
      @sysvar::XCP::RadarFC::_g_PER_Hil_ObjBypassingRunnable_ObjBypassingRunnable_m_pad_radarObjPort_par_out_local::TChangeableMemPool::_::_::_m_arrayPool::_0_::_elem::_m_objectInformation::_2_::_m_perObjectType::_m_prob1TwoWheelerN = 128;
      @sysvar::XCP::RadarFC::_g_PER_Hil_ObjBypassingRunnable_ObjBypassingRunnable_m_pad_radarObjPort_par_out_local::TChangeableMemPool::_::_::_m_arrayPool::_0_::_elem::_m_objectInformation::_2_::_m_perObjectType::_m_prob1PedestrianN = 0;
      @sysvar::XCP::RadarFC::_g_PER_Hil_ObjBypassingRunnable_ObjBypassingRunnable_m_pad_radarObjPort_par_out_local::TChangeableMemPool::_::_::_m_arrayPool::_0_::_elem::_m_objectInformation::_2_::_m_perObjectType::_m_prob1MovUnknownN = 0;
      @sysvar::XCP::RadarFC::_g_PER_Hil_ObjBypassingRunnable_ObjBypassingRunnable_m_pad_radarObjPort_par_out_local::TChangeableMemPool::_::_::_m_arrayPool::_0_::_elem::_m_objectInformation::_2_::_m_perObjectType::_m_prob1RoadsideBarrierN = 0;
      @sysvar::XCP::RadarFC::_g_PER_Hil_ObjBypassingRunnable_ObjBypassingRunnable_m_pad_radarObjPort_par_out_local::TChangeableMemPool::_::_::_m_arrayPool::_0_::_elem::_m_objectInformation::_2_::_m_perObjectType::_m_prob1StatUnknownN = 128;
      @sysvar::XCP::RadarFC::_g_PER_Hil_ObjBypassingRunnable_ObjBypassingRunnable_m_pad_radarObjPort_par_out_local::TChangeableMemPool::_::_::_m_arrayPool::_0_::_elem::_m_objectInformation::_2_::_m_perObjectType::_m_prob1PassengerCarN = 0;
      @sysvar::XCP::RadarFC::_g_PER_Hil_ObjBypassingRunnable_ObjBypassingRunnable_m_pad_radarObjPort_par_out_local::TChangeableMemPool::_::_::_m_arrayPool::_0_::_elem::_m_objectInformation::_2_::_m_perObjectType::_m_prob1TruckN = 0;
      @sysvar::XCP::RadarFC::_g_PER_Hil_ObjBypassingRunnable_ObjBypassingRunnable_m_pad_radarObjPort_par_out_local::TChangeableMemPool::_::_::_m_arrayPool::_0_::_elem::_m_objectInformation::_2_::_m_perObjectType::_m_prob1FourWheelUnknownN = 128;
      @sysvar::XCP::RadarFC::_g_PER_Hil_ObjBypassingRunnable_ObjBypassingRunnable_m_pad_radarObjPort_par_out_local::TChangeableMemPool::_::_::_m_arrayPool::_0_::_elem::_m_objectInformation::_2_::_m_dWidthN = 64;
          break;

      case 3: //"2Wheeler::Cloe-> Motorbike"
      @sysvar::XCP::RadarFC::_g_PER_Hil_ObjBypassingRunnable_ObjBypassingRunnable_m_pad_radarObjPort_par_out_local::TChangeableMemPool::_::_::_m_arrayPool::_0_::_elem::_m_objectInformation::_2_::_m_perObjectType::_m_prob1ObstacleN = 128;
      @sysvar::XCP::RadarFC::_g_PER_Hil_ObjBypassingRunnable_ObjBypassingRunnable_m_pad_radarObjPort_par_out_local::TChangeableMemPool::_::_::_m_arrayPool::_0_::_elem::_m_objectInformation::_2_::_m_perObjectType::_m_prob1NonObstacleN = 0;
      @sysvar::XCP::RadarFC::_g_PER_Hil_ObjBypassingRunnable_ObjBypassingRunnable_m_pad_radarObjPort_par_out_local::TChangeableMemPool::_::_::_m_arrayPool::_0_::_elem::_m_objectInformation::_2_::_m_perObjectType::_m_prob1UnknownN = 0;
      @sysvar::XCP::RadarFC::_g_PER_Hil_ObjBypassingRunnable_ObjBypassingRunnable_m_pad_radarObjPort_par_out_local::TChangeableMemPool::_::_::_m_arrayPool::_0_::_elem::_m_objectInformation::_2_::_m_perObjectType::_m_prob1MobileN = 128;
      @sysvar::XCP::RadarFC::_g_PER_Hil_ObjBypassingRunnable_ObjBypassingRunnable_m_pad_radarObjPort_par_out_local::TChangeableMemPool::_::_::_m_arrayPool::_0_::_elem::_m_objectInformation::_2_::_m_perObjectType::_m_prob1StationaryN = 0;
      @sysvar::XCP::RadarFC::_g_PER_Hil_ObjBypassingRunnable_ObjBypassingRunnable_m_pad_radarObjPort_par_out_local::TChangeableMemPool::_::_::_m_arrayPool::_0_::_elem::_m_objectInformation::_2_::_m_perObjectType::_m_prob1ObstUnknownN = 0;
      @sysvar::XCP::RadarFC::_g_PER_Hil_ObjBypassingRunnable_ObjBypassingRunnable_m_pad_radarObjPort_par_out_local::TChangeableMemPool::_::_::_m_arrayPool::_0_::_elem::_m_objectInformation::_2_::_m_perObjectType::_m_prob1FourPlusWheelerN = 0;
      @sysvar::XCP::RadarFC::_g_PER_Hil_ObjBypassingRunnable_ObjBypassingRunnable_m_pad_radarObjPort_par_out_local::TChangeableMemPool::_::_::_m_arrayPool::_0_::_elem::_m_objectInformation::_2_::_m_perObjectType::_m_prob1TwoWheelerN = 128;
      @sysvar::XCP::RadarFC::_g_PER_Hil_ObjBypassingRunnable_ObjBypassingRunnable_m_pad_radarObjPort_par_out_local::TChangeableMemPool::_::_::_m_arrayPool::_0_::_elem::_m_objectInformation::_2_::_m_perObjectType::_m_prob1PedestrianN = 0;
      @sysvar::XCP::RadarFC::_g_PER_Hil_ObjBypassingRunnable_ObjBypassingRunnable_m_pad_radarObjPort_par_out_local::TChangeableMemPool::_::_::_m_arrayPool::_0_::_elem::_m_objectInformation::_2_::_m_perObjectType::_m_prob1MovUnknownN = 0;
      @sysvar::XCP::RadarFC::_g_PER_Hil_ObjBypassingRunnable_ObjBypassingRunnable_m_pad_radarObjPort_par_out_local::TChangeableMemPool::_::_::_m_arrayPool::_0_::_elem::_m_objectInformation::_2_::_m_perObjectType::_m_prob1RoadsideBarrierN = 0;
      @sysvar::XCP::RadarFC::_g_PER_Hil_ObjBypassingRunnable_ObjBypassingRunnable_m_pad_radarObjPort_par_out_local::TChangeableMemPool::_::_::_m_arrayPool::_0_::_elem::_m_objectInformation::_2_::_m_perObjectType::_m_prob1StatUnknownN = 128;
      @sysvar::XCP::RadarFC::_g_PER_Hil_ObjBypassingRunnable_ObjBypassingRunnable_m_pad_radarObjPort_par_out_local::TChangeableMemPool::_::_::_m_arrayPool::_0_::_elem::_m_objectInformation::_2_::_m_perObjectType::_m_prob1PassengerCarN = 0;
      @sysvar::XCP::RadarFC::_g_PER_Hil_ObjBypassingRunnable_ObjBypassingRunnable_m_pad_radarObjPort_par_out_local::TChangeableMemPool::_::_::_m_arrayPool::_0_::_elem::_m_objectInformation::_2_::_m_perObjectType::_m_prob1TruckN = 0;
      @sysvar::XCP::RadarFC::_g_PER_Hil_ObjBypassingRunnable_ObjBypassingRunnable_m_pad_radarObjPort_par_out_local::TChangeableMemPool::_::_::_m_arrayPool::_0_::_elem::_m_objectInformation::_2_::_m_perObjectType::_m_prob1FourWheelUnknownN = 128;
      @sysvar::XCP::RadarFC::_g_PER_Hil_ObjBypassingRunnable_ObjBypassingRunnable_m_pad_radarObjPort_par_out_local::TChangeableMemPool::_::_::_m_arrayPool::_0_::_elem::_m_objectInformation::_2_::_m_dWidthN = 64;
          break;

      case 4: //"PassengerCar"
      @sysvar::XCP::RadarFC::_g_PER_Hil_ObjBypassingRunnable_ObjBypassingRunnable_m_pad_radarObjPort_par_out_local::TChangeableMemPool::_::_::_m_arrayPool::_0_::_elem::_m_objectInformation::_2_::_m_perObjectType::_m_prob1ObstacleN = 128;
      @sysvar::XCP::RadarFC::_g_PER_Hil_ObjBypassingRunnable_ObjBypassingRunnable_m_pad_radarObjPort_par_out_local::TChangeableMemPool::_::_::_m_arrayPool::_0_::_elem::_m_objectInformation::_2_::_m_perObjectType::_m_prob1NonObstacleN = 0;
      @sysvar::XCP::RadarFC::_g_PER_Hil_ObjBypassingRunnable_ObjBypassingRunnable_m_pad_radarObjPort_par_out_local::TChangeableMemPool::_::_::_m_arrayPool::_0_::_elem::_m_objectInformation::_2_::_m_perObjectType::_m_prob1UnknownN = 0;
      @sysvar::XCP::RadarFC::_g_PER_Hil_ObjBypassingRunnable_ObjBypassingRunnable_m_pad_radarObjPort_par_out_local::TChangeableMemPool::_::_::_m_arrayPool::_0_::_elem::_m_objectInformation::_2_::_m_perObjectType::_m_prob1MobileN = 128;
      @sysvar::XCP::RadarFC::_g_PER_Hil_ObjBypassingRunnable_ObjBypassingRunnable_m_pad_radarObjPort_par_out_local::TChangeableMemPool::_::_::_m_arrayPool::_0_::_elem::_m_objectInformation::_2_::_m_perObjectType::_m_prob1StationaryN = 0;
      @sysvar::XCP::RadarFC::_g_PER_Hil_ObjBypassingRunnable_ObjBypassingRunnable_m_pad_radarObjPort_par_out_local::TChangeableMemPool::_::_::_m_arrayPool::_0_::_elem::_m_objectInformation::_2_::_m_perObjectType::_m_prob1ObstUnknownN = 0;
      @sysvar::XCP::RadarFC::_g_PER_Hil_ObjBypassingRunnable_ObjBypassingRunnable_m_pad_radarObjPort_par_out_local::TChangeableMemPool::_::_::_m_arrayPool::_0_::_elem::_m_objectInformation::_2_::_m_perObjectType::_m_prob1FourPlusWheelerN = 128;
      @sysvar::XCP::RadarFC::_g_PER_Hil_ObjBypassingRunnable_ObjBypassingRunnable_m_pad_radarObjPort_par_out_local::TChangeableMemPool::_::_::_m_arrayPool::_0_::_elem::_m_objectInformation::_2_::_m_perObjectType::_m_prob1TwoWheelerN = 0;
      @sysvar::XCP::RadarFC::_g_PER_Hil_ObjBypassingRunnable_ObjBypassingRunnable_m_pad_radarObjPort_par_out_local::TChangeableMemPool::_::_::_m_arrayPool::_0_::_elem::_m_objectInformation::_2_::_m_perObjectType::_m_prob1PedestrianN = 0;
      @sysvar::XCP::RadarFC::_g_PER_Hil_ObjBypassingRunnable_ObjBypassingRunnable_m_pad_radarObjPort_par_out_local::TChangeableMemPool::_::_::_m_arrayPool::_0_::_elem::_m_objectInformation::_2_::_m_perObjectType::_m_prob1MovUnknownN = 0;
      @sysvar::XCP::RadarFC::_g_PER_Hil_ObjBypassingRunnable_ObjBypassingRunnable_m_pad_radarObjPort_par_out_local::TChangeableMemPool::_::_::_m_arrayPool::_0_::_elem::_m_objectInformation::_2_::_m_perObjectType::_m_prob1RoadsideBarrierN = 0;
      @sysvar::XCP::RadarFC::_g_PER_Hil_ObjBypassingRunnable_ObjBypassingRunnable_m_pad_radarObjPort_par_out_local::TChangeableMemPool::_::_::_m_arrayPool::_0_::_elem::_m_objectInformation::_2_::_m_perObjectType::_m_prob1StatUnknownN = 128;
      @sysvar::XCP::RadarFC::_g_PER_Hil_ObjBypassingRunnable_ObjBypassingRunnable_m_pad_radarObjPort_par_out_local::TChangeableMemPool::_::_::_m_arrayPool::_0_::_elem::_m_objectInformation::_2_::_m_perObjectType::_m_prob1PassengerCarN = 128;
      @sysvar::XCP::RadarFC::_g_PER_Hil_ObjBypassingRunnable_ObjBypassingRunnable_m_pad_radarObjPort_par_out_local::TChangeableMemPool::_::_::_m_arrayPool::_0_::_elem::_m_objectInformation::_2_::_m_perObjectType::_m_prob1TruckN = 0;
      @sysvar::XCP::RadarFC::_g_PER_Hil_ObjBypassingRunnable_ObjBypassingRunnable_m_pad_radarObjPort_par_out_local::TChangeableMemPool::_::_::_m_arrayPool::_0_::_elem::_m_objectInformation::_2_::_m_perObjectType::_m_prob1FourWheelUnknownN = 0;
      @sysvar::XCP::RadarFC::_g_PER_Hil_ObjBypassingRunnable_ObjBypassingRunnable_m_pad_radarObjPort_par_out_local::TChangeableMemPool::_::_::_m_arrayPool::_0_::_elem::_m_objectInformation::_2_::_m_dWidthN = 256;
          break;

      case 5: //"Truck"
      @sysvar::XCP::RadarFC::_g_PER_Hil_ObjBypassingRunnable_ObjBypassingRunnable_m_pad_radarObjPort_par_out_local::TChangeableMemPool::_::_::_m_arrayPool::_0_::_elem::_m_objectInformation::_2_::_m_perObjectType::_m_prob1ObstacleN = 128;
      @sysvar::XCP::RadarFC::_g_PER_Hil_ObjBypassingRunnable_ObjBypassingRunnable_m_pad_radarObjPort_par_out_local::TChangeableMemPool::_::_::_m_arrayPool::_0_::_elem::_m_objectInformation::_2_::_m_perObjectType::_m_prob1NonObstacleN = 0;
      @sysvar::XCP::RadarFC::_g_PER_Hil_ObjBypassingRunnable_ObjBypassingRunnable_m_pad_radarObjPort_par_out_local::TChangeableMemPool::_::_::_m_arrayPool::_0_::_elem::_m_objectInformation::_2_::_m_perObjectType::_m_prob1UnknownN = 0;
      @sysvar::XCP::RadarFC::_g_PER_Hil_ObjBypassingRunnable_ObjBypassingRunnable_m_pad_radarObjPort_par_out_local::TChangeableMemPool::_::_::_m_arrayPool::_0_::_elem::_m_objectInformation::_2_::_m_perObjectType::_m_prob1MobileN = 128;
      @sysvar::XCP::RadarFC::_g_PER_Hil_ObjBypassingRunnable_ObjBypassingRunnable_m_pad_radarObjPort_par_out_local::TChangeableMemPool::_::_::_m_arrayPool::_0_::_elem::_m_objectInformation::_2_::_m_perObjectType::_m_prob1StationaryN = 0;
      @sysvar::XCP::RadarFC::_g_PER_Hil_ObjBypassingRunnable_ObjBypassingRunnable_m_pad_radarObjPort_par_out_local::TChangeableMemPool::_::_::_m_arrayPool::_0_::_elem::_m_objectInformation::_2_::_m_perObjectType::_m_prob1ObstUnknownN = 0;
      @sysvar::XCP::RadarFC::_g_PER_Hil_ObjBypassingRunnable_ObjBypassingRunnable_m_pad_radarObjPort_par_out_local::TChangeableMemPool::_::_::_m_arrayPool::_0_::_elem::_m_objectInformation::_2_::_m_perObjectType::_m_prob1FourPlusWheelerN = 128;
      @sysvar::XCP::RadarFC::_g_PER_Hil_ObjBypassingRunnable_ObjBypassingRunnable_m_pad_radarObjPort_par_out_local::TChangeableMemPool::_::_::_m_arrayPool::_0_::_elem::_m_objectInformation::_2_::_m_perObjectType::_m_prob1TwoWheelerN = 0;
      @sysvar::XCP::RadarFC::_g_PER_Hil_ObjBypassingRunnable_ObjBypassingRunnable_m_pad_radarObjPort_par_out_local::TChangeableMemPool::_::_::_m_arrayPool::_0_::_elem::_m_objectInformation::_2_::_m_perObjectType::_m_prob1PedestrianN = 0;
      @sysvar::XCP::RadarFC::_g_PER_Hil_ObjBypassingRunnable_ObjBypassingRunnable_m_pad_radarObjPort_par_out_local::TChangeableMemPool::_::_::_m_arrayPool::_0_::_elem::_m_objectInformation::_2_::_m_perObjectType::_m_prob1MovUnknownN = 0;
      @sysvar::XCP::RadarFC::_g_PER_Hil_ObjBypassingRunnable_ObjBypassingRunnable_m_pad_radarObjPort_par_out_local::TChangeableMemPool::_::_::_m_arrayPool::_0_::_elem::_m_objectInformation::_2_::_m_perObjectType::_m_prob1RoadsideBarrierN = 0;
      @sysvar::XCP::RadarFC::_g_PER_Hil_ObjBypassingRunnable_ObjBypassingRunnable_m_pad_radarObjPort_par_out_local::TChangeableMemPool::_::_::_m_arrayPool::_0_::_elem::_m_objectInformation::_2_::_m_perObjectType::_m_prob1StatUnknownN = 128;
      @sysvar::XCP::RadarFC::_g_PER_Hil_ObjBypassingRunnable_ObjBypassingRunnable_m_pad_radarObjPort_par_out_local::TChangeableMemPool::_::_::_m_arrayPool::_0_::_elem::_m_objectInformation::_2_::_m_perObjectType::_m_prob1PassengerCarN = 0;
      @sysvar::XCP::RadarFC::_g_PER_Hil_ObjBypassingRunnable_ObjBypassingRunnable_m_pad_radarObjPort_par_out_local::TChangeableMemPool::_::_::_m_arrayPool::_0_::_elem::_m_objectInformation::_2_::_m_perObjectType::_m_prob1TruckN = 128;
      @sysvar::XCP::RadarFC::_g_PER_Hil_ObjBypassingRunnable_ObjBypassingRunnable_m_pad_radarObjPort_par_out_local::TChangeableMemPool::_::_::_m_arrayPool::_0_::_elem::_m_objectInformation::_2_::_m_perObjectType::_m_prob1FourWheelUnknownN = 0;
      @sysvar::XCP::RadarFC::_g_PER_Hil_ObjBypassingRunnable_ObjBypassingRunnable_m_pad_radarObjPort_par_out_local::TChangeableMemPool::_::_::_m_arrayPool::_0_::_elem::_m_objectInformation::_2_::_m_dWidthN = 256;
          break;

      case 6: //"Non-Obstacle::Cloe->Trailer"
      @sysvar::XCP::RadarFC::_g_PER_Hil_ObjBypassingRunnable_ObjBypassingRunnable_m_pad_radarObjPort_par_out_local::TChangeableMemPool::_::_::_m_arrayPool::_0_::_elem::_m_objectInformation::_2_::_m_perObjectType::_m_prob1ObstacleN = 0;
      @sysvar::XCP::RadarFC::_g_PER_Hil_ObjBypassingRunnable_ObjBypassingRunnable_m_pad_radarObjPort_par_out_local::TChangeableMemPool::_::_::_m_arrayPool::_0_::_elem::_m_objectInformation::_2_::_m_perObjectType::_m_prob1NonObstacleN = 128;
      @sysvar::XCP::RadarFC::_g_PER_Hil_ObjBypassingRunnable_ObjBypassingRunnable_m_pad_radarObjPort_par_out_local::TChangeableMemPool::_::_::_m_arrayPool::_0_::_elem::_m_objectInformation::_2_::_m_perObjectType::_m_prob1UnknownN = 0;
      @sysvar::XCP::RadarFC::_g_PER_Hil_ObjBypassingRunnable_ObjBypassingRunnable_m_pad_radarObjPort_par_out_local::TChangeableMemPool::_::_::_m_arrayPool::_0_::_elem::_m_objectInformation::_2_::_m_perObjectType::_m_prob1MobileN = 128;
      @sysvar::XCP::RadarFC::_g_PER_Hil_ObjBypassingRunnable_ObjBypassingRunnable_m_pad_radarObjPort_par_out_local::TChangeableMemPool::_::_::_m_arrayPool::_0_::_elem::_m_objectInformation::_2_::_m_perObjectType::_m_prob1StationaryN = 0;
      @sysvar::XCP::RadarFC::_g_PER_Hil_ObjBypassingRunnable_ObjBypassingRunnable_m_pad_radarObjPort_par_out_local::TChangeableMemPool::_::_::_m_arrayPool::_0_::_elem::_m_objectInformation::_2_::_m_perObjectType::_m_prob1ObstUnknownN = 0;
      @sysvar::XCP::RadarFC::_g_PER_Hil_ObjBypassingRunnable_ObjBypassingRunnable_m_pad_radarObjPort_par_out_local::TChangeableMemPool::_::_::_m_arrayPool::_0_::_elem::_m_objectInformation::_2_::_m_perObjectType::_m_prob1FourPlusWheelerN = 0;
      @sysvar::XCP::RadarFC::_g_PER_Hil_ObjBypassingRunnable_ObjBypassingRunnable_m_pad_radarObjPort_par_out_local::TChangeableMemPool::_::_::_m_arrayPool::_0_::_elem::_m_objectInformation::_2_::_m_perObjectType::_m_prob1TwoWheelerN = 0;
      @sysvar::XCP::RadarFC::_g_PER_Hil_ObjBypassingRunnable_ObjBypassingRunnable_m_pad_radarObjPort_par_out_local::TChangeableMemPool::_::_::_m_arrayPool::_0_::_elem::_m_objectInformation::_2_::_m_perObjectType::_m_prob1PedestrianN = 0;
      @sysvar::XCP::RadarFC::_g_PER_Hil_ObjBypassingRunnable_ObjBypassingRunnable_m_pad_radarObjPort_par_out_local::TChangeableMemPool::_::_::_m_arrayPool::_0_::_elem::_m_objectInformation::_2_::_m_perObjectType::_m_prob1MovUnknownN = 128;
      @sysvar::XCP::RadarFC::_g_PER_Hil_ObjBypassingRunnable_ObjBypassingRunnable_m_pad_radarObjPort_par_out_local::TChangeableMemPool::_::_::_m_arrayPool::_0_::_elem::_m_objectInformation::_2_::_m_perObjectType::_m_prob1RoadsideBarrierN = 0;
      @sysvar::XCP::RadarFC::_g_PER_Hil_ObjBypassingRunnable_ObjBypassingRunnable_m_pad_radarObjPort_par_out_local::TChangeableMemPool::_::_::_m_arrayPool::_0_::_elem::_m_objectInformation::_2_::_m_perObjectType::_m_prob1StatUnknownN = 128;
      @sysvar::XCP::RadarFC::_g_PER_Hil_ObjBypassingRunnable_ObjBypassingRunnable_m_pad_radarObjPort_par_out_local::TChangeableMemPool::_::_::_m_arrayPool::_0_::_elem::_m_objectInformation::_2_::_m_perObjectType::_m_prob1PassengerCarN = 0;
      @sysvar::XCP::RadarFC::_g_PER_Hil_ObjBypassingRunnable_ObjBypassingRunnable_m_pad_radarObjPort_par_out_local::TChangeableMemPool::_::_::_m_arrayPool::_0_::_elem::_m_objectInformation::_2_::_m_perObjectType::_m_prob1TruckN = 0;
      @sysvar::XCP::RadarFC::_g_PER_Hil_ObjBypassingRunnable_ObjBypassingRunnable_m_pad_radarObjPort_par_out_local::TChangeableMemPool::_::_::_m_arrayPool::_0_::_elem::_m_objectInformation::_2_::_m_perObjectType::_m_prob1FourWheelUnknownN = 128;
      @sysvar::XCP::RadarFC::_g_PER_Hil_ObjBypassingRunnable_ObjBypassingRunnable_m_pad_radarObjPort_par_out_local::TChangeableMemPool::_::_::_m_arrayPool::_0_::_elem::_m_objectInformation::_2_::_m_dWidthN = 256;
          break;

      case 7: //"RoadSideBarrier"
      @sysvar::XCP::RadarFC::_g_PER_Hil_ObjBypassingRunnable_ObjBypassingRunnable_m_pad_radarObjPort_par_out_local::TChangeableMemPool::_::_::_m_arrayPool::_0_::_elem::_m_objectInformation::_2_::_m_perObjectType::_m_prob1ObstacleN = 128;
      @sysvar::XCP::RadarFC::_g_PER_Hil_ObjBypassingRunnable_ObjBypassingRunnable_m_pad_radarObjPort_par_out_local::TChangeableMemPool::_::_::_m_arrayPool::_0_::_elem::_m_objectInformation::_2_::_m_perObjectType::_m_prob1NonObstacleN = 0;
      @sysvar::XCP::RadarFC::_g_PER_Hil_ObjBypassingRunnable_ObjBypassingRunnable_m_pad_radarObjPort_par_out_local::TChangeableMemPool::_::_::_m_arrayPool::_0_::_elem::_m_objectInformation::_2_::_m_perObjectType::_m_prob1UnknownN = 0;
      @sysvar::XCP::RadarFC::_g_PER_Hil_ObjBypassingRunnable_ObjBypassingRunnable_m_pad_radarObjPort_par_out_local::TChangeableMemPool::_::_::_m_arrayPool::_0_::_elem::_m_objectInformation::_2_::_m_perObjectType::_m_prob1MobileN = 0;
      @sysvar::XCP::RadarFC::_g_PER_Hil_ObjBypassingRunnable_ObjBypassingRunnable_m_pad_radarObjPort_par_out_local::TChangeableMemPool::_::_::_m_arrayPool::_0_::_elem::_m_objectInformation::_2_::_m_perObjectType::_m_prob1StationaryN = 128;
      @sysvar::XCP::RadarFC::_g_PER_Hil_ObjBypassingRunnable_ObjBypassingRunnable_m_pad_radarObjPort_par_out_local::TChangeableMemPool::_::_::_m_arrayPool::_0_::_elem::_m_objectInformation::_2_::_m_perObjectType::_m_prob1ObstUnknownN = 0;
      @sysvar::XCP::RadarFC::_g_PER_Hil_ObjBypassingRunnable_ObjBypassingRunnable_m_pad_radarObjPort_par_out_local::TChangeableMemPool::_::_::_m_arrayPool::_0_::_elem::_m_objectInformation::_2_::_m_perObjectType::_m_prob1FourPlusWheelerN = 0;
      @sysvar::XCP::RadarFC::_g_PER_Hil_ObjBypassingRunnable_ObjBypassingRunnable_m_pad_radarObjPort_par_out_local::TChangeableMemPool::_::_::_m_arrayPool::_0_::_elem::_m_objectInformation::_2_::_m_perObjectType::_m_prob1TwoWheelerN = 0;
      @sysvar::XCP::RadarFC::_g_PER_Hil_ObjBypassingRunnable_ObjBypassingRunnable_m_pad_radarObjPort_par_out_local::TChangeableMemPool::_::_::_m_arrayPool::_0_::_elem::_m_objectInformation::_2_::_m_perObjectType::_m_prob1PedestrianN = 0;
      @sysvar::XCP::RadarFC::_g_PER_Hil_ObjBypassingRunnable_ObjBypassingRunnable_m_pad_radarObjPort_par_out_local::TChangeableMemPool::_::_::_m_arrayPool::_0_::_elem::_m_objectInformation::_2_::_m_perObjectType::_m_prob1MovUnknownN = 128;
      @sysvar::XCP::RadarFC::_g_PER_Hil_ObjBypassingRunnable_ObjBypassingRunnable_m_pad_radarObjPort_par_out_local::TChangeableMemPool::_::_::_m_arrayPool::_0_::_elem::_m_objectInformation::_2_::_m_perObjectType::_m_prob1RoadsideBarrierN = 128;
      @sysvar::XCP::RadarFC::_g_PER_Hil_ObjBypassingRunnable_ObjBypassingRunnable_m_pad_radarObjPort_par_out_local::TChangeableMemPool::_::_::_m_arrayPool::_0_::_elem::_m_objectInformation::_2_::_m_perObjectType::_m_prob1StatUnknownN = 0;
      @sysvar::XCP::RadarFC::_g_PER_Hil_ObjBypassingRunnable_ObjBypassingRunnable_m_pad_radarObjPort_par_out_local::TChangeableMemPool::_::_::_m_arrayPool::_0_::_elem::_m_objectInformation::_2_::_m_perObjectType::_m_prob1PassengerCarN = 0;
      @sysvar::XCP::RadarFC::_g_PER_Hil_ObjBypassingRunnable_ObjBypassingRunnable_m_pad_radarObjPort_par_out_local::TChangeableMemPool::_::_::_m_arrayPool::_0_::_elem::_m_objectInformation::_2_::_m_perObjectType::_m_prob1TruckN = 0;
      @sysvar::XCP::RadarFC::_g_PER_Hil_ObjBypassingRunnable_ObjBypassingRunnable_m_pad_radarObjPort_par_out_local::TChangeableMemPool::_::_::_m_arrayPool::_0_::_elem::_m_objectInformation::_2_::_m_perObjectType::_m_prob1FourWheelUnknownN = 128;
      @sysvar::XCP::RadarFC::_g_PER_Hil_ObjBypassingRunnable_ObjBypassingRunnable_m_pad_radarObjPort_par_out_local::TChangeableMemPool::_::_::_m_arrayPool::_0_::_elem::_m_objectInformation::_2_::_m_dWidthN = 256;
          break;
      }
      break;

    case 3: //"Object-3"
    //constant
  @sysvar::XCP::RadarFC::_g_PER_Hil_ObjBypassingRunnable_ObjBypassingRunnable_m_pad_radarObjPort_par_out_local::TChangeableMemPool::_::_::_m_arrayPool::_0_::_elem::_m_objectInformation::_3_::_Valid_b = 1;
  @sysvar::XCP::RadarFC::_g_PER_Hil_ObjBypassingRunnable_ObjBypassingRunnable_m_pad_radarObjPort_par_out_local::TChangeableMemPool::_::_::_m_arrayPool::_0_::_elem::_m_objectInformation::_3_::_m_HandleN = 1;
  @sysvar::XCP::RadarFC::_g_PER_Hil_ObjBypassingRunnable_ObjBypassingRunnable_m_pad_radarObjPort_par_out_local::TChangeableMemPool::_::_::_m_arrayPool::_0_::_elem::_m_objectInformation::_3_::_m_alpPiVarYawAngleN = 0;
  @sysvar::XCP::RadarFC::_g_PER_Hil_ObjBypassingRunnable_ObjBypassingRunnable_m_pad_radarObjPort_par_out_local::TChangeableMemPool::_::_::_m_arrayPool::_0_::_elem::_m_objectInformation::_3_::_m_alpPiYawAngleN = 0;
  @sysvar::XCP::RadarFC::_g_PER_Hil_ObjBypassingRunnable_ObjBypassingRunnable_m_pad_radarObjPort_par_out_local::TChangeableMemPool::_::_::_m_arrayPool::_0_::_elem::_m_objectInformation::_3_::_m_varAxN = 0;
  @sysvar::XCP::RadarFC::_g_PER_Hil_ObjBypassingRunnable_ObjBypassingRunnable_m_pad_radarObjPort_par_out_local::TChangeableMemPool::_::_::_m_arrayPool::_0_::_elem::_m_objectInformation::_3_::_m_varAyN = 0;
  @sysvar::XCP::RadarFC::_g_PER_Hil_ObjBypassingRunnable_ObjBypassingRunnable_m_pad_radarObjPort_par_out_local::TChangeableMemPool::_::_::_m_arrayPool::_0_::_elem::_m_objectInformation::_3_::_m_varVxN = 0;
  @sysvar::XCP::RadarFC::_g_PER_Hil_ObjBypassingRunnable_ObjBypassingRunnable_m_pad_radarObjPort_par_out_local::TChangeableMemPool::_::_::_m_arrayPool::_0_::_elem::_m_objectInformation::_3_::_m_varVyN = 0;
  @sysvar::XCP::RadarFC::_g_PER_Hil_ObjBypassingRunnable_ObjBypassingRunnable_m_pad_radarObjPort_par_out_local::TChangeableMemPool::_::_::_m_arrayPool::_0_::_elem::_m_objectInformation::_3_::_m_varDxN = 0;
  @sysvar::XCP::RadarFC::_g_PER_Hil_ObjBypassingRunnable_ObjBypassingRunnable_m_pad_radarObjPort_par_out_local::TChangeableMemPool::_::_::_m_arrayPool::_0_::_elem::_m_objectInformation::_3_::_m_varDyN = 0;
  @sysvar::XCP::RadarFC::_g_PER_Hil_ObjBypassingRunnable_ObjBypassingRunnable_m_pad_radarObjPort_par_out_local::TChangeableMemPool::_::_::_m_arrayPool::_0_::_elem::_m_objectInformation::_3_::_m_dVarLengthN = 0;
  @sysvar::XCP::RadarFC::_g_PER_Hil_ObjBypassingRunnable_ObjBypassingRunnable_m_pad_radarObjPort_par_out_local::TChangeableMemPool::_::_::_m_arrayPool::_0_::_elem::_m_objectInformation::_3_::_m_dVarWidthN = 0;
  @sysvar::XCP::RadarFC::_g_PER_Hil_ObjBypassingRunnable_ObjBypassingRunnable_m_pad_radarObjPort_par_out_local::TChangeableMemPool::_::_::_m_arrayPool::_0_::_elem::_m_objectInformation::_3_::_m_wExistProbN = 64880;
  @sysvar::XCP::RadarFC::_g_PER_Hil_ObjBypassingRunnable_ObjBypassingRunnable_m_pad_radarObjPort_par_out_local::TChangeableMemPool::_::_::_m_arrayPool::_0_::_elem::_m_objectInformation::_3_::_m_isObjectAsil = 1;
  @sysvar::XCP::RadarFC::_g_PER_Hil_ObjBypassingRunnable_ObjBypassingRunnable_m_pad_radarObjPort_par_out_local::TChangeableMemPool::_::_::_m_arrayPool::_0_::_elem::_m_objectInformation::_3_::_m_dLengthN = 128;

      //target movement

  @sysvar::XCP::RadarFC::_g_PER_Hil_ObjBypassingRunnable_ObjBypassingRunnable_m_pad_radarObjPort_par_out_local::TChangeableMemPool::_::_::_m_arrayPool::_0_::_elem::_m_objectInformation::_3_::_m_dxN = @FDX_in_HIL_specific_FRadar_Obj::FDX_in_FRadar_3_m_dxN;
  @sysvar::XCP::RadarFC::_g_PER_Hil_ObjBypassingRunnable_ObjBypassingRunnable_m_pad_radarObjPort_par_out_local::TChangeableMemPool::_::_::_m_arrayPool::_0_::_elem::_m_objectInformation::_3_::_m_dyN = @FDX_in_HIL_specific_FRadar_Obj::FDX_in_FRadar_3_m_dyN;
  @sysvar::XCP::RadarFC::_g_PER_Hil_ObjBypassingRunnable_ObjBypassingRunnable_m_pad_radarObjPort_par_out_local::TChangeableMemPool::_::_::_m_arrayPool::_0_::_elem::_m_objectInformation::_3_::_m_dzN = @FDX_in_HIL_specific_FRadar_Obj::FDX_in_FRadar_3_m_dzN;
  @sysvar::XCP::RadarFC::_g_PER_Hil_ObjBypassingRunnable_ObjBypassingRunnable_m_pad_radarObjPort_par_out_local::TChangeableMemPool::_::_::_m_arrayPool::_0_::_elem::_m_objectInformation::_3_::_m_vxN = @FDX_in_HIL_specific_FRadar_Obj::FDX_in_FRadar_3_m_vxN;
  @sysvar::XCP::RadarFC::_g_PER_Hil_ObjBypassingRunnable_ObjBypassingRunnable_m_pad_radarObjPort_par_out_local::TChangeableMemPool::_::_::_m_arrayPool::_0_::_elem::_m_objectInformation::_3_::_m_vyN = @FDX_in_HIL_specific_FRadar_Obj::FDX_in_FRadar_3_m_vyN;
  @sysvar::XCP::RadarFC::_g_PER_Hil_ObjBypassingRunnable_ObjBypassingRunnable_m_pad_radarObjPort_par_out_local::TChangeableMemPool::_::_::_m_arrayPool::_0_::_elem::_m_objectInformation::_3_::_m_axN = @FDX_in_HIL_specific_FRadar_Obj::FDX_in_FRadar_3_m_axN;
  @sysvar::XCP::RadarFC::_g_PER_Hil_ObjBypassingRunnable_ObjBypassingRunnable_m_pad_radarObjPort_par_out_local::TChangeableMemPool::_::_::_m_arrayPool::_0_::_elem::_m_objectInformation::_3_::_m_ayN = @FDX_in_HIL_specific_FRadar_Obj::FDX_in_FRadar_3_m_ayN;
  @sysvar::XCP::RadarFC::_g_PER_Hil_ObjBypassingRunnable_ObjBypassingRunnable_m_pad_radarObjPort_par_out_local::TChangeableMemPool::_::_::_m_arrayPool::_0_::_elem::_m_objectInformation::_3_::_m_dLengthN = @FDX_in_HIL_specific_FRadar_Obj::FDX_in_FRadar_3_m_dLengthN;
  @sysvar::XCP::RadarFC::_g_PER_Hil_ObjBypassingRunnable_ObjBypassingRunnable_m_pad_radarObjPort_par_out_local::TChangeableMemPool::_::_::_m_arrayPool::_0_::_elem::_m_objectInformation::_3_::_m_dWidthN = @FDX_in_HIL_specific_FRadar_Obj::FDX_in_FRadar_3_m_dWidthN;
  @sysvar::XCP::RadarFC::_g_PER_Hil_ObjBypassingRunnable_ObjBypassingRunnable_m_pad_radarObjPort_par_out_local::TChangeableMemPool::_::_::_m_arrayPool::_0_::_elem::_m_objectInformation::_3_::_m_alpPiYawAngleN = @FDX_in_HIL_specific_FRadar_Obj::FDX_in_FRadar_3_m_alpPiYawAngleN;

      //target object moving or not
      if (abs(@FDX_in_HIL_specific_FRadar_Obj::FDX_in_FRadar_3_m_vxN) != 0)
      {
    @sysvar::XCP::RadarFC::_g_PER_Hil_ObjBypassingRunnable_ObjBypassingRunnable_m_pad_radarObjPort_par_out_local::TChangeableMemPool::_::_::_m_arrayPool::_0_::_elem::_m_objectInformation::_3_::_m_prob1HasBeenObservedMovingN = 126;
    @sysvar::XCP::RadarFC::_g_PER_Hil_ObjBypassingRunnable_ObjBypassingRunnable_m_pad_radarObjPort_par_out_local::TChangeableMemPool::_::_::_m_arrayPool::_0_::_elem::_m_objectInformation::_3_::_m_prob1MovingN = 126;
      }
      else
      {
    @sysvar::XCP::RadarFC::_g_PER_Hil_ObjBypassingRunnable_ObjBypassingRunnable_m_pad_radarObjPort_par_out_local::TChangeableMemPool::_::_::_m_arrayPool::_0_::_elem::_m_objectInformation::_3_::_m_prob1HasBeenObservedMovingN = 0;
    @sysvar::XCP::RadarFC::_g_PER_Hil_ObjBypassingRunnable_ObjBypassingRunnable_m_pad_radarObjPort_par_out_local::TChangeableMemPool::_::_::_m_arrayPool::_0_::_elem::_m_objectInformation::_3_::_m_prob1MovingN = 0;
      }

      //object classification
    switch (@FDX_in_HIL_specific_FRadar_Obj::FDX_in_FRadar_3_Sensed_Object_Classification)
    {
      case 0: //"unknown"
      @sysvar::XCP::RadarFC::_g_PER_Hil_ObjBypassingRunnable_ObjBypassingRunnable_m_pad_radarObjPort_par_out_local::TChangeableMemPool::_::_::_m_arrayPool::_0_::_elem::_m_objectInformation::_3_::_m_perObjectType::_m_prob1ObstacleN = 0;
      @sysvar::XCP::RadarFC::_g_PER_Hil_ObjBypassingRunnable_ObjBypassingRunnable_m_pad_radarObjPort_par_out_local::TChangeableMemPool::_::_::_m_arrayPool::_0_::_elem::_m_objectInformation::_3_::_m_perObjectType::_m_prob1NonObstacleN = 0;
      @sysvar::XCP::RadarFC::_g_PER_Hil_ObjBypassingRunnable_ObjBypassingRunnable_m_pad_radarObjPort_par_out_local::TChangeableMemPool::_::_::_m_arrayPool::_0_::_elem::_m_objectInformation::_3_::_m_perObjectType::_m_prob1UnknownN = 128;
      @sysvar::XCP::RadarFC::_g_PER_Hil_ObjBypassingRunnable_ObjBypassingRunnable_m_pad_radarObjPort_par_out_local::TChangeableMemPool::_::_::_m_arrayPool::_0_::_elem::_m_objectInformation::_3_::_m_perObjectType::_m_prob1MobileN = 0;
      @sysvar::XCP::RadarFC::_g_PER_Hil_ObjBypassingRunnable_ObjBypassingRunnable_m_pad_radarObjPort_par_out_local::TChangeableMemPool::_::_::_m_arrayPool::_0_::_elem::_m_objectInformation::_3_::_m_perObjectType::_m_prob1StationaryN = 0;
      @sysvar::XCP::RadarFC::_g_PER_Hil_ObjBypassingRunnable_ObjBypassingRunnable_m_pad_radarObjPort_par_out_local::TChangeableMemPool::_::_::_m_arrayPool::_0_::_elem::_m_objectInformation::_3_::_m_perObjectType::_m_prob1ObstUnknownN = 128;
      @sysvar::XCP::RadarFC::_g_PER_Hil_ObjBypassingRunnable_ObjBypassingRunnable_m_pad_radarObjPort_par_out_local::TChangeableMemPool::_::_::_m_arrayPool::_0_::_elem::_m_objectInformation::_3_::_m_perObjectType::_m_prob1FourPlusWheelerN = 0;
      @sysvar::XCP::RadarFC::_g_PER_Hil_ObjBypassingRunnable_ObjBypassingRunnable_m_pad_radarObjPort_par_out_local::TChangeableMemPool::_::_::_m_arrayPool::_0_::_elem::_m_objectInformation::_3_::_m_perObjectType::_m_prob1TwoWheelerN = 0;
      @sysvar::XCP::RadarFC::_g_PER_Hil_ObjBypassingRunnable_ObjBypassingRunnable_m_pad_radarObjPort_par_out_local::TChangeableMemPool::_::_::_m_arrayPool::_0_::_elem::_m_objectInformation::_3_::_m_perObjectType::_m_prob1PedestrianN = 0;
      @sysvar::XCP::RadarFC::_g_PER_Hil_ObjBypassingRunnable_ObjBypassingRunnable_m_pad_radarObjPort_par_out_local::TChangeableMemPool::_::_::_m_arrayPool::_0_::_elem::_m_objectInformation::_3_::_m_perObjectType::_m_prob1MovUnknownN = 128;
      @sysvar::XCP::RadarFC::_g_PER_Hil_ObjBypassingRunnable_ObjBypassingRunnable_m_pad_radarObjPort_par_out_local::TChangeableMemPool::_::_::_m_arrayPool::_0_::_elem::_m_objectInformation::_3_::_m_perObjectType::_m_prob1RoadsideBarrierN = 0;
      @sysvar::XCP::RadarFC::_g_PER_Hil_ObjBypassingRunnable_ObjBypassingRunnable_m_pad_radarObjPort_par_out_local::TChangeableMemPool::_::_::_m_arrayPool::_0_::_elem::_m_objectInformation::_3_::_m_perObjectType::_m_prob1StatUnknownN = 128;
      @sysvar::XCP::RadarFC::_g_PER_Hil_ObjBypassingRunnable_ObjBypassingRunnable_m_pad_radarObjPort_par_out_local::TChangeableMemPool::_::_::_m_arrayPool::_0_::_elem::_m_objectInformation::_3_::_m_perObjectType::_m_prob1PassengerCarN = 0;
      @sysvar::XCP::RadarFC::_g_PER_Hil_ObjBypassingRunnable_ObjBypassingRunnable_m_pad_radarObjPort_par_out_local::TChangeableMemPool::_::_::_m_arrayPool::_0_::_elem::_m_objectInformation::_3_::_m_perObjectType::_m_prob1TruckN = 0;
      @sysvar::XCP::RadarFC::_g_PER_Hil_ObjBypassingRunnable_ObjBypassingRunnable_m_pad_radarObjPort_par_out_local::TChangeableMemPool::_::_::_m_arrayPool::_0_::_elem::_m_objectInformation::_3_::_m_perObjectType::_m_prob1FourWheelUnknownN = 128;
      @sysvar::XCP::RadarFC::_g_PER_Hil_ObjBypassingRunnable_ObjBypassingRunnable_m_pad_radarObjPort_par_out_local::TChangeableMemPool::_::_::_m_arrayPool::_0_::_elem::_m_objectInformation::_3_::_m_dWidthN = 256;
          break;

      case 1: //"Pedestrian"
      @sysvar::XCP::RadarFC::_g_PER_Hil_ObjBypassingRunnable_ObjBypassingRunnable_m_pad_radarObjPort_par_out_local::TChangeableMemPool::_::_::_m_arrayPool::_0_::_elem::_m_objectInformation::_3_::_m_perObjectType::_m_prob1ObstacleN = 128;
      @sysvar::XCP::RadarFC::_g_PER_Hil_ObjBypassingRunnable_ObjBypassingRunnable_m_pad_radarObjPort_par_out_local::TChangeableMemPool::_::_::_m_arrayPool::_0_::_elem::_m_objectInformation::_3_::_m_perObjectType::_m_prob1NonObstacleN = 0;
      @sysvar::XCP::RadarFC::_g_PER_Hil_ObjBypassingRunnable_ObjBypassingRunnable_m_pad_radarObjPort_par_out_local::TChangeableMemPool::_::_::_m_arrayPool::_0_::_elem::_m_objectInformation::_3_::_m_perObjectType::_m_prob1UnknownN = 0;
      @sysvar::XCP::RadarFC::_g_PER_Hil_ObjBypassingRunnable_ObjBypassingRunnable_m_pad_radarObjPort_par_out_local::TChangeableMemPool::_::_::_m_arrayPool::_0_::_elem::_m_objectInformation::_3_::_m_perObjectType::_m_prob1MobileN = 128;
      @sysvar::XCP::RadarFC::_g_PER_Hil_ObjBypassingRunnable_ObjBypassingRunnable_m_pad_radarObjPort_par_out_local::TChangeableMemPool::_::_::_m_arrayPool::_0_::_elem::_m_objectInformation::_3_::_m_perObjectType::_m_prob1StationaryN = 0;
      @sysvar::XCP::RadarFC::_g_PER_Hil_ObjBypassingRunnable_ObjBypassingRunnable_m_pad_radarObjPort_par_out_local::TChangeableMemPool::_::_::_m_arrayPool::_0_::_elem::_m_objectInformation::_3_::_m_perObjectType::_m_prob1ObstUnknownN = 0;
      @sysvar::XCP::RadarFC::_g_PER_Hil_ObjBypassingRunnable_ObjBypassingRunnable_m_pad_radarObjPort_par_out_local::TChangeableMemPool::_::_::_m_arrayPool::_0_::_elem::_m_objectInformation::_3_::_m_perObjectType::_m_prob1FourPlusWheelerN = 0;
      @sysvar::XCP::RadarFC::_g_PER_Hil_ObjBypassingRunnable_ObjBypassingRunnable_m_pad_radarObjPort_par_out_local::TChangeableMemPool::_::_::_m_arrayPool::_0_::_elem::_m_objectInformation::_3_::_m_perObjectType::_m_prob1TwoWheelerN = 0;
      @sysvar::XCP::RadarFC::_g_PER_Hil_ObjBypassingRunnable_ObjBypassingRunnable_m_pad_radarObjPort_par_out_local::TChangeableMemPool::_::_::_m_arrayPool::_0_::_elem::_m_objectInformation::_3_::_m_perObjectType::_m_prob1PedestrianN = 128;
      @sysvar::XCP::RadarFC::_g_PER_Hil_ObjBypassingRunnable_ObjBypassingRunnable_m_pad_radarObjPort_par_out_local::TChangeableMemPool::_::_::_m_arrayPool::_0_::_elem::_m_objectInformation::_3_::_m_perObjectType::_m_prob1MovUnknownN = 0;
      @sysvar::XCP::RadarFC::_g_PER_Hil_ObjBypassingRunnable_ObjBypassingRunnable_m_pad_radarObjPort_par_out_local::TChangeableMemPool::_::_::_m_arrayPool::_0_::_elem::_m_objectInformation::_3_::_m_perObjectType::_m_prob1RoadsideBarrierN = 0;
      @sysvar::XCP::RadarFC::_g_PER_Hil_ObjBypassingRunnable_ObjBypassingRunnable_m_pad_radarObjPort_par_out_local::TChangeableMemPool::_::_::_m_arrayPool::_0_::_elem::_m_objectInformation::_3_::_m_perObjectType::_m_prob1StatUnknownN = 128;
      @sysvar::XCP::RadarFC::_g_PER_Hil_ObjBypassingRunnable_ObjBypassingRunnable_m_pad_radarObjPort_par_out_local::TChangeableMemPool::_::_::_m_arrayPool::_0_::_elem::_m_objectInformation::_3_::_m_perObjectType::_m_prob1PassengerCarN = 0;
      @sysvar::XCP::RadarFC::_g_PER_Hil_ObjBypassingRunnable_ObjBypassingRunnable_m_pad_radarObjPort_par_out_local::TChangeableMemPool::_::_::_m_arrayPool::_0_::_elem::_m_objectInformation::_3_::_m_perObjectType::_m_prob1TruckN = 0;
      @sysvar::XCP::RadarFC::_g_PER_Hil_ObjBypassingRunnable_ObjBypassingRunnable_m_pad_radarObjPort_par_out_local::TChangeableMemPool::_::_::_m_arrayPool::_0_::_elem::_m_objectInformation::_3_::_m_perObjectType::_m_prob1FourWheelUnknownN = 128;
      @sysvar::XCP::RadarFC::_g_PER_Hil_ObjBypassingRunnable_ObjBypassingRunnable_m_pad_radarObjPort_par_out_local::TChangeableMemPool::_::_::_m_arrayPool::_0_::_elem::_m_objectInformation::_3_::_m_dWidthN = 64;
          break;

      case 2: //"2Wheeler::Cloe-> Bike"
      @sysvar::XCP::RadarFC::_g_PER_Hil_ObjBypassingRunnable_ObjBypassingRunnable_m_pad_radarObjPort_par_out_local::TChangeableMemPool::_::_::_m_arrayPool::_0_::_elem::_m_objectInformation::_3_::_m_perObjectType::_m_prob1ObstacleN = 128;
      @sysvar::XCP::RadarFC::_g_PER_Hil_ObjBypassingRunnable_ObjBypassingRunnable_m_pad_radarObjPort_par_out_local::TChangeableMemPool::_::_::_m_arrayPool::_0_::_elem::_m_objectInformation::_3_::_m_perObjectType::_m_prob1NonObstacleN = 0;
      @sysvar::XCP::RadarFC::_g_PER_Hil_ObjBypassingRunnable_ObjBypassingRunnable_m_pad_radarObjPort_par_out_local::TChangeableMemPool::_::_::_m_arrayPool::_0_::_elem::_m_objectInformation::_3_::_m_perObjectType::_m_prob1UnknownN = 0;
      @sysvar::XCP::RadarFC::_g_PER_Hil_ObjBypassingRunnable_ObjBypassingRunnable_m_pad_radarObjPort_par_out_local::TChangeableMemPool::_::_::_m_arrayPool::_0_::_elem::_m_objectInformation::_3_::_m_perObjectType::_m_prob1MobileN = 128;
      @sysvar::XCP::RadarFC::_g_PER_Hil_ObjBypassingRunnable_ObjBypassingRunnable_m_pad_radarObjPort_par_out_local::TChangeableMemPool::_::_::_m_arrayPool::_0_::_elem::_m_objectInformation::_3_::_m_perObjectType::_m_prob1StationaryN = 0;
      @sysvar::XCP::RadarFC::_g_PER_Hil_ObjBypassingRunnable_ObjBypassingRunnable_m_pad_radarObjPort_par_out_local::TChangeableMemPool::_::_::_m_arrayPool::_0_::_elem::_m_objectInformation::_3_::_m_perObjectType::_m_prob1ObstUnknownN = 0;
      @sysvar::XCP::RadarFC::_g_PER_Hil_ObjBypassingRunnable_ObjBypassingRunnable_m_pad_radarObjPort_par_out_local::TChangeableMemPool::_::_::_m_arrayPool::_0_::_elem::_m_objectInformation::_3_::_m_perObjectType::_m_prob1FourPlusWheelerN = 0;
      @sysvar::XCP::RadarFC::_g_PER_Hil_ObjBypassingRunnable_ObjBypassingRunnable_m_pad_radarObjPort_par_out_local::TChangeableMemPool::_::_::_m_arrayPool::_0_::_elem::_m_objectInformation::_3_::_m_perObjectType::_m_prob1TwoWheelerN = 128;
      @sysvar::XCP::RadarFC::_g_PER_Hil_ObjBypassingRunnable_ObjBypassingRunnable_m_pad_radarObjPort_par_out_local::TChangeableMemPool::_::_::_m_arrayPool::_0_::_elem::_m_objectInformation::_3_::_m_perObjectType::_m_prob1PedestrianN = 0;
      @sysvar::XCP::RadarFC::_g_PER_Hil_ObjBypassingRunnable_ObjBypassingRunnable_m_pad_radarObjPort_par_out_local::TChangeableMemPool::_::_::_m_arrayPool::_0_::_elem::_m_objectInformation::_3_::_m_perObjectType::_m_prob1MovUnknownN = 0;
      @sysvar::XCP::RadarFC::_g_PER_Hil_ObjBypassingRunnable_ObjBypassingRunnable_m_pad_radarObjPort_par_out_local::TChangeableMemPool::_::_::_m_arrayPool::_0_::_elem::_m_objectInformation::_3_::_m_perObjectType::_m_prob1RoadsideBarrierN = 0;
      @sysvar::XCP::RadarFC::_g_PER_Hil_ObjBypassingRunnable_ObjBypassingRunnable_m_pad_radarObjPort_par_out_local::TChangeableMemPool::_::_::_m_arrayPool::_0_::_elem::_m_objectInformation::_3_::_m_perObjectType::_m_prob1StatUnknownN = 128;
      @sysvar::XCP::RadarFC::_g_PER_Hil_ObjBypassingRunnable_ObjBypassingRunnable_m_pad_radarObjPort_par_out_local::TChangeableMemPool::_::_::_m_arrayPool::_0_::_elem::_m_objectInformation::_3_::_m_perObjectType::_m_prob1PassengerCarN = 0;
      @sysvar::XCP::RadarFC::_g_PER_Hil_ObjBypassingRunnable_ObjBypassingRunnable_m_pad_radarObjPort_par_out_local::TChangeableMemPool::_::_::_m_arrayPool::_0_::_elem::_m_objectInformation::_3_::_m_perObjectType::_m_prob1TruckN = 0;
      @sysvar::XCP::RadarFC::_g_PER_Hil_ObjBypassingRunnable_ObjBypassingRunnable_m_pad_radarObjPort_par_out_local::TChangeableMemPool::_::_::_m_arrayPool::_0_::_elem::_m_objectInformation::_3_::_m_perObjectType::_m_prob1FourWheelUnknownN = 128;
      @sysvar::XCP::RadarFC::_g_PER_Hil_ObjBypassingRunnable_ObjBypassingRunnable_m_pad_radarObjPort_par_out_local::TChangeableMemPool::_::_::_m_arrayPool::_0_::_elem::_m_objectInformation::_3_::_m_dWidthN = 64;
          break;

      case 3: //"2Wheeler::Cloe-> Motorbike"
      @sysvar::XCP::RadarFC::_g_PER_Hil_ObjBypassingRunnable_ObjBypassingRunnable_m_pad_radarObjPort_par_out_local::TChangeableMemPool::_::_::_m_arrayPool::_0_::_elem::_m_objectInformation::_3_::_m_perObjectType::_m_prob1ObstacleN = 128;
      @sysvar::XCP::RadarFC::_g_PER_Hil_ObjBypassingRunnable_ObjBypassingRunnable_m_pad_radarObjPort_par_out_local::TChangeableMemPool::_::_::_m_arrayPool::_0_::_elem::_m_objectInformation::_3_::_m_perObjectType::_m_prob1NonObstacleN = 0;
      @sysvar::XCP::RadarFC::_g_PER_Hil_ObjBypassingRunnable_ObjBypassingRunnable_m_pad_radarObjPort_par_out_local::TChangeableMemPool::_::_::_m_arrayPool::_0_::_elem::_m_objectInformation::_3_::_m_perObjectType::_m_prob1UnknownN = 0;
      @sysvar::XCP::RadarFC::_g_PER_Hil_ObjBypassingRunnable_ObjBypassingRunnable_m_pad_radarObjPort_par_out_local::TChangeableMemPool::_::_::_m_arrayPool::_0_::_elem::_m_objectInformation::_3_::_m_perObjectType::_m_prob1MobileN = 128;
      @sysvar::XCP::RadarFC::_g_PER_Hil_ObjBypassingRunnable_ObjBypassingRunnable_m_pad_radarObjPort_par_out_local::TChangeableMemPool::_::_::_m_arrayPool::_0_::_elem::_m_objectInformation::_3_::_m_perObjectType::_m_prob1StationaryN = 0;
      @sysvar::XCP::RadarFC::_g_PER_Hil_ObjBypassingRunnable_ObjBypassingRunnable_m_pad_radarObjPort_par_out_local::TChangeableMemPool::_::_::_m_arrayPool::_0_::_elem::_m_objectInformation::_3_::_m_perObjectType::_m_prob1ObstUnknownN = 0;
      @sysvar::XCP::RadarFC::_g_PER_Hil_ObjBypassingRunnable_ObjBypassingRunnable_m_pad_radarObjPort_par_out_local::TChangeableMemPool::_::_::_m_arrayPool::_0_::_elem::_m_objectInformation::_3_::_m_perObjectType::_m_prob1FourPlusWheelerN = 0;
      @sysvar::XCP::RadarFC::_g_PER_Hil_ObjBypassingRunnable_ObjBypassingRunnable_m_pad_radarObjPort_par_out_local::TChangeableMemPool::_::_::_m_arrayPool::_0_::_elem::_m_objectInformation::_3_::_m_perObjectType::_m_prob1TwoWheelerN = 128;
      @sysvar::XCP::RadarFC::_g_PER_Hil_ObjBypassingRunnable_ObjBypassingRunnable_m_pad_radarObjPort_par_out_local::TChangeableMemPool::_::_::_m_arrayPool::_0_::_elem::_m_objectInformation::_3_::_m_perObjectType::_m_prob1PedestrianN = 0;
      @sysvar::XCP::RadarFC::_g_PER_Hil_ObjBypassingRunnable_ObjBypassingRunnable_m_pad_radarObjPort_par_out_local::TChangeableMemPool::_::_::_m_arrayPool::_0_::_elem::_m_objectInformation::_3_::_m_perObjectType::_m_prob1MovUnknownN = 0;
      @sysvar::XCP::RadarFC::_g_PER_Hil_ObjBypassingRunnable_ObjBypassingRunnable_m_pad_radarObjPort_par_out_local::TChangeableMemPool::_::_::_m_arrayPool::_0_::_elem::_m_objectInformation::_3_::_m_perObjectType::_m_prob1RoadsideBarrierN = 0;
      @sysvar::XCP::RadarFC::_g_PER_Hil_ObjBypassingRunnable_ObjBypassingRunnable_m_pad_radarObjPort_par_out_local::TChangeableMemPool::_::_::_m_arrayPool::_0_::_elem::_m_objectInformation::_3_::_m_perObjectType::_m_prob1StatUnknownN = 128;
      @sysvar::XCP::RadarFC::_g_PER_Hil_ObjBypassingRunnable_ObjBypassingRunnable_m_pad_radarObjPort_par_out_local::TChangeableMemPool::_::_::_m_arrayPool::_0_::_elem::_m_objectInformation::_3_::_m_perObjectType::_m_prob1PassengerCarN = 0;
      @sysvar::XCP::RadarFC::_g_PER_Hil_ObjBypassingRunnable_ObjBypassingRunnable_m_pad_radarObjPort_par_out_local::TChangeableMemPool::_::_::_m_arrayPool::_0_::_elem::_m_objectInformation::_3_::_m_perObjectType::_m_prob1TruckN = 0;
      @sysvar::XCP::RadarFC::_g_PER_Hil_ObjBypassingRunnable_ObjBypassingRunnable_m_pad_radarObjPort_par_out_local::TChangeableMemPool::_::_::_m_arrayPool::_0_::_elem::_m_objectInformation::_3_::_m_perObjectType::_m_prob1FourWheelUnknownN = 128;
      @sysvar::XCP::RadarFC::_g_PER_Hil_ObjBypassingRunnable_ObjBypassingRunnable_m_pad_radarObjPort_par_out_local::TChangeableMemPool::_::_::_m_arrayPool::_0_::_elem::_m_objectInformation::_3_::_m_dWidthN = 64;
          break;

      case 4: //"PassengerCar"
      @sysvar::XCP::RadarFC::_g_PER_Hil_ObjBypassingRunnable_ObjBypassingRunnable_m_pad_radarObjPort_par_out_local::TChangeableMemPool::_::_::_m_arrayPool::_0_::_elem::_m_objectInformation::_3_::_m_perObjectType::_m_prob1ObstacleN = 128;
      @sysvar::XCP::RadarFC::_g_PER_Hil_ObjBypassingRunnable_ObjBypassingRunnable_m_pad_radarObjPort_par_out_local::TChangeableMemPool::_::_::_m_arrayPool::_0_::_elem::_m_objectInformation::_3_::_m_perObjectType::_m_prob1NonObstacleN = 0;
      @sysvar::XCP::RadarFC::_g_PER_Hil_ObjBypassingRunnable_ObjBypassingRunnable_m_pad_radarObjPort_par_out_local::TChangeableMemPool::_::_::_m_arrayPool::_0_::_elem::_m_objectInformation::_3_::_m_perObjectType::_m_prob1UnknownN = 0;
      @sysvar::XCP::RadarFC::_g_PER_Hil_ObjBypassingRunnable_ObjBypassingRunnable_m_pad_radarObjPort_par_out_local::TChangeableMemPool::_::_::_m_arrayPool::_0_::_elem::_m_objectInformation::_3_::_m_perObjectType::_m_prob1MobileN = 128;
      @sysvar::XCP::RadarFC::_g_PER_Hil_ObjBypassingRunnable_ObjBypassingRunnable_m_pad_radarObjPort_par_out_local::TChangeableMemPool::_::_::_m_arrayPool::_0_::_elem::_m_objectInformation::_3_::_m_perObjectType::_m_prob1StationaryN = 0;
      @sysvar::XCP::RadarFC::_g_PER_Hil_ObjBypassingRunnable_ObjBypassingRunnable_m_pad_radarObjPort_par_out_local::TChangeableMemPool::_::_::_m_arrayPool::_0_::_elem::_m_objectInformation::_3_::_m_perObjectType::_m_prob1ObstUnknownN = 0;
      @sysvar::XCP::RadarFC::_g_PER_Hil_ObjBypassingRunnable_ObjBypassingRunnable_m_pad_radarObjPort_par_out_local::TChangeableMemPool::_::_::_m_arrayPool::_0_::_elem::_m_objectInformation::_3_::_m_perObjectType::_m_prob1FourPlusWheelerN = 128;
      @sysvar::XCP::RadarFC::_g_PER_Hil_ObjBypassingRunnable_ObjBypassingRunnable_m_pad_radarObjPort_par_out_local::TChangeableMemPool::_::_::_m_arrayPool::_0_::_elem::_m_objectInformation::_3_::_m_perObjectType::_m_prob1TwoWheelerN = 0;
      @sysvar::XCP::RadarFC::_g_PER_Hil_ObjBypassingRunnable_ObjBypassingRunnable_m_pad_radarObjPort_par_out_local::TChangeableMemPool::_::_::_m_arrayPool::_0_::_elem::_m_objectInformation::_3_::_m_perObjectType::_m_prob1PedestrianN = 0;
      @sysvar::XCP::RadarFC::_g_PER_Hil_ObjBypassingRunnable_ObjBypassingRunnable_m_pad_radarObjPort_par_out_local::TChangeableMemPool::_::_::_m_arrayPool::_0_::_elem::_m_objectInformation::_3_::_m_perObjectType::_m_prob1MovUnknownN = 0;
      @sysvar::XCP::RadarFC::_g_PER_Hil_ObjBypassingRunnable_ObjBypassingRunnable_m_pad_radarObjPort_par_out_local::TChangeableMemPool::_::_::_m_arrayPool::_0_::_elem::_m_objectInformation::_3_::_m_perObjectType::_m_prob1RoadsideBarrierN = 0;
      @sysvar::XCP::RadarFC::_g_PER_Hil_ObjBypassingRunnable_ObjBypassingRunnable_m_pad_radarObjPort_par_out_local::TChangeableMemPool::_::_::_m_arrayPool::_0_::_elem::_m_objectInformation::_3_::_m_perObjectType::_m_prob1StatUnknownN = 128;
      @sysvar::XCP::RadarFC::_g_PER_Hil_ObjBypassingRunnable_ObjBypassingRunnable_m_pad_radarObjPort_par_out_local::TChangeableMemPool::_::_::_m_arrayPool::_0_::_elem::_m_objectInformation::_3_::_m_perObjectType::_m_prob1PassengerCarN = 128;
      @sysvar::XCP::RadarFC::_g_PER_Hil_ObjBypassingRunnable_ObjBypassingRunnable_m_pad_radarObjPort_par_out_local::TChangeableMemPool::_::_::_m_arrayPool::_0_::_elem::_m_objectInformation::_3_::_m_perObjectType::_m_prob1TruckN = 0;
      @sysvar::XCP::RadarFC::_g_PER_Hil_ObjBypassingRunnable_ObjBypassingRunnable_m_pad_radarObjPort_par_out_local::TChangeableMemPool::_::_::_m_arrayPool::_0_::_elem::_m_objectInformation::_3_::_m_perObjectType::_m_prob1FourWheelUnknownN = 0;
      @sysvar::XCP::RadarFC::_g_PER_Hil_ObjBypassingRunnable_ObjBypassingRunnable_m_pad_radarObjPort_par_out_local::TChangeableMemPool::_::_::_m_arrayPool::_0_::_elem::_m_objectInformation::_3_::_m_dWidthN = 256;
          break;

      case 5: //"Truck"
      @sysvar::XCP::RadarFC::_g_PER_Hil_ObjBypassingRunnable_ObjBypassingRunnable_m_pad_radarObjPort_par_out_local::TChangeableMemPool::_::_::_m_arrayPool::_0_::_elem::_m_objectInformation::_3_::_m_perObjectType::_m_prob1ObstacleN = 128;
      @sysvar::XCP::RadarFC::_g_PER_Hil_ObjBypassingRunnable_ObjBypassingRunnable_m_pad_radarObjPort_par_out_local::TChangeableMemPool::_::_::_m_arrayPool::_0_::_elem::_m_objectInformation::_3_::_m_perObjectType::_m_prob1NonObstacleN = 0;
      @sysvar::XCP::RadarFC::_g_PER_Hil_ObjBypassingRunnable_ObjBypassingRunnable_m_pad_radarObjPort_par_out_local::TChangeableMemPool::_::_::_m_arrayPool::_0_::_elem::_m_objectInformation::_3_::_m_perObjectType::_m_prob1UnknownN = 0;
      @sysvar::XCP::RadarFC::_g_PER_Hil_ObjBypassingRunnable_ObjBypassingRunnable_m_pad_radarObjPort_par_out_local::TChangeableMemPool::_::_::_m_arrayPool::_0_::_elem::_m_objectInformation::_3_::_m_perObjectType::_m_prob1MobileN = 128;
      @sysvar::XCP::RadarFC::_g_PER_Hil_ObjBypassingRunnable_ObjBypassingRunnable_m_pad_radarObjPort_par_out_local::TChangeableMemPool::_::_::_m_arrayPool::_0_::_elem::_m_objectInformation::_3_::_m_perObjectType::_m_prob1StationaryN = 0;
      @sysvar::XCP::RadarFC::_g_PER_Hil_ObjBypassingRunnable_ObjBypassingRunnable_m_pad_radarObjPort_par_out_local::TChangeableMemPool::_::_::_m_arrayPool::_0_::_elem::_m_objectInformation::_3_::_m_perObjectType::_m_prob1ObstUnknownN = 0;
      @sysvar::XCP::RadarFC::_g_PER_Hil_ObjBypassingRunnable_ObjBypassingRunnable_m_pad_radarObjPort_par_out_local::TChangeableMemPool::_::_::_m_arrayPool::_0_::_elem::_m_objectInformation::_3_::_m_perObjectType::_m_prob1FourPlusWheelerN = 128;
      @sysvar::XCP::RadarFC::_g_PER_Hil_ObjBypassingRunnable_ObjBypassingRunnable_m_pad_radarObjPort_par_out_local::TChangeableMemPool::_::_::_m_arrayPool::_0_::_elem::_m_objectInformation::_3_::_m_perObjectType::_m_prob1TwoWheelerN = 0;
      @sysvar::XCP::RadarFC::_g_PER_Hil_ObjBypassingRunnable_ObjBypassingRunnable_m_pad_radarObjPort_par_out_local::TChangeableMemPool::_::_::_m_arrayPool::_0_::_elem::_m_objectInformation::_3_::_m_perObjectType::_m_prob1PedestrianN = 0;
      @sysvar::XCP::RadarFC::_g_PER_Hil_ObjBypassingRunnable_ObjBypassingRunnable_m_pad_radarObjPort_par_out_local::TChangeableMemPool::_::_::_m_arrayPool::_0_::_elem::_m_objectInformation::_3_::_m_perObjectType::_m_prob1MovUnknownN = 0;
      @sysvar::XCP::RadarFC::_g_PER_Hil_ObjBypassingRunnable_ObjBypassingRunnable_m_pad_radarObjPort_par_out_local::TChangeableMemPool::_::_::_m_arrayPool::_0_::_elem::_m_objectInformation::_3_::_m_perObjectType::_m_prob1RoadsideBarrierN = 0;
      @sysvar::XCP::RadarFC::_g_PER_Hil_ObjBypassingRunnable_ObjBypassingRunnable_m_pad_radarObjPort_par_out_local::TChangeableMemPool::_::_::_m_arrayPool::_0_::_elem::_m_objectInformation::_3_::_m_perObjectType::_m_prob1StatUnknownN = 128;
      @sysvar::XCP::RadarFC::_g_PER_Hil_ObjBypassingRunnable_ObjBypassingRunnable_m_pad_radarObjPort_par_out_local::TChangeableMemPool::_::_::_m_arrayPool::_0_::_elem::_m_objectInformation::_3_::_m_perObjectType::_m_prob1PassengerCarN = 0;
      @sysvar::XCP::RadarFC::_g_PER_Hil_ObjBypassingRunnable_ObjBypassingRunnable_m_pad_radarObjPort_par_out_local::TChangeableMemPool::_::_::_m_arrayPool::_0_::_elem::_m_objectInformation::_3_::_m_perObjectType::_m_prob1TruckN = 128;
      @sysvar::XCP::RadarFC::_g_PER_Hil_ObjBypassingRunnable_ObjBypassingRunnable_m_pad_radarObjPort_par_out_local::TChangeableMemPool::_::_::_m_arrayPool::_0_::_elem::_m_objectInformation::_3_::_m_perObjectType::_m_prob1FourWheelUnknownN = 0;
      @sysvar::XCP::RadarFC::_g_PER_Hil_ObjBypassingRunnable_ObjBypassingRunnable_m_pad_radarObjPort_par_out_local::TChangeableMemPool::_::_::_m_arrayPool::_0_::_elem::_m_objectInformation::_3_::_m_dWidthN = 256;
          break;

      case 6: //"Non-Obstacle::Cloe->Trailer"
      @sysvar::XCP::RadarFC::_g_PER_Hil_ObjBypassingRunnable_ObjBypassingRunnable_m_pad_radarObjPort_par_out_local::TChangeableMemPool::_::_::_m_arrayPool::_0_::_elem::_m_objectInformation::_3_::_m_perObjectType::_m_prob1ObstacleN = 0;
      @sysvar::XCP::RadarFC::_g_PER_Hil_ObjBypassingRunnable_ObjBypassingRunnable_m_pad_radarObjPort_par_out_local::TChangeableMemPool::_::_::_m_arrayPool::_0_::_elem::_m_objectInformation::_3_::_m_perObjectType::_m_prob1NonObstacleN = 128;
      @sysvar::XCP::RadarFC::_g_PER_Hil_ObjBypassingRunnable_ObjBypassingRunnable_m_pad_radarObjPort_par_out_local::TChangeableMemPool::_::_::_m_arrayPool::_0_::_elem::_m_objectInformation::_3_::_m_perObjectType::_m_prob1UnknownN = 0;
      @sysvar::XCP::RadarFC::_g_PER_Hil_ObjBypassingRunnable_ObjBypassingRunnable_m_pad_radarObjPort_par_out_local::TChangeableMemPool::_::_::_m_arrayPool::_0_::_elem::_m_objectInformation::_3_::_m_perObjectType::_m_prob1MobileN = 128;
      @sysvar::XCP::RadarFC::_g_PER_Hil_ObjBypassingRunnable_ObjBypassingRunnable_m_pad_radarObjPort_par_out_local::TChangeableMemPool::_::_::_m_arrayPool::_0_::_elem::_m_objectInformation::_3_::_m_perObjectType::_m_prob1StationaryN = 0;
      @sysvar::XCP::RadarFC::_g_PER_Hil_ObjBypassingRunnable_ObjBypassingRunnable_m_pad_radarObjPort_par_out_local::TChangeableMemPool::_::_::_m_arrayPool::_0_::_elem::_m_objectInformation::_3_::_m_perObjectType::_m_prob1ObstUnknownN = 0;
      @sysvar::XCP::RadarFC::_g_PER_Hil_ObjBypassingRunnable_ObjBypassingRunnable_m_pad_radarObjPort_par_out_local::TChangeableMemPool::_::_::_m_arrayPool::_0_::_elem::_m_objectInformation::_3_::_m_perObjectType::_m_prob1FourPlusWheelerN = 0;
      @sysvar::XCP::RadarFC::_g_PER_Hil_ObjBypassingRunnable_ObjBypassingRunnable_m_pad_radarObjPort_par_out_local::TChangeableMemPool::_::_::_m_arrayPool::_0_::_elem::_m_objectInformation::_3_::_m_perObjectType::_m_prob1TwoWheelerN = 0;
      @sysvar::XCP::RadarFC::_g_PER_Hil_ObjBypassingRunnable_ObjBypassingRunnable_m_pad_radarObjPort_par_out_local::TChangeableMemPool::_::_::_m_arrayPool::_0_::_elem::_m_objectInformation::_3_::_m_perObjectType::_m_prob1PedestrianN = 0;
      @sysvar::XCP::RadarFC::_g_PER_Hil_ObjBypassingRunnable_ObjBypassingRunnable_m_pad_radarObjPort_par_out_local::TChangeableMemPool::_::_::_m_arrayPool::_0_::_elem::_m_objectInformation::_3_::_m_perObjectType::_m_prob1MovUnknownN = 128;
      @sysvar::XCP::RadarFC::_g_PER_Hil_ObjBypassingRunnable_ObjBypassingRunnable_m_pad_radarObjPort_par_out_local::TChangeableMemPool::_::_::_m_arrayPool::_0_::_elem::_m_objectInformation::_3_::_m_perObjectType::_m_prob1RoadsideBarrierN = 0;
      @sysvar::XCP::RadarFC::_g_PER_Hil_ObjBypassingRunnable_ObjBypassingRunnable_m_pad_radarObjPort_par_out_local::TChangeableMemPool::_::_::_m_arrayPool::_0_::_elem::_m_objectInformation::_3_::_m_perObjectType::_m_prob1StatUnknownN = 128;
      @sysvar::XCP::RadarFC::_g_PER_Hil_ObjBypassingRunnable_ObjBypassingRunnable_m_pad_radarObjPort_par_out_local::TChangeableMemPool::_::_::_m_arrayPool::_0_::_elem::_m_objectInformation::_3_::_m_perObjectType::_m_prob1PassengerCarN = 0;
      @sysvar::XCP::RadarFC::_g_PER_Hil_ObjBypassingRunnable_ObjBypassingRunnable_m_pad_radarObjPort_par_out_local::TChangeableMemPool::_::_::_m_arrayPool::_0_::_elem::_m_objectInformation::_3_::_m_perObjectType::_m_prob1TruckN = 0;
      @sysvar::XCP::RadarFC::_g_PER_Hil_ObjBypassingRunnable_ObjBypassingRunnable_m_pad_radarObjPort_par_out_local::TChangeableMemPool::_::_::_m_arrayPool::_0_::_elem::_m_objectInformation::_3_::_m_perObjectType::_m_prob1FourWheelUnknownN = 128;
      @sysvar::XCP::RadarFC::_g_PER_Hil_ObjBypassingRunnable_ObjBypassingRunnable_m_pad_radarObjPort_par_out_local::TChangeableMemPool::_::_::_m_arrayPool::_0_::_elem::_m_objectInformation::_3_::_m_dWidthN = 256;
          break;

      case 7: //"RoadSideBarrier"
      @sysvar::XCP::RadarFC::_g_PER_Hil_ObjBypassingRunnable_ObjBypassingRunnable_m_pad_radarObjPort_par_out_local::TChangeableMemPool::_::_::_m_arrayPool::_0_::_elem::_m_objectInformation::_3_::_m_perObjectType::_m_prob1ObstacleN = 128;
      @sysvar::XCP::RadarFC::_g_PER_Hil_ObjBypassingRunnable_ObjBypassingRunnable_m_pad_radarObjPort_par_out_local::TChangeableMemPool::_::_::_m_arrayPool::_0_::_elem::_m_objectInformation::_3_::_m_perObjectType::_m_prob1NonObstacleN = 0;
      @sysvar::XCP::RadarFC::_g_PER_Hil_ObjBypassingRunnable_ObjBypassingRunnable_m_pad_radarObjPort_par_out_local::TChangeableMemPool::_::_::_m_arrayPool::_0_::_elem::_m_objectInformation::_3_::_m_perObjectType::_m_prob1UnknownN = 0;
      @sysvar::XCP::RadarFC::_g_PER_Hil_ObjBypassingRunnable_ObjBypassingRunnable_m_pad_radarObjPort_par_out_local::TChangeableMemPool::_::_::_m_arrayPool::_0_::_elem::_m_objectInformation::_3_::_m_perObjectType::_m_prob1MobileN = 0;
      @sysvar::XCP::RadarFC::_g_PER_Hil_ObjBypassingRunnable_ObjBypassingRunnable_m_pad_radarObjPort_par_out_local::TChangeableMemPool::_::_::_m_arrayPool::_0_::_elem::_m_objectInformation::_3_::_m_perObjectType::_m_prob1StationaryN = 128;
      @sysvar::XCP::RadarFC::_g_PER_Hil_ObjBypassingRunnable_ObjBypassingRunnable_m_pad_radarObjPort_par_out_local::TChangeableMemPool::_::_::_m_arrayPool::_0_::_elem::_m_objectInformation::_3_::_m_perObjectType::_m_prob1ObstUnknownN = 0;
      @sysvar::XCP::RadarFC::_g_PER_Hil_ObjBypassingRunnable_ObjBypassingRunnable_m_pad_radarObjPort_par_out_local::TChangeableMemPool::_::_::_m_arrayPool::_0_::_elem::_m_objectInformation::_3_::_m_perObjectType::_m_prob1FourPlusWheelerN = 0;
      @sysvar::XCP::RadarFC::_g_PER_Hil_ObjBypassingRunnable_ObjBypassingRunnable_m_pad_radarObjPort_par_out_local::TChangeableMemPool::_::_::_m_arrayPool::_0_::_elem::_m_objectInformation::_3_::_m_perObjectType::_m_prob1TwoWheelerN = 0;
      @sysvar::XCP::RadarFC::_g_PER_Hil_ObjBypassingRunnable_ObjBypassingRunnable_m_pad_radarObjPort_par_out_local::TChangeableMemPool::_::_::_m_arrayPool::_0_::_elem::_m_objectInformation::_3_::_m_perObjectType::_m_prob1PedestrianN = 0;
      @sysvar::XCP::RadarFC::_g_PER_Hil_ObjBypassingRunnable_ObjBypassingRunnable_m_pad_radarObjPort_par_out_local::TChangeableMemPool::_::_::_m_arrayPool::_0_::_elem::_m_objectInformation::_3_::_m_perObjectType::_m_prob1MovUnknownN = 128;
      @sysvar::XCP::RadarFC::_g_PER_Hil_ObjBypassingRunnable_ObjBypassingRunnable_m_pad_radarObjPort_par_out_local::TChangeableMemPool::_::_::_m_arrayPool::_0_::_elem::_m_objectInformation::_3_::_m_perObjectType::_m_prob1RoadsideBarrierN = 128;
      @sysvar::XCP::RadarFC::_g_PER_Hil_ObjBypassingRunnable_ObjBypassingRunnable_m_pad_radarObjPort_par_out_local::TChangeableMemPool::_::_::_m_arrayPool::_0_::_elem::_m_objectInformation::_3_::_m_perObjectType::_m_prob1StatUnknownN = 0;
      @sysvar::XCP::RadarFC::_g_PER_Hil_ObjBypassingRunnable_ObjBypassingRunnable_m_pad_radarObjPort_par_out_local::TChangeableMemPool::_::_::_m_arrayPool::_0_::_elem::_m_objectInformation::_3_::_m_perObjectType::_m_prob1PassengerCarN = 0;
      @sysvar::XCP::RadarFC::_g_PER_Hil_ObjBypassingRunnable_ObjBypassingRunnable_m_pad_radarObjPort_par_out_local::TChangeableMemPool::_::_::_m_arrayPool::_0_::_elem::_m_objectInformation::_3_::_m_perObjectType::_m_prob1TruckN = 0;
      @sysvar::XCP::RadarFC::_g_PER_Hil_ObjBypassingRunnable_ObjBypassingRunnable_m_pad_radarObjPort_par_out_local::TChangeableMemPool::_::_::_m_arrayPool::_0_::_elem::_m_objectInformation::_3_::_m_perObjectType::_m_prob1FourWheelUnknownN = 128;
      @sysvar::XCP::RadarFC::_g_PER_Hil_ObjBypassingRunnable_ObjBypassingRunnable_m_pad_radarObjPort_par_out_local::TChangeableMemPool::_::_::_m_arrayPool::_0_::_elem::_m_objectInformation::_3_::_m_dWidthN = 256;
          break;
      }
      break;

    case 4: //"Object-4"
    //constant
  @sysvar::XCP::RadarFC::_g_PER_Hil_ObjBypassingRunnable_ObjBypassingRunnable_m_pad_radarObjPort_par_out_local::TChangeableMemPool::_::_::_m_arrayPool::_0_::_elem::_m_objectInformation::_4_::_Valid_b = 1;
  @sysvar::XCP::RadarFC::_g_PER_Hil_ObjBypassingRunnable_ObjBypassingRunnable_m_pad_radarObjPort_par_out_local::TChangeableMemPool::_::_::_m_arrayPool::_0_::_elem::_m_objectInformation::_4_::_m_HandleN = 1;
  @sysvar::XCP::RadarFC::_g_PER_Hil_ObjBypassingRunnable_ObjBypassingRunnable_m_pad_radarObjPort_par_out_local::TChangeableMemPool::_::_::_m_arrayPool::_0_::_elem::_m_objectInformation::_4_::_m_alpPiVarYawAngleN = 0;
  @sysvar::XCP::RadarFC::_g_PER_Hil_ObjBypassingRunnable_ObjBypassingRunnable_m_pad_radarObjPort_par_out_local::TChangeableMemPool::_::_::_m_arrayPool::_0_::_elem::_m_objectInformation::_4_::_m_alpPiYawAngleN = 0;
  @sysvar::XCP::RadarFC::_g_PER_Hil_ObjBypassingRunnable_ObjBypassingRunnable_m_pad_radarObjPort_par_out_local::TChangeableMemPool::_::_::_m_arrayPool::_0_::_elem::_m_objectInformation::_4_::_m_varAxN = 0;
  @sysvar::XCP::RadarFC::_g_PER_Hil_ObjBypassingRunnable_ObjBypassingRunnable_m_pad_radarObjPort_par_out_local::TChangeableMemPool::_::_::_m_arrayPool::_0_::_elem::_m_objectInformation::_4_::_m_varAyN = 0;
  @sysvar::XCP::RadarFC::_g_PER_Hil_ObjBypassingRunnable_ObjBypassingRunnable_m_pad_radarObjPort_par_out_local::TChangeableMemPool::_::_::_m_arrayPool::_0_::_elem::_m_objectInformation::_4_::_m_varVxN = 0;
  @sysvar::XCP::RadarFC::_g_PER_Hil_ObjBypassingRunnable_ObjBypassingRunnable_m_pad_radarObjPort_par_out_local::TChangeableMemPool::_::_::_m_arrayPool::_0_::_elem::_m_objectInformation::_4_::_m_varVyN = 0;
  @sysvar::XCP::RadarFC::_g_PER_Hil_ObjBypassingRunnable_ObjBypassingRunnable_m_pad_radarObjPort_par_out_local::TChangeableMemPool::_::_::_m_arrayPool::_0_::_elem::_m_objectInformation::_4_::_m_varDxN = 0;
  @sysvar::XCP::RadarFC::_g_PER_Hil_ObjBypassingRunnable_ObjBypassingRunnable_m_pad_radarObjPort_par_out_local::TChangeableMemPool::_::_::_m_arrayPool::_0_::_elem::_m_objectInformation::_4_::_m_varDyN = 0;
  @sysvar::XCP::RadarFC::_g_PER_Hil_ObjBypassingRunnable_ObjBypassingRunnable_m_pad_radarObjPort_par_out_local::TChangeableMemPool::_::_::_m_arrayPool::_0_::_elem::_m_objectInformation::_4_::_m_dVarLengthN = 0;
  @sysvar::XCP::RadarFC::_g_PER_Hil_ObjBypassingRunnable_ObjBypassingRunnable_m_pad_radarObjPort_par_out_local::TChangeableMemPool::_::_::_m_arrayPool::_0_::_elem::_m_objectInformation::_4_::_m_dVarWidthN = 0;
  @sysvar::XCP::RadarFC::_g_PER_Hil_ObjBypassingRunnable_ObjBypassingRunnable_m_pad_radarObjPort_par_out_local::TChangeableMemPool::_::_::_m_arrayPool::_0_::_elem::_m_objectInformation::_4_::_m_wExistProbN = 64880;
  @sysvar::XCP::RadarFC::_g_PER_Hil_ObjBypassingRunnable_ObjBypassingRunnable_m_pad_radarObjPort_par_out_local::TChangeableMemPool::_::_::_m_arrayPool::_0_::_elem::_m_objectInformation::_4_::_m_isObjectAsil = 1;
  @sysvar::XCP::RadarFC::_g_PER_Hil_ObjBypassingRunnable_ObjBypassingRunnable_m_pad_radarObjPort_par_out_local::TChangeableMemPool::_::_::_m_arrayPool::_0_::_elem::_m_objectInformation::_4_::_m_dLengthN = 128;

      //target movement

  @sysvar::XCP::RadarFC::_g_PER_Hil_ObjBypassingRunnable_ObjBypassingRunnable_m_pad_radarObjPort_par_out_local::TChangeableMemPool::_::_::_m_arrayPool::_0_::_elem::_m_objectInformation::_4_::_m_dxN = @FDX_in_HIL_specific_FRadar_Obj::FDX_in_FRadar_4_m_dxN;
  @sysvar::XCP::RadarFC::_g_PER_Hil_ObjBypassingRunnable_ObjBypassingRunnable_m_pad_radarObjPort_par_out_local::TChangeableMemPool::_::_::_m_arrayPool::_0_::_elem::_m_objectInformation::_4_::_m_dyN = @FDX_in_HIL_specific_FRadar_Obj::FDX_in_FRadar_4_m_dyN;
  @sysvar::XCP::RadarFC::_g_PER_Hil_ObjBypassingRunnable_ObjBypassingRunnable_m_pad_radarObjPort_par_out_local::TChangeableMemPool::_::_::_m_arrayPool::_0_::_elem::_m_objectInformation::_4_::_m_dzN = @FDX_in_HIL_specific_FRadar_Obj::FDX_in_FRadar_4_m_dzN;
  @sysvar::XCP::RadarFC::_g_PER_Hil_ObjBypassingRunnable_ObjBypassingRunnable_m_pad_radarObjPort_par_out_local::TChangeableMemPool::_::_::_m_arrayPool::_0_::_elem::_m_objectInformation::_4_::_m_vxN = @FDX_in_HIL_specific_FRadar_Obj::FDX_in_FRadar_4_m_vxN;
  @sysvar::XCP::RadarFC::_g_PER_Hil_ObjBypassingRunnable_ObjBypassingRunnable_m_pad_radarObjPort_par_out_local::TChangeableMemPool::_::_::_m_arrayPool::_0_::_elem::_m_objectInformation::_4_::_m_vyN = @FDX_in_HIL_specific_FRadar_Obj::FDX_in_FRadar_4_m_vyN;
  @sysvar::XCP::RadarFC::_g_PER_Hil_ObjBypassingRunnable_ObjBypassingRunnable_m_pad_radarObjPort_par_out_local::TChangeableMemPool::_::_::_m_arrayPool::_0_::_elem::_m_objectInformation::_4_::_m_axN = @FDX_in_HIL_specific_FRadar_Obj::FDX_in_FRadar_4_m_axN;
  @sysvar::XCP::RadarFC::_g_PER_Hil_ObjBypassingRunnable_ObjBypassingRunnable_m_pad_radarObjPort_par_out_local::TChangeableMemPool::_::_::_m_arrayPool::_0_::_elem::_m_objectInformation::_4_::_m_ayN = @FDX_in_HIL_specific_FRadar_Obj::FDX_in_FRadar_4_m_ayN;
  @sysvar::XCP::RadarFC::_g_PER_Hil_ObjBypassingRunnable_ObjBypassingRunnable_m_pad_radarObjPort_par_out_local::TChangeableMemPool::_::_::_m_arrayPool::_0_::_elem::_m_objectInformation::_4_::_m_dLengthN = @FDX_in_HIL_specific_FRadar_Obj::FDX_in_FRadar_4_m_dLengthN;
  @sysvar::XCP::RadarFC::_g_PER_Hil_ObjBypassingRunnable_ObjBypassingRunnable_m_pad_radarObjPort_par_out_local::TChangeableMemPool::_::_::_m_arrayPool::_0_::_elem::_m_objectInformation::_4_::_m_dWidthN = @FDX_in_HIL_specific_FRadar_Obj::FDX_in_FRadar_4_m_dWidthN;
  @sysvar::XCP::RadarFC::_g_PER_Hil_ObjBypassingRunnable_ObjBypassingRunnable_m_pad_radarObjPort_par_out_local::TChangeableMemPool::_::_::_m_arrayPool::_0_::_elem::_m_objectInformation::_4_::_m_alpPiYawAngleN = @FDX_in_HIL_specific_FRadar_Obj::FDX_in_FRadar_4_m_alpPiYawAngleN;

      //target object moving or not
      if (abs(@FDX_in_HIL_specific_FRadar_Obj::FDX_in_FRadar_4_m_vxN) != 0)
      {
    @sysvar::XCP::RadarFC::_g_PER_Hil_ObjBypassingRunnable_ObjBypassingRunnable_m_pad_radarObjPort_par_out_local::TChangeableMemPool::_::_::_m_arrayPool::_0_::_elem::_m_objectInformation::_4_::_m_prob1HasBeenObservedMovingN = 126;
    @sysvar::XCP::RadarFC::_g_PER_Hil_ObjBypassingRunnable_ObjBypassingRunnable_m_pad_radarObjPort_par_out_local::TChangeableMemPool::_::_::_m_arrayPool::_0_::_elem::_m_objectInformation::_4_::_m_prob1MovingN = 126;
      }
      else
      {
    @sysvar::XCP::RadarFC::_g_PER_Hil_ObjBypassingRunnable_ObjBypassingRunnable_m_pad_radarObjPort_par_out_local::TChangeableMemPool::_::_::_m_arrayPool::_0_::_elem::_m_objectInformation::_4_::_m_prob1HasBeenObservedMovingN = 0;
    @sysvar::XCP::RadarFC::_g_PER_Hil_ObjBypassingRunnable_ObjBypassingRunnable_m_pad_radarObjPort_par_out_local::TChangeableMemPool::_::_::_m_arrayPool::_0_::_elem::_m_objectInformation::_4_::_m_prob1MovingN = 0;
      }

      //object classification
    switch (@FDX_in_HIL_specific_FRadar_Obj::FDX_in_FRadar_4_Sensed_Object_Classification)
    {
      case 0: //"unknown"
      @sysvar::XCP::RadarFC::_g_PER_Hil_ObjBypassingRunnable_ObjBypassingRunnable_m_pad_radarObjPort_par_out_local::TChangeableMemPool::_::_::_m_arrayPool::_0_::_elem::_m_objectInformation::_4_::_m_perObjectType::_m_prob1ObstacleN = 0;
      @sysvar::XCP::RadarFC::_g_PER_Hil_ObjBypassingRunnable_ObjBypassingRunnable_m_pad_radarObjPort_par_out_local::TChangeableMemPool::_::_::_m_arrayPool::_0_::_elem::_m_objectInformation::_4_::_m_perObjectType::_m_prob1NonObstacleN = 0;
      @sysvar::XCP::RadarFC::_g_PER_Hil_ObjBypassingRunnable_ObjBypassingRunnable_m_pad_radarObjPort_par_out_local::TChangeableMemPool::_::_::_m_arrayPool::_0_::_elem::_m_objectInformation::_4_::_m_perObjectType::_m_prob1UnknownN = 128;
      @sysvar::XCP::RadarFC::_g_PER_Hil_ObjBypassingRunnable_ObjBypassingRunnable_m_pad_radarObjPort_par_out_local::TChangeableMemPool::_::_::_m_arrayPool::_0_::_elem::_m_objectInformation::_4_::_m_perObjectType::_m_prob1MobileN = 0;
      @sysvar::XCP::RadarFC::_g_PER_Hil_ObjBypassingRunnable_ObjBypassingRunnable_m_pad_radarObjPort_par_out_local::TChangeableMemPool::_::_::_m_arrayPool::_0_::_elem::_m_objectInformation::_4_::_m_perObjectType::_m_prob1StationaryN = 0;
      @sysvar::XCP::RadarFC::_g_PER_Hil_ObjBypassingRunnable_ObjBypassingRunnable_m_pad_radarObjPort_par_out_local::TChangeableMemPool::_::_::_m_arrayPool::_0_::_elem::_m_objectInformation::_4_::_m_perObjectType::_m_prob1ObstUnknownN = 128;
      @sysvar::XCP::RadarFC::_g_PER_Hil_ObjBypassingRunnable_ObjBypassingRunnable_m_pad_radarObjPort_par_out_local::TChangeableMemPool::_::_::_m_arrayPool::_0_::_elem::_m_objectInformation::_4_::_m_perObjectType::_m_prob1FourPlusWheelerN = 0;
      @sysvar::XCP::RadarFC::_g_PER_Hil_ObjBypassingRunnable_ObjBypassingRunnable_m_pad_radarObjPort_par_out_local::TChangeableMemPool::_::_::_m_arrayPool::_0_::_elem::_m_objectInformation::_4_::_m_perObjectType::_m_prob1TwoWheelerN = 0;
      @sysvar::XCP::RadarFC::_g_PER_Hil_ObjBypassingRunnable_ObjBypassingRunnable_m_pad_radarObjPort_par_out_local::TChangeableMemPool::_::_::_m_arrayPool::_0_::_elem::_m_objectInformation::_4_::_m_perObjectType::_m_prob1PedestrianN = 0;
      @sysvar::XCP::RadarFC::_g_PER_Hil_ObjBypassingRunnable_ObjBypassingRunnable_m_pad_radarObjPort_par_out_local::TChangeableMemPool::_::_::_m_arrayPool::_0_::_elem::_m_objectInformation::_4_::_m_perObjectType::_m_prob1MovUnknownN = 128;
      @sysvar::XCP::RadarFC::_g_PER_Hil_ObjBypassingRunnable_ObjBypassingRunnable_m_pad_radarObjPort_par_out_local::TChangeableMemPool::_::_::_m_arrayPool::_0_::_elem::_m_objectInformation::_4_::_m_perObjectType::_m_prob1RoadsideBarrierN = 0;
      @sysvar::XCP::RadarFC::_g_PER_Hil_ObjBypassingRunnable_ObjBypassingRunnable_m_pad_radarObjPort_par_out_local::TChangeableMemPool::_::_::_m_arrayPool::_0_::_elem::_m_objectInformation::_4_::_m_perObjectType::_m_prob1StatUnknownN = 128;
      @sysvar::XCP::RadarFC::_g_PER_Hil_ObjBypassingRunnable_ObjBypassingRunnable_m_pad_radarObjPort_par_out_local::TChangeableMemPool::_::_::_m_arrayPool::_0_::_elem::_m_objectInformation::_4_::_m_perObjectType::_m_prob1PassengerCarN = 0;
      @sysvar::XCP::RadarFC::_g_PER_Hil_ObjBypassingRunnable_ObjBypassingRunnable_m_pad_radarObjPort_par_out_local::TChangeableMemPool::_::_::_m_arrayPool::_0_::_elem::_m_objectInformation::_4_::_m_perObjectType::_m_prob1TruckN = 0;
      @sysvar::XCP::RadarFC::_g_PER_Hil_ObjBypassingRunnable_ObjBypassingRunnable_m_pad_radarObjPort_par_out_local::TChangeableMemPool::_::_::_m_arrayPool::_0_::_elem::_m_objectInformation::_4_::_m_perObjectType::_m_prob1FourWheelUnknownN = 128;
      @sysvar::XCP::RadarFC::_g_PER_Hil_ObjBypassingRunnable_ObjBypassingRunnable_m_pad_radarObjPort_par_out_local::TChangeableMemPool::_::_::_m_arrayPool::_0_::_elem::_m_objectInformation::_4_::_m_dWidthN = 256;
          break;

      case 1: //"Pedestrian"
      @sysvar::XCP::RadarFC::_g_PER_Hil_ObjBypassingRunnable_ObjBypassingRunnable_m_pad_radarObjPort_par_out_local::TChangeableMemPool::_::_::_m_arrayPool::_0_::_elem::_m_objectInformation::_4_::_m_perObjectType::_m_prob1ObstacleN = 128;
      @sysvar::XCP::RadarFC::_g_PER_Hil_ObjBypassingRunnable_ObjBypassingRunnable_m_pad_radarObjPort_par_out_local::TChangeableMemPool::_::_::_m_arrayPool::_0_::_elem::_m_objectInformation::_4_::_m_perObjectType::_m_prob1NonObstacleN = 0;
      @sysvar::XCP::RadarFC::_g_PER_Hil_ObjBypassingRunnable_ObjBypassingRunnable_m_pad_radarObjPort_par_out_local::TChangeableMemPool::_::_::_m_arrayPool::_0_::_elem::_m_objectInformation::_4_::_m_perObjectType::_m_prob1UnknownN = 0;
      @sysvar::XCP::RadarFC::_g_PER_Hil_ObjBypassingRunnable_ObjBypassingRunnable_m_pad_radarObjPort_par_out_local::TChangeableMemPool::_::_::_m_arrayPool::_0_::_elem::_m_objectInformation::_4_::_m_perObjectType::_m_prob1MobileN = 128;
      @sysvar::XCP::RadarFC::_g_PER_Hil_ObjBypassingRunnable_ObjBypassingRunnable_m_pad_radarObjPort_par_out_local::TChangeableMemPool::_::_::_m_arrayPool::_0_::_elem::_m_objectInformation::_4_::_m_perObjectType::_m_prob1StationaryN = 0;
      @sysvar::XCP::RadarFC::_g_PER_Hil_ObjBypassingRunnable_ObjBypassingRunnable_m_pad_radarObjPort_par_out_local::TChangeableMemPool::_::_::_m_arrayPool::_0_::_elem::_m_objectInformation::_4_::_m_perObjectType::_m_prob1ObstUnknownN = 0;
      @sysvar::XCP::RadarFC::_g_PER_Hil_ObjBypassingRunnable_ObjBypassingRunnable_m_pad_radarObjPort_par_out_local::TChangeableMemPool::_::_::_m_arrayPool::_0_::_elem::_m_objectInformation::_4_::_m_perObjectType::_m_prob1FourPlusWheelerN = 0;
      @sysvar::XCP::RadarFC::_g_PER_Hil_ObjBypassingRunnable_ObjBypassingRunnable_m_pad_radarObjPort_par_out_local::TChangeableMemPool::_::_::_m_arrayPool::_0_::_elem::_m_objectInformation::_4_::_m_perObjectType::_m_prob1TwoWheelerN = 0;
      @sysvar::XCP::RadarFC::_g_PER_Hil_ObjBypassingRunnable_ObjBypassingRunnable_m_pad_radarObjPort_par_out_local::TChangeableMemPool::_::_::_m_arrayPool::_0_::_elem::_m_objectInformation::_4_::_m_perObjectType::_m_prob1PedestrianN = 128;
      @sysvar::XCP::RadarFC::_g_PER_Hil_ObjBypassingRunnable_ObjBypassingRunnable_m_pad_radarObjPort_par_out_local::TChangeableMemPool::_::_::_m_arrayPool::_0_::_elem::_m_objectInformation::_4_::_m_perObjectType::_m_prob1MovUnknownN = 0;
      @sysvar::XCP::RadarFC::_g_PER_Hil_ObjBypassingRunnable_ObjBypassingRunnable_m_pad_radarObjPort_par_out_local::TChangeableMemPool::_::_::_m_arrayPool::_0_::_elem::_m_objectInformation::_4_::_m_perObjectType::_m_prob1RoadsideBarrierN = 0;
      @sysvar::XCP::RadarFC::_g_PER_Hil_ObjBypassingRunnable_ObjBypassingRunnable_m_pad_radarObjPort_par_out_local::TChangeableMemPool::_::_::_m_arrayPool::_0_::_elem::_m_objectInformation::_4_::_m_perObjectType::_m_prob1StatUnknownN = 128;
      @sysvar::XCP::RadarFC::_g_PER_Hil_ObjBypassingRunnable_ObjBypassingRunnable_m_pad_radarObjPort_par_out_local::TChangeableMemPool::_::_::_m_arrayPool::_0_::_elem::_m_objectInformation::_4_::_m_perObjectType::_m_prob1PassengerCarN = 0;
      @sysvar::XCP::RadarFC::_g_PER_Hil_ObjBypassingRunnable_ObjBypassingRunnable_m_pad_radarObjPort_par_out_local::TChangeableMemPool::_::_::_m_arrayPool::_0_::_elem::_m_objectInformation::_4_::_m_perObjectType::_m_prob1TruckN = 0;
      @sysvar::XCP::RadarFC::_g_PER_Hil_ObjBypassingRunnable_ObjBypassingRunnable_m_pad_radarObjPort_par_out_local::TChangeableMemPool::_::_::_m_arrayPool::_0_::_elem::_m_objectInformation::_4_::_m_perObjectType::_m_prob1FourWheelUnknownN = 128;
      @sysvar::XCP::RadarFC::_g_PER_Hil_ObjBypassingRunnable_ObjBypassingRunnable_m_pad_radarObjPort_par_out_local::TChangeableMemPool::_::_::_m_arrayPool::_0_::_elem::_m_objectInformation::_4_::_m_dWidthN = 64;
          break;

      case 2: //"2Wheeler::Cloe-> Bike"
      @sysvar::XCP::RadarFC::_g_PER_Hil_ObjBypassingRunnable_ObjBypassingRunnable_m_pad_radarObjPort_par_out_local::TChangeableMemPool::_::_::_m_arrayPool::_0_::_elem::_m_objectInformation::_4_::_m_perObjectType::_m_prob1ObstacleN = 128;
      @sysvar::XCP::RadarFC::_g_PER_Hil_ObjBypassingRunnable_ObjBypassingRunnable_m_pad_radarObjPort_par_out_local::TChangeableMemPool::_::_::_m_arrayPool::_0_::_elem::_m_objectInformation::_4_::_m_perObjectType::_m_prob1NonObstacleN = 0;
      @sysvar::XCP::RadarFC::_g_PER_Hil_ObjBypassingRunnable_ObjBypassingRunnable_m_pad_radarObjPort_par_out_local::TChangeableMemPool::_::_::_m_arrayPool::_0_::_elem::_m_objectInformation::_4_::_m_perObjectType::_m_prob1UnknownN = 0;
      @sysvar::XCP::RadarFC::_g_PER_Hil_ObjBypassingRunnable_ObjBypassingRunnable_m_pad_radarObjPort_par_out_local::TChangeableMemPool::_::_::_m_arrayPool::_0_::_elem::_m_objectInformation::_4_::_m_perObjectType::_m_prob1MobileN = 128;
      @sysvar::XCP::RadarFC::_g_PER_Hil_ObjBypassingRunnable_ObjBypassingRunnable_m_pad_radarObjPort_par_out_local::TChangeableMemPool::_::_::_m_arrayPool::_0_::_elem::_m_objectInformation::_4_::_m_perObjectType::_m_prob1StationaryN = 0;
      @sysvar::XCP::RadarFC::_g_PER_Hil_ObjBypassingRunnable_ObjBypassingRunnable_m_pad_radarObjPort_par_out_local::TChangeableMemPool::_::_::_m_arrayPool::_0_::_elem::_m_objectInformation::_4_::_m_perObjectType::_m_prob1ObstUnknownN = 0;
      @sysvar::XCP::RadarFC::_g_PER_Hil_ObjBypassingRunnable_ObjBypassingRunnable_m_pad_radarObjPort_par_out_local::TChangeableMemPool::_::_::_m_arrayPool::_0_::_elem::_m_objectInformation::_4_::_m_perObjectType::_m_prob1FourPlusWheelerN = 0;
      @sysvar::XCP::RadarFC::_g_PER_Hil_ObjBypassingRunnable_ObjBypassingRunnable_m_pad_radarObjPort_par_out_local::TChangeableMemPool::_::_::_m_arrayPool::_0_::_elem::_m_objectInformation::_4_::_m_perObjectType::_m_prob1TwoWheelerN = 128;
      @sysvar::XCP::RadarFC::_g_PER_Hil_ObjBypassingRunnable_ObjBypassingRunnable_m_pad_radarObjPort_par_out_local::TChangeableMemPool::_::_::_m_arrayPool::_0_::_elem::_m_objectInformation::_4_::_m_perObjectType::_m_prob1PedestrianN = 0;
      @sysvar::XCP::RadarFC::_g_PER_Hil_ObjBypassingRunnable_ObjBypassingRunnable_m_pad_radarObjPort_par_out_local::TChangeableMemPool::_::_::_m_arrayPool::_0_::_elem::_m_objectInformation::_4_::_m_perObjectType::_m_prob1MovUnknownN = 0;
      @sysvar::XCP::RadarFC::_g_PER_Hil_ObjBypassingRunnable_ObjBypassingRunnable_m_pad_radarObjPort_par_out_local::TChangeableMemPool::_::_::_m_arrayPool::_0_::_elem::_m_objectInformation::_4_::_m_perObjectType::_m_prob1RoadsideBarrierN = 0;
      @sysvar::XCP::RadarFC::_g_PER_Hil_ObjBypassingRunnable_ObjBypassingRunnable_m_pad_radarObjPort_par_out_local::TChangeableMemPool::_::_::_m_arrayPool::_0_::_elem::_m_objectInformation::_4_::_m_perObjectType::_m_prob1StatUnknownN = 128;
      @sysvar::XCP::RadarFC::_g_PER_Hil_ObjBypassingRunnable_ObjBypassingRunnable_m_pad_radarObjPort_par_out_local::TChangeableMemPool::_::_::_m_arrayPool::_0_::_elem::_m_objectInformation::_4_::_m_perObjectType::_m_prob1PassengerCarN = 0;
      @sysvar::XCP::RadarFC::_g_PER_Hil_ObjBypassingRunnable_ObjBypassingRunnable_m_pad_radarObjPort_par_out_local::TChangeableMemPool::_::_::_m_arrayPool::_0_::_elem::_m_objectInformation::_4_::_m_perObjectType::_m_prob1TruckN = 0;
      @sysvar::XCP::RadarFC::_g_PER_Hil_ObjBypassingRunnable_ObjBypassingRunnable_m_pad_radarObjPort_par_out_local::TChangeableMemPool::_::_::_m_arrayPool::_0_::_elem::_m_objectInformation::_4_::_m_perObjectType::_m_prob1FourWheelUnknownN = 128;
      @sysvar::XCP::RadarFC::_g_PER_Hil_ObjBypassingRunnable_ObjBypassingRunnable_m_pad_radarObjPort_par_out_local::TChangeableMemPool::_::_::_m_arrayPool::_0_::_elem::_m_objectInformation::_4_::_m_dWidthN = 64;
          break;

      case 3: //"2Wheeler::Cloe-> Motorbike"
      @sysvar::XCP::RadarFC::_g_PER_Hil_ObjBypassingRunnable_ObjBypassingRunnable_m_pad_radarObjPort_par_out_local::TChangeableMemPool::_::_::_m_arrayPool::_0_::_elem::_m_objectInformation::_4_::_m_perObjectType::_m_prob1ObstacleN = 128;
      @sysvar::XCP::RadarFC::_g_PER_Hil_ObjBypassingRunnable_ObjBypassingRunnable_m_pad_radarObjPort_par_out_local::TChangeableMemPool::_::_::_m_arrayPool::_0_::_elem::_m_objectInformation::_4_::_m_perObjectType::_m_prob1NonObstacleN = 0;
      @sysvar::XCP::RadarFC::_g_PER_Hil_ObjBypassingRunnable_ObjBypassingRunnable_m_pad_radarObjPort_par_out_local::TChangeableMemPool::_::_::_m_arrayPool::_0_::_elem::_m_objectInformation::_4_::_m_perObjectType::_m_prob1UnknownN = 0;
      @sysvar::XCP::RadarFC::_g_PER_Hil_ObjBypassingRunnable_ObjBypassingRunnable_m_pad_radarObjPort_par_out_local::TChangeableMemPool::_::_::_m_arrayPool::_0_::_elem::_m_objectInformation::_4_::_m_perObjectType::_m_prob1MobileN = 128;
      @sysvar::XCP::RadarFC::_g_PER_Hil_ObjBypassingRunnable_ObjBypassingRunnable_m_pad_radarObjPort_par_out_local::TChangeableMemPool::_::_::_m_arrayPool::_0_::_elem::_m_objectInformation::_4_::_m_perObjectType::_m_prob1StationaryN = 0;
      @sysvar::XCP::RadarFC::_g_PER_Hil_ObjBypassingRunnable_ObjBypassingRunnable_m_pad_radarObjPort_par_out_local::TChangeableMemPool::_::_::_m_arrayPool::_0_::_elem::_m_objectInformation::_4_::_m_perObjectType::_m_prob1ObstUnknownN = 0;
      @sysvar::XCP::RadarFC::_g_PER_Hil_ObjBypassingRunnable_ObjBypassingRunnable_m_pad_radarObjPort_par_out_local::TChangeableMemPool::_::_::_m_arrayPool::_0_::_elem::_m_objectInformation::_4_::_m_perObjectType::_m_prob1FourPlusWheelerN = 0;
      @sysvar::XCP::RadarFC::_g_PER_Hil_ObjBypassingRunnable_ObjBypassingRunnable_m_pad_radarObjPort_par_out_local::TChangeableMemPool::_::_::_m_arrayPool::_0_::_elem::_m_objectInformation::_4_::_m_perObjectType::_m_prob1TwoWheelerN = 128;
      @sysvar::XCP::RadarFC::_g_PER_Hil_ObjBypassingRunnable_ObjBypassingRunnable_m_pad_radarObjPort_par_out_local::TChangeableMemPool::_::_::_m_arrayPool::_0_::_elem::_m_objectInformation::_4_::_m_perObjectType::_m_prob1PedestrianN = 0;
      @sysvar::XCP::RadarFC::_g_PER_Hil_ObjBypassingRunnable_ObjBypassingRunnable_m_pad_radarObjPort_par_out_local::TChangeableMemPool::_::_::_m_arrayPool::_0_::_elem::_m_objectInformation::_4_::_m_perObjectType::_m_prob1MovUnknownN = 0;
      @sysvar::XCP::RadarFC::_g_PER_Hil_ObjBypassingRunnable_ObjBypassingRunnable_m_pad_radarObjPort_par_out_local::TChangeableMemPool::_::_::_m_arrayPool::_0_::_elem::_m_objectInformation::_4_::_m_perObjectType::_m_prob1RoadsideBarrierN = 0;
      @sysvar::XCP::RadarFC::_g_PER_Hil_ObjBypassingRunnable_ObjBypassingRunnable_m_pad_radarObjPort_par_out_local::TChangeableMemPool::_::_::_m_arrayPool::_0_::_elem::_m_objectInformation::_4_::_m_perObjectType::_m_prob1StatUnknownN = 128;
      @sysvar::XCP::RadarFC::_g_PER_Hil_ObjBypassingRunnable_ObjBypassingRunnable_m_pad_radarObjPort_par_out_local::TChangeableMemPool::_::_::_m_arrayPool::_0_::_elem::_m_objectInformation::_4_::_m_perObjectType::_m_prob1PassengerCarN = 0;
      @sysvar::XCP::RadarFC::_g_PER_Hil_ObjBypassingRunnable_ObjBypassingRunnable_m_pad_radarObjPort_par_out_local::TChangeableMemPool::_::_::_m_arrayPool::_0_::_elem::_m_objectInformation::_4_::_m_perObjectType::_m_prob1TruckN = 0;
      @sysvar::XCP::RadarFC::_g_PER_Hil_ObjBypassingRunnable_ObjBypassingRunnable_m_pad_radarObjPort_par_out_local::TChangeableMemPool::_::_::_m_arrayPool::_0_::_elem::_m_objectInformation::_4_::_m_perObjectType::_m_prob1FourWheelUnknownN = 128;
      @sysvar::XCP::RadarFC::_g_PER_Hil_ObjBypassingRunnable_ObjBypassingRunnable_m_pad_radarObjPort_par_out_local::TChangeableMemPool::_::_::_m_arrayPool::_0_::_elem::_m_objectInformation::_4_::_m_dWidthN = 64;
          break;

      case 4: //"PassengerCar"
      @sysvar::XCP::RadarFC::_g_PER_Hil_ObjBypassingRunnable_ObjBypassingRunnable_m_pad_radarObjPort_par_out_local::TChangeableMemPool::_::_::_m_arrayPool::_0_::_elem::_m_objectInformation::_4_::_m_perObjectType::_m_prob1ObstacleN = 128;
      @sysvar::XCP::RadarFC::_g_PER_Hil_ObjBypassingRunnable_ObjBypassingRunnable_m_pad_radarObjPort_par_out_local::TChangeableMemPool::_::_::_m_arrayPool::_0_::_elem::_m_objectInformation::_4_::_m_perObjectType::_m_prob1NonObstacleN = 0;
      @sysvar::XCP::RadarFC::_g_PER_Hil_ObjBypassingRunnable_ObjBypassingRunnable_m_pad_radarObjPort_par_out_local::TChangeableMemPool::_::_::_m_arrayPool::_0_::_elem::_m_objectInformation::_4_::_m_perObjectType::_m_prob1UnknownN = 0;
      @sysvar::XCP::RadarFC::_g_PER_Hil_ObjBypassingRunnable_ObjBypassingRunnable_m_pad_radarObjPort_par_out_local::TChangeableMemPool::_::_::_m_arrayPool::_0_::_elem::_m_objectInformation::_4_::_m_perObjectType::_m_prob1MobileN = 128;
      @sysvar::XCP::RadarFC::_g_PER_Hil_ObjBypassingRunnable_ObjBypassingRunnable_m_pad_radarObjPort_par_out_local::TChangeableMemPool::_::_::_m_arrayPool::_0_::_elem::_m_objectInformation::_4_::_m_perObjectType::_m_prob1StationaryN = 0;
      @sysvar::XCP::RadarFC::_g_PER_Hil_ObjBypassingRunnable_ObjBypassingRunnable_m_pad_radarObjPort_par_out_local::TChangeableMemPool::_::_::_m_arrayPool::_0_::_elem::_m_objectInformation::_4_::_m_perObjectType::_m_prob1ObstUnknownN = 0;
      @sysvar::XCP::RadarFC::_g_PER_Hil_ObjBypassingRunnable_ObjBypassingRunnable_m_pad_radarObjPort_par_out_local::TChangeableMemPool::_::_::_m_arrayPool::_0_::_elem::_m_objectInformation::_4_::_m_perObjectType::_m_prob1FourPlusWheelerN = 128;
      @sysvar::XCP::RadarFC::_g_PER_Hil_ObjBypassingRunnable_ObjBypassingRunnable_m_pad_radarObjPort_par_out_local::TChangeableMemPool::_::_::_m_arrayPool::_0_::_elem::_m_objectInformation::_4_::_m_perObjectType::_m_prob1TwoWheelerN = 0;
      @sysvar::XCP::RadarFC::_g_PER_Hil_ObjBypassingRunnable_ObjBypassingRunnable_m_pad_radarObjPort_par_out_local::TChangeableMemPool::_::_::_m_arrayPool::_0_::_elem::_m_objectInformation::_4_::_m_perObjectType::_m_prob1PedestrianN = 0;
      @sysvar::XCP::RadarFC::_g_PER_Hil_ObjBypassingRunnable_ObjBypassingRunnable_m_pad_radarObjPort_par_out_local::TChangeableMemPool::_::_::_m_arrayPool::_0_::_elem::_m_objectInformation::_4_::_m_perObjectType::_m_prob1MovUnknownN = 0;
      @sysvar::XCP::RadarFC::_g_PER_Hil_ObjBypassingRunnable_ObjBypassingRunnable_m_pad_radarObjPort_par_out_local::TChangeableMemPool::_::_::_m_arrayPool::_0_::_elem::_m_objectInformation::_4_::_m_perObjectType::_m_prob1RoadsideBarrierN = 0;
      @sysvar::XCP::RadarFC::_g_PER_Hil_ObjBypassingRunnable_ObjBypassingRunnable_m_pad_radarObjPort_par_out_local::TChangeableMemPool::_::_::_m_arrayPool::_0_::_elem::_m_objectInformation::_4_::_m_perObjectType::_m_prob1StatUnknownN = 128;
      @sysvar::XCP::RadarFC::_g_PER_Hil_ObjBypassingRunnable_ObjBypassingRunnable_m_pad_radarObjPort_par_out_local::TChangeableMemPool::_::_::_m_arrayPool::_0_::_elem::_m_objectInformation::_4_::_m_perObjectType::_m_prob1PassengerCarN = 128;
      @sysvar::XCP::RadarFC::_g_PER_Hil_ObjBypassingRunnable_ObjBypassingRunnable_m_pad_radarObjPort_par_out_local::TChangeableMemPool::_::_::_m_arrayPool::_0_::_elem::_m_objectInformation::_4_::_m_perObjectType::_m_prob1TruckN = 0;
      @sysvar::XCP::RadarFC::_g_PER_Hil_ObjBypassingRunnable_ObjBypassingRunnable_m_pad_radarObjPort_par_out_local::TChangeableMemPool::_::_::_m_arrayPool::_0_::_elem::_m_objectInformation::_4_::_m_perObjectType::_m_prob1FourWheelUnknownN = 0;
      @sysvar::XCP::RadarFC::_g_PER_Hil_ObjBypassingRunnable_ObjBypassingRunnable_m_pad_radarObjPort_par_out_local::TChangeableMemPool::_::_::_m_arrayPool::_0_::_elem::_m_objectInformation::_4_::_m_dWidthN = 256;
          break;

      case 5: //"Truck"
      @sysvar::XCP::RadarFC::_g_PER_Hil_ObjBypassingRunnable_ObjBypassingRunnable_m_pad_radarObjPort_par_out_local::TChangeableMemPool::_::_::_m_arrayPool::_0_::_elem::_m_objectInformation::_4_::_m_perObjectType::_m_prob1ObstacleN = 128;
      @sysvar::XCP::RadarFC::_g_PER_Hil_ObjBypassingRunnable_ObjBypassingRunnable_m_pad_radarObjPort_par_out_local::TChangeableMemPool::_::_::_m_arrayPool::_0_::_elem::_m_objectInformation::_4_::_m_perObjectType::_m_prob1NonObstacleN = 0;
      @sysvar::XCP::RadarFC::_g_PER_Hil_ObjBypassingRunnable_ObjBypassingRunnable_m_pad_radarObjPort_par_out_local::TChangeableMemPool::_::_::_m_arrayPool::_0_::_elem::_m_objectInformation::_4_::_m_perObjectType::_m_prob1UnknownN = 0;
      @sysvar::XCP::RadarFC::_g_PER_Hil_ObjBypassingRunnable_ObjBypassingRunnable_m_pad_radarObjPort_par_out_local::TChangeableMemPool::_::_::_m_arrayPool::_0_::_elem::_m_objectInformation::_4_::_m_perObjectType::_m_prob1MobileN = 128;
      @sysvar::XCP::RadarFC::_g_PER_Hil_ObjBypassingRunnable_ObjBypassingRunnable_m_pad_radarObjPort_par_out_local::TChangeableMemPool::_::_::_m_arrayPool::_0_::_elem::_m_objectInformation::_4_::_m_perObjectType::_m_prob1StationaryN = 0;
      @sysvar::XCP::RadarFC::_g_PER_Hil_ObjBypassingRunnable_ObjBypassingRunnable_m_pad_radarObjPort_par_out_local::TChangeableMemPool::_::_::_m_arrayPool::_0_::_elem::_m_objectInformation::_4_::_m_perObjectType::_m_prob1ObstUnknownN = 0;
      @sysvar::XCP::RadarFC::_g_PER_Hil_ObjBypassingRunnable_ObjBypassingRunnable_m_pad_radarObjPort_par_out_local::TChangeableMemPool::_::_::_m_arrayPool::_0_::_elem::_m_objectInformation::_4_::_m_perObjectType::_m_prob1FourPlusWheelerN = 128;
      @sysvar::XCP::RadarFC::_g_PER_Hil_ObjBypassingRunnable_ObjBypassingRunnable_m_pad_radarObjPort_par_out_local::TChangeableMemPool::_::_::_m_arrayPool::_0_::_elem::_m_objectInformation::_4_::_m_perObjectType::_m_prob1TwoWheelerN = 0;
      @sysvar::XCP::RadarFC::_g_PER_Hil_ObjBypassingRunnable_ObjBypassingRunnable_m_pad_radarObjPort_par_out_local::TChangeableMemPool::_::_::_m_arrayPool::_0_::_elem::_m_objectInformation::_4_::_m_perObjectType::_m_prob1PedestrianN = 0;
      @sysvar::XCP::RadarFC::_g_PER_Hil_ObjBypassingRunnable_ObjBypassingRunnable_m_pad_radarObjPort_par_out_local::TChangeableMemPool::_::_::_m_arrayPool::_0_::_elem::_m_objectInformation::_4_::_m_perObjectType::_m_prob1MovUnknownN = 0;
      @sysvar::XCP::RadarFC::_g_PER_Hil_ObjBypassingRunnable_ObjBypassingRunnable_m_pad_radarObjPort_par_out_local::TChangeableMemPool::_::_::_m_arrayPool::_0_::_elem::_m_objectInformation::_4_::_m_perObjectType::_m_prob1RoadsideBarrierN = 0;
      @sysvar::XCP::RadarFC::_g_PER_Hil_ObjBypassingRunnable_ObjBypassingRunnable_m_pad_radarObjPort_par_out_local::TChangeableMemPool::_::_::_m_arrayPool::_0_::_elem::_m_objectInformation::_4_::_m_perObjectType::_m_prob1StatUnknownN = 128;
      @sysvar::XCP::RadarFC::_g_PER_Hil_ObjBypassingRunnable_ObjBypassingRunnable_m_pad_radarObjPort_par_out_local::TChangeableMemPool::_::_::_m_arrayPool::_0_::_elem::_m_objectInformation::_4_::_m_perObjectType::_m_prob1PassengerCarN = 0;
      @sysvar::XCP::RadarFC::_g_PER_Hil_ObjBypassingRunnable_ObjBypassingRunnable_m_pad_radarObjPort_par_out_local::TChangeableMemPool::_::_::_m_arrayPool::_0_::_elem::_m_objectInformation::_4_::_m_perObjectType::_m_prob1TruckN = 128;
      @sysvar::XCP::RadarFC::_g_PER_Hil_ObjBypassingRunnable_ObjBypassingRunnable_m_pad_radarObjPort_par_out_local::TChangeableMemPool::_::_::_m_arrayPool::_0_::_elem::_m_objectInformation::_4_::_m_perObjectType::_m_prob1FourWheelUnknownN = 0;
      @sysvar::XCP::RadarFC::_g_PER_Hil_ObjBypassingRunnable_ObjBypassingRunnable_m_pad_radarObjPort_par_out_local::TChangeableMemPool::_::_::_m_arrayPool::_0_::_elem::_m_objectInformation::_4_::_m_dWidthN = 256;
          break;

      case 6: //"Non-Obstacle::Cloe->Trailer"
      @sysvar::XCP::RadarFC::_g_PER_Hil_ObjBypassingRunnable_ObjBypassingRunnable_m_pad_radarObjPort_par_out_local::TChangeableMemPool::_::_::_m_arrayPool::_0_::_elem::_m_objectInformation::_4_::_m_perObjectType::_m_prob1ObstacleN = 0;
      @sysvar::XCP::RadarFC::_g_PER_Hil_ObjBypassingRunnable_ObjBypassingRunnable_m_pad_radarObjPort_par_out_local::TChangeableMemPool::_::_::_m_arrayPool::_0_::_elem::_m_objectInformation::_4_::_m_perObjectType::_m_prob1NonObstacleN = 128;
      @sysvar::XCP::RadarFC::_g_PER_Hil_ObjBypassingRunnable_ObjBypassingRunnable_m_pad_radarObjPort_par_out_local::TChangeableMemPool::_::_::_m_arrayPool::_0_::_elem::_m_objectInformation::_4_::_m_perObjectType::_m_prob1UnknownN = 0;
      @sysvar::XCP::RadarFC::_g_PER_Hil_ObjBypassingRunnable_ObjBypassingRunnable_m_pad_radarObjPort_par_out_local::TChangeableMemPool::_::_::_m_arrayPool::_0_::_elem::_m_objectInformation::_4_::_m_perObjectType::_m_prob1MobileN = 128;
      @sysvar::XCP::RadarFC::_g_PER_Hil_ObjBypassingRunnable_ObjBypassingRunnable_m_pad_radarObjPort_par_out_local::TChangeableMemPool::_::_::_m_arrayPool::_0_::_elem::_m_objectInformation::_4_::_m_perObjectType::_m_prob1StationaryN = 0;
      @sysvar::XCP::RadarFC::_g_PER_Hil_ObjBypassingRunnable_ObjBypassingRunnable_m_pad_radarObjPort_par_out_local::TChangeableMemPool::_::_::_m_arrayPool::_0_::_elem::_m_objectInformation::_4_::_m_perObjectType::_m_prob1ObstUnknownN = 0;
      @sysvar::XCP::RadarFC::_g_PER_Hil_ObjBypassingRunnable_ObjBypassingRunnable_m_pad_radarObjPort_par_out_local::TChangeableMemPool::_::_::_m_arrayPool::_0_::_elem::_m_objectInformation::_4_::_m_perObjectType::_m_prob1FourPlusWheelerN = 0;
      @sysvar::XCP::RadarFC::_g_PER_Hil_ObjBypassingRunnable_ObjBypassingRunnable_m_pad_radarObjPort_par_out_local::TChangeableMemPool::_::_::_m_arrayPool::_0_::_elem::_m_objectInformation::_4_::_m_perObjectType::_m_prob1TwoWheelerN = 0;
      @sysvar::XCP::RadarFC::_g_PER_Hil_ObjBypassingRunnable_ObjBypassingRunnable_m_pad_radarObjPort_par_out_local::TChangeableMemPool::_::_::_m_arrayPool::_0_::_elem::_m_objectInformation::_4_::_m_perObjectType::_m_prob1PedestrianN = 0;
      @sysvar::XCP::RadarFC::_g_PER_Hil_ObjBypassingRunnable_ObjBypassingRunnable_m_pad_radarObjPort_par_out_local::TChangeableMemPool::_::_::_m_arrayPool::_0_::_elem::_m_objectInformation::_4_::_m_perObjectType::_m_prob1MovUnknownN = 128;
      @sysvar::XCP::RadarFC::_g_PER_Hil_ObjBypassingRunnable_ObjBypassingRunnable_m_pad_radarObjPort_par_out_local::TChangeableMemPool::_::_::_m_arrayPool::_0_::_elem::_m_objectInformation::_4_::_m_perObjectType::_m_prob1RoadsideBarrierN = 0;
      @sysvar::XCP::RadarFC::_g_PER_Hil_ObjBypassingRunnable_ObjBypassingRunnable_m_pad_radarObjPort_par_out_local::TChangeableMemPool::_::_::_m_arrayPool::_0_::_elem::_m_objectInformation::_4_::_m_perObjectType::_m_prob1StatUnknownN = 128;
      @sysvar::XCP::RadarFC::_g_PER_Hil_ObjBypassingRunnable_ObjBypassingRunnable_m_pad_radarObjPort_par_out_local::TChangeableMemPool::_::_::_m_arrayPool::_0_::_elem::_m_objectInformation::_4_::_m_perObjectType::_m_prob1PassengerCarN = 0;
      @sysvar::XCP::RadarFC::_g_PER_Hil_ObjBypassingRunnable_ObjBypassingRunnable_m_pad_radarObjPort_par_out_local::TChangeableMemPool::_::_::_m_arrayPool::_0_::_elem::_m_objectInformation::_4_::_m_perObjectType::_m_prob1TruckN = 0;
      @sysvar::XCP::RadarFC::_g_PER_Hil_ObjBypassingRunnable_ObjBypassingRunnable_m_pad_radarObjPort_par_out_local::TChangeableMemPool::_::_::_m_arrayPool::_0_::_elem::_m_objectInformation::_4_::_m_perObjectType::_m_prob1FourWheelUnknownN = 128;
      @sysvar::XCP::RadarFC::_g_PER_Hil_ObjBypassingRunnable_ObjBypassingRunnable_m_pad_radarObjPort_par_out_local::TChangeableMemPool::_::_::_m_arrayPool::_0_::_elem::_m_objectInformation::_4_::_m_dWidthN = 256;
          break;

      case 7: //"RoadSideBarrier"
      @sysvar::XCP::RadarFC::_g_PER_Hil_ObjBypassingRunnable_ObjBypassingRunnable_m_pad_radarObjPort_par_out_local::TChangeableMemPool::_::_::_m_arrayPool::_0_::_elem::_m_objectInformation::_4_::_m_perObjectType::_m_prob1ObstacleN = 128;
      @sysvar::XCP::RadarFC::_g_PER_Hil_ObjBypassingRunnable_ObjBypassingRunnable_m_pad_radarObjPort_par_out_local::TChangeableMemPool::_::_::_m_arrayPool::_0_::_elem::_m_objectInformation::_4_::_m_perObjectType::_m_prob1NonObstacleN = 0;
      @sysvar::XCP::RadarFC::_g_PER_Hil_ObjBypassingRunnable_ObjBypassingRunnable_m_pad_radarObjPort_par_out_local::TChangeableMemPool::_::_::_m_arrayPool::_0_::_elem::_m_objectInformation::_4_::_m_perObjectType::_m_prob1UnknownN = 0;
      @sysvar::XCP::RadarFC::_g_PER_Hil_ObjBypassingRunnable_ObjBypassingRunnable_m_pad_radarObjPort_par_out_local::TChangeableMemPool::_::_::_m_arrayPool::_0_::_elem::_m_objectInformation::_4_::_m_perObjectType::_m_prob1MobileN = 0;
      @sysvar::XCP::RadarFC::_g_PER_Hil_ObjBypassingRunnable_ObjBypassingRunnable_m_pad_radarObjPort_par_out_local::TChangeableMemPool::_::_::_m_arrayPool::_0_::_elem::_m_objectInformation::_4_::_m_perObjectType::_m_prob1StationaryN = 128;
      @sysvar::XCP::RadarFC::_g_PER_Hil_ObjBypassingRunnable_ObjBypassingRunnable_m_pad_radarObjPort_par_out_local::TChangeableMemPool::_::_::_m_arrayPool::_0_::_elem::_m_objectInformation::_4_::_m_perObjectType::_m_prob1ObstUnknownN = 0;
      @sysvar::XCP::RadarFC::_g_PER_Hil_ObjBypassingRunnable_ObjBypassingRunnable_m_pad_radarObjPort_par_out_local::TChangeableMemPool::_::_::_m_arrayPool::_0_::_elem::_m_objectInformation::_4_::_m_perObjectType::_m_prob1FourPlusWheelerN = 0;
      @sysvar::XCP::RadarFC::_g_PER_Hil_ObjBypassingRunnable_ObjBypassingRunnable_m_pad_radarObjPort_par_out_local::TChangeableMemPool::_::_::_m_arrayPool::_0_::_elem::_m_objectInformation::_4_::_m_perObjectType::_m_prob1TwoWheelerN = 0;
      @sysvar::XCP::RadarFC::_g_PER_Hil_ObjBypassingRunnable_ObjBypassingRunnable_m_pad_radarObjPort_par_out_local::TChangeableMemPool::_::_::_m_arrayPool::_0_::_elem::_m_objectInformation::_4_::_m_perObjectType::_m_prob1PedestrianN = 0;
      @sysvar::XCP::RadarFC::_g_PER_Hil_ObjBypassingRunnable_ObjBypassingRunnable_m_pad_radarObjPort_par_out_local::TChangeableMemPool::_::_::_m_arrayPool::_0_::_elem::_m_objectInformation::_4_::_m_perObjectType::_m_prob1MovUnknownN = 128;
      @sysvar::XCP::RadarFC::_g_PER_Hil_ObjBypassingRunnable_ObjBypassingRunnable_m_pad_radarObjPort_par_out_local::TChangeableMemPool::_::_::_m_arrayPool::_0_::_elem::_m_objectInformation::_4_::_m_perObjectType::_m_prob1RoadsideBarrierN = 128;
      @sysvar::XCP::RadarFC::_g_PER_Hil_ObjBypassingRunnable_ObjBypassingRunnable_m_pad_radarObjPort_par_out_local::TChangeableMemPool::_::_::_m_arrayPool::_0_::_elem::_m_objectInformation::_4_::_m_perObjectType::_m_prob1StatUnknownN = 0;
      @sysvar::XCP::RadarFC::_g_PER_Hil_ObjBypassingRunnable_ObjBypassingRunnable_m_pad_radarObjPort_par_out_local::TChangeableMemPool::_::_::_m_arrayPool::_0_::_elem::_m_objectInformation::_4_::_m_perObjectType::_m_prob1PassengerCarN = 0;
      @sysvar::XCP::RadarFC::_g_PER_Hil_ObjBypassingRunnable_ObjBypassingRunnable_m_pad_radarObjPort_par_out_local::TChangeableMemPool::_::_::_m_arrayPool::_0_::_elem::_m_objectInformation::_4_::_m_perObjectType::_m_prob1TruckN = 0;
      @sysvar::XCP::RadarFC::_g_PER_Hil_ObjBypassingRunnable_ObjBypassingRunnable_m_pad_radarObjPort_par_out_local::TChangeableMemPool::_::_::_m_arrayPool::_0_::_elem::_m_objectInformation::_4_::_m_perObjectType::_m_prob1FourWheelUnknownN = 128;
      @sysvar::XCP::RadarFC::_g_PER_Hil_ObjBypassingRunnable_ObjBypassingRunnable_m_pad_radarObjPort_par_out_local::TChangeableMemPool::_::_::_m_arrayPool::_0_::_elem::_m_objectInformation::_4_::_m_dWidthN = 256;
          break;
      }
      break;

    case 5: //"Object-5"
    //constant
  @sysvar::XCP::RadarFC::_g_PER_Hil_ObjBypassingRunnable_ObjBypassingRunnable_m_pad_radarObjPort_par_out_local::TChangeableMemPool::_::_::_m_arrayPool::_0_::_elem::_m_objectInformation::_5_::_Valid_b = 1;
  @sysvar::XCP::RadarFC::_g_PER_Hil_ObjBypassingRunnable_ObjBypassingRunnable_m_pad_radarObjPort_par_out_local::TChangeableMemPool::_::_::_m_arrayPool::_0_::_elem::_m_objectInformation::_5_::_m_HandleN = 1;
  @sysvar::XCP::RadarFC::_g_PER_Hil_ObjBypassingRunnable_ObjBypassingRunnable_m_pad_radarObjPort_par_out_local::TChangeableMemPool::_::_::_m_arrayPool::_0_::_elem::_m_objectInformation::_5_::_m_alpPiVarYawAngleN = 0;
  @sysvar::XCP::RadarFC::_g_PER_Hil_ObjBypassingRunnable_ObjBypassingRunnable_m_pad_radarObjPort_par_out_local::TChangeableMemPool::_::_::_m_arrayPool::_0_::_elem::_m_objectInformation::_5_::_m_alpPiYawAngleN = 0;
  @sysvar::XCP::RadarFC::_g_PER_Hil_ObjBypassingRunnable_ObjBypassingRunnable_m_pad_radarObjPort_par_out_local::TChangeableMemPool::_::_::_m_arrayPool::_0_::_elem::_m_objectInformation::_5_::_m_varAxN = 0;
  @sysvar::XCP::RadarFC::_g_PER_Hil_ObjBypassingRunnable_ObjBypassingRunnable_m_pad_radarObjPort_par_out_local::TChangeableMemPool::_::_::_m_arrayPool::_0_::_elem::_m_objectInformation::_5_::_m_varAyN = 0;
  @sysvar::XCP::RadarFC::_g_PER_Hil_ObjBypassingRunnable_ObjBypassingRunnable_m_pad_radarObjPort_par_out_local::TChangeableMemPool::_::_::_m_arrayPool::_0_::_elem::_m_objectInformation::_5_::_m_varVxN = 0;
  @sysvar::XCP::RadarFC::_g_PER_Hil_ObjBypassingRunnable_ObjBypassingRunnable_m_pad_radarObjPort_par_out_local::TChangeableMemPool::_::_::_m_arrayPool::_0_::_elem::_m_objectInformation::_5_::_m_varVyN = 0;
  @sysvar::XCP::RadarFC::_g_PER_Hil_ObjBypassingRunnable_ObjBypassingRunnable_m_pad_radarObjPort_par_out_local::TChangeableMemPool::_::_::_m_arrayPool::_0_::_elem::_m_objectInformation::_5_::_m_varDxN = 0;
  @sysvar::XCP::RadarFC::_g_PER_Hil_ObjBypassingRunnable_ObjBypassingRunnable_m_pad_radarObjPort_par_out_local::TChangeableMemPool::_::_::_m_arrayPool::_0_::_elem::_m_objectInformation::_5_::_m_varDyN = 0;
  @sysvar::XCP::RadarFC::_g_PER_Hil_ObjBypassingRunnable_ObjBypassingRunnable_m_pad_radarObjPort_par_out_local::TChangeableMemPool::_::_::_m_arrayPool::_0_::_elem::_m_objectInformation::_5_::_m_dVarLengthN = 0;
  @sysvar::XCP::RadarFC::_g_PER_Hil_ObjBypassingRunnable_ObjBypassingRunnable_m_pad_radarObjPort_par_out_local::TChangeableMemPool::_::_::_m_arrayPool::_0_::_elem::_m_objectInformation::_5_::_m_dVarWidthN = 0;
  @sysvar::XCP::RadarFC::_g_PER_Hil_ObjBypassingRunnable_ObjBypassingRunnable_m_pad_radarObjPort_par_out_local::TChangeableMemPool::_::_::_m_arrayPool::_0_::_elem::_m_objectInformation::_5_::_m_wExistProbN = 64880;
  @sysvar::XCP::RadarFC::_g_PER_Hil_ObjBypassingRunnable_ObjBypassingRunnable_m_pad_radarObjPort_par_out_local::TChangeableMemPool::_::_::_m_arrayPool::_0_::_elem::_m_objectInformation::_5_::_m_isObjectAsil = 1;
  @sysvar::XCP::RadarFC::_g_PER_Hil_ObjBypassingRunnable_ObjBypassingRunnable_m_pad_radarObjPort_par_out_local::TChangeableMemPool::_::_::_m_arrayPool::_0_::_elem::_m_objectInformation::_5_::_m_dLengthN = 128;

      //target movement

  @sysvar::XCP::RadarFC::_g_PER_Hil_ObjBypassingRunnable_ObjBypassingRunnable_m_pad_radarObjPort_par_out_local::TChangeableMemPool::_::_::_m_arrayPool::_0_::_elem::_m_objectInformation::_5_::_m_dxN = @FDX_in_HIL_specific_FRadar_Obj::FDX_in_FRadar_5_m_dxN;
  @sysvar::XCP::RadarFC::_g_PER_Hil_ObjBypassingRunnable_ObjBypassingRunnable_m_pad_radarObjPort_par_out_local::TChangeableMemPool::_::_::_m_arrayPool::_0_::_elem::_m_objectInformation::_5_::_m_dyN = @FDX_in_HIL_specific_FRadar_Obj::FDX_in_FRadar_5_m_dyN;
  @sysvar::XCP::RadarFC::_g_PER_Hil_ObjBypassingRunnable_ObjBypassingRunnable_m_pad_radarObjPort_par_out_local::TChangeableMemPool::_::_::_m_arrayPool::_0_::_elem::_m_objectInformation::_5_::_m_dzN = @FDX_in_HIL_specific_FRadar_Obj::FDX_in_FRadar_5_m_dzN;
  @sysvar::XCP::RadarFC::_g_PER_Hil_ObjBypassingRunnable_ObjBypassingRunnable_m_pad_radarObjPort_par_out_local::TChangeableMemPool::_::_::_m_arrayPool::_0_::_elem::_m_objectInformation::_5_::_m_vxN = @FDX_in_HIL_specific_FRadar_Obj::FDX_in_FRadar_5_m_vxN;
  @sysvar::XCP::RadarFC::_g_PER_Hil_ObjBypassingRunnable_ObjBypassingRunnable_m_pad_radarObjPort_par_out_local::TChangeableMemPool::_::_::_m_arrayPool::_0_::_elem::_m_objectInformation::_5_::_m_vyN = @FDX_in_HIL_specific_FRadar_Obj::FDX_in_FRadar_5_m_vyN;
  @sysvar::XCP::RadarFC::_g_PER_Hil_ObjBypassingRunnable_ObjBypassingRunnable_m_pad_radarObjPort_par_out_local::TChangeableMemPool::_::_::_m_arrayPool::_0_::_elem::_m_objectInformation::_5_::_m_axN = @FDX_in_HIL_specific_FRadar_Obj::FDX_in_FRadar_5_m_axN;
  @sysvar::XCP::RadarFC::_g_PER_Hil_ObjBypassingRunnable_ObjBypassingRunnable_m_pad_radarObjPort_par_out_local::TChangeableMemPool::_::_::_m_arrayPool::_0_::_elem::_m_objectInformation::_5_::_m_ayN = @FDX_in_HIL_specific_FRadar_Obj::FDX_in_FRadar_5_m_ayN;
  @sysvar::XCP::RadarFC::_g_PER_Hil_ObjBypassingRunnable_ObjBypassingRunnable_m_pad_radarObjPort_par_out_local::TChangeableMemPool::_::_::_m_arrayPool::_0_::_elem::_m_objectInformation::_5_::_m_dLengthN = @FDX_in_HIL_specific_FRadar_Obj::FDX_in_FRadar_5_m_dLengthN;
  @sysvar::XCP::RadarFC::_g_PER_Hil_ObjBypassingRunnable_ObjBypassingRunnable_m_pad_radarObjPort_par_out_local::TChangeableMemPool::_::_::_m_arrayPool::_0_::_elem::_m_objectInformation::_5_::_m_dWidthN = @FDX_in_HIL_specific_FRadar_Obj::FDX_in_FRadar_5_m_dWidthN;
  @sysvar::XCP::RadarFC::_g_PER_Hil_ObjBypassingRunnable_ObjBypassingRunnable_m_pad_radarObjPort_par_out_local::TChangeableMemPool::_::_::_m_arrayPool::_0_::_elem::_m_objectInformation::_5_::_m_alpPiYawAngleN = @FDX_in_HIL_specific_FRadar_Obj::FDX_in_FRadar_5_m_alpPiYawAngleN;

      //target object moving or not
      if (abs(@FDX_in_HIL_specific_FRadar_Obj::FDX_in_FRadar_5_m_vxN) != 0)
      {
    @sysvar::XCP::RadarFC::_g_PER_Hil_ObjBypassingRunnable_ObjBypassingRunnable_m_pad_radarObjPort_par_out_local::TChangeableMemPool::_::_::_m_arrayPool::_0_::_elem::_m_objectInformation::_5_::_m_prob1HasBeenObservedMovingN = 126;
    @sysvar::XCP::RadarFC::_g_PER_Hil_ObjBypassingRunnable_ObjBypassingRunnable_m_pad_radarObjPort_par_out_local::TChangeableMemPool::_::_::_m_arrayPool::_0_::_elem::_m_objectInformation::_5_::_m_prob1MovingN = 126;
      }
      else
      {
    @sysvar::XCP::RadarFC::_g_PER_Hil_ObjBypassingRunnable_ObjBypassingRunnable_m_pad_radarObjPort_par_out_local::TChangeableMemPool::_::_::_m_arrayPool::_0_::_elem::_m_objectInformation::_5_::_m_prob1HasBeenObservedMovingN = 0;
    @sysvar::XCP::RadarFC::_g_PER_Hil_ObjBypassingRunnable_ObjBypassingRunnable_m_pad_radarObjPort_par_out_local::TChangeableMemPool::_::_::_m_arrayPool::_0_::_elem::_m_objectInformation::_5_::_m_prob1MovingN = 0;
      }

      //object classification
    switch (@FDX_in_HIL_specific_FRadar_Obj::FDX_in_FRadar_5_Sensed_Object_Classification)
    {
      case 0: //"unknown"
      @sysvar::XCP::RadarFC::_g_PER_Hil_ObjBypassingRunnable_ObjBypassingRunnable_m_pad_radarObjPort_par_out_local::TChangeableMemPool::_::_::_m_arrayPool::_0_::_elem::_m_objectInformation::_5_::_m_perObjectType::_m_prob1ObstacleN = 0;
      @sysvar::XCP::RadarFC::_g_PER_Hil_ObjBypassingRunnable_ObjBypassingRunnable_m_pad_radarObjPort_par_out_local::TChangeableMemPool::_::_::_m_arrayPool::_0_::_elem::_m_objectInformation::_5_::_m_perObjectType::_m_prob1NonObstacleN = 0;
      @sysvar::XCP::RadarFC::_g_PER_Hil_ObjBypassingRunnable_ObjBypassingRunnable_m_pad_radarObjPort_par_out_local::TChangeableMemPool::_::_::_m_arrayPool::_0_::_elem::_m_objectInformation::_5_::_m_perObjectType::_m_prob1UnknownN = 128;
      @sysvar::XCP::RadarFC::_g_PER_Hil_ObjBypassingRunnable_ObjBypassingRunnable_m_pad_radarObjPort_par_out_local::TChangeableMemPool::_::_::_m_arrayPool::_0_::_elem::_m_objectInformation::_5_::_m_perObjectType::_m_prob1MobileN = 0;
      @sysvar::XCP::RadarFC::_g_PER_Hil_ObjBypassingRunnable_ObjBypassingRunnable_m_pad_radarObjPort_par_out_local::TChangeableMemPool::_::_::_m_arrayPool::_0_::_elem::_m_objectInformation::_5_::_m_perObjectType::_m_prob1StationaryN = 0;
      @sysvar::XCP::RadarFC::_g_PER_Hil_ObjBypassingRunnable_ObjBypassingRunnable_m_pad_radarObjPort_par_out_local::TChangeableMemPool::_::_::_m_arrayPool::_0_::_elem::_m_objectInformation::_5_::_m_perObjectType::_m_prob1ObstUnknownN = 128;
      @sysvar::XCP::RadarFC::_g_PER_Hil_ObjBypassingRunnable_ObjBypassingRunnable_m_pad_radarObjPort_par_out_local::TChangeableMemPool::_::_::_m_arrayPool::_0_::_elem::_m_objectInformation::_5_::_m_perObjectType::_m_prob1FourPlusWheelerN = 0;
      @sysvar::XCP::RadarFC::_g_PER_Hil_ObjBypassingRunnable_ObjBypassingRunnable_m_pad_radarObjPort_par_out_local::TChangeableMemPool::_::_::_m_arrayPool::_0_::_elem::_m_objectInformation::_5_::_m_perObjectType::_m_prob1TwoWheelerN = 0;
      @sysvar::XCP::RadarFC::_g_PER_Hil_ObjBypassingRunnable_ObjBypassingRunnable_m_pad_radarObjPort_par_out_local::TChangeableMemPool::_::_::_m_arrayPool::_0_::_elem::_m_objectInformation::_5_::_m_perObjectType::_m_prob1PedestrianN = 0;
      @sysvar::XCP::RadarFC::_g_PER_Hil_ObjBypassingRunnable_ObjBypassingRunnable_m_pad_radarObjPort_par_out_local::TChangeableMemPool::_::_::_m_arrayPool::_0_::_elem::_m_objectInformation::_5_::_m_perObjectType::_m_prob1MovUnknownN = 128;
      @sysvar::XCP::RadarFC::_g_PER_Hil_ObjBypassingRunnable_ObjBypassingRunnable_m_pad_radarObjPort_par_out_local::TChangeableMemPool::_::_::_m_arrayPool::_0_::_elem::_m_objectInformation::_5_::_m_perObjectType::_m_prob1RoadsideBarrierN = 0;
      @sysvar::XCP::RadarFC::_g_PER_Hil_ObjBypassingRunnable_ObjBypassingRunnable_m_pad_radarObjPort_par_out_local::TChangeableMemPool::_::_::_m_arrayPool::_0_::_elem::_m_objectInformation::_5_::_m_perObjectType::_m_prob1StatUnknownN = 128;
      @sysvar::XCP::RadarFC::_g_PER_Hil_ObjBypassingRunnable_ObjBypassingRunnable_m_pad_radarObjPort_par_out_local::TChangeableMemPool::_::_::_m_arrayPool::_0_::_elem::_m_objectInformation::_5_::_m_perObjectType::_m_prob1PassengerCarN = 0;
      @sysvar::XCP::RadarFC::_g_PER_Hil_ObjBypassingRunnable_ObjBypassingRunnable_m_pad_radarObjPort_par_out_local::TChangeableMemPool::_::_::_m_arrayPool::_0_::_elem::_m_objectInformation::_5_::_m_perObjectType::_m_prob1TruckN = 0;
      @sysvar::XCP::RadarFC::_g_PER_Hil_ObjBypassingRunnable_ObjBypassingRunnable_m_pad_radarObjPort_par_out_local::TChangeableMemPool::_::_::_m_arrayPool::_0_::_elem::_m_objectInformation::_5_::_m_perObjectType::_m_prob1FourWheelUnknownN = 128;
      @sysvar::XCP::RadarFC::_g_PER_Hil_ObjBypassingRunnable_ObjBypassingRunnable_m_pad_radarObjPort_par_out_local::TChangeableMemPool::_::_::_m_arrayPool::_0_::_elem::_m_objectInformation::_5_::_m_dWidthN = 256;
          break;

      case 1: //"Pedestrian"
      @sysvar::XCP::RadarFC::_g_PER_Hil_ObjBypassingRunnable_ObjBypassingRunnable_m_pad_radarObjPort_par_out_local::TChangeableMemPool::_::_::_m_arrayPool::_0_::_elem::_m_objectInformation::_5_::_m_perObjectType::_m_prob1ObstacleN = 128;
      @sysvar::XCP::RadarFC::_g_PER_Hil_ObjBypassingRunnable_ObjBypassingRunnable_m_pad_radarObjPort_par_out_local::TChangeableMemPool::_::_::_m_arrayPool::_0_::_elem::_m_objectInformation::_5_::_m_perObjectType::_m_prob1NonObstacleN = 0;
      @sysvar::XCP::RadarFC::_g_PER_Hil_ObjBypassingRunnable_ObjBypassingRunnable_m_pad_radarObjPort_par_out_local::TChangeableMemPool::_::_::_m_arrayPool::_0_::_elem::_m_objectInformation::_5_::_m_perObjectType::_m_prob1UnknownN = 0;
      @sysvar::XCP::RadarFC::_g_PER_Hil_ObjBypassingRunnable_ObjBypassingRunnable_m_pad_radarObjPort_par_out_local::TChangeableMemPool::_::_::_m_arrayPool::_0_::_elem::_m_objectInformation::_5_::_m_perObjectType::_m_prob1MobileN = 128;
      @sysvar::XCP::RadarFC::_g_PER_Hil_ObjBypassingRunnable_ObjBypassingRunnable_m_pad_radarObjPort_par_out_local::TChangeableMemPool::_::_::_m_arrayPool::_0_::_elem::_m_objectInformation::_5_::_m_perObjectType::_m_prob1StationaryN = 0;
      @sysvar::XCP::RadarFC::_g_PER_Hil_ObjBypassingRunnable_ObjBypassingRunnable_m_pad_radarObjPort_par_out_local::TChangeableMemPool::_::_::_m_arrayPool::_0_::_elem::_m_objectInformation::_5_::_m_perObjectType::_m_prob1ObstUnknownN = 0;
      @sysvar::XCP::RadarFC::_g_PER_Hil_ObjBypassingRunnable_ObjBypassingRunnable_m_pad_radarObjPort_par_out_local::TChangeableMemPool::_::_::_m_arrayPool::_0_::_elem::_m_objectInformation::_5_::_m_perObjectType::_m_prob1FourPlusWheelerN = 0;
      @sysvar::XCP::RadarFC::_g_PER_Hil_ObjBypassingRunnable_ObjBypassingRunnable_m_pad_radarObjPort_par_out_local::TChangeableMemPool::_::_::_m_arrayPool::_0_::_elem::_m_objectInformation::_5_::_m_perObjectType::_m_prob1TwoWheelerN = 0;
      @sysvar::XCP::RadarFC::_g_PER_Hil_ObjBypassingRunnable_ObjBypassingRunnable_m_pad_radarObjPort_par_out_local::TChangeableMemPool::_::_::_m_arrayPool::_0_::_elem::_m_objectInformation::_5_::_m_perObjectType::_m_prob1PedestrianN = 128;
      @sysvar::XCP::RadarFC::_g_PER_Hil_ObjBypassingRunnable_ObjBypassingRunnable_m_pad_radarObjPort_par_out_local::TChangeableMemPool::_::_::_m_arrayPool::_0_::_elem::_m_objectInformation::_5_::_m_perObjectType::_m_prob1MovUnknownN = 0;
      @sysvar::XCP::RadarFC::_g_PER_Hil_ObjBypassingRunnable_ObjBypassingRunnable_m_pad_radarObjPort_par_out_local::TChangeableMemPool::_::_::_m_arrayPool::_0_::_elem::_m_objectInformation::_5_::_m_perObjectType::_m_prob1RoadsideBarrierN = 0;
      @sysvar::XCP::RadarFC::_g_PER_Hil_ObjBypassingRunnable_ObjBypassingRunnable_m_pad_radarObjPort_par_out_local::TChangeableMemPool::_::_::_m_arrayPool::_0_::_elem::_m_objectInformation::_5_::_m_perObjectType::_m_prob1StatUnknownN = 128;
      @sysvar::XCP::RadarFC::_g_PER_Hil_ObjBypassingRunnable_ObjBypassingRunnable_m_pad_radarObjPort_par_out_local::TChangeableMemPool::_::_::_m_arrayPool::_0_::_elem::_m_objectInformation::_5_::_m_perObjectType::_m_prob1PassengerCarN = 0;
      @sysvar::XCP::RadarFC::_g_PER_Hil_ObjBypassingRunnable_ObjBypassingRunnable_m_pad_radarObjPort_par_out_local::TChangeableMemPool::_::_::_m_arrayPool::_0_::_elem::_m_objectInformation::_5_::_m_perObjectType::_m_prob1TruckN = 0;
      @sysvar::XCP::RadarFC::_g_PER_Hil_ObjBypassingRunnable_ObjBypassingRunnable_m_pad_radarObjPort_par_out_local::TChangeableMemPool::_::_::_m_arrayPool::_0_::_elem::_m_objectInformation::_5_::_m_perObjectType::_m_prob1FourWheelUnknownN = 128;
      @sysvar::XCP::RadarFC::_g_PER_Hil_ObjBypassingRunnable_ObjBypassingRunnable_m_pad_radarObjPort_par_out_local::TChangeableMemPool::_::_::_m_arrayPool::_0_::_elem::_m_objectInformation::_5_::_m_dWidthN = 64;
          break;

      case 2: //"2Wheeler::Cloe-> Bike"
      @sysvar::XCP::RadarFC::_g_PER_Hil_ObjBypassingRunnable_ObjBypassingRunnable_m_pad_radarObjPort_par_out_local::TChangeableMemPool::_::_::_m_arrayPool::_0_::_elem::_m_objectInformation::_5_::_m_perObjectType::_m_prob1ObstacleN = 128;
      @sysvar::XCP::RadarFC::_g_PER_Hil_ObjBypassingRunnable_ObjBypassingRunnable_m_pad_radarObjPort_par_out_local::TChangeableMemPool::_::_::_m_arrayPool::_0_::_elem::_m_objectInformation::_5_::_m_perObjectType::_m_prob1NonObstacleN = 0;
      @sysvar::XCP::RadarFC::_g_PER_Hil_ObjBypassingRunnable_ObjBypassingRunnable_m_pad_radarObjPort_par_out_local::TChangeableMemPool::_::_::_m_arrayPool::_0_::_elem::_m_objectInformation::_5_::_m_perObjectType::_m_prob1UnknownN = 0;
      @sysvar::XCP::RadarFC::_g_PER_Hil_ObjBypassingRunnable_ObjBypassingRunnable_m_pad_radarObjPort_par_out_local::TChangeableMemPool::_::_::_m_arrayPool::_0_::_elem::_m_objectInformation::_5_::_m_perObjectType::_m_prob1MobileN = 128;
      @sysvar::XCP::RadarFC::_g_PER_Hil_ObjBypassingRunnable_ObjBypassingRunnable_m_pad_radarObjPort_par_out_local::TChangeableMemPool::_::_::_m_arrayPool::_0_::_elem::_m_objectInformation::_5_::_m_perObjectType::_m_prob1StationaryN = 0;
      @sysvar::XCP::RadarFC::_g_PER_Hil_ObjBypassingRunnable_ObjBypassingRunnable_m_pad_radarObjPort_par_out_local::TChangeableMemPool::_::_::_m_arrayPool::_0_::_elem::_m_objectInformation::_5_::_m_perObjectType::_m_prob1ObstUnknownN = 0;
      @sysvar::XCP::RadarFC::_g_PER_Hil_ObjBypassingRunnable_ObjBypassingRunnable_m_pad_radarObjPort_par_out_local::TChangeableMemPool::_::_::_m_arrayPool::_0_::_elem::_m_objectInformation::_5_::_m_perObjectType::_m_prob1FourPlusWheelerN = 0;
      @sysvar::XCP::RadarFC::_g_PER_Hil_ObjBypassingRunnable_ObjBypassingRunnable_m_pad_radarObjPort_par_out_local::TChangeableMemPool::_::_::_m_arrayPool::_0_::_elem::_m_objectInformation::_5_::_m_perObjectType::_m_prob1TwoWheelerN = 128;
      @sysvar::XCP::RadarFC::_g_PER_Hil_ObjBypassingRunnable_ObjBypassingRunnable_m_pad_radarObjPort_par_out_local::TChangeableMemPool::_::_::_m_arrayPool::_0_::_elem::_m_objectInformation::_5_::_m_perObjectType::_m_prob1PedestrianN = 0;
      @sysvar::XCP::RadarFC::_g_PER_Hil_ObjBypassingRunnable_ObjBypassingRunnable_m_pad_radarObjPort_par_out_local::TChangeableMemPool::_::_::_m_arrayPool::_0_::_elem::_m_objectInformation::_5_::_m_perObjectType::_m_prob1MovUnknownN = 0;
      @sysvar::XCP::RadarFC::_g_PER_Hil_ObjBypassingRunnable_ObjBypassingRunnable_m_pad_radarObjPort_par_out_local::TChangeableMemPool::_::_::_m_arrayPool::_0_::_elem::_m_objectInformation::_5_::_m_perObjectType::_m_prob1RoadsideBarrierN = 0;
      @sysvar::XCP::RadarFC::_g_PER_Hil_ObjBypassingRunnable_ObjBypassingRunnable_m_pad_radarObjPort_par_out_local::TChangeableMemPool::_::_::_m_arrayPool::_0_::_elem::_m_objectInformation::_5_::_m_perObjectType::_m_prob1StatUnknownN = 128;
      @sysvar::XCP::RadarFC::_g_PER_Hil_ObjBypassingRunnable_ObjBypassingRunnable_m_pad_radarObjPort_par_out_local::TChangeableMemPool::_::_::_m_arrayPool::_0_::_elem::_m_objectInformation::_5_::_m_perObjectType::_m_prob1PassengerCarN = 0;
      @sysvar::XCP::RadarFC::_g_PER_Hil_ObjBypassingRunnable_ObjBypassingRunnable_m_pad_radarObjPort_par_out_local::TChangeableMemPool::_::_::_m_arrayPool::_0_::_elem::_m_objectInformation::_5_::_m_perObjectType::_m_prob1TruckN = 0;
      @sysvar::XCP::RadarFC::_g_PER_Hil_ObjBypassingRunnable_ObjBypassingRunnable_m_pad_radarObjPort_par_out_local::TChangeableMemPool::_::_::_m_arrayPool::_0_::_elem::_m_objectInformation::_5_::_m_perObjectType::_m_prob1FourWheelUnknownN = 128;
      @sysvar::XCP::RadarFC::_g_PER_Hil_ObjBypassingRunnable_ObjBypassingRunnable_m_pad_radarObjPort_par_out_local::TChangeableMemPool::_::_::_m_arrayPool::_0_::_elem::_m_objectInformation::_5_::_m_dWidthN = 64;
          break;

      case 3: //"2Wheeler::Cloe-> Motorbike"
      @sysvar::XCP::RadarFC::_g_PER_Hil_ObjBypassingRunnable_ObjBypassingRunnable_m_pad_radarObjPort_par_out_local::TChangeableMemPool::_::_::_m_arrayPool::_0_::_elem::_m_objectInformation::_5_::_m_perObjectType::_m_prob1ObstacleN = 128;
      @sysvar::XCP::RadarFC::_g_PER_Hil_ObjBypassingRunnable_ObjBypassingRunnable_m_pad_radarObjPort_par_out_local::TChangeableMemPool::_::_::_m_arrayPool::_0_::_elem::_m_objectInformation::_5_::_m_perObjectType::_m_prob1NonObstacleN = 0;
      @sysvar::XCP::RadarFC::_g_PER_Hil_ObjBypassingRunnable_ObjBypassingRunnable_m_pad_radarObjPort_par_out_local::TChangeableMemPool::_::_::_m_arrayPool::_0_::_elem::_m_objectInformation::_5_::_m_perObjectType::_m_prob1UnknownN = 0;
      @sysvar::XCP::RadarFC::_g_PER_Hil_ObjBypassingRunnable_ObjBypassingRunnable_m_pad_radarObjPort_par_out_local::TChangeableMemPool::_::_::_m_arrayPool::_0_::_elem::_m_objectInformation::_5_::_m_perObjectType::_m_prob1MobileN = 128;
      @sysvar::XCP::RadarFC::_g_PER_Hil_ObjBypassingRunnable_ObjBypassingRunnable_m_pad_radarObjPort_par_out_local::TChangeableMemPool::_::_::_m_arrayPool::_0_::_elem::_m_objectInformation::_5_::_m_perObjectType::_m_prob1StationaryN = 0;
      @sysvar::XCP::RadarFC::_g_PER_Hil_ObjBypassingRunnable_ObjBypassingRunnable_m_pad_radarObjPort_par_out_local::TChangeableMemPool::_::_::_m_arrayPool::_0_::_elem::_m_objectInformation::_5_::_m_perObjectType::_m_prob1ObstUnknownN = 0;
      @sysvar::XCP::RadarFC::_g_PER_Hil_ObjBypassingRunnable_ObjBypassingRunnable_m_pad_radarObjPort_par_out_local::TChangeableMemPool::_::_::_m_arrayPool::_0_::_elem::_m_objectInformation::_5_::_m_perObjectType::_m_prob1FourPlusWheelerN = 0;
      @sysvar::XCP::RadarFC::_g_PER_Hil_ObjBypassingRunnable_ObjBypassingRunnable_m_pad_radarObjPort_par_out_local::TChangeableMemPool::_::_::_m_arrayPool::_0_::_elem::_m_objectInformation::_5_::_m_perObjectType::_m_prob1TwoWheelerN = 128;
      @sysvar::XCP::RadarFC::_g_PER_Hil_ObjBypassingRunnable_ObjBypassingRunnable_m_pad_radarObjPort_par_out_local::TChangeableMemPool::_::_::_m_arrayPool::_0_::_elem::_m_objectInformation::_5_::_m_perObjectType::_m_prob1PedestrianN = 0;
      @sysvar::XCP::RadarFC::_g_PER_Hil_ObjBypassingRunnable_ObjBypassingRunnable_m_pad_radarObjPort_par_out_local::TChangeableMemPool::_::_::_m_arrayPool::_0_::_elem::_m_objectInformation::_5_::_m_perObjectType::_m_prob1MovUnknownN = 0;
      @sysvar::XCP::RadarFC::_g_PER_Hil_ObjBypassingRunnable_ObjBypassingRunnable_m_pad_radarObjPort_par_out_local::TChangeableMemPool::_::_::_m_arrayPool::_0_::_elem::_m_objectInformation::_5_::_m_perObjectType::_m_prob1RoadsideBarrierN = 0;
      @sysvar::XCP::RadarFC::_g_PER_Hil_ObjBypassingRunnable_ObjBypassingRunnable_m_pad_radarObjPort_par_out_local::TChangeableMemPool::_::_::_m_arrayPool::_0_::_elem::_m_objectInformation::_5_::_m_perObjectType::_m_prob1StatUnknownN = 128;
      @sysvar::XCP::RadarFC::_g_PER_Hil_ObjBypassingRunnable_ObjBypassingRunnable_m_pad_radarObjPort_par_out_local::TChangeableMemPool::_::_::_m_arrayPool::_0_::_elem::_m_objectInformation::_5_::_m_perObjectType::_m_prob1PassengerCarN = 0;
      @sysvar::XCP::RadarFC::_g_PER_Hil_ObjBypassingRunnable_ObjBypassingRunnable_m_pad_radarObjPort_par_out_local::TChangeableMemPool::_::_::_m_arrayPool::_0_::_elem::_m_objectInformation::_5_::_m_perObjectType::_m_prob1TruckN = 0;
      @sysvar::XCP::RadarFC::_g_PER_Hil_ObjBypassingRunnable_ObjBypassingRunnable_m_pad_radarObjPort_par_out_local::TChangeableMemPool::_::_::_m_arrayPool::_0_::_elem::_m_objectInformation::_5_::_m_perObjectType::_m_prob1FourWheelUnknownN = 128;
      @sysvar::XCP::RadarFC::_g_PER_Hil_ObjBypassingRunnable_ObjBypassingRunnable_m_pad_radarObjPort_par_out_local::TChangeableMemPool::_::_::_m_arrayPool::_0_::_elem::_m_objectInformation::_5_::_m_dWidthN = 64;
          break;

      case 4: //"PassengerCar"
      @sysvar::XCP::RadarFC::_g_PER_Hil_ObjBypassingRunnable_ObjBypassingRunnable_m_pad_radarObjPort_par_out_local::TChangeableMemPool::_::_::_m_arrayPool::_0_::_elem::_m_objectInformation::_5_::_m_perObjectType::_m_prob1ObstacleN = 128;
      @sysvar::XCP::RadarFC::_g_PER_Hil_ObjBypassingRunnable_ObjBypassingRunnable_m_pad_radarObjPort_par_out_local::TChangeableMemPool::_::_::_m_arrayPool::_0_::_elem::_m_objectInformation::_5_::_m_perObjectType::_m_prob1NonObstacleN = 0;
      @sysvar::XCP::RadarFC::_g_PER_Hil_ObjBypassingRunnable_ObjBypassingRunnable_m_pad_radarObjPort_par_out_local::TChangeableMemPool::_::_::_m_arrayPool::_0_::_elem::_m_objectInformation::_5_::_m_perObjectType::_m_prob1UnknownN = 0;
      @sysvar::XCP::RadarFC::_g_PER_Hil_ObjBypassingRunnable_ObjBypassingRunnable_m_pad_radarObjPort_par_out_local::TChangeableMemPool::_::_::_m_arrayPool::_0_::_elem::_m_objectInformation::_5_::_m_perObjectType::_m_prob1MobileN = 128;
      @sysvar::XCP::RadarFC::_g_PER_Hil_ObjBypassingRunnable_ObjBypassingRunnable_m_pad_radarObjPort_par_out_local::TChangeableMemPool::_::_::_m_arrayPool::_0_::_elem::_m_objectInformation::_5_::_m_perObjectType::_m_prob1StationaryN = 0;
      @sysvar::XCP::RadarFC::_g_PER_Hil_ObjBypassingRunnable_ObjBypassingRunnable_m_pad_radarObjPort_par_out_local::TChangeableMemPool::_::_::_m_arrayPool::_0_::_elem::_m_objectInformation::_5_::_m_perObjectType::_m_prob1ObstUnknownN = 0;
      @sysvar::XCP::RadarFC::_g_PER_Hil_ObjBypassingRunnable_ObjBypassingRunnable_m_pad_radarObjPort_par_out_local::TChangeableMemPool::_::_::_m_arrayPool::_0_::_elem::_m_objectInformation::_5_::_m_perObjectType::_m_prob1FourPlusWheelerN = 128;
      @sysvar::XCP::RadarFC::_g_PER_Hil_ObjBypassingRunnable_ObjBypassingRunnable_m_pad_radarObjPort_par_out_local::TChangeableMemPool::_::_::_m_arrayPool::_0_::_elem::_m_objectInformation::_5_::_m_perObjectType::_m_prob1TwoWheelerN = 0;
      @sysvar::XCP::RadarFC::_g_PER_Hil_ObjBypassingRunnable_ObjBypassingRunnable_m_pad_radarObjPort_par_out_local::TChangeableMemPool::_::_::_m_arrayPool::_0_::_elem::_m_objectInformation::_5_::_m_perObjectType::_m_prob1PedestrianN = 0;
      @sysvar::XCP::RadarFC::_g_PER_Hil_ObjBypassingRunnable_ObjBypassingRunnable_m_pad_radarObjPort_par_out_local::TChangeableMemPool::_::_::_m_arrayPool::_0_::_elem::_m_objectInformation::_5_::_m_perObjectType::_m_prob1MovUnknownN = 0;
      @sysvar::XCP::RadarFC::_g_PER_Hil_ObjBypassingRunnable_ObjBypassingRunnable_m_pad_radarObjPort_par_out_local::TChangeableMemPool::_::_::_m_arrayPool::_0_::_elem::_m_objectInformation::_5_::_m_perObjectType::_m_prob1RoadsideBarrierN = 0;
      @sysvar::XCP::RadarFC::_g_PER_Hil_ObjBypassingRunnable_ObjBypassingRunnable_m_pad_radarObjPort_par_out_local::TChangeableMemPool::_::_::_m_arrayPool::_0_::_elem::_m_objectInformation::_5_::_m_perObjectType::_m_prob1StatUnknownN = 128;
      @sysvar::XCP::RadarFC::_g_PER_Hil_ObjBypassingRunnable_ObjBypassingRunnable_m_pad_radarObjPort_par_out_local::TChangeableMemPool::_::_::_m_arrayPool::_0_::_elem::_m_objectInformation::_5_::_m_perObjectType::_m_prob1PassengerCarN = 128;
      @sysvar::XCP::RadarFC::_g_PER_Hil_ObjBypassingRunnable_ObjBypassingRunnable_m_pad_radarObjPort_par_out_local::TChangeableMemPool::_::_::_m_arrayPool::_0_::_elem::_m_objectInformation::_5_::_m_perObjectType::_m_prob1TruckN = 0;
      @sysvar::XCP::RadarFC::_g_PER_Hil_ObjBypassingRunnable_ObjBypassingRunnable_m_pad_radarObjPort_par_out_local::TChangeableMemPool::_::_::_m_arrayPool::_0_::_elem::_m_objectInformation::_5_::_m_perObjectType::_m_prob1FourWheelUnknownN = 0;
      @sysvar::XCP::RadarFC::_g_PER_Hil_ObjBypassingRunnable_ObjBypassingRunnable_m_pad_radarObjPort_par_out_local::TChangeableMemPool::_::_::_m_arrayPool::_0_::_elem::_m_objectInformation::_5_::_m_dWidthN = 256;
          break;

      case 5: //"Truck"
      @sysvar::XCP::RadarFC::_g_PER_Hil_ObjBypassingRunnable_ObjBypassingRunnable_m_pad_radarObjPort_par_out_local::TChangeableMemPool::_::_::_m_arrayPool::_0_::_elem::_m_objectInformation::_5_::_m_perObjectType::_m_prob1ObstacleN = 128;
      @sysvar::XCP::RadarFC::_g_PER_Hil_ObjBypassingRunnable_ObjBypassingRunnable_m_pad_radarObjPort_par_out_local::TChangeableMemPool::_::_::_m_arrayPool::_0_::_elem::_m_objectInformation::_5_::_m_perObjectType::_m_prob1NonObstacleN = 0;
      @sysvar::XCP::RadarFC::_g_PER_Hil_ObjBypassingRunnable_ObjBypassingRunnable_m_pad_radarObjPort_par_out_local::TChangeableMemPool::_::_::_m_arrayPool::_0_::_elem::_m_objectInformation::_5_::_m_perObjectType::_m_prob1UnknownN = 0;
      @sysvar::XCP::RadarFC::_g_PER_Hil_ObjBypassingRunnable_ObjBypassingRunnable_m_pad_radarObjPort_par_out_local::TChangeableMemPool::_::_::_m_arrayPool::_0_::_elem::_m_objectInformation::_5_::_m_perObjectType::_m_prob1MobileN = 128;
      @sysvar::XCP::RadarFC::_g_PER_Hil_ObjBypassingRunnable_ObjBypassingRunnable_m_pad_radarObjPort_par_out_local::TChangeableMemPool::_::_::_m_arrayPool::_0_::_elem::_m_objectInformation::_5_::_m_perObjectType::_m_prob1StationaryN = 0;
      @sysvar::XCP::RadarFC::_g_PER_Hil_ObjBypassingRunnable_ObjBypassingRunnable_m_pad_radarObjPort_par_out_local::TChangeableMemPool::_::_::_m_arrayPool::_0_::_elem::_m_objectInformation::_5_::_m_perObjectType::_m_prob1ObstUnknownN = 0;
      @sysvar::XCP::RadarFC::_g_PER_Hil_ObjBypassingRunnable_ObjBypassingRunnable_m_pad_radarObjPort_par_out_local::TChangeableMemPool::_::_::_m_arrayPool::_0_::_elem::_m_objectInformation::_5_::_m_perObjectType::_m_prob1FourPlusWheelerN = 128;
      @sysvar::XCP::RadarFC::_g_PER_Hil_ObjBypassingRunnable_ObjBypassingRunnable_m_pad_radarObjPort_par_out_local::TChangeableMemPool::_::_::_m_arrayPool::_0_::_elem::_m_objectInformation::_5_::_m_perObjectType::_m_prob1TwoWheelerN = 0;
      @sysvar::XCP::RadarFC::_g_PER_Hil_ObjBypassingRunnable_ObjBypassingRunnable_m_pad_radarObjPort_par_out_local::TChangeableMemPool::_::_::_m_arrayPool::_0_::_elem::_m_objectInformation::_5_::_m_perObjectType::_m_prob1PedestrianN = 0;
      @sysvar::XCP::RadarFC::_g_PER_Hil_ObjBypassingRunnable_ObjBypassingRunnable_m_pad_radarObjPort_par_out_local::TChangeableMemPool::_::_::_m_arrayPool::_0_::_elem::_m_objectInformation::_5_::_m_perObjectType::_m_prob1MovUnknownN = 0;
      @sysvar::XCP::RadarFC::_g_PER_Hil_ObjBypassingRunnable_ObjBypassingRunnable_m_pad_radarObjPort_par_out_local::TChangeableMemPool::_::_::_m_arrayPool::_0_::_elem::_m_objectInformation::_5_::_m_perObjectType::_m_prob1RoadsideBarrierN = 0;
      @sysvar::XCP::RadarFC::_g_PER_Hil_ObjBypassingRunnable_ObjBypassingRunnable_m_pad_radarObjPort_par_out_local::TChangeableMemPool::_::_::_m_arrayPool::_0_::_elem::_m_objectInformation::_5_::_m_perObjectType::_m_prob1StatUnknownN = 128;
      @sysvar::XCP::RadarFC::_g_PER_Hil_ObjBypassingRunnable_ObjBypassingRunnable_m_pad_radarObjPort_par_out_local::TChangeableMemPool::_::_::_m_arrayPool::_0_::_elem::_m_objectInformation::_5_::_m_perObjectType::_m_prob1PassengerCarN = 0;
      @sysvar::XCP::RadarFC::_g_PER_Hil_ObjBypassingRunnable_ObjBypassingRunnable_m_pad_radarObjPort_par_out_local::TChangeableMemPool::_::_::_m_arrayPool::_0_::_elem::_m_objectInformation::_5_::_m_perObjectType::_m_prob1TruckN = 128;
      @sysvar::XCP::RadarFC::_g_PER_Hil_ObjBypassingRunnable_ObjBypassingRunnable_m_pad_radarObjPort_par_out_local::TChangeableMemPool::_::_::_m_arrayPool::_0_::_elem::_m_objectInformation::_5_::_m_perObjectType::_m_prob1FourWheelUnknownN = 0;
      @sysvar::XCP::RadarFC::_g_PER_Hil_ObjBypassingRunnable_ObjBypassingRunnable_m_pad_radarObjPort_par_out_local::TChangeableMemPool::_::_::_m_arrayPool::_0_::_elem::_m_objectInformation::_5_::_m_dWidthN = 256;
          break;

      case 6: //"Non-Obstacle::Cloe->Trailer"
      @sysvar::XCP::RadarFC::_g_PER_Hil_ObjBypassingRunnable_ObjBypassingRunnable_m_pad_radarObjPort_par_out_local::TChangeableMemPool::_::_::_m_arrayPool::_0_::_elem::_m_objectInformation::_5_::_m_perObjectType::_m_prob1ObstacleN = 0;
      @sysvar::XCP::RadarFC::_g_PER_Hil_ObjBypassingRunnable_ObjBypassingRunnable_m_pad_radarObjPort_par_out_local::TChangeableMemPool::_::_::_m_arrayPool::_0_::_elem::_m_objectInformation::_5_::_m_perObjectType::_m_prob1NonObstacleN = 128;
      @sysvar::XCP::RadarFC::_g_PER_Hil_ObjBypassingRunnable_ObjBypassingRunnable_m_pad_radarObjPort_par_out_local::TChangeableMemPool::_::_::_m_arrayPool::_0_::_elem::_m_objectInformation::_5_::_m_perObjectType::_m_prob1UnknownN = 0;
      @sysvar::XCP::RadarFC::_g_PER_Hil_ObjBypassingRunnable_ObjBypassingRunnable_m_pad_radarObjPort_par_out_local::TChangeableMemPool::_::_::_m_arrayPool::_0_::_elem::_m_objectInformation::_5_::_m_perObjectType::_m_prob1MobileN = 128;
      @sysvar::XCP::RadarFC::_g_PER_Hil_ObjBypassingRunnable_ObjBypassingRunnable_m_pad_radarObjPort_par_out_local::TChangeableMemPool::_::_::_m_arrayPool::_0_::_elem::_m_objectInformation::_5_::_m_perObjectType::_m_prob1StationaryN = 0;
      @sysvar::XCP::RadarFC::_g_PER_Hil_ObjBypassingRunnable_ObjBypassingRunnable_m_pad_radarObjPort_par_out_local::TChangeableMemPool::_::_::_m_arrayPool::_0_::_elem::_m_objectInformation::_5_::_m_perObjectType::_m_prob1ObstUnknownN = 0;
      @sysvar::XCP::RadarFC::_g_PER_Hil_ObjBypassingRunnable_ObjBypassingRunnable_m_pad_radarObjPort_par_out_local::TChangeableMemPool::_::_::_m_arrayPool::_0_::_elem::_m_objectInformation::_5_::_m_perObjectType::_m_prob1FourPlusWheelerN = 0;
      @sysvar::XCP::RadarFC::_g_PER_Hil_ObjBypassingRunnable_ObjBypassingRunnable_m_pad_radarObjPort_par_out_local::TChangeableMemPool::_::_::_m_arrayPool::_0_::_elem::_m_objectInformation::_5_::_m_perObjectType::_m_prob1TwoWheelerN = 0;
      @sysvar::XCP::RadarFC::_g_PER_Hil_ObjBypassingRunnable_ObjBypassingRunnable_m_pad_radarObjPort_par_out_local::TChangeableMemPool::_::_::_m_arrayPool::_0_::_elem::_m_objectInformation::_5_::_m_perObjectType::_m_prob1PedestrianN = 0;
      @sysvar::XCP::RadarFC::_g_PER_Hil_ObjBypassingRunnable_ObjBypassingRunnable_m_pad_radarObjPort_par_out_local::TChangeableMemPool::_::_::_m_arrayPool::_0_::_elem::_m_objectInformation::_5_::_m_perObjectType::_m_prob1MovUnknownN = 128;
      @sysvar::XCP::RadarFC::_g_PER_Hil_ObjBypassingRunnable_ObjBypassingRunnable_m_pad_radarObjPort_par_out_local::TChangeableMemPool::_::_::_m_arrayPool::_0_::_elem::_m_objectInformation::_5_::_m_perObjectType::_m_prob1RoadsideBarrierN = 0;
      @sysvar::XCP::RadarFC::_g_PER_Hil_ObjBypassingRunnable_ObjBypassingRunnable_m_pad_radarObjPort_par_out_local::TChangeableMemPool::_::_::_m_arrayPool::_0_::_elem::_m_objectInformation::_5_::_m_perObjectType::_m_prob1StatUnknownN = 128;
      @sysvar::XCP::RadarFC::_g_PER_Hil_ObjBypassingRunnable_ObjBypassingRunnable_m_pad_radarObjPort_par_out_local::TChangeableMemPool::_::_::_m_arrayPool::_0_::_elem::_m_objectInformation::_5_::_m_perObjectType::_m_prob1PassengerCarN = 0;
      @sysvar::XCP::RadarFC::_g_PER_Hil_ObjBypassingRunnable_ObjBypassingRunnable_m_pad_radarObjPort_par_out_local::TChangeableMemPool::_::_::_m_arrayPool::_0_::_elem::_m_objectInformation::_5_::_m_perObjectType::_m_prob1TruckN = 0;
      @sysvar::XCP::RadarFC::_g_PER_Hil_ObjBypassingRunnable_ObjBypassingRunnable_m_pad_radarObjPort_par_out_local::TChangeableMemPool::_::_::_m_arrayPool::_0_::_elem::_m_objectInformation::_5_::_m_perObjectType::_m_prob1FourWheelUnknownN = 128;
      @sysvar::XCP::RadarFC::_g_PER_Hil_ObjBypassingRunnable_ObjBypassingRunnable_m_pad_radarObjPort_par_out_local::TChangeableMemPool::_::_::_m_arrayPool::_0_::_elem::_m_objectInformation::_5_::_m_dWidthN = 256;
          break;

      case 7: //"RoadSideBarrier"
      @sysvar::XCP::RadarFC::_g_PER_Hil_ObjBypassingRunnable_ObjBypassingRunnable_m_pad_radarObjPort_par_out_local::TChangeableMemPool::_::_::_m_arrayPool::_0_::_elem::_m_objectInformation::_5_::_m_perObjectType::_m_prob1ObstacleN = 128;
      @sysvar::XCP::RadarFC::_g_PER_Hil_ObjBypassingRunnable_ObjBypassingRunnable_m_pad_radarObjPort_par_out_local::TChangeableMemPool::_::_::_m_arrayPool::_0_::_elem::_m_objectInformation::_5_::_m_perObjectType::_m_prob1NonObstacleN = 0;
      @sysvar::XCP::RadarFC::_g_PER_Hil_ObjBypassingRunnable_ObjBypassingRunnable_m_pad_radarObjPort_par_out_local::TChangeableMemPool::_::_::_m_arrayPool::_0_::_elem::_m_objectInformation::_5_::_m_perObjectType::_m_prob1UnknownN = 0;
      @sysvar::XCP::RadarFC::_g_PER_Hil_ObjBypassingRunnable_ObjBypassingRunnable_m_pad_radarObjPort_par_out_local::TChangeableMemPool::_::_::_m_arrayPool::_0_::_elem::_m_objectInformation::_5_::_m_perObjectType::_m_prob1MobileN = 0;
      @sysvar::XCP::RadarFC::_g_PER_Hil_ObjBypassingRunnable_ObjBypassingRunnable_m_pad_radarObjPort_par_out_local::TChangeableMemPool::_::_::_m_arrayPool::_0_::_elem::_m_objectInformation::_5_::_m_perObjectType::_m_prob1StationaryN = 128;
      @sysvar::XCP::RadarFC::_g_PER_Hil_ObjBypassingRunnable_ObjBypassingRunnable_m_pad_radarObjPort_par_out_local::TChangeableMemPool::_::_::_m_arrayPool::_0_::_elem::_m_objectInformation::_5_::_m_perObjectType::_m_prob1ObstUnknownN = 0;
      @sysvar::XCP::RadarFC::_g_PER_Hil_ObjBypassingRunnable_ObjBypassingRunnable_m_pad_radarObjPort_par_out_local::TChangeableMemPool::_::_::_m_arrayPool::_0_::_elem::_m_objectInformation::_5_::_m_perObjectType::_m_prob1FourPlusWheelerN = 0;
      @sysvar::XCP::RadarFC::_g_PER_Hil_ObjBypassingRunnable_ObjBypassingRunnable_m_pad_radarObjPort_par_out_local::TChangeableMemPool::_::_::_m_arrayPool::_0_::_elem::_m_objectInformation::_5_::_m_perObjectType::_m_prob1TwoWheelerN = 0;
      @sysvar::XCP::RadarFC::_g_PER_Hil_ObjBypassingRunnable_ObjBypassingRunnable_m_pad_radarObjPort_par_out_local::TChangeableMemPool::_::_::_m_arrayPool::_0_::_elem::_m_objectInformation::_5_::_m_perObjectType::_m_prob1PedestrianN = 0;
      @sysvar::XCP::RadarFC::_g_PER_Hil_ObjBypassingRunnable_ObjBypassingRunnable_m_pad_radarObjPort_par_out_local::TChangeableMemPool::_::_::_m_arrayPool::_0_::_elem::_m_objectInformation::_5_::_m_perObjectType::_m_prob1MovUnknownN = 128;
      @sysvar::XCP::RadarFC::_g_PER_Hil_ObjBypassingRunnable_ObjBypassingRunnable_m_pad_radarObjPort_par_out_local::TChangeableMemPool::_::_::_m_arrayPool::_0_::_elem::_m_objectInformation::_5_::_m_perObjectType::_m_prob1RoadsideBarrierN = 128;
      @sysvar::XCP::RadarFC::_g_PER_Hil_ObjBypassingRunnable_ObjBypassingRunnable_m_pad_radarObjPort_par_out_local::TChangeableMemPool::_::_::_m_arrayPool::_0_::_elem::_m_objectInformation::_5_::_m_perObjectType::_m_prob1StatUnknownN = 0;
      @sysvar::XCP::RadarFC::_g_PER_Hil_ObjBypassingRunnable_ObjBypassingRunnable_m_pad_radarObjPort_par_out_local::TChangeableMemPool::_::_::_m_arrayPool::_0_::_elem::_m_objectInformation::_5_::_m_perObjectType::_m_prob1PassengerCarN = 0;
      @sysvar::XCP::RadarFC::_g_PER_Hil_ObjBypassingRunnable_ObjBypassingRunnable_m_pad_radarObjPort_par_out_local::TChangeableMemPool::_::_::_m_arrayPool::_0_::_elem::_m_objectInformation::_5_::_m_perObjectType::_m_prob1TruckN = 0;
      @sysvar::XCP::RadarFC::_g_PER_Hil_ObjBypassingRunnable_ObjBypassingRunnable_m_pad_radarObjPort_par_out_local::TChangeableMemPool::_::_::_m_arrayPool::_0_::_elem::_m_objectInformation::_5_::_m_perObjectType::_m_prob1FourWheelUnknownN = 128;
      @sysvar::XCP::RadarFC::_g_PER_Hil_ObjBypassingRunnable_ObjBypassingRunnable_m_pad_radarObjPort_par_out_local::TChangeableMemPool::_::_::_m_arrayPool::_0_::_elem::_m_objectInformation::_5_::_m_dWidthN = 256;
          break;
      }
      break;

    case 6: //"Object-6"
    //constant
  @sysvar::XCP::RadarFC::_g_PER_Hil_ObjBypassingRunnable_ObjBypassingRunnable_m_pad_radarObjPort_par_out_local::TChangeableMemPool::_::_::_m_arrayPool::_0_::_elem::_m_objectInformation::_6_::_Valid_b = 1;
  @sysvar::XCP::RadarFC::_g_PER_Hil_ObjBypassingRunnable_ObjBypassingRunnable_m_pad_radarObjPort_par_out_local::TChangeableMemPool::_::_::_m_arrayPool::_0_::_elem::_m_objectInformation::_6_::_m_HandleN = 1;
  @sysvar::XCP::RadarFC::_g_PER_Hil_ObjBypassingRunnable_ObjBypassingRunnable_m_pad_radarObjPort_par_out_local::TChangeableMemPool::_::_::_m_arrayPool::_0_::_elem::_m_objectInformation::_6_::_m_alpPiVarYawAngleN = 0;
  @sysvar::XCP::RadarFC::_g_PER_Hil_ObjBypassingRunnable_ObjBypassingRunnable_m_pad_radarObjPort_par_out_local::TChangeableMemPool::_::_::_m_arrayPool::_0_::_elem::_m_objectInformation::_6_::_m_alpPiYawAngleN = 0;
  @sysvar::XCP::RadarFC::_g_PER_Hil_ObjBypassingRunnable_ObjBypassingRunnable_m_pad_radarObjPort_par_out_local::TChangeableMemPool::_::_::_m_arrayPool::_0_::_elem::_m_objectInformation::_6_::_m_varAxN = 0;
  @sysvar::XCP::RadarFC::_g_PER_Hil_ObjBypassingRunnable_ObjBypassingRunnable_m_pad_radarObjPort_par_out_local::TChangeableMemPool::_::_::_m_arrayPool::_0_::_elem::_m_objectInformation::_6_::_m_varAyN = 0;
  @sysvar::XCP::RadarFC::_g_PER_Hil_ObjBypassingRunnable_ObjBypassingRunnable_m_pad_radarObjPort_par_out_local::TChangeableMemPool::_::_::_m_arrayPool::_0_::_elem::_m_objectInformation::_6_::_m_varVxN = 0;
  @sysvar::XCP::RadarFC::_g_PER_Hil_ObjBypassingRunnable_ObjBypassingRunnable_m_pad_radarObjPort_par_out_local::TChangeableMemPool::_::_::_m_arrayPool::_0_::_elem::_m_objectInformation::_6_::_m_varVyN = 0;
  @sysvar::XCP::RadarFC::_g_PER_Hil_ObjBypassingRunnable_ObjBypassingRunnable_m_pad_radarObjPort_par_out_local::TChangeableMemPool::_::_::_m_arrayPool::_0_::_elem::_m_objectInformation::_6_::_m_varDxN = 0;
  @sysvar::XCP::RadarFC::_g_PER_Hil_ObjBypassingRunnable_ObjBypassingRunnable_m_pad_radarObjPort_par_out_local::TChangeableMemPool::_::_::_m_arrayPool::_0_::_elem::_m_objectInformation::_6_::_m_varDyN = 0;
  @sysvar::XCP::RadarFC::_g_PER_Hil_ObjBypassingRunnable_ObjBypassingRunnable_m_pad_radarObjPort_par_out_local::TChangeableMemPool::_::_::_m_arrayPool::_0_::_elem::_m_objectInformation::_6_::_m_dVarLengthN = 0;
  @sysvar::XCP::RadarFC::_g_PER_Hil_ObjBypassingRunnable_ObjBypassingRunnable_m_pad_radarObjPort_par_out_local::TChangeableMemPool::_::_::_m_arrayPool::_0_::_elem::_m_objectInformation::_6_::_m_dVarWidthN = 0;
  @sysvar::XCP::RadarFC::_g_PER_Hil_ObjBypassingRunnable_ObjBypassingRunnable_m_pad_radarObjPort_par_out_local::TChangeableMemPool::_::_::_m_arrayPool::_0_::_elem::_m_objectInformation::_6_::_m_wExistProbN = 64880;
  @sysvar::XCP::RadarFC::_g_PER_Hil_ObjBypassingRunnable_ObjBypassingRunnable_m_pad_radarObjPort_par_out_local::TChangeableMemPool::_::_::_m_arrayPool::_0_::_elem::_m_objectInformation::_6_::_m_isObjectAsil = 1;
  @sysvar::XCP::RadarFC::_g_PER_Hil_ObjBypassingRunnable_ObjBypassingRunnable_m_pad_radarObjPort_par_out_local::TChangeableMemPool::_::_::_m_arrayPool::_0_::_elem::_m_objectInformation::_6_::_m_dLengthN = 128;

      //target movement

  @sysvar::XCP::RadarFC::_g_PER_Hil_ObjBypassingRunnable_ObjBypassingRunnable_m_pad_radarObjPort_par_out_local::TChangeableMemPool::_::_::_m_arrayPool::_0_::_elem::_m_objectInformation::_6_::_m_dxN = @FDX_in_HIL_specific_FRadar_Obj::FDX_in_FRadar_6_m_dxN;
  @sysvar::XCP::RadarFC::_g_PER_Hil_ObjBypassingRunnable_ObjBypassingRunnable_m_pad_radarObjPort_par_out_local::TChangeableMemPool::_::_::_m_arrayPool::_0_::_elem::_m_objectInformation::_6_::_m_dyN = @FDX_in_HIL_specific_FRadar_Obj::FDX_in_FRadar_6_m_dyN;
  @sysvar::XCP::RadarFC::_g_PER_Hil_ObjBypassingRunnable_ObjBypassingRunnable_m_pad_radarObjPort_par_out_local::TChangeableMemPool::_::_::_m_arrayPool::_0_::_elem::_m_objectInformation::_6_::_m_dzN = @FDX_in_HIL_specific_FRadar_Obj::FDX_in_FRadar_6_m_dzN;
  @sysvar::XCP::RadarFC::_g_PER_Hil_ObjBypassingRunnable_ObjBypassingRunnable_m_pad_radarObjPort_par_out_local::TChangeableMemPool::_::_::_m_arrayPool::_0_::_elem::_m_objectInformation::_6_::_m_vxN = @FDX_in_HIL_specific_FRadar_Obj::FDX_in_FRadar_6_m_vxN;
  @sysvar::XCP::RadarFC::_g_PER_Hil_ObjBypassingRunnable_ObjBypassingRunnable_m_pad_radarObjPort_par_out_local::TChangeableMemPool::_::_::_m_arrayPool::_0_::_elem::_m_objectInformation::_6_::_m_vyN = @FDX_in_HIL_specific_FRadar_Obj::FDX_in_FRadar_6_m_vyN;
  @sysvar::XCP::RadarFC::_g_PER_Hil_ObjBypassingRunnable_ObjBypassingRunnable_m_pad_radarObjPort_par_out_local::TChangeableMemPool::_::_::_m_arrayPool::_0_::_elem::_m_objectInformation::_6_::_m_axN = @FDX_in_HIL_specific_FRadar_Obj::FDX_in_FRadar_6_m_axN;
  @sysvar::XCP::RadarFC::_g_PER_Hil_ObjBypassingRunnable_ObjBypassingRunnable_m_pad_radarObjPort_par_out_local::TChangeableMemPool::_::_::_m_arrayPool::_0_::_elem::_m_objectInformation::_6_::_m_ayN = @FDX_in_HIL_specific_FRadar_Obj::FDX_in_FRadar_6_m_ayN;
  @sysvar::XCP::RadarFC::_g_PER_Hil_ObjBypassingRunnable_ObjBypassingRunnable_m_pad_radarObjPort_par_out_local::TChangeableMemPool::_::_::_m_arrayPool::_0_::_elem::_m_objectInformation::_6_::_m_dLengthN = @FDX_in_HIL_specific_FRadar_Obj::FDX_in_FRadar_6_m_dLengthN;
  @sysvar::XCP::RadarFC::_g_PER_Hil_ObjBypassingRunnable_ObjBypassingRunnable_m_pad_radarObjPort_par_out_local::TChangeableMemPool::_::_::_m_arrayPool::_0_::_elem::_m_objectInformation::_6_::_m_dWidthN = @FDX_in_HIL_specific_FRadar_Obj::FDX_in_FRadar_6_m_dWidthN;
  @sysvar::XCP::RadarFC::_g_PER_Hil_ObjBypassingRunnable_ObjBypassingRunnable_m_pad_radarObjPort_par_out_local::TChangeableMemPool::_::_::_m_arrayPool::_0_::_elem::_m_objectInformation::_6_::_m_alpPiYawAngleN = @FDX_in_HIL_specific_FRadar_Obj::FDX_in_FRadar_6_m_alpPiYawAngleN;

      //target object moving or not
      if (abs(@FDX_in_HIL_specific_FRadar_Obj::FDX_in_FRadar_6_m_vxN) != 0)
      {
    @sysvar::XCP::RadarFC::_g_PER_Hil_ObjBypassingRunnable_ObjBypassingRunnable_m_pad_radarObjPort_par_out_local::TChangeableMemPool::_::_::_m_arrayPool::_0_::_elem::_m_objectInformation::_6_::_m_prob1HasBeenObservedMovingN = 126;
    @sysvar::XCP::RadarFC::_g_PER_Hil_ObjBypassingRunnable_ObjBypassingRunnable_m_pad_radarObjPort_par_out_local::TChangeableMemPool::_::_::_m_arrayPool::_0_::_elem::_m_objectInformation::_6_::_m_prob1MovingN = 126;
      }
      else
      {
    @sysvar::XCP::RadarFC::_g_PER_Hil_ObjBypassingRunnable_ObjBypassingRunnable_m_pad_radarObjPort_par_out_local::TChangeableMemPool::_::_::_m_arrayPool::_0_::_elem::_m_objectInformation::_6_::_m_prob1HasBeenObservedMovingN = 0;
    @sysvar::XCP::RadarFC::_g_PER_Hil_ObjBypassingRunnable_ObjBypassingRunnable_m_pad_radarObjPort_par_out_local::TChangeableMemPool::_::_::_m_arrayPool::_0_::_elem::_m_objectInformation::_6_::_m_prob1MovingN = 0;
      }

      //object classification
    switch (@FDX_in_HIL_specific_FRadar_Obj::FDX_in_FRadar_6_Sensed_Object_Classification)
    {
      case 0: //"unknown"
      @sysvar::XCP::RadarFC::_g_PER_Hil_ObjBypassingRunnable_ObjBypassingRunnable_m_pad_radarObjPort_par_out_local::TChangeableMemPool::_::_::_m_arrayPool::_0_::_elem::_m_objectInformation::_6_::_m_perObjectType::_m_prob1ObstacleN = 0;
      @sysvar::XCP::RadarFC::_g_PER_Hil_ObjBypassingRunnable_ObjBypassingRunnable_m_pad_radarObjPort_par_out_local::TChangeableMemPool::_::_::_m_arrayPool::_0_::_elem::_m_objectInformation::_6_::_m_perObjectType::_m_prob1NonObstacleN = 0;
      @sysvar::XCP::RadarFC::_g_PER_Hil_ObjBypassingRunnable_ObjBypassingRunnable_m_pad_radarObjPort_par_out_local::TChangeableMemPool::_::_::_m_arrayPool::_0_::_elem::_m_objectInformation::_6_::_m_perObjectType::_m_prob1UnknownN = 128;
      @sysvar::XCP::RadarFC::_g_PER_Hil_ObjBypassingRunnable_ObjBypassingRunnable_m_pad_radarObjPort_par_out_local::TChangeableMemPool::_::_::_m_arrayPool::_0_::_elem::_m_objectInformation::_6_::_m_perObjectType::_m_prob1MobileN = 0;
      @sysvar::XCP::RadarFC::_g_PER_Hil_ObjBypassingRunnable_ObjBypassingRunnable_m_pad_radarObjPort_par_out_local::TChangeableMemPool::_::_::_m_arrayPool::_0_::_elem::_m_objectInformation::_6_::_m_perObjectType::_m_prob1StationaryN = 0;
      @sysvar::XCP::RadarFC::_g_PER_Hil_ObjBypassingRunnable_ObjBypassingRunnable_m_pad_radarObjPort_par_out_local::TChangeableMemPool::_::_::_m_arrayPool::_0_::_elem::_m_objectInformation::_6_::_m_perObjectType::_m_prob1ObstUnknownN = 128;
      @sysvar::XCP::RadarFC::_g_PER_Hil_ObjBypassingRunnable_ObjBypassingRunnable_m_pad_radarObjPort_par_out_local::TChangeableMemPool::_::_::_m_arrayPool::_0_::_elem::_m_objectInformation::_6_::_m_perObjectType::_m_prob1FourPlusWheelerN = 0;
      @sysvar::XCP::RadarFC::_g_PER_Hil_ObjBypassingRunnable_ObjBypassingRunnable_m_pad_radarObjPort_par_out_local::TChangeableMemPool::_::_::_m_arrayPool::_0_::_elem::_m_objectInformation::_6_::_m_perObjectType::_m_prob1TwoWheelerN = 0;
      @sysvar::XCP::RadarFC::_g_PER_Hil_ObjBypassingRunnable_ObjBypassingRunnable_m_pad_radarObjPort_par_out_local::TChangeableMemPool::_::_::_m_arrayPool::_0_::_elem::_m_objectInformation::_6_::_m_perObjectType::_m_prob1PedestrianN = 0;
      @sysvar::XCP::RadarFC::_g_PER_Hil_ObjBypassingRunnable_ObjBypassingRunnable_m_pad_radarObjPort_par_out_local::TChangeableMemPool::_::_::_m_arrayPool::_0_::_elem::_m_objectInformation::_6_::_m_perObjectType::_m_prob1MovUnknownN = 128;
      @sysvar::XCP::RadarFC::_g_PER_Hil_ObjBypassingRunnable_ObjBypassingRunnable_m_pad_radarObjPort_par_out_local::TChangeableMemPool::_::_::_m_arrayPool::_0_::_elem::_m_objectInformation::_6_::_m_perObjectType::_m_prob1RoadsideBarrierN = 0;
      @sysvar::XCP::RadarFC::_g_PER_Hil_ObjBypassingRunnable_ObjBypassingRunnable_m_pad_radarObjPort_par_out_local::TChangeableMemPool::_::_::_m_arrayPool::_0_::_elem::_m_objectInformation::_6_::_m_perObjectType::_m_prob1StatUnknownN = 128;
      @sysvar::XCP::RadarFC::_g_PER_Hil_ObjBypassingRunnable_ObjBypassingRunnable_m_pad_radarObjPort_par_out_local::TChangeableMemPool::_::_::_m_arrayPool::_0_::_elem::_m_objectInformation::_6_::_m_perObjectType::_m_prob1PassengerCarN = 0;
      @sysvar::XCP::RadarFC::_g_PER_Hil_ObjBypassingRunnable_ObjBypassingRunnable_m_pad_radarObjPort_par_out_local::TChangeableMemPool::_::_::_m_arrayPool::_0_::_elem::_m_objectInformation::_6_::_m_perObjectType::_m_prob1TruckN = 0;
      @sysvar::XCP::RadarFC::_g_PER_Hil_ObjBypassingRunnable_ObjBypassingRunnable_m_pad_radarObjPort_par_out_local::TChangeableMemPool::_::_::_m_arrayPool::_0_::_elem::_m_objectInformation::_6_::_m_perObjectType::_m_prob1FourWheelUnknownN = 128;
      @sysvar::XCP::RadarFC::_g_PER_Hil_ObjBypassingRunnable_ObjBypassingRunnable_m_pad_radarObjPort_par_out_local::TChangeableMemPool::_::_::_m_arrayPool::_0_::_elem::_m_objectInformation::_6_::_m_dWidthN = 256;
          break;

      case 1: //"Pedestrian"
      @sysvar::XCP::RadarFC::_g_PER_Hil_ObjBypassingRunnable_ObjBypassingRunnable_m_pad_radarObjPort_par_out_local::TChangeableMemPool::_::_::_m_arrayPool::_0_::_elem::_m_objectInformation::_6_::_m_perObjectType::_m_prob1ObstacleN = 128;
      @sysvar::XCP::RadarFC::_g_PER_Hil_ObjBypassingRunnable_ObjBypassingRunnable_m_pad_radarObjPort_par_out_local::TChangeableMemPool::_::_::_m_arrayPool::_0_::_elem::_m_objectInformation::_6_::_m_perObjectType::_m_prob1NonObstacleN = 0;
      @sysvar::XCP::RadarFC::_g_PER_Hil_ObjBypassingRunnable_ObjBypassingRunnable_m_pad_radarObjPort_par_out_local::TChangeableMemPool::_::_::_m_arrayPool::_0_::_elem::_m_objectInformation::_6_::_m_perObjectType::_m_prob1UnknownN = 0;
      @sysvar::XCP::RadarFC::_g_PER_Hil_ObjBypassingRunnable_ObjBypassingRunnable_m_pad_radarObjPort_par_out_local::TChangeableMemPool::_::_::_m_arrayPool::_0_::_elem::_m_objectInformation::_6_::_m_perObjectType::_m_prob1MobileN = 128;
      @sysvar::XCP::RadarFC::_g_PER_Hil_ObjBypassingRunnable_ObjBypassingRunnable_m_pad_radarObjPort_par_out_local::TChangeableMemPool::_::_::_m_arrayPool::_0_::_elem::_m_objectInformation::_6_::_m_perObjectType::_m_prob1StationaryN = 0;
      @sysvar::XCP::RadarFC::_g_PER_Hil_ObjBypassingRunnable_ObjBypassingRunnable_m_pad_radarObjPort_par_out_local::TChangeableMemPool::_::_::_m_arrayPool::_0_::_elem::_m_objectInformation::_6_::_m_perObjectType::_m_prob1ObstUnknownN = 0;
      @sysvar::XCP::RadarFC::_g_PER_Hil_ObjBypassingRunnable_ObjBypassingRunnable_m_pad_radarObjPort_par_out_local::TChangeableMemPool::_::_::_m_arrayPool::_0_::_elem::_m_objectInformation::_6_::_m_perObjectType::_m_prob1FourPlusWheelerN = 0;
      @sysvar::XCP::RadarFC::_g_PER_Hil_ObjBypassingRunnable_ObjBypassingRunnable_m_pad_radarObjPort_par_out_local::TChangeableMemPool::_::_::_m_arrayPool::_0_::_elem::_m_objectInformation::_6_::_m_perObjectType::_m_prob1TwoWheelerN = 0;
      @sysvar::XCP::RadarFC::_g_PER_Hil_ObjBypassingRunnable_ObjBypassingRunnable_m_pad_radarObjPort_par_out_local::TChangeableMemPool::_::_::_m_arrayPool::_0_::_elem::_m_objectInformation::_6_::_m_perObjectType::_m_prob1PedestrianN = 128;
      @sysvar::XCP::RadarFC::_g_PER_Hil_ObjBypassingRunnable_ObjBypassingRunnable_m_pad_radarObjPort_par_out_local::TChangeableMemPool::_::_::_m_arrayPool::_0_::_elem::_m_objectInformation::_6_::_m_perObjectType::_m_prob1MovUnknownN = 0;
      @sysvar::XCP::RadarFC::_g_PER_Hil_ObjBypassingRunnable_ObjBypassingRunnable_m_pad_radarObjPort_par_out_local::TChangeableMemPool::_::_::_m_arrayPool::_0_::_elem::_m_objectInformation::_6_::_m_perObjectType::_m_prob1RoadsideBarrierN = 0;
      @sysvar::XCP::RadarFC::_g_PER_Hil_ObjBypassingRunnable_ObjBypassingRunnable_m_pad_radarObjPort_par_out_local::TChangeableMemPool::_::_::_m_arrayPool::_0_::_elem::_m_objectInformation::_6_::_m_perObjectType::_m_prob1StatUnknownN = 128;
      @sysvar::XCP::RadarFC::_g_PER_Hil_ObjBypassingRunnable_ObjBypassingRunnable_m_pad_radarObjPort_par_out_local::TChangeableMemPool::_::_::_m_arrayPool::_0_::_elem::_m_objectInformation::_6_::_m_perObjectType::_m_prob1PassengerCarN = 0;
      @sysvar::XCP::RadarFC::_g_PER_Hil_ObjBypassingRunnable_ObjBypassingRunnable_m_pad_radarObjPort_par_out_local::TChangeableMemPool::_::_::_m_arrayPool::_0_::_elem::_m_objectInformation::_6_::_m_perObjectType::_m_prob1TruckN = 0;
      @sysvar::XCP::RadarFC::_g_PER_Hil_ObjBypassingRunnable_ObjBypassingRunnable_m_pad_radarObjPort_par_out_local::TChangeableMemPool::_::_::_m_arrayPool::_0_::_elem::_m_objectInformation::_6_::_m_perObjectType::_m_prob1FourWheelUnknownN = 128;
      @sysvar::XCP::RadarFC::_g_PER_Hil_ObjBypassingRunnable_ObjBypassingRunnable_m_pad_radarObjPort_par_out_local::TChangeableMemPool::_::_::_m_arrayPool::_0_::_elem::_m_objectInformation::_6_::_m_dWidthN = 64;
          break;

      case 2: //"2Wheeler::Cloe-> Bike"
      @sysvar::XCP::RadarFC::_g_PER_Hil_ObjBypassingRunnable_ObjBypassingRunnable_m_pad_radarObjPort_par_out_local::TChangeableMemPool::_::_::_m_arrayPool::_0_::_elem::_m_objectInformation::_6_::_m_perObjectType::_m_prob1ObstacleN = 128;
      @sysvar::XCP::RadarFC::_g_PER_Hil_ObjBypassingRunnable_ObjBypassingRunnable_m_pad_radarObjPort_par_out_local::TChangeableMemPool::_::_::_m_arrayPool::_0_::_elem::_m_objectInformation::_6_::_m_perObjectType::_m_prob1NonObstacleN = 0;
      @sysvar::XCP::RadarFC::_g_PER_Hil_ObjBypassingRunnable_ObjBypassingRunnable_m_pad_radarObjPort_par_out_local::TChangeableMemPool::_::_::_m_arrayPool::_0_::_elem::_m_objectInformation::_6_::_m_perObjectType::_m_prob1UnknownN = 0;
      @sysvar::XCP::RadarFC::_g_PER_Hil_ObjBypassingRunnable_ObjBypassingRunnable_m_pad_radarObjPort_par_out_local::TChangeableMemPool::_::_::_m_arrayPool::_0_::_elem::_m_objectInformation::_6_::_m_perObjectType::_m_prob1MobileN = 128;
      @sysvar::XCP::RadarFC::_g_PER_Hil_ObjBypassingRunnable_ObjBypassingRunnable_m_pad_radarObjPort_par_out_local::TChangeableMemPool::_::_::_m_arrayPool::_0_::_elem::_m_objectInformation::_6_::_m_perObjectType::_m_prob1StationaryN = 0;
      @sysvar::XCP::RadarFC::_g_PER_Hil_ObjBypassingRunnable_ObjBypassingRunnable_m_pad_radarObjPort_par_out_local::TChangeableMemPool::_::_::_m_arrayPool::_0_::_elem::_m_objectInformation::_6_::_m_perObjectType::_m_prob1ObstUnknownN = 0;
      @sysvar::XCP::RadarFC::_g_PER_Hil_ObjBypassingRunnable_ObjBypassingRunnable_m_pad_radarObjPort_par_out_local::TChangeableMemPool::_::_::_m_arrayPool::_0_::_elem::_m_objectInformation::_6_::_m_perObjectType::_m_prob1FourPlusWheelerN = 0;
      @sysvar::XCP::RadarFC::_g_PER_Hil_ObjBypassingRunnable_ObjBypassingRunnable_m_pad_radarObjPort_par_out_local::TChangeableMemPool::_::_::_m_arrayPool::_0_::_elem::_m_objectInformation::_6_::_m_perObjectType::_m_prob1TwoWheelerN = 128;
      @sysvar::XCP::RadarFC::_g_PER_Hil_ObjBypassingRunnable_ObjBypassingRunnable_m_pad_radarObjPort_par_out_local::TChangeableMemPool::_::_::_m_arrayPool::_0_::_elem::_m_objectInformation::_6_::_m_perObjectType::_m_prob1PedestrianN = 0;
      @sysvar::XCP::RadarFC::_g_PER_Hil_ObjBypassingRunnable_ObjBypassingRunnable_m_pad_radarObjPort_par_out_local::TChangeableMemPool::_::_::_m_arrayPool::_0_::_elem::_m_objectInformation::_6_::_m_perObjectType::_m_prob1MovUnknownN = 0;
      @sysvar::XCP::RadarFC::_g_PER_Hil_ObjBypassingRunnable_ObjBypassingRunnable_m_pad_radarObjPort_par_out_local::TChangeableMemPool::_::_::_m_arrayPool::_0_::_elem::_m_objectInformation::_6_::_m_perObjectType::_m_prob1RoadsideBarrierN = 0;
      @sysvar::XCP::RadarFC::_g_PER_Hil_ObjBypassingRunnable_ObjBypassingRunnable_m_pad_radarObjPort_par_out_local::TChangeableMemPool::_::_::_m_arrayPool::_0_::_elem::_m_objectInformation::_6_::_m_perObjectType::_m_prob1StatUnknownN = 128;
      @sysvar::XCP::RadarFC::_g_PER_Hil_ObjBypassingRunnable_ObjBypassingRunnable_m_pad_radarObjPort_par_out_local::TChangeableMemPool::_::_::_m_arrayPool::_0_::_elem::_m_objectInformation::_6_::_m_perObjectType::_m_prob1PassengerCarN = 0;
      @sysvar::XCP::RadarFC::_g_PER_Hil_ObjBypassingRunnable_ObjBypassingRunnable_m_pad_radarObjPort_par_out_local::TChangeableMemPool::_::_::_m_arrayPool::_0_::_elem::_m_objectInformation::_6_::_m_perObjectType::_m_prob1TruckN = 0;
      @sysvar::XCP::RadarFC::_g_PER_Hil_ObjBypassingRunnable_ObjBypassingRunnable_m_pad_radarObjPort_par_out_local::TChangeableMemPool::_::_::_m_arrayPool::_0_::_elem::_m_objectInformation::_6_::_m_perObjectType::_m_prob1FourWheelUnknownN = 128;
      @sysvar::XCP::RadarFC::_g_PER_Hil_ObjBypassingRunnable_ObjBypassingRunnable_m_pad_radarObjPort_par_out_local::TChangeableMemPool::_::_::_m_arrayPool::_0_::_elem::_m_objectInformation::_6_::_m_dWidthN = 64;
          break;

      case 3: //"2Wheeler::Cloe-> Motorbike"
      @sysvar::XCP::RadarFC::_g_PER_Hil_ObjBypassingRunnable_ObjBypassingRunnable_m_pad_radarObjPort_par_out_local::TChangeableMemPool::_::_::_m_arrayPool::_0_::_elem::_m_objectInformation::_6_::_m_perObjectType::_m_prob1ObstacleN = 128;
      @sysvar::XCP::RadarFC::_g_PER_Hil_ObjBypassingRunnable_ObjBypassingRunnable_m_pad_radarObjPort_par_out_local::TChangeableMemPool::_::_::_m_arrayPool::_0_::_elem::_m_objectInformation::_6_::_m_perObjectType::_m_prob1NonObstacleN = 0;
      @sysvar::XCP::RadarFC::_g_PER_Hil_ObjBypassingRunnable_ObjBypassingRunnable_m_pad_radarObjPort_par_out_local::TChangeableMemPool::_::_::_m_arrayPool::_0_::_elem::_m_objectInformation::_6_::_m_perObjectType::_m_prob1UnknownN = 0;
      @sysvar::XCP::RadarFC::_g_PER_Hil_ObjBypassingRunnable_ObjBypassingRunnable_m_pad_radarObjPort_par_out_local::TChangeableMemPool::_::_::_m_arrayPool::_0_::_elem::_m_objectInformation::_6_::_m_perObjectType::_m_prob1MobileN = 128;
      @sysvar::XCP::RadarFC::_g_PER_Hil_ObjBypassingRunnable_ObjBypassingRunnable_m_pad_radarObjPort_par_out_local::TChangeableMemPool::_::_::_m_arrayPool::_0_::_elem::_m_objectInformation::_6_::_m_perObjectType::_m_prob1StationaryN = 0;
      @sysvar::XCP::RadarFC::_g_PER_Hil_ObjBypassingRunnable_ObjBypassingRunnable_m_pad_radarObjPort_par_out_local::TChangeableMemPool::_::_::_m_arrayPool::_0_::_elem::_m_objectInformation::_6_::_m_perObjectType::_m_prob1ObstUnknownN = 0;
      @sysvar::XCP::RadarFC::_g_PER_Hil_ObjBypassingRunnable_ObjBypassingRunnable_m_pad_radarObjPort_par_out_local::TChangeableMemPool::_::_::_m_arrayPool::_0_::_elem::_m_objectInformation::_6_::_m_perObjectType::_m_prob1FourPlusWheelerN = 0;
      @sysvar::XCP::RadarFC::_g_PER_Hil_ObjBypassingRunnable_ObjBypassingRunnable_m_pad_radarObjPort_par_out_local::TChangeableMemPool::_::_::_m_arrayPool::_0_::_elem::_m_objectInformation::_6_::_m_perObjectType::_m_prob1TwoWheelerN = 128;
      @sysvar::XCP::RadarFC::_g_PER_Hil_ObjBypassingRunnable_ObjBypassingRunnable_m_pad_radarObjPort_par_out_local::TChangeableMemPool::_::_::_m_arrayPool::_0_::_elem::_m_objectInformation::_6_::_m_perObjectType::_m_prob1PedestrianN = 0;
      @sysvar::XCP::RadarFC::_g_PER_Hil_ObjBypassingRunnable_ObjBypassingRunnable_m_pad_radarObjPort_par_out_local::TChangeableMemPool::_::_::_m_arrayPool::_0_::_elem::_m_objectInformation::_6_::_m_perObjectType::_m_prob1MovUnknownN = 0;
      @sysvar::XCP::RadarFC::_g_PER_Hil_ObjBypassingRunnable_ObjBypassingRunnable_m_pad_radarObjPort_par_out_local::TChangeableMemPool::_::_::_m_arrayPool::_0_::_elem::_m_objectInformation::_6_::_m_perObjectType::_m_prob1RoadsideBarrierN = 0;
      @sysvar::XCP::RadarFC::_g_PER_Hil_ObjBypassingRunnable_ObjBypassingRunnable_m_pad_radarObjPort_par_out_local::TChangeableMemPool::_::_::_m_arrayPool::_0_::_elem::_m_objectInformation::_6_::_m_perObjectType::_m_prob1StatUnknownN = 128;
      @sysvar::XCP::RadarFC::_g_PER_Hil_ObjBypassingRunnable_ObjBypassingRunnable_m_pad_radarObjPort_par_out_local::TChangeableMemPool::_::_::_m_arrayPool::_0_::_elem::_m_objectInformation::_6_::_m_perObjectType::_m_prob1PassengerCarN = 0;
      @sysvar::XCP::RadarFC::_g_PER_Hil_ObjBypassingRunnable_ObjBypassingRunnable_m_pad_radarObjPort_par_out_local::TChangeableMemPool::_::_::_m_arrayPool::_0_::_elem::_m_objectInformation::_6_::_m_perObjectType::_m_prob1TruckN = 0;
      @sysvar::XCP::RadarFC::_g_PER_Hil_ObjBypassingRunnable_ObjBypassingRunnable_m_pad_radarObjPort_par_out_local::TChangeableMemPool::_::_::_m_arrayPool::_0_::_elem::_m_objectInformation::_6_::_m_perObjectType::_m_prob1FourWheelUnknownN = 128;
      @sysvar::XCP::RadarFC::_g_PER_Hil_ObjBypassingRunnable_ObjBypassingRunnable_m_pad_radarObjPort_par_out_local::TChangeableMemPool::_::_::_m_arrayPool::_0_::_elem::_m_objectInformation::_6_::_m_dWidthN = 64;
          break;

      case 4: //"PassengerCar"
      @sysvar::XCP::RadarFC::_g_PER_Hil_ObjBypassingRunnable_ObjBypassingRunnable_m_pad_radarObjPort_par_out_local::TChangeableMemPool::_::_::_m_arrayPool::_0_::_elem::_m_objectInformation::_6_::_m_perObjectType::_m_prob1ObstacleN = 128;
      @sysvar::XCP::RadarFC::_g_PER_Hil_ObjBypassingRunnable_ObjBypassingRunnable_m_pad_radarObjPort_par_out_local::TChangeableMemPool::_::_::_m_arrayPool::_0_::_elem::_m_objectInformation::_6_::_m_perObjectType::_m_prob1NonObstacleN = 0;
      @sysvar::XCP::RadarFC::_g_PER_Hil_ObjBypassingRunnable_ObjBypassingRunnable_m_pad_radarObjPort_par_out_local::TChangeableMemPool::_::_::_m_arrayPool::_0_::_elem::_m_objectInformation::_6_::_m_perObjectType::_m_prob1UnknownN = 0;
      @sysvar::XCP::RadarFC::_g_PER_Hil_ObjBypassingRunnable_ObjBypassingRunnable_m_pad_radarObjPort_par_out_local::TChangeableMemPool::_::_::_m_arrayPool::_0_::_elem::_m_objectInformation::_6_::_m_perObjectType::_m_prob1MobileN = 128;
      @sysvar::XCP::RadarFC::_g_PER_Hil_ObjBypassingRunnable_ObjBypassingRunnable_m_pad_radarObjPort_par_out_local::TChangeableMemPool::_::_::_m_arrayPool::_0_::_elem::_m_objectInformation::_6_::_m_perObjectType::_m_prob1StationaryN = 0;
      @sysvar::XCP::RadarFC::_g_PER_Hil_ObjBypassingRunnable_ObjBypassingRunnable_m_pad_radarObjPort_par_out_local::TChangeableMemPool::_::_::_m_arrayPool::_0_::_elem::_m_objectInformation::_6_::_m_perObjectType::_m_prob1ObstUnknownN = 0;
      @sysvar::XCP::RadarFC::_g_PER_Hil_ObjBypassingRunnable_ObjBypassingRunnable_m_pad_radarObjPort_par_out_local::TChangeableMemPool::_::_::_m_arrayPool::_0_::_elem::_m_objectInformation::_6_::_m_perObjectType::_m_prob1FourPlusWheelerN = 128;
      @sysvar::XCP::RadarFC::_g_PER_Hil_ObjBypassingRunnable_ObjBypassingRunnable_m_pad_radarObjPort_par_out_local::TChangeableMemPool::_::_::_m_arrayPool::_0_::_elem::_m_objectInformation::_6_::_m_perObjectType::_m_prob1TwoWheelerN = 0;
      @sysvar::XCP::RadarFC::_g_PER_Hil_ObjBypassingRunnable_ObjBypassingRunnable_m_pad_radarObjPort_par_out_local::TChangeableMemPool::_::_::_m_arrayPool::_0_::_elem::_m_objectInformation::_6_::_m_perObjectType::_m_prob1PedestrianN = 0;
      @sysvar::XCP::RadarFC::_g_PER_Hil_ObjBypassingRunnable_ObjBypassingRunnable_m_pad_radarObjPort_par_out_local::TChangeableMemPool::_::_::_m_arrayPool::_0_::_elem::_m_objectInformation::_6_::_m_perObjectType::_m_prob1MovUnknownN = 0;
      @sysvar::XCP::RadarFC::_g_PER_Hil_ObjBypassingRunnable_ObjBypassingRunnable_m_pad_radarObjPort_par_out_local::TChangeableMemPool::_::_::_m_arrayPool::_0_::_elem::_m_objectInformation::_6_::_m_perObjectType::_m_prob1RoadsideBarrierN = 0;
      @sysvar::XCP::RadarFC::_g_PER_Hil_ObjBypassingRunnable_ObjBypassingRunnable_m_pad_radarObjPort_par_out_local::TChangeableMemPool::_::_::_m_arrayPool::_0_::_elem::_m_objectInformation::_6_::_m_perObjectType::_m_prob1StatUnknownN = 128;
      @sysvar::XCP::RadarFC::_g_PER_Hil_ObjBypassingRunnable_ObjBypassingRunnable_m_pad_radarObjPort_par_out_local::TChangeableMemPool::_::_::_m_arrayPool::_0_::_elem::_m_objectInformation::_6_::_m_perObjectType::_m_prob1PassengerCarN = 128;
      @sysvar::XCP::RadarFC::_g_PER_Hil_ObjBypassingRunnable_ObjBypassingRunnable_m_pad_radarObjPort_par_out_local::TChangeableMemPool::_::_::_m_arrayPool::_0_::_elem::_m_objectInformation::_6_::_m_perObjectType::_m_prob1TruckN = 0;
      @sysvar::XCP::RadarFC::_g_PER_Hil_ObjBypassingRunnable_ObjBypassingRunnable_m_pad_radarObjPort_par_out_local::TChangeableMemPool::_::_::_m_arrayPool::_0_::_elem::_m_objectInformation::_6_::_m_perObjectType::_m_prob1FourWheelUnknownN = 0;
      @sysvar::XCP::RadarFC::_g_PER_Hil_ObjBypassingRunnable_ObjBypassingRunnable_m_pad_radarObjPort_par_out_local::TChangeableMemPool::_::_::_m_arrayPool::_0_::_elem::_m_objectInformation::_6_::_m_dWidthN = 256;
          break;

      case 5: //"Truck"
      @sysvar::XCP::RadarFC::_g_PER_Hil_ObjBypassingRunnable_ObjBypassingRunnable_m_pad_radarObjPort_par_out_local::TChangeableMemPool::_::_::_m_arrayPool::_0_::_elem::_m_objectInformation::_6_::_m_perObjectType::_m_prob1ObstacleN = 128;
      @sysvar::XCP::RadarFC::_g_PER_Hil_ObjBypassingRunnable_ObjBypassingRunnable_m_pad_radarObjPort_par_out_local::TChangeableMemPool::_::_::_m_arrayPool::_0_::_elem::_m_objectInformation::_6_::_m_perObjectType::_m_prob1NonObstacleN = 0;
      @sysvar::XCP::RadarFC::_g_PER_Hil_ObjBypassingRunnable_ObjBypassingRunnable_m_pad_radarObjPort_par_out_local::TChangeableMemPool::_::_::_m_arrayPool::_0_::_elem::_m_objectInformation::_6_::_m_perObjectType::_m_prob1UnknownN = 0;
      @sysvar::XCP::RadarFC::_g_PER_Hil_ObjBypassingRunnable_ObjBypassingRunnable_m_pad_radarObjPort_par_out_local::TChangeableMemPool::_::_::_m_arrayPool::_0_::_elem::_m_objectInformation::_6_::_m_perObjectType::_m_prob1MobileN = 128;
      @sysvar::XCP::RadarFC::_g_PER_Hil_ObjBypassingRunnable_ObjBypassingRunnable_m_pad_radarObjPort_par_out_local::TChangeableMemPool::_::_::_m_arrayPool::_0_::_elem::_m_objectInformation::_6_::_m_perObjectType::_m_prob1StationaryN = 0;
      @sysvar::XCP::RadarFC::_g_PER_Hil_ObjBypassingRunnable_ObjBypassingRunnable_m_pad_radarObjPort_par_out_local::TChangeableMemPool::_::_::_m_arrayPool::_0_::_elem::_m_objectInformation::_6_::_m_perObjectType::_m_prob1ObstUnknownN = 0;
      @sysvar::XCP::RadarFC::_g_PER_Hil_ObjBypassingRunnable_ObjBypassingRunnable_m_pad_radarObjPort_par_out_local::TChangeableMemPool::_::_::_m_arrayPool::_0_::_elem::_m_objectInformation::_6_::_m_perObjectType::_m_prob1FourPlusWheelerN = 128;
      @sysvar::XCP::RadarFC::_g_PER_Hil_ObjBypassingRunnable_ObjBypassingRunnable_m_pad_radarObjPort_par_out_local::TChangeableMemPool::_::_::_m_arrayPool::_0_::_elem::_m_objectInformation::_6_::_m_perObjectType::_m_prob1TwoWheelerN = 0;
      @sysvar::XCP::RadarFC::_g_PER_Hil_ObjBypassingRunnable_ObjBypassingRunnable_m_pad_radarObjPort_par_out_local::TChangeableMemPool::_::_::_m_arrayPool::_0_::_elem::_m_objectInformation::_6_::_m_perObjectType::_m_prob1PedestrianN = 0;
      @sysvar::XCP::RadarFC::_g_PER_Hil_ObjBypassingRunnable_ObjBypassingRunnable_m_pad_radarObjPort_par_out_local::TChangeableMemPool::_::_::_m_arrayPool::_0_::_elem::_m_objectInformation::_6_::_m_perObjectType::_m_prob1MovUnknownN = 0;
      @sysvar::XCP::RadarFC::_g_PER_Hil_ObjBypassingRunnable_ObjBypassingRunnable_m_pad_radarObjPort_par_out_local::TChangeableMemPool::_::_::_m_arrayPool::_0_::_elem::_m_objectInformation::_6_::_m_perObjectType::_m_prob1RoadsideBarrierN = 0;
      @sysvar::XCP::RadarFC::_g_PER_Hil_ObjBypassingRunnable_ObjBypassingRunnable_m_pad_radarObjPort_par_out_local::TChangeableMemPool::_::_::_m_arrayPool::_0_::_elem::_m_objectInformation::_6_::_m_perObjectType::_m_prob1StatUnknownN = 128;
      @sysvar::XCP::RadarFC::_g_PER_Hil_ObjBypassingRunnable_ObjBypassingRunnable_m_pad_radarObjPort_par_out_local::TChangeableMemPool::_::_::_m_arrayPool::_0_::_elem::_m_objectInformation::_6_::_m_perObjectType::_m_prob1PassengerCarN = 0;
      @sysvar::XCP::RadarFC::_g_PER_Hil_ObjBypassingRunnable_ObjBypassingRunnable_m_pad_radarObjPort_par_out_local::TChangeableMemPool::_::_::_m_arrayPool::_0_::_elem::_m_objectInformation::_6_::_m_perObjectType::_m_prob1TruckN = 128;
      @sysvar::XCP::RadarFC::_g_PER_Hil_ObjBypassingRunnable_ObjBypassingRunnable_m_pad_radarObjPort_par_out_local::TChangeableMemPool::_::_::_m_arrayPool::_0_::_elem::_m_objectInformation::_6_::_m_perObjectType::_m_prob1FourWheelUnknownN = 0;
      @sysvar::XCP::RadarFC::_g_PER_Hil_ObjBypassingRunnable_ObjBypassingRunnable_m_pad_radarObjPort_par_out_local::TChangeableMemPool::_::_::_m_arrayPool::_0_::_elem::_m_objectInformation::_6_::_m_dWidthN = 256;
          break;

      case 6: //"Non-Obstacle::Cloe->Trailer"
      @sysvar::XCP::RadarFC::_g_PER_Hil_ObjBypassingRunnable_ObjBypassingRunnable_m_pad_radarObjPort_par_out_local::TChangeableMemPool::_::_::_m_arrayPool::_0_::_elem::_m_objectInformation::_6_::_m_perObjectType::_m_prob1ObstacleN = 0;
      @sysvar::XCP::RadarFC::_g_PER_Hil_ObjBypassingRunnable_ObjBypassingRunnable_m_pad_radarObjPort_par_out_local::TChangeableMemPool::_::_::_m_arrayPool::_0_::_elem::_m_objectInformation::_6_::_m_perObjectType::_m_prob1NonObstacleN = 128;
      @sysvar::XCP::RadarFC::_g_PER_Hil_ObjBypassingRunnable_ObjBypassingRunnable_m_pad_radarObjPort_par_out_local::TChangeableMemPool::_::_::_m_arrayPool::_0_::_elem::_m_objectInformation::_6_::_m_perObjectType::_m_prob1UnknownN = 0;
      @sysvar::XCP::RadarFC::_g_PER_Hil_ObjBypassingRunnable_ObjBypassingRunnable_m_pad_radarObjPort_par_out_local::TChangeableMemPool::_::_::_m_arrayPool::_0_::_elem::_m_objectInformation::_6_::_m_perObjectType::_m_prob1MobileN = 128;
      @sysvar::XCP::RadarFC::_g_PER_Hil_ObjBypassingRunnable_ObjBypassingRunnable_m_pad_radarObjPort_par_out_local::TChangeableMemPool::_::_::_m_arrayPool::_0_::_elem::_m_objectInformation::_6_::_m_perObjectType::_m_prob1StationaryN = 0;
      @sysvar::XCP::RadarFC::_g_PER_Hil_ObjBypassingRunnable_ObjBypassingRunnable_m_pad_radarObjPort_par_out_local::TChangeableMemPool::_::_::_m_arrayPool::_0_::_elem::_m_objectInformation::_6_::_m_perObjectType::_m_prob1ObstUnknownN = 0;
      @sysvar::XCP::RadarFC::_g_PER_Hil_ObjBypassingRunnable_ObjBypassingRunnable_m_pad_radarObjPort_par_out_local::TChangeableMemPool::_::_::_m_arrayPool::_0_::_elem::_m_objectInformation::_6_::_m_perObjectType::_m_prob1FourPlusWheelerN = 0;
      @sysvar::XCP::RadarFC::_g_PER_Hil_ObjBypassingRunnable_ObjBypassingRunnable_m_pad_radarObjPort_par_out_local::TChangeableMemPool::_::_::_m_arrayPool::_0_::_elem::_m_objectInformation::_6_::_m_perObjectType::_m_prob1TwoWheelerN = 0;
      @sysvar::XCP::RadarFC::_g_PER_Hil_ObjBypassingRunnable_ObjBypassingRunnable_m_pad_radarObjPort_par_out_local::TChangeableMemPool::_::_::_m_arrayPool::_0_::_elem::_m_objectInformation::_6_::_m_perObjectType::_m_prob1PedestrianN = 0;
      @sysvar::XCP::RadarFC::_g_PER_Hil_ObjBypassingRunnable_ObjBypassingRunnable_m_pad_radarObjPort_par_out_local::TChangeableMemPool::_::_::_m_arrayPool::_0_::_elem::_m_objectInformation::_6_::_m_perObjectType::_m_prob1MovUnknownN = 128;
      @sysvar::XCP::RadarFC::_g_PER_Hil_ObjBypassingRunnable_ObjBypassingRunnable_m_pad_radarObjPort_par_out_local::TChangeableMemPool::_::_::_m_arrayPool::_0_::_elem::_m_objectInformation::_6_::_m_perObjectType::_m_prob1RoadsideBarrierN = 0;
      @sysvar::XCP::RadarFC::_g_PER_Hil_ObjBypassingRunnable_ObjBypassingRunnable_m_pad_radarObjPort_par_out_local::TChangeableMemPool::_::_::_m_arrayPool::_0_::_elem::_m_objectInformation::_6_::_m_perObjectType::_m_prob1StatUnknownN = 128;
      @sysvar::XCP::RadarFC::_g_PER_Hil_ObjBypassingRunnable_ObjBypassingRunnable_m_pad_radarObjPort_par_out_local::TChangeableMemPool::_::_::_m_arrayPool::_0_::_elem::_m_objectInformation::_6_::_m_perObjectType::_m_prob1PassengerCarN = 0;
      @sysvar::XCP::RadarFC::_g_PER_Hil_ObjBypassingRunnable_ObjBypassingRunnable_m_pad_radarObjPort_par_out_local::TChangeableMemPool::_::_::_m_arrayPool::_0_::_elem::_m_objectInformation::_6_::_m_perObjectType::_m_prob1TruckN = 0;
      @sysvar::XCP::RadarFC::_g_PER_Hil_ObjBypassingRunnable_ObjBypassingRunnable_m_pad_radarObjPort_par_out_local::TChangeableMemPool::_::_::_m_arrayPool::_0_::_elem::_m_objectInformation::_6_::_m_perObjectType::_m_prob1FourWheelUnknownN = 128;
      @sysvar::XCP::RadarFC::_g_PER_Hil_ObjBypassingRunnable_ObjBypassingRunnable_m_pad_radarObjPort_par_out_local::TChangeableMemPool::_::_::_m_arrayPool::_0_::_elem::_m_objectInformation::_6_::_m_dWidthN = 256;
          break;

      case 7: //"RoadSideBarrier"
      @sysvar::XCP::RadarFC::_g_PER_Hil_ObjBypassingRunnable_ObjBypassingRunnable_m_pad_radarObjPort_par_out_local::TChangeableMemPool::_::_::_m_arrayPool::_0_::_elem::_m_objectInformation::_6_::_m_perObjectType::_m_prob1ObstacleN = 128;
      @sysvar::XCP::RadarFC::_g_PER_Hil_ObjBypassingRunnable_ObjBypassingRunnable_m_pad_radarObjPort_par_out_local::TChangeableMemPool::_::_::_m_arrayPool::_0_::_elem::_m_objectInformation::_6_::_m_perObjectType::_m_prob1NonObstacleN = 0;
      @sysvar::XCP::RadarFC::_g_PER_Hil_ObjBypassingRunnable_ObjBypassingRunnable_m_pad_radarObjPort_par_out_local::TChangeableMemPool::_::_::_m_arrayPool::_0_::_elem::_m_objectInformation::_6_::_m_perObjectType::_m_prob1UnknownN = 0;
      @sysvar::XCP::RadarFC::_g_PER_Hil_ObjBypassingRunnable_ObjBypassingRunnable_m_pad_radarObjPort_par_out_local::TChangeableMemPool::_::_::_m_arrayPool::_0_::_elem::_m_objectInformation::_6_::_m_perObjectType::_m_prob1MobileN = 0;
      @sysvar::XCP::RadarFC::_g_PER_Hil_ObjBypassingRunnable_ObjBypassingRunnable_m_pad_radarObjPort_par_out_local::TChangeableMemPool::_::_::_m_arrayPool::_0_::_elem::_m_objectInformation::_6_::_m_perObjectType::_m_prob1StationaryN = 128;
      @sysvar::XCP::RadarFC::_g_PER_Hil_ObjBypassingRunnable_ObjBypassingRunnable_m_pad_radarObjPort_par_out_local::TChangeableMemPool::_::_::_m_arrayPool::_0_::_elem::_m_objectInformation::_6_::_m_perObjectType::_m_prob1ObstUnknownN = 0;
      @sysvar::XCP::RadarFC::_g_PER_Hil_ObjBypassingRunnable_ObjBypassingRunnable_m_pad_radarObjPort_par_out_local::TChangeableMemPool::_::_::_m_arrayPool::_0_::_elem::_m_objectInformation::_6_::_m_perObjectType::_m_prob1FourPlusWheelerN = 0;
      @sysvar::XCP::RadarFC::_g_PER_Hil_ObjBypassingRunnable_ObjBypassingRunnable_m_pad_radarObjPort_par_out_local::TChangeableMemPool::_::_::_m_arrayPool::_0_::_elem::_m_objectInformation::_6_::_m_perObjectType::_m_prob1TwoWheelerN = 0;
      @sysvar::XCP::RadarFC::_g_PER_Hil_ObjBypassingRunnable_ObjBypassingRunnable_m_pad_radarObjPort_par_out_local::TChangeableMemPool::_::_::_m_arrayPool::_0_::_elem::_m_objectInformation::_6_::_m_perObjectType::_m_prob1PedestrianN = 0;
      @sysvar::XCP::RadarFC::_g_PER_Hil_ObjBypassingRunnable_ObjBypassingRunnable_m_pad_radarObjPort_par_out_local::TChangeableMemPool::_::_::_m_arrayPool::_0_::_elem::_m_objectInformation::_6_::_m_perObjectType::_m_prob1MovUnknownN = 128;
      @sysvar::XCP::RadarFC::_g_PER_Hil_ObjBypassingRunnable_ObjBypassingRunnable_m_pad_radarObjPort_par_out_local::TChangeableMemPool::_::_::_m_arrayPool::_0_::_elem::_m_objectInformation::_6_::_m_perObjectType::_m_prob1RoadsideBarrierN = 128;
      @sysvar::XCP::RadarFC::_g_PER_Hil_ObjBypassingRunnable_ObjBypassingRunnable_m_pad_radarObjPort_par_out_local::TChangeableMemPool::_::_::_m_arrayPool::_0_::_elem::_m_objectInformation::_6_::_m_perObjectType::_m_prob1StatUnknownN = 0;
      @sysvar::XCP::RadarFC::_g_PER_Hil_ObjBypassingRunnable_ObjBypassingRunnable_m_pad_radarObjPort_par_out_local::TChangeableMemPool::_::_::_m_arrayPool::_0_::_elem::_m_objectInformation::_6_::_m_perObjectType::_m_prob1PassengerCarN = 0;
      @sysvar::XCP::RadarFC::_g_PER_Hil_ObjBypassingRunnable_ObjBypassingRunnable_m_pad_radarObjPort_par_out_local::TChangeableMemPool::_::_::_m_arrayPool::_0_::_elem::_m_objectInformation::_6_::_m_perObjectType::_m_prob1TruckN = 0;
      @sysvar::XCP::RadarFC::_g_PER_Hil_ObjBypassingRunnable_ObjBypassingRunnable_m_pad_radarObjPort_par_out_local::TChangeableMemPool::_::_::_m_arrayPool::_0_::_elem::_m_objectInformation::_6_::_m_perObjectType::_m_prob1FourWheelUnknownN = 128;
      @sysvar::XCP::RadarFC::_g_PER_Hil_ObjBypassingRunnable_ObjBypassingRunnable_m_pad_radarObjPort_par_out_local::TChangeableMemPool::_::_::_m_arrayPool::_0_::_elem::_m_objectInformation::_6_::_m_dWidthN = 256;
          break;
      }
      break;

    case 7: //"Object-7"
    //constant
  @sysvar::XCP::RadarFC::_g_PER_Hil_ObjBypassingRunnable_ObjBypassingRunnable_m_pad_radarObjPort_par_out_local::TChangeableMemPool::_::_::_m_arrayPool::_0_::_elem::_m_objectInformation::_7_::_Valid_b = 1;
  @sysvar::XCP::RadarFC::_g_PER_Hil_ObjBypassingRunnable_ObjBypassingRunnable_m_pad_radarObjPort_par_out_local::TChangeableMemPool::_::_::_m_arrayPool::_0_::_elem::_m_objectInformation::_7_::_m_HandleN = 1;
  @sysvar::XCP::RadarFC::_g_PER_Hil_ObjBypassingRunnable_ObjBypassingRunnable_m_pad_radarObjPort_par_out_local::TChangeableMemPool::_::_::_m_arrayPool::_0_::_elem::_m_objectInformation::_7_::_m_alpPiVarYawAngleN = 0;
  @sysvar::XCP::RadarFC::_g_PER_Hil_ObjBypassingRunnable_ObjBypassingRunnable_m_pad_radarObjPort_par_out_local::TChangeableMemPool::_::_::_m_arrayPool::_0_::_elem::_m_objectInformation::_7_::_m_alpPiYawAngleN = 0;
  @sysvar::XCP::RadarFC::_g_PER_Hil_ObjBypassingRunnable_ObjBypassingRunnable_m_pad_radarObjPort_par_out_local::TChangeableMemPool::_::_::_m_arrayPool::_0_::_elem::_m_objectInformation::_7_::_m_varAxN = 0;
  @sysvar::XCP::RadarFC::_g_PER_Hil_ObjBypassingRunnable_ObjBypassingRunnable_m_pad_radarObjPort_par_out_local::TChangeableMemPool::_::_::_m_arrayPool::_0_::_elem::_m_objectInformation::_7_::_m_varAyN = 0;
  @sysvar::XCP::RadarFC::_g_PER_Hil_ObjBypassingRunnable_ObjBypassingRunnable_m_pad_radarObjPort_par_out_local::TChangeableMemPool::_::_::_m_arrayPool::_0_::_elem::_m_objectInformation::_7_::_m_varVxN = 0;
  @sysvar::XCP::RadarFC::_g_PER_Hil_ObjBypassingRunnable_ObjBypassingRunnable_m_pad_radarObjPort_par_out_local::TChangeableMemPool::_::_::_m_arrayPool::_0_::_elem::_m_objectInformation::_7_::_m_varVyN = 0;
  @sysvar::XCP::RadarFC::_g_PER_Hil_ObjBypassingRunnable_ObjBypassingRunnable_m_pad_radarObjPort_par_out_local::TChangeableMemPool::_::_::_m_arrayPool::_0_::_elem::_m_objectInformation::_7_::_m_varDxN = 0;
  @sysvar::XCP::RadarFC::_g_PER_Hil_ObjBypassingRunnable_ObjBypassingRunnable_m_pad_radarObjPort_par_out_local::TChangeableMemPool::_::_::_m_arrayPool::_0_::_elem::_m_objectInformation::_7_::_m_varDyN = 0;
  @sysvar::XCP::RadarFC::_g_PER_Hil_ObjBypassingRunnable_ObjBypassingRunnable_m_pad_radarObjPort_par_out_local::TChangeableMemPool::_::_::_m_arrayPool::_0_::_elem::_m_objectInformation::_7_::_m_dVarLengthN = 0;
  @sysvar::XCP::RadarFC::_g_PER_Hil_ObjBypassingRunnable_ObjBypassingRunnable_m_pad_radarObjPort_par_out_local::TChangeableMemPool::_::_::_m_arrayPool::_0_::_elem::_m_objectInformation::_7_::_m_dVarWidthN = 0;
  @sysvar::XCP::RadarFC::_g_PER_Hil_ObjBypassingRunnable_ObjBypassingRunnable_m_pad_radarObjPort_par_out_local::TChangeableMemPool::_::_::_m_arrayPool::_0_::_elem::_m_objectInformation::_7_::_m_wExistProbN = 64880;
  @sysvar::XCP::RadarFC::_g_PER_Hil_ObjBypassingRunnable_ObjBypassingRunnable_m_pad_radarObjPort_par_out_local::TChangeableMemPool::_::_::_m_arrayPool::_0_::_elem::_m_objectInformation::_7_::_m_isObjectAsil = 1;
  @sysvar::XCP::RadarFC::_g_PER_Hil_ObjBypassingRunnable_ObjBypassingRunnable_m_pad_radarObjPort_par_out_local::TChangeableMemPool::_::_::_m_arrayPool::_0_::_elem::_m_objectInformation::_7_::_m_dLengthN = 128;

      //target movement

  @sysvar::XCP::RadarFC::_g_PER_Hil_ObjBypassingRunnable_ObjBypassingRunnable_m_pad_radarObjPort_par_out_local::TChangeableMemPool::_::_::_m_arrayPool::_0_::_elem::_m_objectInformation::_7_::_m_dxN = @FDX_in_HIL_specific_FRadar_Obj::FDX_in_FRadar_7_m_dxN;
  @sysvar::XCP::RadarFC::_g_PER_Hil_ObjBypassingRunnable_ObjBypassingRunnable_m_pad_radarObjPort_par_out_local::TChangeableMemPool::_::_::_m_arrayPool::_0_::_elem::_m_objectInformation::_7_::_m_dyN = @FDX_in_HIL_specific_FRadar_Obj::FDX_in_FRadar_7_m_dyN;
  @sysvar::XCP::RadarFC::_g_PER_Hil_ObjBypassingRunnable_ObjBypassingRunnable_m_pad_radarObjPort_par_out_local::TChangeableMemPool::_::_::_m_arrayPool::_0_::_elem::_m_objectInformation::_7_::_m_dzN = @FDX_in_HIL_specific_FRadar_Obj::FDX_in_FRadar_7_m_dzN;
  @sysvar::XCP::RadarFC::_g_PER_Hil_ObjBypassingRunnable_ObjBypassingRunnable_m_pad_radarObjPort_par_out_local::TChangeableMemPool::_::_::_m_arrayPool::_0_::_elem::_m_objectInformation::_7_::_m_vxN = @FDX_in_HIL_specific_FRadar_Obj::FDX_in_FRadar_7_m_vxN;
  @sysvar::XCP::RadarFC::_g_PER_Hil_ObjBypassingRunnable_ObjBypassingRunnable_m_pad_radarObjPort_par_out_local::TChangeableMemPool::_::_::_m_arrayPool::_0_::_elem::_m_objectInformation::_7_::_m_vyN = @FDX_in_HIL_specific_FRadar_Obj::FDX_in_FRadar_7_m_vyN;
  @sysvar::XCP::RadarFC::_g_PER_Hil_ObjBypassingRunnable_ObjBypassingRunnable_m_pad_radarObjPort_par_out_local::TChangeableMemPool::_::_::_m_arrayPool::_0_::_elem::_m_objectInformation::_7_::_m_axN = @FDX_in_HIL_specific_FRadar_Obj::FDX_in_FRadar_7_m_axN;
  @sysvar::XCP::RadarFC::_g_PER_Hil_ObjBypassingRunnable_ObjBypassingRunnable_m_pad_radarObjPort_par_out_local::TChangeableMemPool::_::_::_m_arrayPool::_0_::_elem::_m_objectInformation::_7_::_m_ayN = @FDX_in_HIL_specific_FRadar_Obj::FDX_in_FRadar_7_m_ayN;
  @sysvar::XCP::RadarFC::_g_PER_Hil_ObjBypassingRunnable_ObjBypassingRunnable_m_pad_radarObjPort_par_out_local::TChangeableMemPool::_::_::_m_arrayPool::_0_::_elem::_m_objectInformation::_7_::_m_dLengthN = @FDX_in_HIL_specific_FRadar_Obj::FDX_in_FRadar_7_m_dLengthN;
  @sysvar::XCP::RadarFC::_g_PER_Hil_ObjBypassingRunnable_ObjBypassingRunnable_m_pad_radarObjPort_par_out_local::TChangeableMemPool::_::_::_m_arrayPool::_0_::_elem::_m_objectInformation::_7_::_m_dWidthN = @FDX_in_HIL_specific_FRadar_Obj::FDX_in_FRadar_7_m_dWidthN;
  @sysvar::XCP::RadarFC::_g_PER_Hil_ObjBypassingRunnable_ObjBypassingRunnable_m_pad_radarObjPort_par_out_local::TChangeableMemPool::_::_::_m_arrayPool::_0_::_elem::_m_objectInformation::_7_::_m_alpPiYawAngleN = @FDX_in_HIL_specific_FRadar_Obj::FDX_in_FRadar_7_m_alpPiYawAngleN;

      //target object moving or not
      if (abs(@FDX_in_HIL_specific_FRadar_Obj::FDX_in_FRadar_7_m_vxN) != 0)
      {
    @sysvar::XCP::RadarFC::_g_PER_Hil_ObjBypassingRunnable_ObjBypassingRunnable_m_pad_radarObjPort_par_out_local::TChangeableMemPool::_::_::_m_arrayPool::_0_::_elem::_m_objectInformation::_7_::_m_prob1HasBeenObservedMovingN = 126;
    @sysvar::XCP::RadarFC::_g_PER_Hil_ObjBypassingRunnable_ObjBypassingRunnable_m_pad_radarObjPort_par_out_local::TChangeableMemPool::_::_::_m_arrayPool::_0_::_elem::_m_objectInformation::_7_::_m_prob1MovingN = 126;
      }
      else
      {
    @sysvar::XCP::RadarFC::_g_PER_Hil_ObjBypassingRunnable_ObjBypassingRunnable_m_pad_radarObjPort_par_out_local::TChangeableMemPool::_::_::_m_arrayPool::_0_::_elem::_m_objectInformation::_7_::_m_prob1HasBeenObservedMovingN = 0;
    @sysvar::XCP::RadarFC::_g_PER_Hil_ObjBypassingRunnable_ObjBypassingRunnable_m_pad_radarObjPort_par_out_local::TChangeableMemPool::_::_::_m_arrayPool::_0_::_elem::_m_objectInformation::_7_::_m_prob1MovingN = 0;
      }

      //object classification
    switch (@FDX_in_HIL_specific_FRadar_Obj::FDX_in_FRadar_7_Sensed_Object_Classification)
    {
      case 0: //"unknown"
      @sysvar::XCP::RadarFC::_g_PER_Hil_ObjBypassingRunnable_ObjBypassingRunnable_m_pad_radarObjPort_par_out_local::TChangeableMemPool::_::_::_m_arrayPool::_0_::_elem::_m_objectInformation::_7_::_m_perObjectType::_m_prob1ObstacleN = 0;
      @sysvar::XCP::RadarFC::_g_PER_Hil_ObjBypassingRunnable_ObjBypassingRunnable_m_pad_radarObjPort_par_out_local::TChangeableMemPool::_::_::_m_arrayPool::_0_::_elem::_m_objectInformation::_7_::_m_perObjectType::_m_prob1NonObstacleN = 0;
      @sysvar::XCP::RadarFC::_g_PER_Hil_ObjBypassingRunnable_ObjBypassingRunnable_m_pad_radarObjPort_par_out_local::TChangeableMemPool::_::_::_m_arrayPool::_0_::_elem::_m_objectInformation::_7_::_m_perObjectType::_m_prob1UnknownN = 128;
      @sysvar::XCP::RadarFC::_g_PER_Hil_ObjBypassingRunnable_ObjBypassingRunnable_m_pad_radarObjPort_par_out_local::TChangeableMemPool::_::_::_m_arrayPool::_0_::_elem::_m_objectInformation::_7_::_m_perObjectType::_m_prob1MobileN = 0;
      @sysvar::XCP::RadarFC::_g_PER_Hil_ObjBypassingRunnable_ObjBypassingRunnable_m_pad_radarObjPort_par_out_local::TChangeableMemPool::_::_::_m_arrayPool::_0_::_elem::_m_objectInformation::_7_::_m_perObjectType::_m_prob1StationaryN = 0;
      @sysvar::XCP::RadarFC::_g_PER_Hil_ObjBypassingRunnable_ObjBypassingRunnable_m_pad_radarObjPort_par_out_local::TChangeableMemPool::_::_::_m_arrayPool::_0_::_elem::_m_objectInformation::_7_::_m_perObjectType::_m_prob1ObstUnknownN = 128;
      @sysvar::XCP::RadarFC::_g_PER_Hil_ObjBypassingRunnable_ObjBypassingRunnable_m_pad_radarObjPort_par_out_local::TChangeableMemPool::_::_::_m_arrayPool::_0_::_elem::_m_objectInformation::_7_::_m_perObjectType::_m_prob1FourPlusWheelerN = 0;
      @sysvar::XCP::RadarFC::_g_PER_Hil_ObjBypassingRunnable_ObjBypassingRunnable_m_pad_radarObjPort_par_out_local::TChangeableMemPool::_::_::_m_arrayPool::_0_::_elem::_m_objectInformation::_7_::_m_perObjectType::_m_prob1TwoWheelerN = 0;
      @sysvar::XCP::RadarFC::_g_PER_Hil_ObjBypassingRunnable_ObjBypassingRunnable_m_pad_radarObjPort_par_out_local::TChangeableMemPool::_::_::_m_arrayPool::_0_::_elem::_m_objectInformation::_7_::_m_perObjectType::_m_prob1PedestrianN = 0;
      @sysvar::XCP::RadarFC::_g_PER_Hil_ObjBypassingRunnable_ObjBypassingRunnable_m_pad_radarObjPort_par_out_local::TChangeableMemPool::_::_::_m_arrayPool::_0_::_elem::_m_objectInformation::_7_::_m_perObjectType::_m_prob1MovUnknownN = 128;
      @sysvar::XCP::RadarFC::_g_PER_Hil_ObjBypassingRunnable_ObjBypassingRunnable_m_pad_radarObjPort_par_out_local::TChangeableMemPool::_::_::_m_arrayPool::_0_::_elem::_m_objectInformation::_7_::_m_perObjectType::_m_prob1RoadsideBarrierN = 0;
      @sysvar::XCP::RadarFC::_g_PER_Hil_ObjBypassingRunnable_ObjBypassingRunnable_m_pad_radarObjPort_par_out_local::TChangeableMemPool::_::_::_m_arrayPool::_0_::_elem::_m_objectInformation::_7_::_m_perObjectType::_m_prob1StatUnknownN = 128;
      @sysvar::XCP::RadarFC::_g_PER_Hil_ObjBypassingRunnable_ObjBypassingRunnable_m_pad_radarObjPort_par_out_local::TChangeableMemPool::_::_::_m_arrayPool::_0_::_elem::_m_objectInformation::_7_::_m_perObjectType::_m_prob1PassengerCarN = 0;
      @sysvar::XCP::RadarFC::_g_PER_Hil_ObjBypassingRunnable_ObjBypassingRunnable_m_pad_radarObjPort_par_out_local::TChangeableMemPool::_::_::_m_arrayPool::_0_::_elem::_m_objectInformation::_7_::_m_perObjectType::_m_prob1TruckN = 0;
      @sysvar::XCP::RadarFC::_g_PER_Hil_ObjBypassingRunnable_ObjBypassingRunnable_m_pad_radarObjPort_par_out_local::TChangeableMemPool::_::_::_m_arrayPool::_0_::_elem::_m_objectInformation::_7_::_m_perObjectType::_m_prob1FourWheelUnknownN = 128;
      @sysvar::XCP::RadarFC::_g_PER_Hil_ObjBypassingRunnable_ObjBypassingRunnable_m_pad_radarObjPort_par_out_local::TChangeableMemPool::_::_::_m_arrayPool::_0_::_elem::_m_objectInformation::_7_::_m_dWidthN = 256;
          break;

      case 1: //"Pedestrian"
      @sysvar::XCP::RadarFC::_g_PER_Hil_ObjBypassingRunnable_ObjBypassingRunnable_m_pad_radarObjPort_par_out_local::TChangeableMemPool::_::_::_m_arrayPool::_0_::_elem::_m_objectInformation::_7_::_m_perObjectType::_m_prob1ObstacleN = 128;
      @sysvar::XCP::RadarFC::_g_PER_Hil_ObjBypassingRunnable_ObjBypassingRunnable_m_pad_radarObjPort_par_out_local::TChangeableMemPool::_::_::_m_arrayPool::_0_::_elem::_m_objectInformation::_7_::_m_perObjectType::_m_prob1NonObstacleN = 0;
      @sysvar::XCP::RadarFC::_g_PER_Hil_ObjBypassingRunnable_ObjBypassingRunnable_m_pad_radarObjPort_par_out_local::TChangeableMemPool::_::_::_m_arrayPool::_0_::_elem::_m_objectInformation::_7_::_m_perObjectType::_m_prob1UnknownN = 0;
      @sysvar::XCP::RadarFC::_g_PER_Hil_ObjBypassingRunnable_ObjBypassingRunnable_m_pad_radarObjPort_par_out_local::TChangeableMemPool::_::_::_m_arrayPool::_0_::_elem::_m_objectInformation::_7_::_m_perObjectType::_m_prob1MobileN = 128;
      @sysvar::XCP::RadarFC::_g_PER_Hil_ObjBypassingRunnable_ObjBypassingRunnable_m_pad_radarObjPort_par_out_local::TChangeableMemPool::_::_::_m_arrayPool::_0_::_elem::_m_objectInformation::_7_::_m_perObjectType::_m_prob1StationaryN = 0;
      @sysvar::XCP::RadarFC::_g_PER_Hil_ObjBypassingRunnable_ObjBypassingRunnable_m_pad_radarObjPort_par_out_local::TChangeableMemPool::_::_::_m_arrayPool::_0_::_elem::_m_objectInformation::_7_::_m_perObjectType::_m_prob1ObstUnknownN = 0;
      @sysvar::XCP::RadarFC::_g_PER_Hil_ObjBypassingRunnable_ObjBypassingRunnable_m_pad_radarObjPort_par_out_local::TChangeableMemPool::_::_::_m_arrayPool::_0_::_elem::_m_objectInformation::_7_::_m_perObjectType::_m_prob1FourPlusWheelerN = 0;
      @sysvar::XCP::RadarFC::_g_PER_Hil_ObjBypassingRunnable_ObjBypassingRunnable_m_pad_radarObjPort_par_out_local::TChangeableMemPool::_::_::_m_arrayPool::_0_::_elem::_m_objectInformation::_7_::_m_perObjectType::_m_prob1TwoWheelerN = 0;
      @sysvar::XCP::RadarFC::_g_PER_Hil_ObjBypassingRunnable_ObjBypassingRunnable_m_pad_radarObjPort_par_out_local::TChangeableMemPool::_::_::_m_arrayPool::_0_::_elem::_m_objectInformation::_7_::_m_perObjectType::_m_prob1PedestrianN = 128;
      @sysvar::XCP::RadarFC::_g_PER_Hil_ObjBypassingRunnable_ObjBypassingRunnable_m_pad_radarObjPort_par_out_local::TChangeableMemPool::_::_::_m_arrayPool::_0_::_elem::_m_objectInformation::_7_::_m_perObjectType::_m_prob1MovUnknownN = 0;
      @sysvar::XCP::RadarFC::_g_PER_Hil_ObjBypassingRunnable_ObjBypassingRunnable_m_pad_radarObjPort_par_out_local::TChangeableMemPool::_::_::_m_arrayPool::_0_::_elem::_m_objectInformation::_7_::_m_perObjectType::_m_prob1RoadsideBarrierN = 0;
      @sysvar::XCP::RadarFC::_g_PER_Hil_ObjBypassingRunnable_ObjBypassingRunnable_m_pad_radarObjPort_par_out_local::TChangeableMemPool::_::_::_m_arrayPool::_0_::_elem::_m_objectInformation::_7_::_m_perObjectType::_m_prob1StatUnknownN = 128;
      @sysvar::XCP::RadarFC::_g_PER_Hil_ObjBypassingRunnable_ObjBypassingRunnable_m_pad_radarObjPort_par_out_local::TChangeableMemPool::_::_::_m_arrayPool::_0_::_elem::_m_objectInformation::_7_::_m_perObjectType::_m_prob1PassengerCarN = 0;
      @sysvar::XCP::RadarFC::_g_PER_Hil_ObjBypassingRunnable_ObjBypassingRunnable_m_pad_radarObjPort_par_out_local::TChangeableMemPool::_::_::_m_arrayPool::_0_::_elem::_m_objectInformation::_7_::_m_perObjectType::_m_prob1TruckN = 0;
      @sysvar::XCP::RadarFC::_g_PER_Hil_ObjBypassingRunnable_ObjBypassingRunnable_m_pad_radarObjPort_par_out_local::TChangeableMemPool::_::_::_m_arrayPool::_0_::_elem::_m_objectInformation::_7_::_m_perObjectType::_m_prob1FourWheelUnknownN = 128;
      @sysvar::XCP::RadarFC::_g_PER_Hil_ObjBypassingRunnable_ObjBypassingRunnable_m_pad_radarObjPort_par_out_local::TChangeableMemPool::_::_::_m_arrayPool::_0_::_elem::_m_objectInformation::_7_::_m_dWidthN = 64;
          break;

      case 2: //"2Wheeler::Cloe-> Bike"
      @sysvar::XCP::RadarFC::_g_PER_Hil_ObjBypassingRunnable_ObjBypassingRunnable_m_pad_radarObjPort_par_out_local::TChangeableMemPool::_::_::_m_arrayPool::_0_::_elem::_m_objectInformation::_7_::_m_perObjectType::_m_prob1ObstacleN = 128;
      @sysvar::XCP::RadarFC::_g_PER_Hil_ObjBypassingRunnable_ObjBypassingRunnable_m_pad_radarObjPort_par_out_local::TChangeableMemPool::_::_::_m_arrayPool::_0_::_elem::_m_objectInformation::_7_::_m_perObjectType::_m_prob1NonObstacleN = 0;
      @sysvar::XCP::RadarFC::_g_PER_Hil_ObjBypassingRunnable_ObjBypassingRunnable_m_pad_radarObjPort_par_out_local::TChangeableMemPool::_::_::_m_arrayPool::_0_::_elem::_m_objectInformation::_7_::_m_perObjectType::_m_prob1UnknownN = 0;
      @sysvar::XCP::RadarFC::_g_PER_Hil_ObjBypassingRunnable_ObjBypassingRunnable_m_pad_radarObjPort_par_out_local::TChangeableMemPool::_::_::_m_arrayPool::_0_::_elem::_m_objectInformation::_7_::_m_perObjectType::_m_prob1MobileN = 128;
      @sysvar::XCP::RadarFC::_g_PER_Hil_ObjBypassingRunnable_ObjBypassingRunnable_m_pad_radarObjPort_par_out_local::TChangeableMemPool::_::_::_m_arrayPool::_0_::_elem::_m_objectInformation::_7_::_m_perObjectType::_m_prob1StationaryN = 0;
      @sysvar::XCP::RadarFC::_g_PER_Hil_ObjBypassingRunnable_ObjBypassingRunnable_m_pad_radarObjPort_par_out_local::TChangeableMemPool::_::_::_m_arrayPool::_0_::_elem::_m_objectInformation::_7_::_m_perObjectType::_m_prob1ObstUnknownN = 0;
      @sysvar::XCP::RadarFC::_g_PER_Hil_ObjBypassingRunnable_ObjBypassingRunnable_m_pad_radarObjPort_par_out_local::TChangeableMemPool::_::_::_m_arrayPool::_0_::_elem::_m_objectInformation::_7_::_m_perObjectType::_m_prob1FourPlusWheelerN = 0;
      @sysvar::XCP::RadarFC::_g_PER_Hil_ObjBypassingRunnable_ObjBypassingRunnable_m_pad_radarObjPort_par_out_local::TChangeableMemPool::_::_::_m_arrayPool::_0_::_elem::_m_objectInformation::_7_::_m_perObjectType::_m_prob1TwoWheelerN = 128;
      @sysvar::XCP::RadarFC::_g_PER_Hil_ObjBypassingRunnable_ObjBypassingRunnable_m_pad_radarObjPort_par_out_local::TChangeableMemPool::_::_::_m_arrayPool::_0_::_elem::_m_objectInformation::_7_::_m_perObjectType::_m_prob1PedestrianN = 0;
      @sysvar::XCP::RadarFC::_g_PER_Hil_ObjBypassingRunnable_ObjBypassingRunnable_m_pad_radarObjPort_par_out_local::TChangeableMemPool::_::_::_m_arrayPool::_0_::_elem::_m_objectInformation::_7_::_m_perObjectType::_m_prob1MovUnknownN = 0;
      @sysvar::XCP::RadarFC::_g_PER_Hil_ObjBypassingRunnable_ObjBypassingRunnable_m_pad_radarObjPort_par_out_local::TChangeableMemPool::_::_::_m_arrayPool::_0_::_elem::_m_objectInformation::_7_::_m_perObjectType::_m_prob1RoadsideBarrierN = 0;
      @sysvar::XCP::RadarFC::_g_PER_Hil_ObjBypassingRunnable_ObjBypassingRunnable_m_pad_radarObjPort_par_out_local::TChangeableMemPool::_::_::_m_arrayPool::_0_::_elem::_m_objectInformation::_7_::_m_perObjectType::_m_prob1StatUnknownN = 128;
      @sysvar::XCP::RadarFC::_g_PER_Hil_ObjBypassingRunnable_ObjBypassingRunnable_m_pad_radarObjPort_par_out_local::TChangeableMemPool::_::_::_m_arrayPool::_0_::_elem::_m_objectInformation::_7_::_m_perObjectType::_m_prob1PassengerCarN = 0;
      @sysvar::XCP::RadarFC::_g_PER_Hil_ObjBypassingRunnable_ObjBypassingRunnable_m_pad_radarObjPort_par_out_local::TChangeableMemPool::_::_::_m_arrayPool::_0_::_elem::_m_objectInformation::_7_::_m_perObjectType::_m_prob1TruckN = 0;
      @sysvar::XCP::RadarFC::_g_PER_Hil_ObjBypassingRunnable_ObjBypassingRunnable_m_pad_radarObjPort_par_out_local::TChangeableMemPool::_::_::_m_arrayPool::_0_::_elem::_m_objectInformation::_7_::_m_perObjectType::_m_prob1FourWheelUnknownN = 128;
      @sysvar::XCP::RadarFC::_g_PER_Hil_ObjBypassingRunnable_ObjBypassingRunnable_m_pad_radarObjPort_par_out_local::TChangeableMemPool::_::_::_m_arrayPool::_0_::_elem::_m_objectInformation::_7_::_m_dWidthN = 64;
          break;

      case 3: //"2Wheeler::Cloe-> Motorbike"
      @sysvar::XCP::RadarFC::_g_PER_Hil_ObjBypassingRunnable_ObjBypassingRunnable_m_pad_radarObjPort_par_out_local::TChangeableMemPool::_::_::_m_arrayPool::_0_::_elem::_m_objectInformation::_7_::_m_perObjectType::_m_prob1ObstacleN = 128;
      @sysvar::XCP::RadarFC::_g_PER_Hil_ObjBypassingRunnable_ObjBypassingRunnable_m_pad_radarObjPort_par_out_local::TChangeableMemPool::_::_::_m_arrayPool::_0_::_elem::_m_objectInformation::_7_::_m_perObjectType::_m_prob1NonObstacleN = 0;
      @sysvar::XCP::RadarFC::_g_PER_Hil_ObjBypassingRunnable_ObjBypassingRunnable_m_pad_radarObjPort_par_out_local::TChangeableMemPool::_::_::_m_arrayPool::_0_::_elem::_m_objectInformation::_7_::_m_perObjectType::_m_prob1UnknownN = 0;
      @sysvar::XCP::RadarFC::_g_PER_Hil_ObjBypassingRunnable_ObjBypassingRunnable_m_pad_radarObjPort_par_out_local::TChangeableMemPool::_::_::_m_arrayPool::_0_::_elem::_m_objectInformation::_7_::_m_perObjectType::_m_prob1MobileN = 128;
      @sysvar::XCP::RadarFC::_g_PER_Hil_ObjBypassingRunnable_ObjBypassingRunnable_m_pad_radarObjPort_par_out_local::TChangeableMemPool::_::_::_m_arrayPool::_0_::_elem::_m_objectInformation::_7_::_m_perObjectType::_m_prob1StationaryN = 0;
      @sysvar::XCP::RadarFC::_g_PER_Hil_ObjBypassingRunnable_ObjBypassingRunnable_m_pad_radarObjPort_par_out_local::TChangeableMemPool::_::_::_m_arrayPool::_0_::_elem::_m_objectInformation::_7_::_m_perObjectType::_m_prob1ObstUnknownN = 0;
      @sysvar::XCP::RadarFC::_g_PER_Hil_ObjBypassingRunnable_ObjBypassingRunnable_m_pad_radarObjPort_par_out_local::TChangeableMemPool::_::_::_m_arrayPool::_0_::_elem::_m_objectInformation::_7_::_m_perObjectType::_m_prob1FourPlusWheelerN = 0;
      @sysvar::XCP::RadarFC::_g_PER_Hil_ObjBypassingRunnable_ObjBypassingRunnable_m_pad_radarObjPort_par_out_local::TChangeableMemPool::_::_::_m_arrayPool::_0_::_elem::_m_objectInformation::_7_::_m_perObjectType::_m_prob1TwoWheelerN = 128;
      @sysvar::XCP::RadarFC::_g_PER_Hil_ObjBypassingRunnable_ObjBypassingRunnable_m_pad_radarObjPort_par_out_local::TChangeableMemPool::_::_::_m_arrayPool::_0_::_elem::_m_objectInformation::_7_::_m_perObjectType::_m_prob1PedestrianN = 0;
      @sysvar::XCP::RadarFC::_g_PER_Hil_ObjBypassingRunnable_ObjBypassingRunnable_m_pad_radarObjPort_par_out_local::TChangeableMemPool::_::_::_m_arrayPool::_0_::_elem::_m_objectInformation::_7_::_m_perObjectType::_m_prob1MovUnknownN = 0;
      @sysvar::XCP::RadarFC::_g_PER_Hil_ObjBypassingRunnable_ObjBypassingRunnable_m_pad_radarObjPort_par_out_local::TChangeableMemPool::_::_::_m_arrayPool::_0_::_elem::_m_objectInformation::_7_::_m_perObjectType::_m_prob1RoadsideBarrierN = 0;
      @sysvar::XCP::RadarFC::_g_PER_Hil_ObjBypassingRunnable_ObjBypassingRunnable_m_pad_radarObjPort_par_out_local::TChangeableMemPool::_::_::_m_arrayPool::_0_::_elem::_m_objectInformation::_7_::_m_perObjectType::_m_prob1StatUnknownN = 128;
      @sysvar::XCP::RadarFC::_g_PER_Hil_ObjBypassingRunnable_ObjBypassingRunnable_m_pad_radarObjPort_par_out_local::TChangeableMemPool::_::_::_m_arrayPool::_0_::_elem::_m_objectInformation::_7_::_m_perObjectType::_m_prob1PassengerCarN = 0;
      @sysvar::XCP::RadarFC::_g_PER_Hil_ObjBypassingRunnable_ObjBypassingRunnable_m_pad_radarObjPort_par_out_local::TChangeableMemPool::_::_::_m_arrayPool::_0_::_elem::_m_objectInformation::_7_::_m_perObjectType::_m_prob1TruckN = 0;
      @sysvar::XCP::RadarFC::_g_PER_Hil_ObjBypassingRunnable_ObjBypassingRunnable_m_pad_radarObjPort_par_out_local::TChangeableMemPool::_::_::_m_arrayPool::_0_::_elem::_m_objectInformation::_7_::_m_perObjectType::_m_prob1FourWheelUnknownN = 128;
      @sysvar::XCP::RadarFC::_g_PER_Hil_ObjBypassingRunnable_ObjBypassingRunnable_m_pad_radarObjPort_par_out_local::TChangeableMemPool::_::_::_m_arrayPool::_0_::_elem::_m_objectInformation::_7_::_m_dWidthN = 64;
          break;

      case 4: //"PassengerCar"
      @sysvar::XCP::RadarFC::_g_PER_Hil_ObjBypassingRunnable_ObjBypassingRunnable_m_pad_radarObjPort_par_out_local::TChangeableMemPool::_::_::_m_arrayPool::_0_::_elem::_m_objectInformation::_7_::_m_perObjectType::_m_prob1ObstacleN = 128;
      @sysvar::XCP::RadarFC::_g_PER_Hil_ObjBypassingRunnable_ObjBypassingRunnable_m_pad_radarObjPort_par_out_local::TChangeableMemPool::_::_::_m_arrayPool::_0_::_elem::_m_objectInformation::_7_::_m_perObjectType::_m_prob1NonObstacleN = 0;
      @sysvar::XCP::RadarFC::_g_PER_Hil_ObjBypassingRunnable_ObjBypassingRunnable_m_pad_radarObjPort_par_out_local::TChangeableMemPool::_::_::_m_arrayPool::_0_::_elem::_m_objectInformation::_7_::_m_perObjectType::_m_prob1UnknownN = 0;
      @sysvar::XCP::RadarFC::_g_PER_Hil_ObjBypassingRunnable_ObjBypassingRunnable_m_pad_radarObjPort_par_out_local::TChangeableMemPool::_::_::_m_arrayPool::_0_::_elem::_m_objectInformation::_7_::_m_perObjectType::_m_prob1MobileN = 128;
      @sysvar::XCP::RadarFC::_g_PER_Hil_ObjBypassingRunnable_ObjBypassingRunnable_m_pad_radarObjPort_par_out_local::TChangeableMemPool::_::_::_m_arrayPool::_0_::_elem::_m_objectInformation::_7_::_m_perObjectType::_m_prob1StationaryN = 0;
      @sysvar::XCP::RadarFC::_g_PER_Hil_ObjBypassingRunnable_ObjBypassingRunnable_m_pad_radarObjPort_par_out_local::TChangeableMemPool::_::_::_m_arrayPool::_0_::_elem::_m_objectInformation::_7_::_m_perObjectType::_m_prob1ObstUnknownN = 0;
      @sysvar::XCP::RadarFC::_g_PER_Hil_ObjBypassingRunnable_ObjBypassingRunnable_m_pad_radarObjPort_par_out_local::TChangeableMemPool::_::_::_m_arrayPool::_0_::_elem::_m_objectInformation::_7_::_m_perObjectType::_m_prob1FourPlusWheelerN = 128;
      @sysvar::XCP::RadarFC::_g_PER_Hil_ObjBypassingRunnable_ObjBypassingRunnable_m_pad_radarObjPort_par_out_local::TChangeableMemPool::_::_::_m_arrayPool::_0_::_elem::_m_objectInformation::_7_::_m_perObjectType::_m_prob1TwoWheelerN = 0;
      @sysvar::XCP::RadarFC::_g_PER_Hil_ObjBypassingRunnable_ObjBypassingRunnable_m_pad_radarObjPort_par_out_local::TChangeableMemPool::_::_::_m_arrayPool::_0_::_elem::_m_objectInformation::_7_::_m_perObjectType::_m_prob1PedestrianN = 0;
      @sysvar::XCP::RadarFC::_g_PER_Hil_ObjBypassingRunnable_ObjBypassingRunnable_m_pad_radarObjPort_par_out_local::TChangeableMemPool::_::_::_m_arrayPool::_0_::_elem::_m_objectInformation::_7_::_m_perObjectType::_m_prob1MovUnknownN = 0;
      @sysvar::XCP::RadarFC::_g_PER_Hil_ObjBypassingRunnable_ObjBypassingRunnable_m_pad_radarObjPort_par_out_local::TChangeableMemPool::_::_::_m_arrayPool::_0_::_elem::_m_objectInformation::_7_::_m_perObjectType::_m_prob1RoadsideBarrierN = 0;
      @sysvar::XCP::RadarFC::_g_PER_Hil_ObjBypassingRunnable_ObjBypassingRunnable_m_pad_radarObjPort_par_out_local::TChangeableMemPool::_::_::_m_arrayPool::_0_::_elem::_m_objectInformation::_7_::_m_perObjectType::_m_prob1StatUnknownN = 128;
      @sysvar::XCP::RadarFC::_g_PER_Hil_ObjBypassingRunnable_ObjBypassingRunnable_m_pad_radarObjPort_par_out_local::TChangeableMemPool::_::_::_m_arrayPool::_0_::_elem::_m_objectInformation::_7_::_m_perObjectType::_m_prob1PassengerCarN = 128;
      @sysvar::XCP::RadarFC::_g_PER_Hil_ObjBypassingRunnable_ObjBypassingRunnable_m_pad_radarObjPort_par_out_local::TChangeableMemPool::_::_::_m_arrayPool::_0_::_elem::_m_objectInformation::_7_::_m_perObjectType::_m_prob1TruckN = 0;
      @sysvar::XCP::RadarFC::_g_PER_Hil_ObjBypassingRunnable_ObjBypassingRunnable_m_pad_radarObjPort_par_out_local::TChangeableMemPool::_::_::_m_arrayPool::_0_::_elem::_m_objectInformation::_7_::_m_perObjectType::_m_prob1FourWheelUnknownN = 0;
      @sysvar::XCP::RadarFC::_g_PER_Hil_ObjBypassingRunnable_ObjBypassingRunnable_m_pad_radarObjPort_par_out_local::TChangeableMemPool::_::_::_m_arrayPool::_0_::_elem::_m_objectInformation::_7_::_m_dWidthN = 256;
          break;

      case 5: //"Truck"
      @sysvar::XCP::RadarFC::_g_PER_Hil_ObjBypassingRunnable_ObjBypassingRunnable_m_pad_radarObjPort_par_out_local::TChangeableMemPool::_::_::_m_arrayPool::_0_::_elem::_m_objectInformation::_7_::_m_perObjectType::_m_prob1ObstacleN = 128;
      @sysvar::XCP::RadarFC::_g_PER_Hil_ObjBypassingRunnable_ObjBypassingRunnable_m_pad_radarObjPort_par_out_local::TChangeableMemPool::_::_::_m_arrayPool::_0_::_elem::_m_objectInformation::_7_::_m_perObjectType::_m_prob1NonObstacleN = 0;
      @sysvar::XCP::RadarFC::_g_PER_Hil_ObjBypassingRunnable_ObjBypassingRunnable_m_pad_radarObjPort_par_out_local::TChangeableMemPool::_::_::_m_arrayPool::_0_::_elem::_m_objectInformation::_7_::_m_perObjectType::_m_prob1UnknownN = 0;
      @sysvar::XCP::RadarFC::_g_PER_Hil_ObjBypassingRunnable_ObjBypassingRunnable_m_pad_radarObjPort_par_out_local::TChangeableMemPool::_::_::_m_arrayPool::_0_::_elem::_m_objectInformation::_7_::_m_perObjectType::_m_prob1MobileN = 128;
      @sysvar::XCP::RadarFC::_g_PER_Hil_ObjBypassingRunnable_ObjBypassingRunnable_m_pad_radarObjPort_par_out_local::TChangeableMemPool::_::_::_m_arrayPool::_0_::_elem::_m_objectInformation::_7_::_m_perObjectType::_m_prob1StationaryN = 0;
      @sysvar::XCP::RadarFC::_g_PER_Hil_ObjBypassingRunnable_ObjBypassingRunnable_m_pad_radarObjPort_par_out_local::TChangeableMemPool::_::_::_m_arrayPool::_0_::_elem::_m_objectInformation::_7_::_m_perObjectType::_m_prob1ObstUnknownN = 0;
      @sysvar::XCP::RadarFC::_g_PER_Hil_ObjBypassingRunnable_ObjBypassingRunnable_m_pad_radarObjPort_par_out_local::TChangeableMemPool::_::_::_m_arrayPool::_0_::_elem::_m_objectInformation::_7_::_m_perObjectType::_m_prob1FourPlusWheelerN = 128;
      @sysvar::XCP::RadarFC::_g_PER_Hil_ObjBypassingRunnable_ObjBypassingRunnable_m_pad_radarObjPort_par_out_local::TChangeableMemPool::_::_::_m_arrayPool::_0_::_elem::_m_objectInformation::_7_::_m_perObjectType::_m_prob1TwoWheelerN = 0;
      @sysvar::XCP::RadarFC::_g_PER_Hil_ObjBypassingRunnable_ObjBypassingRunnable_m_pad_radarObjPort_par_out_local::TChangeableMemPool::_::_::_m_arrayPool::_0_::_elem::_m_objectInformation::_7_::_m_perObjectType::_m_prob1PedestrianN = 0;
      @sysvar::XCP::RadarFC::_g_PER_Hil_ObjBypassingRunnable_ObjBypassingRunnable_m_pad_radarObjPort_par_out_local::TChangeableMemPool::_::_::_m_arrayPool::_0_::_elem::_m_objectInformation::_7_::_m_perObjectType::_m_prob1MovUnknownN = 0;
      @sysvar::XCP::RadarFC::_g_PER_Hil_ObjBypassingRunnable_ObjBypassingRunnable_m_pad_radarObjPort_par_out_local::TChangeableMemPool::_::_::_m_arrayPool::_0_::_elem::_m_objectInformation::_7_::_m_perObjectType::_m_prob1RoadsideBarrierN = 0;
      @sysvar::XCP::RadarFC::_g_PER_Hil_ObjBypassingRunnable_ObjBypassingRunnable_m_pad_radarObjPort_par_out_local::TChangeableMemPool::_::_::_m_arrayPool::_0_::_elem::_m_objectInformation::_7_::_m_perObjectType::_m_prob1StatUnknownN = 128;
      @sysvar::XCP::RadarFC::_g_PER_Hil_ObjBypassingRunnable_ObjBypassingRunnable_m_pad_radarObjPort_par_out_local::TChangeableMemPool::_::_::_m_arrayPool::_0_::_elem::_m_objectInformation::_7_::_m_perObjectType::_m_prob1PassengerCarN = 0;
      @sysvar::XCP::RadarFC::_g_PER_Hil_ObjBypassingRunnable_ObjBypassingRunnable_m_pad_radarObjPort_par_out_local::TChangeableMemPool::_::_::_m_arrayPool::_0_::_elem::_m_objectInformation::_7_::_m_perObjectType::_m_prob1TruckN = 128;
      @sysvar::XCP::RadarFC::_g_PER_Hil_ObjBypassingRunnable_ObjBypassingRunnable_m_pad_radarObjPort_par_out_local::TChangeableMemPool::_::_::_m_arrayPool::_0_::_elem::_m_objectInformation::_7_::_m_perObjectType::_m_prob1FourWheelUnknownN = 0;
      @sysvar::XCP::RadarFC::_g_PER_Hil_ObjBypassingRunnable_ObjBypassingRunnable_m_pad_radarObjPort_par_out_local::TChangeableMemPool::_::_::_m_arrayPool::_0_::_elem::_m_objectInformation::_7_::_m_dWidthN = 256;
          break;

      case 6: //"Non-Obstacle::Cloe->Trailer"
      @sysvar::XCP::RadarFC::_g_PER_Hil_ObjBypassingRunnable_ObjBypassingRunnable_m_pad_radarObjPort_par_out_local::TChangeableMemPool::_::_::_m_arrayPool::_0_::_elem::_m_objectInformation::_7_::_m_perObjectType::_m_prob1ObstacleN = 0;
      @sysvar::XCP::RadarFC::_g_PER_Hil_ObjBypassingRunnable_ObjBypassingRunnable_m_pad_radarObjPort_par_out_local::TChangeableMemPool::_::_::_m_arrayPool::_0_::_elem::_m_objectInformation::_7_::_m_perObjectType::_m_prob1NonObstacleN = 128;
      @sysvar::XCP::RadarFC::_g_PER_Hil_ObjBypassingRunnable_ObjBypassingRunnable_m_pad_radarObjPort_par_out_local::TChangeableMemPool::_::_::_m_arrayPool::_0_::_elem::_m_objectInformation::_7_::_m_perObjectType::_m_prob1UnknownN = 0;
      @sysvar::XCP::RadarFC::_g_PER_Hil_ObjBypassingRunnable_ObjBypassingRunnable_m_pad_radarObjPort_par_out_local::TChangeableMemPool::_::_::_m_arrayPool::_0_::_elem::_m_objectInformation::_7_::_m_perObjectType::_m_prob1MobileN = 128;
      @sysvar::XCP::RadarFC::_g_PER_Hil_ObjBypassingRunnable_ObjBypassingRunnable_m_pad_radarObjPort_par_out_local::TChangeableMemPool::_::_::_m_arrayPool::_0_::_elem::_m_objectInformation::_7_::_m_perObjectType::_m_prob1StationaryN = 0;
      @sysvar::XCP::RadarFC::_g_PER_Hil_ObjBypassingRunnable_ObjBypassingRunnable_m_pad_radarObjPort_par_out_local::TChangeableMemPool::_::_::_m_arrayPool::_0_::_elem::_m_objectInformation::_7_::_m_perObjectType::_m_prob1ObstUnknownN = 0;
      @sysvar::XCP::RadarFC::_g_PER_Hil_ObjBypassingRunnable_ObjBypassingRunnable_m_pad_radarObjPort_par_out_local::TChangeableMemPool::_::_::_m_arrayPool::_0_::_elem::_m_objectInformation::_7_::_m_perObjectType::_m_prob1FourPlusWheelerN = 0;
      @sysvar::XCP::RadarFC::_g_PER_Hil_ObjBypassingRunnable_ObjBypassingRunnable_m_pad_radarObjPort_par_out_local::TChangeableMemPool::_::_::_m_arrayPool::_0_::_elem::_m_objectInformation::_7_::_m_perObjectType::_m_prob1TwoWheelerN = 0;
      @sysvar::XCP::RadarFC::_g_PER_Hil_ObjBypassingRunnable_ObjBypassingRunnable_m_pad_radarObjPort_par_out_local::TChangeableMemPool::_::_::_m_arrayPool::_0_::_elem::_m_objectInformation::_7_::_m_perObjectType::_m_prob1PedestrianN = 0;
      @sysvar::XCP::RadarFC::_g_PER_Hil_ObjBypassingRunnable_ObjBypassingRunnable_m_pad_radarObjPort_par_out_local::TChangeableMemPool::_::_::_m_arrayPool::_0_::_elem::_m_objectInformation::_7_::_m_perObjectType::_m_prob1MovUnknownN = 128;
      @sysvar::XCP::RadarFC::_g_PER_Hil_ObjBypassingRunnable_ObjBypassingRunnable_m_pad_radarObjPort_par_out_local::TChangeableMemPool::_::_::_m_arrayPool::_0_::_elem::_m_objectInformation::_7_::_m_perObjectType::_m_prob1RoadsideBarrierN = 0;
      @sysvar::XCP::RadarFC::_g_PER_Hil_ObjBypassingRunnable_ObjBypassingRunnable_m_pad_radarObjPort_par_out_local::TChangeableMemPool::_::_::_m_arrayPool::_0_::_elem::_m_objectInformation::_7_::_m_perObjectType::_m_prob1StatUnknownN = 128;
      @sysvar::XCP::RadarFC::_g_PER_Hil_ObjBypassingRunnable_ObjBypassingRunnable_m_pad_radarObjPort_par_out_local::TChangeableMemPool::_::_::_m_arrayPool::_0_::_elem::_m_objectInformation::_7_::_m_perObjectType::_m_prob1PassengerCarN = 0;
      @sysvar::XCP::RadarFC::_g_PER_Hil_ObjBypassingRunnable_ObjBypassingRunnable_m_pad_radarObjPort_par_out_local::TChangeableMemPool::_::_::_m_arrayPool::_0_::_elem::_m_objectInformation::_7_::_m_perObjectType::_m_prob1TruckN = 0;
      @sysvar::XCP::RadarFC::_g_PER_Hil_ObjBypassingRunnable_ObjBypassingRunnable_m_pad_radarObjPort_par_out_local::TChangeableMemPool::_::_::_m_arrayPool::_0_::_elem::_m_objectInformation::_7_::_m_perObjectType::_m_prob1FourWheelUnknownN = 128;
      @sysvar::XCP::RadarFC::_g_PER_Hil_ObjBypassingRunnable_ObjBypassingRunnable_m_pad_radarObjPort_par_out_local::TChangeableMemPool::_::_::_m_arrayPool::_0_::_elem::_m_objectInformation::_7_::_m_dWidthN = 256;
          break;

      case 7: //"RoadSideBarrier"
      @sysvar::XCP::RadarFC::_g_PER_Hil_ObjBypassingRunnable_ObjBypassingRunnable_m_pad_radarObjPort_par_out_local::TChangeableMemPool::_::_::_m_arrayPool::_0_::_elem::_m_objectInformation::_7_::_m_perObjectType::_m_prob1ObstacleN = 128;
      @sysvar::XCP::RadarFC::_g_PER_Hil_ObjBypassingRunnable_ObjBypassingRunnable_m_pad_radarObjPort_par_out_local::TChangeableMemPool::_::_::_m_arrayPool::_0_::_elem::_m_objectInformation::_7_::_m_perObjectType::_m_prob1NonObstacleN = 0;
      @sysvar::XCP::RadarFC::_g_PER_Hil_ObjBypassingRunnable_ObjBypassingRunnable_m_pad_radarObjPort_par_out_local::TChangeableMemPool::_::_::_m_arrayPool::_0_::_elem::_m_objectInformation::_7_::_m_perObjectType::_m_prob1UnknownN = 0;
      @sysvar::XCP::RadarFC::_g_PER_Hil_ObjBypassingRunnable_ObjBypassingRunnable_m_pad_radarObjPort_par_out_local::TChangeableMemPool::_::_::_m_arrayPool::_0_::_elem::_m_objectInformation::_7_::_m_perObjectType::_m_prob1MobileN = 0;
      @sysvar::XCP::RadarFC::_g_PER_Hil_ObjBypassingRunnable_ObjBypassingRunnable_m_pad_radarObjPort_par_out_local::TChangeableMemPool::_::_::_m_arrayPool::_0_::_elem::_m_objectInformation::_7_::_m_perObjectType::_m_prob1StationaryN = 128;
      @sysvar::XCP::RadarFC::_g_PER_Hil_ObjBypassingRunnable_ObjBypassingRunnable_m_pad_radarObjPort_par_out_local::TChangeableMemPool::_::_::_m_arrayPool::_0_::_elem::_m_objectInformation::_7_::_m_perObjectType::_m_prob1ObstUnknownN = 0;
      @sysvar::XCP::RadarFC::_g_PER_Hil_ObjBypassingRunnable_ObjBypassingRunnable_m_pad_radarObjPort_par_out_local::TChangeableMemPool::_::_::_m_arrayPool::_0_::_elem::_m_objectInformation::_7_::_m_perObjectType::_m_prob1FourPlusWheelerN = 0;
      @sysvar::XCP::RadarFC::_g_PER_Hil_ObjBypassingRunnable_ObjBypassingRunnable_m_pad_radarObjPort_par_out_local::TChangeableMemPool::_::_::_m_arrayPool::_0_::_elem::_m_objectInformation::_7_::_m_perObjectType::_m_prob1TwoWheelerN = 0;
      @sysvar::XCP::RadarFC::_g_PER_Hil_ObjBypassingRunnable_ObjBypassingRunnable_m_pad_radarObjPort_par_out_local::TChangeableMemPool::_::_::_m_arrayPool::_0_::_elem::_m_objectInformation::_7_::_m_perObjectType::_m_prob1PedestrianN = 0;
      @sysvar::XCP::RadarFC::_g_PER_Hil_ObjBypassingRunnable_ObjBypassingRunnable_m_pad_radarObjPort_par_out_local::TChangeableMemPool::_::_::_m_arrayPool::_0_::_elem::_m_objectInformation::_7_::_m_perObjectType::_m_prob1MovUnknownN = 128;
      @sysvar::XCP::RadarFC::_g_PER_Hil_ObjBypassingRunnable_ObjBypassingRunnable_m_pad_radarObjPort_par_out_local::TChangeableMemPool::_::_::_m_arrayPool::_0_::_elem::_m_objectInformation::_7_::_m_perObjectType::_m_prob1RoadsideBarrierN = 128;
      @sysvar::XCP::RadarFC::_g_PER_Hil_ObjBypassingRunnable_ObjBypassingRunnable_m_pad_radarObjPort_par_out_local::TChangeableMemPool::_::_::_m_arrayPool::_0_::_elem::_m_objectInformation::_7_::_m_perObjectType::_m_prob1StatUnknownN = 0;
      @sysvar::XCP::RadarFC::_g_PER_Hil_ObjBypassingRunnable_ObjBypassingRunnable_m_pad_radarObjPort_par_out_local::TChangeableMemPool::_::_::_m_arrayPool::_0_::_elem::_m_objectInformation::_7_::_m_perObjectType::_m_prob1PassengerCarN = 0;
      @sysvar::XCP::RadarFC::_g_PER_Hil_ObjBypassingRunnable_ObjBypassingRunnable_m_pad_radarObjPort_par_out_local::TChangeableMemPool::_::_::_m_arrayPool::_0_::_elem::_m_objectInformation::_7_::_m_perObjectType::_m_prob1TruckN = 0;
      @sysvar::XCP::RadarFC::_g_PER_Hil_ObjBypassingRunnable_ObjBypassingRunnable_m_pad_radarObjPort_par_out_local::TChangeableMemPool::_::_::_m_arrayPool::_0_::_elem::_m_objectInformation::_7_::_m_perObjectType::_m_prob1FourWheelUnknownN = 128;
      @sysvar::XCP::RadarFC::_g_PER_Hil_ObjBypassingRunnable_ObjBypassingRunnable_m_pad_radarObjPort_par_out_local::TChangeableMemPool::_::_::_m_arrayPool::_0_::_elem::_m_objectInformation::_7_::_m_dWidthN = 256;
          break;
      }
      break;

    case 8: //"Object-8"
    //constant
  @sysvar::XCP::RadarFC::_g_PER_Hil_ObjBypassingRunnable_ObjBypassingRunnable_m_pad_radarObjPort_par_out_local::TChangeableMemPool::_::_::_m_arrayPool::_0_::_elem::_m_objectInformation::_8_::_Valid_b = 1;
  @sysvar::XCP::RadarFC::_g_PER_Hil_ObjBypassingRunnable_ObjBypassingRunnable_m_pad_radarObjPort_par_out_local::TChangeableMemPool::_::_::_m_arrayPool::_0_::_elem::_m_objectInformation::_8_::_m_HandleN = 1;
  @sysvar::XCP::RadarFC::_g_PER_Hil_ObjBypassingRunnable_ObjBypassingRunnable_m_pad_radarObjPort_par_out_local::TChangeableMemPool::_::_::_m_arrayPool::_0_::_elem::_m_objectInformation::_8_::_m_alpPiVarYawAngleN = 0;
  @sysvar::XCP::RadarFC::_g_PER_Hil_ObjBypassingRunnable_ObjBypassingRunnable_m_pad_radarObjPort_par_out_local::TChangeableMemPool::_::_::_m_arrayPool::_0_::_elem::_m_objectInformation::_8_::_m_alpPiYawAngleN = 0;
  @sysvar::XCP::RadarFC::_g_PER_Hil_ObjBypassingRunnable_ObjBypassingRunnable_m_pad_radarObjPort_par_out_local::TChangeableMemPool::_::_::_m_arrayPool::_0_::_elem::_m_objectInformation::_8_::_m_varAxN = 0;
  @sysvar::XCP::RadarFC::_g_PER_Hil_ObjBypassingRunnable_ObjBypassingRunnable_m_pad_radarObjPort_par_out_local::TChangeableMemPool::_::_::_m_arrayPool::_0_::_elem::_m_objectInformation::_8_::_m_varAyN = 0;
  @sysvar::XCP::RadarFC::_g_PER_Hil_ObjBypassingRunnable_ObjBypassingRunnable_m_pad_radarObjPort_par_out_local::TChangeableMemPool::_::_::_m_arrayPool::_0_::_elem::_m_objectInformation::_8_::_m_varVxN = 0;
  @sysvar::XCP::RadarFC::_g_PER_Hil_ObjBypassingRunnable_ObjBypassingRunnable_m_pad_radarObjPort_par_out_local::TChangeableMemPool::_::_::_m_arrayPool::_0_::_elem::_m_objectInformation::_8_::_m_varVyN = 0;
  @sysvar::XCP::RadarFC::_g_PER_Hil_ObjBypassingRunnable_ObjBypassingRunnable_m_pad_radarObjPort_par_out_local::TChangeableMemPool::_::_::_m_arrayPool::_0_::_elem::_m_objectInformation::_8_::_m_varDxN = 0;
  @sysvar::XCP::RadarFC::_g_PER_Hil_ObjBypassingRunnable_ObjBypassingRunnable_m_pad_radarObjPort_par_out_local::TChangeableMemPool::_::_::_m_arrayPool::_0_::_elem::_m_objectInformation::_8_::_m_varDyN = 0;
  @sysvar::XCP::RadarFC::_g_PER_Hil_ObjBypassingRunnable_ObjBypassingRunnable_m_pad_radarObjPort_par_out_local::TChangeableMemPool::_::_::_m_arrayPool::_0_::_elem::_m_objectInformation::_8_::_m_dVarLengthN = 0;
  @sysvar::XCP::RadarFC::_g_PER_Hil_ObjBypassingRunnable_ObjBypassingRunnable_m_pad_radarObjPort_par_out_local::TChangeableMemPool::_::_::_m_arrayPool::_0_::_elem::_m_objectInformation::_8_::_m_dVarWidthN = 0;
  @sysvar::XCP::RadarFC::_g_PER_Hil_ObjBypassingRunnable_ObjBypassingRunnable_m_pad_radarObjPort_par_out_local::TChangeableMemPool::_::_::_m_arrayPool::_0_::_elem::_m_objectInformation::_8_::_m_wExistProbN = 64880;
  @sysvar::XCP::RadarFC::_g_PER_Hil_ObjBypassingRunnable_ObjBypassingRunnable_m_pad_radarObjPort_par_out_local::TChangeableMemPool::_::_::_m_arrayPool::_0_::_elem::_m_objectInformation::_8_::_m_isObjectAsil = 1;
  @sysvar::XCP::RadarFC::_g_PER_Hil_ObjBypassingRunnable_ObjBypassingRunnable_m_pad_radarObjPort_par_out_local::TChangeableMemPool::_::_::_m_arrayPool::_0_::_elem::_m_objectInformation::_8_::_m_dLengthN = 128;

      //target movement

  @sysvar::XCP::RadarFC::_g_PER_Hil_ObjBypassingRunnable_ObjBypassingRunnable_m_pad_radarObjPort_par_out_local::TChangeableMemPool::_::_::_m_arrayPool::_0_::_elem::_m_objectInformation::_8_::_m_dxN = @FDX_in_HIL_specific_FRadar_Obj::FDX_in_FRadar_8_m_dxN;
  @sysvar::XCP::RadarFC::_g_PER_Hil_ObjBypassingRunnable_ObjBypassingRunnable_m_pad_radarObjPort_par_out_local::TChangeableMemPool::_::_::_m_arrayPool::_0_::_elem::_m_objectInformation::_8_::_m_dyN = @FDX_in_HIL_specific_FRadar_Obj::FDX_in_FRadar_8_m_dyN;
  @sysvar::XCP::RadarFC::_g_PER_Hil_ObjBypassingRunnable_ObjBypassingRunnable_m_pad_radarObjPort_par_out_local::TChangeableMemPool::_::_::_m_arrayPool::_0_::_elem::_m_objectInformation::_8_::_m_dzN = @FDX_in_HIL_specific_FRadar_Obj::FDX_in_FRadar_8_m_dzN;
  @sysvar::XCP::RadarFC::_g_PER_Hil_ObjBypassingRunnable_ObjBypassingRunnable_m_pad_radarObjPort_par_out_local::TChangeableMemPool::_::_::_m_arrayPool::_0_::_elem::_m_objectInformation::_8_::_m_vxN = @FDX_in_HIL_specific_FRadar_Obj::FDX_in_FRadar_8_m_vxN;
  @sysvar::XCP::RadarFC::_g_PER_Hil_ObjBypassingRunnable_ObjBypassingRunnable_m_pad_radarObjPort_par_out_local::TChangeableMemPool::_::_::_m_arrayPool::_0_::_elem::_m_objectInformation::_8_::_m_vyN = @FDX_in_HIL_specific_FRadar_Obj::FDX_in_FRadar_8_m_vyN;
  @sysvar::XCP::RadarFC::_g_PER_Hil_ObjBypassingRunnable_ObjBypassingRunnable_m_pad_radarObjPort_par_out_local::TChangeableMemPool::_::_::_m_arrayPool::_0_::_elem::_m_objectInformation::_8_::_m_axN = @FDX_in_HIL_specific_FRadar_Obj::FDX_in_FRadar_8_m_axN;
  @sysvar::XCP::RadarFC::_g_PER_Hil_ObjBypassingRunnable_ObjBypassingRunnable_m_pad_radarObjPort_par_out_local::TChangeableMemPool::_::_::_m_arrayPool::_0_::_elem::_m_objectInformation::_8_::_m_ayN = @FDX_in_HIL_specific_FRadar_Obj::FDX_in_FRadar_8_m_ayN;
  @sysvar::XCP::RadarFC::_g_PER_Hil_ObjBypassingRunnable_ObjBypassingRunnable_m_pad_radarObjPort_par_out_local::TChangeableMemPool::_::_::_m_arrayPool::_0_::_elem::_m_objectInformation::_8_::_m_dLengthN = @FDX_in_HIL_specific_FRadar_Obj::FDX_in_FRadar_8_m_dLengthN;
  @sysvar::XCP::RadarFC::_g_PER_Hil_ObjBypassingRunnable_ObjBypassingRunnable_m_pad_radarObjPort_par_out_local::TChangeableMemPool::_::_::_m_arrayPool::_0_::_elem::_m_objectInformation::_8_::_m_dWidthN = @FDX_in_HIL_specific_FRadar_Obj::FDX_in_FRadar_8_m_dWidthN;
  @sysvar::XCP::RadarFC::_g_PER_Hil_ObjBypassingRunnable_ObjBypassingRunnable_m_pad_radarObjPort_par_out_local::TChangeableMemPool::_::_::_m_arrayPool::_0_::_elem::_m_objectInformation::_8_::_m_alpPiYawAngleN = @FDX_in_HIL_specific_FRadar_Obj::FDX_in_FRadar_8_m_alpPiYawAngleN;

      //target object moving or not
      if (abs(@FDX_in_HIL_specific_FRadar_Obj::FDX_in_FRadar_8_m_vxN) != 0)
      {
    @sysvar::XCP::RadarFC::_g_PER_Hil_ObjBypassingRunnable_ObjBypassingRunnable_m_pad_radarObjPort_par_out_local::TChangeableMemPool::_::_::_m_arrayPool::_0_::_elem::_m_objectInformation::_8_::_m_prob1HasBeenObservedMovingN = 126;
    @sysvar::XCP::RadarFC::_g_PER_Hil_ObjBypassingRunnable_ObjBypassingRunnable_m_pad_radarObjPort_par_out_local::TChangeableMemPool::_::_::_m_arrayPool::_0_::_elem::_m_objectInformation::_8_::_m_prob1MovingN = 126;
      }
      else
      {
    @sysvar::XCP::RadarFC::_g_PER_Hil_ObjBypassingRunnable_ObjBypassingRunnable_m_pad_radarObjPort_par_out_local::TChangeableMemPool::_::_::_m_arrayPool::_0_::_elem::_m_objectInformation::_8_::_m_prob1HasBeenObservedMovingN = 0;
    @sysvar::XCP::RadarFC::_g_PER_Hil_ObjBypassingRunnable_ObjBypassingRunnable_m_pad_radarObjPort_par_out_local::TChangeableMemPool::_::_::_m_arrayPool::_0_::_elem::_m_objectInformation::_8_::_m_prob1MovingN = 0;
      }

      //object classification
    switch (@FDX_in_HIL_specific_FRadar_Obj::FDX_in_FRadar_8_Sensed_Object_Classification)
    {
      case 0: //"unknown"
      @sysvar::XCP::RadarFC::_g_PER_Hil_ObjBypassingRunnable_ObjBypassingRunnable_m_pad_radarObjPort_par_out_local::TChangeableMemPool::_::_::_m_arrayPool::_0_::_elem::_m_objectInformation::_8_::_m_perObjectType::_m_prob1ObstacleN = 0;
      @sysvar::XCP::RadarFC::_g_PER_Hil_ObjBypassingRunnable_ObjBypassingRunnable_m_pad_radarObjPort_par_out_local::TChangeableMemPool::_::_::_m_arrayPool::_0_::_elem::_m_objectInformation::_8_::_m_perObjectType::_m_prob1NonObstacleN = 0;
      @sysvar::XCP::RadarFC::_g_PER_Hil_ObjBypassingRunnable_ObjBypassingRunnable_m_pad_radarObjPort_par_out_local::TChangeableMemPool::_::_::_m_arrayPool::_0_::_elem::_m_objectInformation::_8_::_m_perObjectType::_m_prob1UnknownN = 128;
      @sysvar::XCP::RadarFC::_g_PER_Hil_ObjBypassingRunnable_ObjBypassingRunnable_m_pad_radarObjPort_par_out_local::TChangeableMemPool::_::_::_m_arrayPool::_0_::_elem::_m_objectInformation::_8_::_m_perObjectType::_m_prob1MobileN = 0;
      @sysvar::XCP::RadarFC::_g_PER_Hil_ObjBypassingRunnable_ObjBypassingRunnable_m_pad_radarObjPort_par_out_local::TChangeableMemPool::_::_::_m_arrayPool::_0_::_elem::_m_objectInformation::_8_::_m_perObjectType::_m_prob1StationaryN = 0;
      @sysvar::XCP::RadarFC::_g_PER_Hil_ObjBypassingRunnable_ObjBypassingRunnable_m_pad_radarObjPort_par_out_local::TChangeableMemPool::_::_::_m_arrayPool::_0_::_elem::_m_objectInformation::_8_::_m_perObjectType::_m_prob1ObstUnknownN = 128;
      @sysvar::XCP::RadarFC::_g_PER_Hil_ObjBypassingRunnable_ObjBypassingRunnable_m_pad_radarObjPort_par_out_local::TChangeableMemPool::_::_::_m_arrayPool::_0_::_elem::_m_objectInformation::_8_::_m_perObjectType::_m_prob1FourPlusWheelerN = 0;
      @sysvar::XCP::RadarFC::_g_PER_Hil_ObjBypassingRunnable_ObjBypassingRunnable_m_pad_radarObjPort_par_out_local::TChangeableMemPool::_::_::_m_arrayPool::_0_::_elem::_m_objectInformation::_8_::_m_perObjectType::_m_prob1TwoWheelerN = 0;
      @sysvar::XCP::RadarFC::_g_PER_Hil_ObjBypassingRunnable_ObjBypassingRunnable_m_pad_radarObjPort_par_out_local::TChangeableMemPool::_::_::_m_arrayPool::_0_::_elem::_m_objectInformation::_8_::_m_perObjectType::_m_prob1PedestrianN = 0;
      @sysvar::XCP::RadarFC::_g_PER_Hil_ObjBypassingRunnable_ObjBypassingRunnable_m_pad_radarObjPort_par_out_local::TChangeableMemPool::_::_::_m_arrayPool::_0_::_elem::_m_objectInformation::_8_::_m_perObjectType::_m_prob1MovUnknownN = 128;
      @sysvar::XCP::RadarFC::_g_PER_Hil_ObjBypassingRunnable_ObjBypassingRunnable_m_pad_radarObjPort_par_out_local::TChangeableMemPool::_::_::_m_arrayPool::_0_::_elem::_m_objectInformation::_8_::_m_perObjectType::_m_prob1RoadsideBarrierN = 0;
      @sysvar::XCP::RadarFC::_g_PER_Hil_ObjBypassingRunnable_ObjBypassingRunnable_m_pad_radarObjPort_par_out_local::TChangeableMemPool::_::_::_m_arrayPool::_0_::_elem::_m_objectInformation::_8_::_m_perObjectType::_m_prob1StatUnknownN = 128;
      @sysvar::XCP::RadarFC::_g_PER_Hil_ObjBypassingRunnable_ObjBypassingRunnable_m_pad_radarObjPort_par_out_local::TChangeableMemPool::_::_::_m_arrayPool::_0_::_elem::_m_objectInformation::_8_::_m_perObjectType::_m_prob1PassengerCarN = 0;
      @sysvar::XCP::RadarFC::_g_PER_Hil_ObjBypassingRunnable_ObjBypassingRunnable_m_pad_radarObjPort_par_out_local::TChangeableMemPool::_::_::_m_arrayPool::_0_::_elem::_m_objectInformation::_8_::_m_perObjectType::_m_prob1TruckN = 0;
      @sysvar::XCP::RadarFC::_g_PER_Hil_ObjBypassingRunnable_ObjBypassingRunnable_m_pad_radarObjPort_par_out_local::TChangeableMemPool::_::_::_m_arrayPool::_0_::_elem::_m_objectInformation::_8_::_m_perObjectType::_m_prob1FourWheelUnknownN = 128;
      @sysvar::XCP::RadarFC::_g_PER_Hil_ObjBypassingRunnable_ObjBypassingRunnable_m_pad_radarObjPort_par_out_local::TChangeableMemPool::_::_::_m_arrayPool::_0_::_elem::_m_objectInformation::_8_::_m_dWidthN = 256;
          break;

      case 1: //"Pedestrian"
      @sysvar::XCP::RadarFC::_g_PER_Hil_ObjBypassingRunnable_ObjBypassingRunnable_m_pad_radarObjPort_par_out_local::TChangeableMemPool::_::_::_m_arrayPool::_0_::_elem::_m_objectInformation::_8_::_m_perObjectType::_m_prob1ObstacleN = 128;
      @sysvar::XCP::RadarFC::_g_PER_Hil_ObjBypassingRunnable_ObjBypassingRunnable_m_pad_radarObjPort_par_out_local::TChangeableMemPool::_::_::_m_arrayPool::_0_::_elem::_m_objectInformation::_8_::_m_perObjectType::_m_prob1NonObstacleN = 0;
      @sysvar::XCP::RadarFC::_g_PER_Hil_ObjBypassingRunnable_ObjBypassingRunnable_m_pad_radarObjPort_par_out_local::TChangeableMemPool::_::_::_m_arrayPool::_0_::_elem::_m_objectInformation::_8_::_m_perObjectType::_m_prob1UnknownN = 0;
      @sysvar::XCP::RadarFC::_g_PER_Hil_ObjBypassingRunnable_ObjBypassingRunnable_m_pad_radarObjPort_par_out_local::TChangeableMemPool::_::_::_m_arrayPool::_0_::_elem::_m_objectInformation::_8_::_m_perObjectType::_m_prob1MobileN = 128;
      @sysvar::XCP::RadarFC::_g_PER_Hil_ObjBypassingRunnable_ObjBypassingRunnable_m_pad_radarObjPort_par_out_local::TChangeableMemPool::_::_::_m_arrayPool::_0_::_elem::_m_objectInformation::_8_::_m_perObjectType::_m_prob1StationaryN = 0;
      @sysvar::XCP::RadarFC::_g_PER_Hil_ObjBypassingRunnable_ObjBypassingRunnable_m_pad_radarObjPort_par_out_local::TChangeableMemPool::_::_::_m_arrayPool::_0_::_elem::_m_objectInformation::_8_::_m_perObjectType::_m_prob1ObstUnknownN = 0;
      @sysvar::XCP::RadarFC::_g_PER_Hil_ObjBypassingRunnable_ObjBypassingRunnable_m_pad_radarObjPort_par_out_local::TChangeableMemPool::_::_::_m_arrayPool::_0_::_elem::_m_objectInformation::_8_::_m_perObjectType::_m_prob1FourPlusWheelerN = 0;
      @sysvar::XCP::RadarFC::_g_PER_Hil_ObjBypassingRunnable_ObjBypassingRunnable_m_pad_radarObjPort_par_out_local::TChangeableMemPool::_::_::_m_arrayPool::_0_::_elem::_m_objectInformation::_8_::_m_perObjectType::_m_prob1TwoWheelerN = 0;
      @sysvar::XCP::RadarFC::_g_PER_Hil_ObjBypassingRunnable_ObjBypassingRunnable_m_pad_radarObjPort_par_out_local::TChangeableMemPool::_::_::_m_arrayPool::_0_::_elem::_m_objectInformation::_8_::_m_perObjectType::_m_prob1PedestrianN = 128;
      @sysvar::XCP::RadarFC::_g_PER_Hil_ObjBypassingRunnable_ObjBypassingRunnable_m_pad_radarObjPort_par_out_local::TChangeableMemPool::_::_::_m_arrayPool::_0_::_elem::_m_objectInformation::_8_::_m_perObjectType::_m_prob1MovUnknownN = 0;
      @sysvar::XCP::RadarFC::_g_PER_Hil_ObjBypassingRunnable_ObjBypassingRunnable_m_pad_radarObjPort_par_out_local::TChangeableMemPool::_::_::_m_arrayPool::_0_::_elem::_m_objectInformation::_8_::_m_perObjectType::_m_prob1RoadsideBarrierN = 0;
      @sysvar::XCP::RadarFC::_g_PER_Hil_ObjBypassingRunnable_ObjBypassingRunnable_m_pad_radarObjPort_par_out_local::TChangeableMemPool::_::_::_m_arrayPool::_0_::_elem::_m_objectInformation::_8_::_m_perObjectType::_m_prob1StatUnknownN = 128;
      @sysvar::XCP::RadarFC::_g_PER_Hil_ObjBypassingRunnable_ObjBypassingRunnable_m_pad_radarObjPort_par_out_local::TChangeableMemPool::_::_::_m_arrayPool::_0_::_elem::_m_objectInformation::_8_::_m_perObjectType::_m_prob1PassengerCarN = 0;
      @sysvar::XCP::RadarFC::_g_PER_Hil_ObjBypassingRunnable_ObjBypassingRunnable_m_pad_radarObjPort_par_out_local::TChangeableMemPool::_::_::_m_arrayPool::_0_::_elem::_m_objectInformation::_8_::_m_perObjectType::_m_prob1TruckN = 0;
      @sysvar::XCP::RadarFC::_g_PER_Hil_ObjBypassingRunnable_ObjBypassingRunnable_m_pad_radarObjPort_par_out_local::TChangeableMemPool::_::_::_m_arrayPool::_0_::_elem::_m_objectInformation::_8_::_m_perObjectType::_m_prob1FourWheelUnknownN = 128;
      @sysvar::XCP::RadarFC::_g_PER_Hil_ObjBypassingRunnable_ObjBypassingRunnable_m_pad_radarObjPort_par_out_local::TChangeableMemPool::_::_::_m_arrayPool::_0_::_elem::_m_objectInformation::_8_::_m_dWidthN = 64;
          break;

      case 2: //"2Wheeler::Cloe-> Bike"
      @sysvar::XCP::RadarFC::_g_PER_Hil_ObjBypassingRunnable_ObjBypassingRunnable_m_pad_radarObjPort_par_out_local::TChangeableMemPool::_::_::_m_arrayPool::_0_::_elem::_m_objectInformation::_8_::_m_perObjectType::_m_prob1ObstacleN = 128;
      @sysvar::XCP::RadarFC::_g_PER_Hil_ObjBypassingRunnable_ObjBypassingRunnable_m_pad_radarObjPort_par_out_local::TChangeableMemPool::_::_::_m_arrayPool::_0_::_elem::_m_objectInformation::_8_::_m_perObjectType::_m_prob1NonObstacleN = 0;
      @sysvar::XCP::RadarFC::_g_PER_Hil_ObjBypassingRunnable_ObjBypassingRunnable_m_pad_radarObjPort_par_out_local::TChangeableMemPool::_::_::_m_arrayPool::_0_::_elem::_m_objectInformation::_8_::_m_perObjectType::_m_prob1UnknownN = 0;
      @sysvar::XCP::RadarFC::_g_PER_Hil_ObjBypassingRunnable_ObjBypassingRunnable_m_pad_radarObjPort_par_out_local::TChangeableMemPool::_::_::_m_arrayPool::_0_::_elem::_m_objectInformation::_8_::_m_perObjectType::_m_prob1MobileN = 128;
      @sysvar::XCP::RadarFC::_g_PER_Hil_ObjBypassingRunnable_ObjBypassingRunnable_m_pad_radarObjPort_par_out_local::TChangeableMemPool::_::_::_m_arrayPool::_0_::_elem::_m_objectInformation::_8_::_m_perObjectType::_m_prob1StationaryN = 0;
      @sysvar::XCP::RadarFC::_g_PER_Hil_ObjBypassingRunnable_ObjBypassingRunnable_m_pad_radarObjPort_par_out_local::TChangeableMemPool::_::_::_m_arrayPool::_0_::_elem::_m_objectInformation::_8_::_m_perObjectType::_m_prob1ObstUnknownN = 0;
      @sysvar::XCP::RadarFC::_g_PER_Hil_ObjBypassingRunnable_ObjBypassingRunnable_m_pad_radarObjPort_par_out_local::TChangeableMemPool::_::_::_m_arrayPool::_0_::_elem::_m_objectInformation::_8_::_m_perObjectType::_m_prob1FourPlusWheelerN = 0;
      @sysvar::XCP::RadarFC::_g_PER_Hil_ObjBypassingRunnable_ObjBypassingRunnable_m_pad_radarObjPort_par_out_local::TChangeableMemPool::_::_::_m_arrayPool::_0_::_elem::_m_objectInformation::_8_::_m_perObjectType::_m_prob1TwoWheelerN = 128;
      @sysvar::XCP::RadarFC::_g_PER_Hil_ObjBypassingRunnable_ObjBypassingRunnable_m_pad_radarObjPort_par_out_local::TChangeableMemPool::_::_::_m_arrayPool::_0_::_elem::_m_objectInformation::_8_::_m_perObjectType::_m_prob1PedestrianN = 0;
      @sysvar::XCP::RadarFC::_g_PER_Hil_ObjBypassingRunnable_ObjBypassingRunnable_m_pad_radarObjPort_par_out_local::TChangeableMemPool::_::_::_m_arrayPool::_0_::_elem::_m_objectInformation::_8_::_m_perObjectType::_m_prob1MovUnknownN = 0;
      @sysvar::XCP::RadarFC::_g_PER_Hil_ObjBypassingRunnable_ObjBypassingRunnable_m_pad_radarObjPort_par_out_local::TChangeableMemPool::_::_::_m_arrayPool::_0_::_elem::_m_objectInformation::_8_::_m_perObjectType::_m_prob1RoadsideBarrierN = 0;
      @sysvar::XCP::RadarFC::_g_PER_Hil_ObjBypassingRunnable_ObjBypassingRunnable_m_pad_radarObjPort_par_out_local::TChangeableMemPool::_::_::_m_arrayPool::_0_::_elem::_m_objectInformation::_8_::_m_perObjectType::_m_prob1StatUnknownN = 128;
      @sysvar::XCP::RadarFC::_g_PER_Hil_ObjBypassingRunnable_ObjBypassingRunnable_m_pad_radarObjPort_par_out_local::TChangeableMemPool::_::_::_m_arrayPool::_0_::_elem::_m_objectInformation::_8_::_m_perObjectType::_m_prob1PassengerCarN = 0;
      @sysvar::XCP::RadarFC::_g_PER_Hil_ObjBypassingRunnable_ObjBypassingRunnable_m_pad_radarObjPort_par_out_local::TChangeableMemPool::_::_::_m_arrayPool::_0_::_elem::_m_objectInformation::_8_::_m_perObjectType::_m_prob1TruckN = 0;
      @sysvar::XCP::RadarFC::_g_PER_Hil_ObjBypassingRunnable_ObjBypassingRunnable_m_pad_radarObjPort_par_out_local::TChangeableMemPool::_::_::_m_arrayPool::_0_::_elem::_m_objectInformation::_8_::_m_perObjectType::_m_prob1FourWheelUnknownN = 128;
      @sysvar::XCP::RadarFC::_g_PER_Hil_ObjBypassingRunnable_ObjBypassingRunnable_m_pad_radarObjPort_par_out_local::TChangeableMemPool::_::_::_m_arrayPool::_0_::_elem::_m_objectInformation::_8_::_m_dWidthN = 64;
          break;

      case 3: //"2Wheeler::Cloe-> Motorbike"
      @sysvar::XCP::RadarFC::_g_PER_Hil_ObjBypassingRunnable_ObjBypassingRunnable_m_pad_radarObjPort_par_out_local::TChangeableMemPool::_::_::_m_arrayPool::_0_::_elem::_m_objectInformation::_8_::_m_perObjectType::_m_prob1ObstacleN = 128;
      @sysvar::XCP::RadarFC::_g_PER_Hil_ObjBypassingRunnable_ObjBypassingRunnable_m_pad_radarObjPort_par_out_local::TChangeableMemPool::_::_::_m_arrayPool::_0_::_elem::_m_objectInformation::_8_::_m_perObjectType::_m_prob1NonObstacleN = 0;
      @sysvar::XCP::RadarFC::_g_PER_Hil_ObjBypassingRunnable_ObjBypassingRunnable_m_pad_radarObjPort_par_out_local::TChangeableMemPool::_::_::_m_arrayPool::_0_::_elem::_m_objectInformation::_8_::_m_perObjectType::_m_prob1UnknownN = 0;
      @sysvar::XCP::RadarFC::_g_PER_Hil_ObjBypassingRunnable_ObjBypassingRunnable_m_pad_radarObjPort_par_out_local::TChangeableMemPool::_::_::_m_arrayPool::_0_::_elem::_m_objectInformation::_8_::_m_perObjectType::_m_prob1MobileN = 128;
      @sysvar::XCP::RadarFC::_g_PER_Hil_ObjBypassingRunnable_ObjBypassingRunnable_m_pad_radarObjPort_par_out_local::TChangeableMemPool::_::_::_m_arrayPool::_0_::_elem::_m_objectInformation::_8_::_m_perObjectType::_m_prob1StationaryN = 0;
      @sysvar::XCP::RadarFC::_g_PER_Hil_ObjBypassingRunnable_ObjBypassingRunnable_m_pad_radarObjPort_par_out_local::TChangeableMemPool::_::_::_m_arrayPool::_0_::_elem::_m_objectInformation::_8_::_m_perObjectType::_m_prob1ObstUnknownN = 0;
      @sysvar::XCP::RadarFC::_g_PER_Hil_ObjBypassingRunnable_ObjBypassingRunnable_m_pad_radarObjPort_par_out_local::TChangeableMemPool::_::_::_m_arrayPool::_0_::_elem::_m_objectInformation::_8_::_m_perObjectType::_m_prob1FourPlusWheelerN = 0;
      @sysvar::XCP::RadarFC::_g_PER_Hil_ObjBypassingRunnable_ObjBypassingRunnable_m_pad_radarObjPort_par_out_local::TChangeableMemPool::_::_::_m_arrayPool::_0_::_elem::_m_objectInformation::_8_::_m_perObjectType::_m_prob1TwoWheelerN = 128;
      @sysvar::XCP::RadarFC::_g_PER_Hil_ObjBypassingRunnable_ObjBypassingRunnable_m_pad_radarObjPort_par_out_local::TChangeableMemPool::_::_::_m_arrayPool::_0_::_elem::_m_objectInformation::_8_::_m_perObjectType::_m_prob1PedestrianN = 0;
      @sysvar::XCP::RadarFC::_g_PER_Hil_ObjBypassingRunnable_ObjBypassingRunnable_m_pad_radarObjPort_par_out_local::TChangeableMemPool::_::_::_m_arrayPool::_0_::_elem::_m_objectInformation::_8_::_m_perObjectType::_m_prob1MovUnknownN = 0;
      @sysvar::XCP::RadarFC::_g_PER_Hil_ObjBypassingRunnable_ObjBypassingRunnable_m_pad_radarObjPort_par_out_local::TChangeableMemPool::_::_::_m_arrayPool::_0_::_elem::_m_objectInformation::_8_::_m_perObjectType::_m_prob1RoadsideBarrierN = 0;
      @sysvar::XCP::RadarFC::_g_PER_Hil_ObjBypassingRunnable_ObjBypassingRunnable_m_pad_radarObjPort_par_out_local::TChangeableMemPool::_::_::_m_arrayPool::_0_::_elem::_m_objectInformation::_8_::_m_perObjectType::_m_prob1StatUnknownN = 128;
      @sysvar::XCP::RadarFC::_g_PER_Hil_ObjBypassingRunnable_ObjBypassingRunnable_m_pad_radarObjPort_par_out_local::TChangeableMemPool::_::_::_m_arrayPool::_0_::_elem::_m_objectInformation::_8_::_m_perObjectType::_m_prob1PassengerCarN = 0;
      @sysvar::XCP::RadarFC::_g_PER_Hil_ObjBypassingRunnable_ObjBypassingRunnable_m_pad_radarObjPort_par_out_local::TChangeableMemPool::_::_::_m_arrayPool::_0_::_elem::_m_objectInformation::_8_::_m_perObjectType::_m_prob1TruckN = 0;
      @sysvar::XCP::RadarFC::_g_PER_Hil_ObjBypassingRunnable_ObjBypassingRunnable_m_pad_radarObjPort_par_out_local::TChangeableMemPool::_::_::_m_arrayPool::_0_::_elem::_m_objectInformation::_8_::_m_perObjectType::_m_prob1FourWheelUnknownN = 128;
      @sysvar::XCP::RadarFC::_g_PER_Hil_ObjBypassingRunnable_ObjBypassingRunnable_m_pad_radarObjPort_par_out_local::TChangeableMemPool::_::_::_m_arrayPool::_0_::_elem::_m_objectInformation::_8_::_m_dWidthN = 64;
          break;

      case 4: //"PassengerCar"
      @sysvar::XCP::RadarFC::_g_PER_Hil_ObjBypassingRunnable_ObjBypassingRunnable_m_pad_radarObjPort_par_out_local::TChangeableMemPool::_::_::_m_arrayPool::_0_::_elem::_m_objectInformation::_8_::_m_perObjectType::_m_prob1ObstacleN = 128;
      @sysvar::XCP::RadarFC::_g_PER_Hil_ObjBypassingRunnable_ObjBypassingRunnable_m_pad_radarObjPort_par_out_local::TChangeableMemPool::_::_::_m_arrayPool::_0_::_elem::_m_objectInformation::_8_::_m_perObjectType::_m_prob1NonObstacleN = 0;
      @sysvar::XCP::RadarFC::_g_PER_Hil_ObjBypassingRunnable_ObjBypassingRunnable_m_pad_radarObjPort_par_out_local::TChangeableMemPool::_::_::_m_arrayPool::_0_::_elem::_m_objectInformation::_8_::_m_perObjectType::_m_prob1UnknownN = 0;
      @sysvar::XCP::RadarFC::_g_PER_Hil_ObjBypassingRunnable_ObjBypassingRunnable_m_pad_radarObjPort_par_out_local::TChangeableMemPool::_::_::_m_arrayPool::_0_::_elem::_m_objectInformation::_8_::_m_perObjectType::_m_prob1MobileN = 128;
      @sysvar::XCP::RadarFC::_g_PER_Hil_ObjBypassingRunnable_ObjBypassingRunnable_m_pad_radarObjPort_par_out_local::TChangeableMemPool::_::_::_m_arrayPool::_0_::_elem::_m_objectInformation::_8_::_m_perObjectType::_m_prob1StationaryN = 0;
      @sysvar::XCP::RadarFC::_g_PER_Hil_ObjBypassingRunnable_ObjBypassingRunnable_m_pad_radarObjPort_par_out_local::TChangeableMemPool::_::_::_m_arrayPool::_0_::_elem::_m_objectInformation::_8_::_m_perObjectType::_m_prob1ObstUnknownN = 0;
      @sysvar::XCP::RadarFC::_g_PER_Hil_ObjBypassingRunnable_ObjBypassingRunnable_m_pad_radarObjPort_par_out_local::TChangeableMemPool::_::_::_m_arrayPool::_0_::_elem::_m_objectInformation::_8_::_m_perObjectType::_m_prob1FourPlusWheelerN = 128;
      @sysvar::XCP::RadarFC::_g_PER_Hil_ObjBypassingRunnable_ObjBypassingRunnable_m_pad_radarObjPort_par_out_local::TChangeableMemPool::_::_::_m_arrayPool::_0_::_elem::_m_objectInformation::_8_::_m_perObjectType::_m_prob1TwoWheelerN = 0;
      @sysvar::XCP::RadarFC::_g_PER_Hil_ObjBypassingRunnable_ObjBypassingRunnable_m_pad_radarObjPort_par_out_local::TChangeableMemPool::_::_::_m_arrayPool::_0_::_elem::_m_objectInformation::_8_::_m_perObjectType::_m_prob1PedestrianN = 0;
      @sysvar::XCP::RadarFC::_g_PER_Hil_ObjBypassingRunnable_ObjBypassingRunnable_m_pad_radarObjPort_par_out_local::TChangeableMemPool::_::_::_m_arrayPool::_0_::_elem::_m_objectInformation::_8_::_m_perObjectType::_m_prob1MovUnknownN = 0;
      @sysvar::XCP::RadarFC::_g_PER_Hil_ObjBypassingRunnable_ObjBypassingRunnable_m_pad_radarObjPort_par_out_local::TChangeableMemPool::_::_::_m_arrayPool::_0_::_elem::_m_objectInformation::_8_::_m_perObjectType::_m_prob1RoadsideBarrierN = 0;
      @sysvar::XCP::RadarFC::_g_PER_Hil_ObjBypassingRunnable_ObjBypassingRunnable_m_pad_radarObjPort_par_out_local::TChangeableMemPool::_::_::_m_arrayPool::_0_::_elem::_m_objectInformation::_8_::_m_perObjectType::_m_prob1StatUnknownN = 128;
      @sysvar::XCP::RadarFC::_g_PER_Hil_ObjBypassingRunnable_ObjBypassingRunnable_m_pad_radarObjPort_par_out_local::TChangeableMemPool::_::_::_m_arrayPool::_0_::_elem::_m_objectInformation::_8_::_m_perObjectType::_m_prob1PassengerCarN = 128;
      @sysvar::XCP::RadarFC::_g_PER_Hil_ObjBypassingRunnable_ObjBypassingRunnable_m_pad_radarObjPort_par_out_local::TChangeableMemPool::_::_::_m_arrayPool::_0_::_elem::_m_objectInformation::_8_::_m_perObjectType::_m_prob1TruckN = 0;
      @sysvar::XCP::RadarFC::_g_PER_Hil_ObjBypassingRunnable_ObjBypassingRunnable_m_pad_radarObjPort_par_out_local::TChangeableMemPool::_::_::_m_arrayPool::_0_::_elem::_m_objectInformation::_8_::_m_perObjectType::_m_prob1FourWheelUnknownN = 0;
      @sysvar::XCP::RadarFC::_g_PER_Hil_ObjBypassingRunnable_ObjBypassingRunnable_m_pad_radarObjPort_par_out_local::TChangeableMemPool::_::_::_m_arrayPool::_0_::_elem::_m_objectInformation::_8_::_m_dWidthN = 256;
          break;

      case 5: //"Truck"
      @sysvar::XCP::RadarFC::_g_PER_Hil_ObjBypassingRunnable_ObjBypassingRunnable_m_pad_radarObjPort_par_out_local::TChangeableMemPool::_::_::_m_arrayPool::_0_::_elem::_m_objectInformation::_8_::_m_perObjectType::_m_prob1ObstacleN = 128;
      @sysvar::XCP::RadarFC::_g_PER_Hil_ObjBypassingRunnable_ObjBypassingRunnable_m_pad_radarObjPort_par_out_local::TChangeableMemPool::_::_::_m_arrayPool::_0_::_elem::_m_objectInformation::_8_::_m_perObjectType::_m_prob1NonObstacleN = 0;
      @sysvar::XCP::RadarFC::_g_PER_Hil_ObjBypassingRunnable_ObjBypassingRunnable_m_pad_radarObjPort_par_out_local::TChangeableMemPool::_::_::_m_arrayPool::_0_::_elem::_m_objectInformation::_8_::_m_perObjectType::_m_prob1UnknownN = 0;
      @sysvar::XCP::RadarFC::_g_PER_Hil_ObjBypassingRunnable_ObjBypassingRunnable_m_pad_radarObjPort_par_out_local::TChangeableMemPool::_::_::_m_arrayPool::_0_::_elem::_m_objectInformation::_8_::_m_perObjectType::_m_prob1MobileN = 128;
      @sysvar::XCP::RadarFC::_g_PER_Hil_ObjBypassingRunnable_ObjBypassingRunnable_m_pad_radarObjPort_par_out_local::TChangeableMemPool::_::_::_m_arrayPool::_0_::_elem::_m_objectInformation::_8_::_m_perObjectType::_m_prob1StationaryN = 0;
      @sysvar::XCP::RadarFC::_g_PER_Hil_ObjBypassingRunnable_ObjBypassingRunnable_m_pad_radarObjPort_par_out_local::TChangeableMemPool::_::_::_m_arrayPool::_0_::_elem::_m_objectInformation::_8_::_m_perObjectType::_m_prob1ObstUnknownN = 0;
      @sysvar::XCP::RadarFC::_g_PER_Hil_ObjBypassingRunnable_ObjBypassingRunnable_m_pad_radarObjPort_par_out_local::TChangeableMemPool::_::_::_m_arrayPool::_0_::_elem::_m_objectInformation::_8_::_m_perObjectType::_m_prob1FourPlusWheelerN = 128;
      @sysvar::XCP::RadarFC::_g_PER_Hil_ObjBypassingRunnable_ObjBypassingRunnable_m_pad_radarObjPort_par_out_local::TChangeableMemPool::_::_::_m_arrayPool::_0_::_elem::_m_objectInformation::_8_::_m_perObjectType::_m_prob1TwoWheelerN = 0;
      @sysvar::XCP::RadarFC::_g_PER_Hil_ObjBypassingRunnable_ObjBypassingRunnable_m_pad_radarObjPort_par_out_local::TChangeableMemPool::_::_::_m_arrayPool::_0_::_elem::_m_objectInformation::_8_::_m_perObjectType::_m_prob1PedestrianN = 0;
      @sysvar::XCP::RadarFC::_g_PER_Hil_ObjBypassingRunnable_ObjBypassingRunnable_m_pad_radarObjPort_par_out_local::TChangeableMemPool::_::_::_m_arrayPool::_0_::_elem::_m_objectInformation::_8_::_m_perObjectType::_m_prob1MovUnknownN = 0;
      @sysvar::XCP::RadarFC::_g_PER_Hil_ObjBypassingRunnable_ObjBypassingRunnable_m_pad_radarObjPort_par_out_local::TChangeableMemPool::_::_::_m_arrayPool::_0_::_elem::_m_objectInformation::_8_::_m_perObjectType::_m_prob1RoadsideBarrierN = 0;
      @sysvar::XCP::RadarFC::_g_PER_Hil_ObjBypassingRunnable_ObjBypassingRunnable_m_pad_radarObjPort_par_out_local::TChangeableMemPool::_::_::_m_arrayPool::_0_::_elem::_m_objectInformation::_8_::_m_perObjectType::_m_prob1StatUnknownN = 128;
      @sysvar::XCP::RadarFC::_g_PER_Hil_ObjBypassingRunnable_ObjBypassingRunnable_m_pad_radarObjPort_par_out_local::TChangeableMemPool::_::_::_m_arrayPool::_0_::_elem::_m_objectInformation::_8_::_m_perObjectType::_m_prob1PassengerCarN = 0;
      @sysvar::XCP::RadarFC::_g_PER_Hil_ObjBypassingRunnable_ObjBypassingRunnable_m_pad_radarObjPort_par_out_local::TChangeableMemPool::_::_::_m_arrayPool::_0_::_elem::_m_objectInformation::_8_::_m_perObjectType::_m_prob1TruckN = 128;
      @sysvar::XCP::RadarFC::_g_PER_Hil_ObjBypassingRunnable_ObjBypassingRunnable_m_pad_radarObjPort_par_out_local::TChangeableMemPool::_::_::_m_arrayPool::_0_::_elem::_m_objectInformation::_8_::_m_perObjectType::_m_prob1FourWheelUnknownN = 0;
      @sysvar::XCP::RadarFC::_g_PER_Hil_ObjBypassingRunnable_ObjBypassingRunnable_m_pad_radarObjPort_par_out_local::TChangeableMemPool::_::_::_m_arrayPool::_0_::_elem::_m_objectInformation::_8_::_m_dWidthN = 256;
          break;

      case 6: //"Non-Obstacle::Cloe->Trailer"
      @sysvar::XCP::RadarFC::_g_PER_Hil_ObjBypassingRunnable_ObjBypassingRunnable_m_pad_radarObjPort_par_out_local::TChangeableMemPool::_::_::_m_arrayPool::_0_::_elem::_m_objectInformation::_8_::_m_perObjectType::_m_prob1ObstacleN = 0;
      @sysvar::XCP::RadarFC::_g_PER_Hil_ObjBypassingRunnable_ObjBypassingRunnable_m_pad_radarObjPort_par_out_local::TChangeableMemPool::_::_::_m_arrayPool::_0_::_elem::_m_objectInformation::_8_::_m_perObjectType::_m_prob1NonObstacleN = 128;
      @sysvar::XCP::RadarFC::_g_PER_Hil_ObjBypassingRunnable_ObjBypassingRunnable_m_pad_radarObjPort_par_out_local::TChangeableMemPool::_::_::_m_arrayPool::_0_::_elem::_m_objectInformation::_8_::_m_perObjectType::_m_prob1UnknownN = 0;
      @sysvar::XCP::RadarFC::_g_PER_Hil_ObjBypassingRunnable_ObjBypassingRunnable_m_pad_radarObjPort_par_out_local::TChangeableMemPool::_::_::_m_arrayPool::_0_::_elem::_m_objectInformation::_8_::_m_perObjectType::_m_prob1MobileN = 128;
      @sysvar::XCP::RadarFC::_g_PER_Hil_ObjBypassingRunnable_ObjBypassingRunnable_m_pad_radarObjPort_par_out_local::TChangeableMemPool::_::_::_m_arrayPool::_0_::_elem::_m_objectInformation::_8_::_m_perObjectType::_m_prob1StationaryN = 0;
      @sysvar::XCP::RadarFC::_g_PER_Hil_ObjBypassingRunnable_ObjBypassingRunnable_m_pad_radarObjPort_par_out_local::TChangeableMemPool::_::_::_m_arrayPool::_0_::_elem::_m_objectInformation::_8_::_m_perObjectType::_m_prob1ObstUnknownN = 0;
      @sysvar::XCP::RadarFC::_g_PER_Hil_ObjBypassingRunnable_ObjBypassingRunnable_m_pad_radarObjPort_par_out_local::TChangeableMemPool::_::_::_m_arrayPool::_0_::_elem::_m_objectInformation::_8_::_m_perObjectType::_m_prob1FourPlusWheelerN = 0;
      @sysvar::XCP::RadarFC::_g_PER_Hil_ObjBypassingRunnable_ObjBypassingRunnable_m_pad_radarObjPort_par_out_local::TChangeableMemPool::_::_::_m_arrayPool::_0_::_elem::_m_objectInformation::_8_::_m_perObjectType::_m_prob1TwoWheelerN = 0;
      @sysvar::XCP::RadarFC::_g_PER_Hil_ObjBypassingRunnable_ObjBypassingRunnable_m_pad_radarObjPort_par_out_local::TChangeableMemPool::_::_::_m_arrayPool::_0_::_elem::_m_objectInformation::_8_::_m_perObjectType::_m_prob1PedestrianN = 0;
      @sysvar::XCP::RadarFC::_g_PER_Hil_ObjBypassingRunnable_ObjBypassingRunnable_m_pad_radarObjPort_par_out_local::TChangeableMemPool::_::_::_m_arrayPool::_0_::_elem::_m_objectInformation::_8_::_m_perObjectType::_m_prob1MovUnknownN = 128;
      @sysvar::XCP::RadarFC::_g_PER_Hil_ObjBypassingRunnable_ObjBypassingRunnable_m_pad_radarObjPort_par_out_local::TChangeableMemPool::_::_::_m_arrayPool::_0_::_elem::_m_objectInformation::_8_::_m_perObjectType::_m_prob1RoadsideBarrierN = 0;
      @sysvar::XCP::RadarFC::_g_PER_Hil_ObjBypassingRunnable_ObjBypassingRunnable_m_pad_radarObjPort_par_out_local::TChangeableMemPool::_::_::_m_arrayPool::_0_::_elem::_m_objectInformation::_8_::_m_perObjectType::_m_prob1StatUnknownN = 128;
      @sysvar::XCP::RadarFC::_g_PER_Hil_ObjBypassingRunnable_ObjBypassingRunnable_m_pad_radarObjPort_par_out_local::TChangeableMemPool::_::_::_m_arrayPool::_0_::_elem::_m_objectInformation::_8_::_m_perObjectType::_m_prob1PassengerCarN = 0;
      @sysvar::XCP::RadarFC::_g_PER_Hil_ObjBypassingRunnable_ObjBypassingRunnable_m_pad_radarObjPort_par_out_local::TChangeableMemPool::_::_::_m_arrayPool::_0_::_elem::_m_objectInformation::_8_::_m_perObjectType::_m_prob1TruckN = 0;
      @sysvar::XCP::RadarFC::_g_PER_Hil_ObjBypassingRunnable_ObjBypassingRunnable_m_pad_radarObjPort_par_out_local::TChangeableMemPool::_::_::_m_arrayPool::_0_::_elem::_m_objectInformation::_8_::_m_perObjectType::_m_prob1FourWheelUnknownN = 128;
      @sysvar::XCP::RadarFC::_g_PER_Hil_ObjBypassingRunnable_ObjBypassingRunnable_m_pad_radarObjPort_par_out_local::TChangeableMemPool::_::_::_m_arrayPool::_0_::_elem::_m_objectInformation::_8_::_m_dWidthN = 256;
          break;

      case 7: //"RoadSideBarrier"
      @sysvar::XCP::RadarFC::_g_PER_Hil_ObjBypassingRunnable_ObjBypassingRunnable_m_pad_radarObjPort_par_out_local::TChangeableMemPool::_::_::_m_arrayPool::_0_::_elem::_m_objectInformation::_8_::_m_perObjectType::_m_prob1ObstacleN = 128;
      @sysvar::XCP::RadarFC::_g_PER_Hil_ObjBypassingRunnable_ObjBypassingRunnable_m_pad_radarObjPort_par_out_local::TChangeableMemPool::_::_::_m_arrayPool::_0_::_elem::_m_objectInformation::_8_::_m_perObjectType::_m_prob1NonObstacleN = 0;
      @sysvar::XCP::RadarFC::_g_PER_Hil_ObjBypassingRunnable_ObjBypassingRunnable_m_pad_radarObjPort_par_out_local::TChangeableMemPool::_::_::_m_arrayPool::_0_::_elem::_m_objectInformation::_8_::_m_perObjectType::_m_prob1UnknownN = 0;
      @sysvar::XCP::RadarFC::_g_PER_Hil_ObjBypassingRunnable_ObjBypassingRunnable_m_pad_radarObjPort_par_out_local::TChangeableMemPool::_::_::_m_arrayPool::_0_::_elem::_m_objectInformation::_8_::_m_perObjectType::_m_prob1MobileN = 0;
      @sysvar::XCP::RadarFC::_g_PER_Hil_ObjBypassingRunnable_ObjBypassingRunnable_m_pad_radarObjPort_par_out_local::TChangeableMemPool::_::_::_m_arrayPool::_0_::_elem::_m_objectInformation::_8_::_m_perObjectType::_m_prob1StationaryN = 128;
      @sysvar::XCP::RadarFC::_g_PER_Hil_ObjBypassingRunnable_ObjBypassingRunnable_m_pad_radarObjPort_par_out_local::TChangeableMemPool::_::_::_m_arrayPool::_0_::_elem::_m_objectInformation::_8_::_m_perObjectType::_m_prob1ObstUnknownN = 0;
      @sysvar::XCP::RadarFC::_g_PER_Hil_ObjBypassingRunnable_ObjBypassingRunnable_m_pad_radarObjPort_par_out_local::TChangeableMemPool::_::_::_m_arrayPool::_0_::_elem::_m_objectInformation::_8_::_m_perObjectType::_m_prob1FourPlusWheelerN = 0;
      @sysvar::XCP::RadarFC::_g_PER_Hil_ObjBypassingRunnable_ObjBypassingRunnable_m_pad_radarObjPort_par_out_local::TChangeableMemPool::_::_::_m_arrayPool::_0_::_elem::_m_objectInformation::_8_::_m_perObjectType::_m_prob1TwoWheelerN = 0;
      @sysvar::XCP::RadarFC::_g_PER_Hil_ObjBypassingRunnable_ObjBypassingRunnable_m_pad_radarObjPort_par_out_local::TChangeableMemPool::_::_::_m_arrayPool::_0_::_elem::_m_objectInformation::_8_::_m_perObjectType::_m_prob1PedestrianN = 0;
      @sysvar::XCP::RadarFC::_g_PER_Hil_ObjBypassingRunnable_ObjBypassingRunnable_m_pad_radarObjPort_par_out_local::TChangeableMemPool::_::_::_m_arrayPool::_0_::_elem::_m_objectInformation::_8_::_m_perObjectType::_m_prob1MovUnknownN = 128;
      @sysvar::XCP::RadarFC::_g_PER_Hil_ObjBypassingRunnable_ObjBypassingRunnable_m_pad_radarObjPort_par_out_local::TChangeableMemPool::_::_::_m_arrayPool::_0_::_elem::_m_objectInformation::_8_::_m_perObjectType::_m_prob1RoadsideBarrierN = 128;
      @sysvar::XCP::RadarFC::_g_PER_Hil_ObjBypassingRunnable_ObjBypassingRunnable_m_pad_radarObjPort_par_out_local::TChangeableMemPool::_::_::_m_arrayPool::_0_::_elem::_m_objectInformation::_8_::_m_perObjectType::_m_prob1StatUnknownN = 0;
      @sysvar::XCP::RadarFC::_g_PER_Hil_ObjBypassingRunnable_ObjBypassingRunnable_m_pad_radarObjPort_par_out_local::TChangeableMemPool::_::_::_m_arrayPool::_0_::_elem::_m_objectInformation::_8_::_m_perObjectType::_m_prob1PassengerCarN = 0;
      @sysvar::XCP::RadarFC::_g_PER_Hil_ObjBypassingRunnable_ObjBypassingRunnable_m_pad_radarObjPort_par_out_local::TChangeableMemPool::_::_::_m_arrayPool::_0_::_elem::_m_objectInformation::_8_::_m_perObjectType::_m_prob1TruckN = 0;
      @sysvar::XCP::RadarFC::_g_PER_Hil_ObjBypassingRunnable_ObjBypassingRunnable_m_pad_radarObjPort_par_out_local::TChangeableMemPool::_::_::_m_arrayPool::_0_::_elem::_m_objectInformation::_8_::_m_perObjectType::_m_prob1FourWheelUnknownN = 128;
      @sysvar::XCP::RadarFC::_g_PER_Hil_ObjBypassingRunnable_ObjBypassingRunnable_m_pad_radarObjPort_par_out_local::TChangeableMemPool::_::_::_m_arrayPool::_0_::_elem::_m_objectInformation::_8_::_m_dWidthN = 256;
          break;
      }
      break;
  }
}