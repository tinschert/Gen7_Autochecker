/*@!Encoding:1252*/
/**
 * @file Road_Obj_CRadarFR_XCP.cin
 * @author ADAS_HIL_TEAM
 * @date 08-21-2023
 * @brief  Handles Radar object injection into XCP
 *
 * ################################################################
 * C O P Y R I G H T S
 * ----------------------------------------------------------------
 * Copyright (c) 2023 by Robert Bosch GmbH. All rights reserved.
 
 * The reproduction, distribution and utilization of this file as
 * well as the communication of its contents to others without express
 * authorization is prohibited. Offenders will be held liable for the
 * payment of damages. All rights reserved in the event of the grant
 * of a patent, utility model or design.
 *
 * ################################################################
*/

includes
{
}

variables
{
  /*
Integers in form of
byte (unsigned, 1 Byte)
word (unsigned, 2 Byte)
dword (unsigned, 4 Byte)
int (signed, 2 Byte)
long (signed, 4 Byte)
int64(signed, 8 Byte)
qword(unsigned, 8 Byte)
Individual character
char (1 Byte)
Floating point numbers
float (8 Byte)
double (8 Byte)
*/  
}


void obj_sim_update_CRadarFR_xcp(byte object_id)
{
  //header
  @sysvar::XCP::RadarFR::_g_PlReCoFw_PlReCoPer_ObjBypassingRunnable_ObjBypassingRunnable_m_pad_radarObjPort_par_out_local::TChangeableMemPool::_::_::_m_arrayPool::_0_::_elem::port_ens_r_obj_sensor_base::_::_m_alignment::_m_alpAzimuthAngOffsetN = -1146;
  @sysvar::XCP::RadarFR::_g_PlReCoFw_PlReCoPer_ObjBypassingRunnable_ObjBypassingRunnable_m_pad_radarObjPort_par_out_local::TChangeableMemPool::_::_::_m_arrayPool::_0_::_elem::port_ens_r_obj_sensor_base::_::_m_alignment::_m_alpMountAngleN = 0;
  @sysvar::XCP::RadarFR::_g_PlReCoFw_PlReCoPer_ObjBypassingRunnable_ObjBypassingRunnable_m_pad_radarObjPort_par_out_local::TChangeableMemPool::_::_::_m_arrayPool::_0_::_elem::port_ens_r_obj_sensor_base::_::_m_alignment::_m_dLongitudinalOffsetRearAxisN = 455;
  @sysvar::XCP::RadarFR::_g_PlReCoFw_PlReCoPer_ObjBypassingRunnable_ObjBypassingRunnable_m_pad_radarObjPort_par_out_local::TChangeableMemPool::_::_::_m_arrayPool::_0_::_elem::port_ens_r_obj_sensor_base::_::_m_alignment::_m_dMountElevationN = 20;
  @sysvar::XCP::RadarFR::_g_PlReCoFw_PlReCoPer_ObjBypassingRunnable_ObjBypassingRunnable_m_pad_radarObjPort_par_out_local::TChangeableMemPool::_::_::_m_arrayPool::_0_::_elem::port_ens_r_obj_sensor_base::_::_m_alignment::_m_dMountOffsetN = 0;

  switch (@Classe_Obj_Sim::obj_data.obj_id[object_id])
  {
    case 0: //"Object-0"
    //constant
    @sysvar::XCP::RadarFR::_g_PlReCoFw_PlReCoPer_ObjBypassingRunnable_ObjBypassingRunnable_m_pad_radarObjPort_par_out_local::TChangeableMemPool::_::_::_m_arrayPool::_0_::_elem::port_ens_r_obj_sensor_base::_::_m_movObjectInformation::_0_::STA_OBJECT_INFORMATION_ST::_::_Meas_b = 1;
    @sysvar::XCP::RadarFR::_g_PlReCoFw_PlReCoPer_ObjBypassingRunnable_ObjBypassingRunnable_m_pad_radarObjPort_par_out_local::TChangeableMemPool::_::_::_m_arrayPool::_0_::_elem::port_ens_r_obj_sensor_base::_::_m_movObjectInformation::_0_::STA_OBJECT_INFORMATION_ST::_::_Measurable_b = 1;
    @sysvar::XCP::RadarFR::_g_PlReCoFw_PlReCoPer_ObjBypassingRunnable_ObjBypassingRunnable_m_pad_radarObjPort_par_out_local::TChangeableMemPool::_::_::_m_arrayPool::_0_::_elem::port_ens_r_obj_sensor_base::_::_m_movObjectInformation::_0_::STA_OBJECT_INFORMATION_ST::_::_Valid_b = 1;
    @sysvar::XCP::RadarFR::_g_PlReCoFw_PlReCoPer_ObjBypassingRunnable_ObjBypassingRunnable_m_pad_radarObjPort_par_out_local::TChangeableMemPool::_::_::_m_arrayPool::_0_::_elem::port_ens_r_obj_sensor_base::_::_m_movObjectInformation::_0_::_m_covarDxAxN = 0;
    @sysvar::XCP::RadarFR::_g_PlReCoFw_PlReCoPer_ObjBypassingRunnable_ObjBypassingRunnable_m_pad_radarObjPort_par_out_local::TChangeableMemPool::_::_::_m_arrayPool::_0_::_elem::port_ens_r_obj_sensor_base::_::_m_movObjectInformation::_0_::_m_covarDxVxN = 0;
    @sysvar::XCP::RadarFR::_g_PlReCoFw_PlReCoPer_ObjBypassingRunnable_ObjBypassingRunnable_m_pad_radarObjPort_par_out_local::TChangeableMemPool::_::_::_m_arrayPool::_0_::_elem::port_ens_r_obj_sensor_base::_::_m_movObjectInformation::_0_::_m_covarDyVyN = 0;
    @sysvar::XCP::RadarFR::_g_PlReCoFw_PlReCoPer_ObjBypassingRunnable_ObjBypassingRunnable_m_pad_radarObjPort_par_out_local::TChangeableMemPool::_::_::_m_arrayPool::_0_::_elem::port_ens_r_obj_sensor_base::_::_m_movObjectInformation::_0_::_m_covarDyWidthN = 0;
    @sysvar::XCP::RadarFR::_g_PlReCoFw_PlReCoPer_ObjBypassingRunnable_ObjBypassingRunnable_m_pad_radarObjPort_par_out_local::TChangeableMemPool::_::_::_m_arrayPool::_0_::_elem::port_ens_r_obj_sensor_base::_::_m_movObjectInformation::_0_::_m_covarVxAxN = 0;
    @sysvar::XCP::RadarFR::_g_PlReCoFw_PlReCoPer_ObjBypassingRunnable_ObjBypassingRunnable_m_pad_radarObjPort_par_out_local::TChangeableMemPool::_::_::_m_arrayPool::_0_::_elem::port_ens_r_obj_sensor_base::_::_m_movObjectInformation::_0_::_m_varAxN = 0;
    @sysvar::XCP::RadarFR::_g_PlReCoFw_PlReCoPer_ObjBypassingRunnable_ObjBypassingRunnable_m_pad_radarObjPort_par_out_local::TChangeableMemPool::_::_::_m_arrayPool::_0_::_elem::port_ens_r_obj_sensor_base::_::_m_movObjectInformation::_0_::_m_varAyN = 0;
    @sysvar::XCP::RadarFR::_g_PlReCoFw_PlReCoPer_ObjBypassingRunnable_ObjBypassingRunnable_m_pad_radarObjPort_par_out_local::TChangeableMemPool::_::_::_m_arrayPool::_0_::_elem::port_ens_r_obj_sensor_base::_::_m_movObjectInformation::_0_::_m_varVxN = 0;
    @sysvar::XCP::RadarFR::_g_PlReCoFw_PlReCoPer_ObjBypassingRunnable_ObjBypassingRunnable_m_pad_radarObjPort_par_out_local::TChangeableMemPool::_::_::_m_arrayPool::_0_::_elem::port_ens_r_obj_sensor_base::_::_m_movObjectInformation::_0_::_m_varVyN = 0;
    @sysvar::XCP::RadarFR::_g_PlReCoFw_PlReCoPer_ObjBypassingRunnable_ObjBypassingRunnable_m_pad_radarObjPort_par_out_local::TChangeableMemPool::_::_::_m_arrayPool::_0_::_elem::port_ens_r_obj_sensor_base::_::_m_movObjectInformation::_0_::STA_OBJECT_INFORMATION_ST::_::_m_varDxN = 0;
    @sysvar::XCP::RadarFR::_g_PlReCoFw_PlReCoPer_ObjBypassingRunnable_ObjBypassingRunnable_m_pad_radarObjPort_par_out_local::TChangeableMemPool::_::_::_m_arrayPool::_0_::_elem::port_ens_r_obj_sensor_base::_::_m_movObjectInformation::_0_::STA_OBJECT_INFORMATION_ST::_::_m_varDyN = 0;
    @sysvar::XCP::RadarFR::_g_PlReCoFw_PlReCoPer_ObjBypassingRunnable_ObjBypassingRunnable_m_pad_radarObjPort_par_out_local::TChangeableMemPool::_::_::_m_arrayPool::_0_::_elem::port_ens_r_obj_sensor_base::_::_m_movObjectInformation::_0_::_m_dVarLengthN = 0;
    @sysvar::XCP::RadarFR::_g_PlReCoFw_PlReCoPer_ObjBypassingRunnable_ObjBypassingRunnable_m_pad_radarObjPort_par_out_local::TChangeableMemPool::_::_::_m_arrayPool::_0_::_elem::port_ens_r_obj_sensor_base::_::_m_movObjectInformation::_0_::_m_dVarWidthN = 0;
    @sysvar::XCP::RadarFR::_g_PlReCoFw_PlReCoPer_ObjBypassingRunnable_ObjBypassingRunnable_m_pad_radarObjPort_par_out_local::TChangeableMemPool::_::_::_m_arrayPool::_0_::_elem::port_ens_r_obj_sensor_base::_::_m_movObjectInformation::_0_::STA_OBJECT_INFORMATION_ST::_::_m_wExistProbN = 64880;
    @sysvar::XCP::RadarFR::_g_PlReCoFw_PlReCoPer_ObjBypassingRunnable_ObjBypassingRunnable_m_pad_radarObjPort_par_out_local::TChangeableMemPool::_::_::_m_arrayPool::_0_::_elem::port_ens_r_obj_sensor_base::_::_m_movObjectInformation::_0_::_m_referencePtPosIndexN = 10;
    @sysvar::XCP::RadarFR::_g_PlReCoFw_PlReCoPer_ObjBypassingRunnable_ObjBypassingRunnable_m_pad_radarObjPort_par_out_local::TChangeableMemPool::_::_::_m_arrayPool::_0_::_elem::port_ens_r_obj_sensor_base::_::_m_movObjectInformation::_0_::_m_alpPiVarYawAngleN = 0;
    @sysvar::XCP::RadarFR::_g_PlReCoFw_PlReCoPer_ObjBypassingRunnable_ObjBypassingRunnable_m_pad_radarObjPort_par_out_local::TChangeableMemPool::_::_::_m_arrayPool::_0_::_elem::port_ens_r_obj_sensor_base::_::_m_movObjectInformation::_0_::_m_alpPiYawAngleN = 0;

    //target movement

    @sysvar::XCP::RadarFR::_g_PlReCoFw_PlReCoPer_ObjBypassingRunnable_ObjBypassingRunnable_m_pad_radarObjPort_par_out_local::TChangeableMemPool::_::_::_m_arrayPool::_0_::_elem::port_ens_r_obj_sensor_base::_::_m_movObjectInformation::_0_::STA_OBJECT_INFORMATION_ST::_::_m_dxN = @Classe_Obj_Sim::obj_data.obj_dx[0] * 128;
    @sysvar::XCP::RadarFR::_g_PlReCoFw_PlReCoPer_ObjBypassingRunnable_ObjBypassingRunnable_m_pad_radarObjPort_par_out_local::TChangeableMemPool::_::_::_m_arrayPool::_0_::_elem::port_ens_r_obj_sensor_base::_::_m_movObjectInformation::_0_::STA_OBJECT_INFORMATION_ST::_::_m_dyN = @Classe_Obj_Sim::obj_data.obj_dy[0] * 128;
    @sysvar::XCP::RadarFR::_g_PlReCoFw_PlReCoPer_ObjBypassingRunnable_ObjBypassingRunnable_m_pad_radarObjPort_par_out_local::TChangeableMemPool::_::_::_m_arrayPool::_0_::_elem::port_ens_r_obj_sensor_base::_::_m_movObjectInformation::_0_::STA_OBJECT_INFORMATION_ST::_::_m_dzN = 0;
    @sysvar::XCP::RadarFR::_g_PlReCoFw_PlReCoPer_ObjBypassingRunnable_ObjBypassingRunnable_m_pad_radarObjPort_par_out_local::TChangeableMemPool::_::_::_m_arrayPool::_0_::_elem::port_ens_r_obj_sensor_base::_::_m_movObjectInformation::_0_::_m_vxN = @Classe_Obj_Sim::obj_data.obj_relative_vx[0] * 256;
    @sysvar::XCP::RadarFR::_g_PlReCoFw_PlReCoPer_ObjBypassingRunnable_ObjBypassingRunnable_m_pad_radarObjPort_par_out_local::TChangeableMemPool::_::_::_m_arrayPool::_0_::_elem::port_ens_r_obj_sensor_base::_::_m_movObjectInformation::_0_::_m_vyN = @Classe_Obj_Sim::obj_data.obj_relative_vy[0] * 256;
    @sysvar::XCP::RadarFR::_g_PlReCoFw_PlReCoPer_ObjBypassingRunnable_ObjBypassingRunnable_m_pad_radarObjPort_par_out_local::TChangeableMemPool::_::_::_m_arrayPool::_0_::_elem::port_ens_r_obj_sensor_base::_::_m_movObjectInformation::_0_::_m_axN = 0;
    @sysvar::XCP::RadarFR::_g_PlReCoFw_PlReCoPer_ObjBypassingRunnable_ObjBypassingRunnable_m_pad_radarObjPort_par_out_local::TChangeableMemPool::_::_::_m_arrayPool::_0_::_elem::port_ens_r_obj_sensor_base::_::_m_movObjectInformation::_0_::_m_ayN = 0;

    //target object moving or not
    if (abs(@Classe_Obj_Sim::obj_data.obj_relative_vx[0]) != 0)
    {
      @sysvar::XCP::RadarFR::_g_PlReCoFw_PlReCoPer_ObjBypassingRunnable_ObjBypassingRunnable_m_pad_radarObjPort_par_out_local::TChangeableMemPool::_::_::_m_arrayPool::_0_::_elem::port_ens_r_obj_sensor_base::_::_m_movObjectInformation::_0_::STA_OBJECT_INFORMATION_ST::_::_m_prob1HasBeenObservedMovingN = 126;
      @sysvar::XCP::RadarFR::_g_PlReCoFw_PlReCoPer_ObjBypassingRunnable_ObjBypassingRunnable_m_pad_radarObjPort_par_out_local::TChangeableMemPool::_::_::_m_arrayPool::_0_::_elem::port_ens_r_obj_sensor_base::_::_m_movObjectInformation::_0_::STA_OBJECT_INFORMATION_ST::_::_m_prob1MovingN = 126;
      @sysvar::XCP::RadarFR::_g_PlReCoFw_PlReCoPer_ObjBypassingRunnable_ObjBypassingRunnable_m_pad_radarObjPort_par_out_local::TChangeableMemPool::_::_::_m_arrayPool::_0_::_elem::port_ens_r_obj_sensor_base::_::_m_movObjectInformation::_0_::STA_OBJECT_INFORMATION_ST::_::_m_ohyObjectType_st::_m_probObstacle_st::_m_prob1MobileN = 128;
      @sysvar::XCP::RadarFR::_g_PlReCoFw_PlReCoPer_ObjBypassingRunnable_ObjBypassingRunnable_m_pad_radarObjPort_par_out_local::TChangeableMemPool::_::_::_m_arrayPool::_0_::_elem::port_ens_r_obj_sensor_base::_::_m_movObjectInformation::_0_::STA_OBJECT_INFORMATION_ST::_::_m_ohyObjectType_st::_m_probObstacle_st::_m_prob1StationaryN = 0;
    }
    else
    {
      @sysvar::XCP::RadarFR::_g_PlReCoFw_PlReCoPer_ObjBypassingRunnable_ObjBypassingRunnable_m_pad_radarObjPort_par_out_local::TChangeableMemPool::_::_::_m_arrayPool::_0_::_elem::port_ens_r_obj_sensor_base::_::_m_movObjectInformation::_0_::STA_OBJECT_INFORMATION_ST::_::_m_prob1HasBeenObservedMovingN = 0;
      @sysvar::XCP::RadarFR::_g_PlReCoFw_PlReCoPer_ObjBypassingRunnable_ObjBypassingRunnable_m_pad_radarObjPort_par_out_local::TChangeableMemPool::_::_::_m_arrayPool::_0_::_elem::port_ens_r_obj_sensor_base::_::_m_movObjectInformation::_0_::STA_OBJECT_INFORMATION_ST::_::_m_prob1MovingN = 0;
      @sysvar::XCP::RadarFR::_g_PlReCoFw_PlReCoPer_ObjBypassingRunnable_ObjBypassingRunnable_m_pad_radarObjPort_par_out_local::TChangeableMemPool::_::_::_m_arrayPool::_0_::_elem::port_ens_r_obj_sensor_base::_::_m_movObjectInformation::_0_::STA_OBJECT_INFORMATION_ST::_::_m_ohyObjectType_st::_m_probObstacle_st::_m_prob1MobileN = 0;
      @sysvar::XCP::RadarFR::_g_PlReCoFw_PlReCoPer_ObjBypassingRunnable_ObjBypassingRunnable_m_pad_radarObjPort_par_out_local::TChangeableMemPool::_::_::_m_arrayPool::_0_::_elem::port_ens_r_obj_sensor_base::_::_m_movObjectInformation::_0_::STA_OBJECT_INFORMATION_ST::_::_m_ohyObjectType_st::_m_probObstacle_st::_m_prob1StationaryN = 128;
    }

      //object classification
    switch (@Classe_Obj_Sim::obj_data.obj_type[0])
    {
      case 0: //"Non-Obstacle"
        @sysvar::XCP::RadarFR::_g_PlReCoFw_PlReCoPer_ObjBypassingRunnable_ObjBypassingRunnable_m_pad_radarObjPort_par_out_local::TChangeableMemPool::_::_::_m_arrayPool::_0_::_elem::port_ens_r_obj_sensor_base::_::_m_movObjectInformation::_0_::STA_OBJECT_INFORMATION_ST::_::_m_ohyObjectType_st::_m_prob1NonObstacleN = 128;
        @sysvar::XCP::RadarFR::_g_PlReCoFw_PlReCoPer_ObjBypassingRunnable_ObjBypassingRunnable_m_pad_radarObjPort_par_out_local::TChangeableMemPool::_::_::_m_arrayPool::_0_::_elem::port_ens_r_obj_sensor_base::_::_m_movObjectInformation::_0_::STA_OBJECT_INFORMATION_ST::_::_m_ohyObjectType_st::_m_prob1ObstacleN = 0;
        @sysvar::XCP::RadarFR::_g_PlReCoFw_PlReCoPer_ObjBypassingRunnable_ObjBypassingRunnable_m_pad_radarObjPort_par_out_local::TChangeableMemPool::_::_::_m_arrayPool::_0_::_elem::port_ens_r_obj_sensor_base::_::_m_movObjectInformation::_0_::STA_OBJECT_INFORMATION_ST::_::_m_ohyObjectType_st::_m_prob1UnknownN = 0;
        @sysvar::XCP::RadarFR::_g_PlReCoFw_PlReCoPer_ObjBypassingRunnable_ObjBypassingRunnable_m_pad_radarObjPort_par_out_local::TChangeableMemPool::_::_::_m_arrayPool::_0_::_elem::port_ens_r_obj_sensor_base::_::_m_movObjectInformation::_0_::STA_OBJECT_INFORMATION_ST::_::_m_ohyObjectType_st::_m_probObstacle_st::_m_prob1UnknownN = 128;
        @sysvar::XCP::RadarFR::_g_PlReCoFw_PlReCoPer_ObjBypassingRunnable_ObjBypassingRunnable_m_pad_radarObjPort_par_out_local::TChangeableMemPool::_::_::_m_arrayPool::_0_::_elem::port_ens_r_obj_sensor_base::_::_m_movObjectInformation::_0_::STA_OBJECT_INFORMATION_ST::_::_m_ohyObjectType_st::_m_probObstacle_st::_m_probMobile_st::_m_prob1FourPlusWheelerN = 0;
        @sysvar::XCP::RadarFR::_g_PlReCoFw_PlReCoPer_ObjBypassingRunnable_ObjBypassingRunnable_m_pad_radarObjPort_par_out_local::TChangeableMemPool::_::_::_m_arrayPool::_0_::_elem::port_ens_r_obj_sensor_base::_::_m_movObjectInformation::_0_::STA_OBJECT_INFORMATION_ST::_::_m_ohyObjectType_st::_m_probObstacle_st::_m_probMobile_st::_m_prob1PedestrianN = 0;
        @sysvar::XCP::RadarFR::_g_PlReCoFw_PlReCoPer_ObjBypassingRunnable_ObjBypassingRunnable_m_pad_radarObjPort_par_out_local::TChangeableMemPool::_::_::_m_arrayPool::_0_::_elem::port_ens_r_obj_sensor_base::_::_m_movObjectInformation::_0_::STA_OBJECT_INFORMATION_ST::_::_m_ohyObjectType_st::_m_probObstacle_st::_m_probMobile_st::_m_prob1TwoWheelerN = 0;
        @sysvar::XCP::RadarFR::_g_PlReCoFw_PlReCoPer_ObjBypassingRunnable_ObjBypassingRunnable_m_pad_radarObjPort_par_out_local::TChangeableMemPool::_::_::_m_arrayPool::_0_::_elem::port_ens_r_obj_sensor_base::_::_m_movObjectInformation::_0_::STA_OBJECT_INFORMATION_ST::_::_m_ohyObjectType_st::_m_probObstacle_st::_m_probMobile_st::_m_prob1UnknownN = 128;
        @sysvar::XCP::RadarFR::_g_PlReCoFw_PlReCoPer_ObjBypassingRunnable_ObjBypassingRunnable_m_pad_radarObjPort_par_out_local::TChangeableMemPool::_::_::_m_arrayPool::_0_::_elem::port_ens_r_obj_sensor_base::_::_m_movObjectInformation::_0_::STA_OBJECT_INFORMATION_ST::_::_m_ohyObjectType_st::_m_probObstacle_st::_m_probMobile_st::_m_probFourPlusWheeler_st::_m_prob1PassengerCarN = 0;
        @sysvar::XCP::RadarFR::_g_PlReCoFw_PlReCoPer_ObjBypassingRunnable_ObjBypassingRunnable_m_pad_radarObjPort_par_out_local::TChangeableMemPool::_::_::_m_arrayPool::_0_::_elem::port_ens_r_obj_sensor_base::_::_m_movObjectInformation::_0_::STA_OBJECT_INFORMATION_ST::_::_m_ohyObjectType_st::_m_probObstacle_st::_m_probMobile_st::_m_probFourPlusWheeler_st::_m_prob1TruckN = 0;
        @sysvar::XCP::RadarFR::_g_PlReCoFw_PlReCoPer_ObjBypassingRunnable_ObjBypassingRunnable_m_pad_radarObjPort_par_out_local::TChangeableMemPool::_::_::_m_arrayPool::_0_::_elem::port_ens_r_obj_sensor_base::_::_m_movObjectInformation::_0_::STA_OBJECT_INFORMATION_ST::_::_m_ohyObjectType_st::_m_probObstacle_st::_m_probMobile_st::_m_probFourPlusWheeler_st::_m_prob1UnknownN = 128;
        @sysvar::XCP::RadarFR::_g_PlReCoFw_PlReCoPer_ObjBypassingRunnable_ObjBypassingRunnable_m_pad_radarObjPort_par_out_local::TChangeableMemPool::_::_::_m_arrayPool::_0_::_elem::port_ens_r_obj_sensor_base::_::_m_movObjectInformation::_0_::STA_OBJECT_INFORMATION_ST::_::_m_ohyObjectType_st::_m_probObstacle_st::_m_probStationary_st::_m_prob1RoadsideBarrierN = 0;
        @sysvar::XCP::RadarFR::_g_PlReCoFw_PlReCoPer_ObjBypassingRunnable_ObjBypassingRunnable_m_pad_radarObjPort_par_out_local::TChangeableMemPool::_::_::_m_arrayPool::_0_::_elem::port_ens_r_obj_sensor_base::_::_m_movObjectInformation::_0_::STA_OBJECT_INFORMATION_ST::_::_m_ohyObjectType_st::_m_probObstacle_st::_m_probStationary_st::_m_prob1UnknownN = 128;
        @sysvar::XCP::RadarFR::_g_PlReCoFw_PlReCoPer_ObjBypassingRunnable_ObjBypassingRunnable_m_pad_radarObjPort_par_out_local::TChangeableMemPool::_::_::_m_arrayPool::_0_::_elem::port_ens_r_obj_sensor_base::_::_m_movObjectInformation::_0_::_m_dLengthN = 64;
        @sysvar::XCP::RadarFR::_g_PlReCoFw_PlReCoPer_ObjBypassingRunnable_ObjBypassingRunnable_m_pad_radarObjPort_par_out_local::TChangeableMemPool::_::_::_m_arrayPool::_0_::_elem::port_ens_r_obj_sensor_base::_::_m_movObjectInformation::_0_::_m_dWidthN = @Classe_Obj_Sim::obj_data.obj_width[0] * 128;
        break;

      case 1: //"unknown"
        @sysvar::XCP::RadarFR::_g_PlReCoFw_PlReCoPer_ObjBypassingRunnable_ObjBypassingRunnable_m_pad_radarObjPort_par_out_local::TChangeableMemPool::_::_::_m_arrayPool::_0_::_elem::port_ens_r_obj_sensor_base::_::_m_movObjectInformation::_0_::STA_OBJECT_INFORMATION_ST::_::_m_ohyObjectType_st::_m_prob1NonObstacleN = 0;
        @sysvar::XCP::RadarFR::_g_PlReCoFw_PlReCoPer_ObjBypassingRunnable_ObjBypassingRunnable_m_pad_radarObjPort_par_out_local::TChangeableMemPool::_::_::_m_arrayPool::_0_::_elem::port_ens_r_obj_sensor_base::_::_m_movObjectInformation::_0_::STA_OBJECT_INFORMATION_ST::_::_m_ohyObjectType_st::_m_prob1ObstacleN = 0;
        @sysvar::XCP::RadarFR::_g_PlReCoFw_PlReCoPer_ObjBypassingRunnable_ObjBypassingRunnable_m_pad_radarObjPort_par_out_local::TChangeableMemPool::_::_::_m_arrayPool::_0_::_elem::port_ens_r_obj_sensor_base::_::_m_movObjectInformation::_0_::STA_OBJECT_INFORMATION_ST::_::_m_ohyObjectType_st::_m_prob1UnknownN = 128;
        @sysvar::XCP::RadarFR::_g_PlReCoFw_PlReCoPer_ObjBypassingRunnable_ObjBypassingRunnable_m_pad_radarObjPort_par_out_local::TChangeableMemPool::_::_::_m_arrayPool::_0_::_elem::port_ens_r_obj_sensor_base::_::_m_movObjectInformation::_0_::STA_OBJECT_INFORMATION_ST::_::_m_ohyObjectType_st::_m_probObstacle_st::_m_prob1UnknownN = 128;
        @sysvar::XCP::RadarFR::_g_PlReCoFw_PlReCoPer_ObjBypassingRunnable_ObjBypassingRunnable_m_pad_radarObjPort_par_out_local::TChangeableMemPool::_::_::_m_arrayPool::_0_::_elem::port_ens_r_obj_sensor_base::_::_m_movObjectInformation::_0_::STA_OBJECT_INFORMATION_ST::_::_m_ohyObjectType_st::_m_probObstacle_st::_m_probMobile_st::_m_prob1FourPlusWheelerN = 0;
        @sysvar::XCP::RadarFR::_g_PlReCoFw_PlReCoPer_ObjBypassingRunnable_ObjBypassingRunnable_m_pad_radarObjPort_par_out_local::TChangeableMemPool::_::_::_m_arrayPool::_0_::_elem::port_ens_r_obj_sensor_base::_::_m_movObjectInformation::_0_::STA_OBJECT_INFORMATION_ST::_::_m_ohyObjectType_st::_m_probObstacle_st::_m_probMobile_st::_m_prob1PedestrianN = 0;
        @sysvar::XCP::RadarFR::_g_PlReCoFw_PlReCoPer_ObjBypassingRunnable_ObjBypassingRunnable_m_pad_radarObjPort_par_out_local::TChangeableMemPool::_::_::_m_arrayPool::_0_::_elem::port_ens_r_obj_sensor_base::_::_m_movObjectInformation::_0_::STA_OBJECT_INFORMATION_ST::_::_m_ohyObjectType_st::_m_probObstacle_st::_m_probMobile_st::_m_prob1TwoWheelerN = 0;
        @sysvar::XCP::RadarFR::_g_PlReCoFw_PlReCoPer_ObjBypassingRunnable_ObjBypassingRunnable_m_pad_radarObjPort_par_out_local::TChangeableMemPool::_::_::_m_arrayPool::_0_::_elem::port_ens_r_obj_sensor_base::_::_m_movObjectInformation::_0_::STA_OBJECT_INFORMATION_ST::_::_m_ohyObjectType_st::_m_probObstacle_st::_m_probMobile_st::_m_prob1UnknownN = 128;
        @sysvar::XCP::RadarFR::_g_PlReCoFw_PlReCoPer_ObjBypassingRunnable_ObjBypassingRunnable_m_pad_radarObjPort_par_out_local::TChangeableMemPool::_::_::_m_arrayPool::_0_::_elem::port_ens_r_obj_sensor_base::_::_m_movObjectInformation::_0_::STA_OBJECT_INFORMATION_ST::_::_m_ohyObjectType_st::_m_probObstacle_st::_m_probMobile_st::_m_probFourPlusWheeler_st::_m_prob1PassengerCarN = 0;
        @sysvar::XCP::RadarFR::_g_PlReCoFw_PlReCoPer_ObjBypassingRunnable_ObjBypassingRunnable_m_pad_radarObjPort_par_out_local::TChangeableMemPool::_::_::_m_arrayPool::_0_::_elem::port_ens_r_obj_sensor_base::_::_m_movObjectInformation::_0_::STA_OBJECT_INFORMATION_ST::_::_m_ohyObjectType_st::_m_probObstacle_st::_m_probMobile_st::_m_probFourPlusWheeler_st::_m_prob1TruckN = 0;
        @sysvar::XCP::RadarFR::_g_PlReCoFw_PlReCoPer_ObjBypassingRunnable_ObjBypassingRunnable_m_pad_radarObjPort_par_out_local::TChangeableMemPool::_::_::_m_arrayPool::_0_::_elem::port_ens_r_obj_sensor_base::_::_m_movObjectInformation::_0_::STA_OBJECT_INFORMATION_ST::_::_m_ohyObjectType_st::_m_probObstacle_st::_m_probMobile_st::_m_probFourPlusWheeler_st::_m_prob1UnknownN = 128;
        @sysvar::XCP::RadarFR::_g_PlReCoFw_PlReCoPer_ObjBypassingRunnable_ObjBypassingRunnable_m_pad_radarObjPort_par_out_local::TChangeableMemPool::_::_::_m_arrayPool::_0_::_elem::port_ens_r_obj_sensor_base::_::_m_movObjectInformation::_0_::STA_OBJECT_INFORMATION_ST::_::_m_ohyObjectType_st::_m_probObstacle_st::_m_probStationary_st::_m_prob1RoadsideBarrierN = 0;
        @sysvar::XCP::RadarFR::_g_PlReCoFw_PlReCoPer_ObjBypassingRunnable_ObjBypassingRunnable_m_pad_radarObjPort_par_out_local::TChangeableMemPool::_::_::_m_arrayPool::_0_::_elem::port_ens_r_obj_sensor_base::_::_m_movObjectInformation::_0_::STA_OBJECT_INFORMATION_ST::_::_m_ohyObjectType_st::_m_probObstacle_st::_m_probStationary_st::_m_prob1UnknownN = 128;
        @sysvar::XCP::RadarFR::_g_PlReCoFw_PlReCoPer_ObjBypassingRunnable_ObjBypassingRunnable_m_pad_radarObjPort_par_out_local::TChangeableMemPool::_::_::_m_arrayPool::_0_::_elem::port_ens_r_obj_sensor_base::_::_m_movObjectInformation::_0_::_m_dLengthN = 0;
        @sysvar::XCP::RadarFR::_g_PlReCoFw_PlReCoPer_ObjBypassingRunnable_ObjBypassingRunnable_m_pad_radarObjPort_par_out_local::TChangeableMemPool::_::_::_m_arrayPool::_0_::_elem::port_ens_r_obj_sensor_base::_::_m_movObjectInformation::_0_::_m_dWidthN = @Classe_Obj_Sim::obj_data.obj_width[0] * 128;
        break;

      case 2: //"RoadSideBarrier"
        @sysvar::XCP::RadarFR::_g_PlReCoFw_PlReCoPer_ObjBypassingRunnable_ObjBypassingRunnable_m_pad_radarObjPort_par_out_local::TChangeableMemPool::_::_::_m_arrayPool::_0_::_elem::port_ens_r_obj_sensor_base::_::_m_movObjectInformation::_0_::STA_OBJECT_INFORMATION_ST::_::_m_ohyObjectType_st::_m_prob1NonObstacleN = 0;
        @sysvar::XCP::RadarFR::_g_PlReCoFw_PlReCoPer_ObjBypassingRunnable_ObjBypassingRunnable_m_pad_radarObjPort_par_out_local::TChangeableMemPool::_::_::_m_arrayPool::_0_::_elem::port_ens_r_obj_sensor_base::_::_m_movObjectInformation::_0_::STA_OBJECT_INFORMATION_ST::_::_m_ohyObjectType_st::_m_prob1ObstacleN = 128;
        @sysvar::XCP::RadarFR::_g_PlReCoFw_PlReCoPer_ObjBypassingRunnable_ObjBypassingRunnable_m_pad_radarObjPort_par_out_local::TChangeableMemPool::_::_::_m_arrayPool::_0_::_elem::port_ens_r_obj_sensor_base::_::_m_movObjectInformation::_0_::STA_OBJECT_INFORMATION_ST::_::_m_ohyObjectType_st::_m_prob1UnknownN = 0;
        @sysvar::XCP::RadarFR::_g_PlReCoFw_PlReCoPer_ObjBypassingRunnable_ObjBypassingRunnable_m_pad_radarObjPort_par_out_local::TChangeableMemPool::_::_::_m_arrayPool::_0_::_elem::port_ens_r_obj_sensor_base::_::_m_movObjectInformation::_0_::STA_OBJECT_INFORMATION_ST::_::_m_ohyObjectType_st::_m_probObstacle_st::_m_prob1MobileN = 0;
        @sysvar::XCP::RadarFR::_g_PlReCoFw_PlReCoPer_ObjBypassingRunnable_ObjBypassingRunnable_m_pad_radarObjPort_par_out_local::TChangeableMemPool::_::_::_m_arrayPool::_0_::_elem::port_ens_r_obj_sensor_base::_::_m_movObjectInformation::_0_::STA_OBJECT_INFORMATION_ST::_::_m_ohyObjectType_st::_m_probObstacle_st::_m_prob1StationaryN = 128;
        @sysvar::XCP::RadarFR::_g_PlReCoFw_PlReCoPer_ObjBypassingRunnable_ObjBypassingRunnable_m_pad_radarObjPort_par_out_local::TChangeableMemPool::_::_::_m_arrayPool::_0_::_elem::port_ens_r_obj_sensor_base::_::_m_movObjectInformation::_0_::STA_OBJECT_INFORMATION_ST::_::_m_ohyObjectType_st::_m_probObstacle_st::_m_prob1UnknownN = 0;
        @sysvar::XCP::RadarFR::_g_PlReCoFw_PlReCoPer_ObjBypassingRunnable_ObjBypassingRunnable_m_pad_radarObjPort_par_out_local::TChangeableMemPool::_::_::_m_arrayPool::_0_::_elem::port_ens_r_obj_sensor_base::_::_m_movObjectInformation::_0_::STA_OBJECT_INFORMATION_ST::_::_m_ohyObjectType_st::_m_probObstacle_st::_m_probMobile_st::_m_prob1FourPlusWheelerN = 0;
        @sysvar::XCP::RadarFR::_g_PlReCoFw_PlReCoPer_ObjBypassingRunnable_ObjBypassingRunnable_m_pad_radarObjPort_par_out_local::TChangeableMemPool::_::_::_m_arrayPool::_0_::_elem::port_ens_r_obj_sensor_base::_::_m_movObjectInformation::_0_::STA_OBJECT_INFORMATION_ST::_::_m_ohyObjectType_st::_m_probObstacle_st::_m_probMobile_st::_m_prob1PedestrianN = 0;
        @sysvar::XCP::RadarFR::_g_PlReCoFw_PlReCoPer_ObjBypassingRunnable_ObjBypassingRunnable_m_pad_radarObjPort_par_out_local::TChangeableMemPool::_::_::_m_arrayPool::_0_::_elem::port_ens_r_obj_sensor_base::_::_m_movObjectInformation::_0_::STA_OBJECT_INFORMATION_ST::_::_m_ohyObjectType_st::_m_probObstacle_st::_m_probMobile_st::_m_prob1TwoWheelerN = 0;
        @sysvar::XCP::RadarFR::_g_PlReCoFw_PlReCoPer_ObjBypassingRunnable_ObjBypassingRunnable_m_pad_radarObjPort_par_out_local::TChangeableMemPool::_::_::_m_arrayPool::_0_::_elem::port_ens_r_obj_sensor_base::_::_m_movObjectInformation::_0_::STA_OBJECT_INFORMATION_ST::_::_m_ohyObjectType_st::_m_probObstacle_st::_m_probMobile_st::_m_prob1UnknownN = 0;
        @sysvar::XCP::RadarFR::_g_PlReCoFw_PlReCoPer_ObjBypassingRunnable_ObjBypassingRunnable_m_pad_radarObjPort_par_out_local::TChangeableMemPool::_::_::_m_arrayPool::_0_::_elem::port_ens_r_obj_sensor_base::_::_m_movObjectInformation::_0_::STA_OBJECT_INFORMATION_ST::_::_m_ohyObjectType_st::_m_probObstacle_st::_m_probMobile_st::_m_probFourPlusWheeler_st::_m_prob1PassengerCarN = 0;
        @sysvar::XCP::RadarFR::_g_PlReCoFw_PlReCoPer_ObjBypassingRunnable_ObjBypassingRunnable_m_pad_radarObjPort_par_out_local::TChangeableMemPool::_::_::_m_arrayPool::_0_::_elem::port_ens_r_obj_sensor_base::_::_m_movObjectInformation::_0_::STA_OBJECT_INFORMATION_ST::_::_m_ohyObjectType_st::_m_probObstacle_st::_m_probMobile_st::_m_probFourPlusWheeler_st::_m_prob1TruckN = 0;
        @sysvar::XCP::RadarFR::_g_PlReCoFw_PlReCoPer_ObjBypassingRunnable_ObjBypassingRunnable_m_pad_radarObjPort_par_out_local::TChangeableMemPool::_::_::_m_arrayPool::_0_::_elem::port_ens_r_obj_sensor_base::_::_m_movObjectInformation::_0_::STA_OBJECT_INFORMATION_ST::_::_m_ohyObjectType_st::_m_probObstacle_st::_m_probMobile_st::_m_probFourPlusWheeler_st::_m_prob1UnknownN = 0;
        @sysvar::XCP::RadarFR::_g_PlReCoFw_PlReCoPer_ObjBypassingRunnable_ObjBypassingRunnable_m_pad_radarObjPort_par_out_local::TChangeableMemPool::_::_::_m_arrayPool::_0_::_elem::port_ens_r_obj_sensor_base::_::_m_movObjectInformation::_0_::STA_OBJECT_INFORMATION_ST::_::_m_ohyObjectType_st::_m_probObstacle_st::_m_probStationary_st::_m_prob1RoadsideBarrierN = 128;
        @sysvar::XCP::RadarFR::_g_PlReCoFw_PlReCoPer_ObjBypassingRunnable_ObjBypassingRunnable_m_pad_radarObjPort_par_out_local::TChangeableMemPool::_::_::_m_arrayPool::_0_::_elem::port_ens_r_obj_sensor_base::_::_m_movObjectInformation::_0_::STA_OBJECT_INFORMATION_ST::_::_m_ohyObjectType_st::_m_probObstacle_st::_m_probStationary_st::_m_prob1UnknownN = 0;
        @sysvar::XCP::RadarFR::_g_PlReCoFw_PlReCoPer_ObjBypassingRunnable_ObjBypassingRunnable_m_pad_radarObjPort_par_out_local::TChangeableMemPool::_::_::_m_arrayPool::_0_::_elem::port_ens_r_obj_sensor_base::_::_m_movObjectInformation::_0_::_m_dLengthN = 64;
        @sysvar::XCP::RadarFR::_g_PlReCoFw_PlReCoPer_ObjBypassingRunnable_ObjBypassingRunnable_m_pad_radarObjPort_par_out_local::TChangeableMemPool::_::_::_m_arrayPool::_0_::_elem::port_ens_r_obj_sensor_base::_::_m_movObjectInformation::_0_::_m_dWidthN = @Classe_Obj_Sim::obj_data.obj_width[0] * 128;
        break;

      case 3: //"2Wheeler"
        @sysvar::XCP::RadarFR::_g_PlReCoFw_PlReCoPer_ObjBypassingRunnable_ObjBypassingRunnable_m_pad_radarObjPort_par_out_local::TChangeableMemPool::_::_::_m_arrayPool::_0_::_elem::port_ens_r_obj_sensor_base::_::_m_movObjectInformation::_0_::STA_OBJECT_INFORMATION_ST::_::_m_ohyObjectType_st::_m_prob1NonObstacleN = 0;
        @sysvar::XCP::RadarFR::_g_PlReCoFw_PlReCoPer_ObjBypassingRunnable_ObjBypassingRunnable_m_pad_radarObjPort_par_out_local::TChangeableMemPool::_::_::_m_arrayPool::_0_::_elem::port_ens_r_obj_sensor_base::_::_m_movObjectInformation::_0_::STA_OBJECT_INFORMATION_ST::_::_m_ohyObjectType_st::_m_prob1ObstacleN = 128;
        @sysvar::XCP::RadarFR::_g_PlReCoFw_PlReCoPer_ObjBypassingRunnable_ObjBypassingRunnable_m_pad_radarObjPort_par_out_local::TChangeableMemPool::_::_::_m_arrayPool::_0_::_elem::port_ens_r_obj_sensor_base::_::_m_movObjectInformation::_0_::STA_OBJECT_INFORMATION_ST::_::_m_ohyObjectType_st::_m_prob1UnknownN = 0;
        @sysvar::XCP::RadarFR::_g_PlReCoFw_PlReCoPer_ObjBypassingRunnable_ObjBypassingRunnable_m_pad_radarObjPort_par_out_local::TChangeableMemPool::_::_::_m_arrayPool::_0_::_elem::port_ens_r_obj_sensor_base::_::_m_movObjectInformation::_0_::STA_OBJECT_INFORMATION_ST::_::_m_ohyObjectType_st::_m_probObstacle_st::_m_prob1UnknownN = 0;
        @sysvar::XCP::RadarFR::_g_PlReCoFw_PlReCoPer_ObjBypassingRunnable_ObjBypassingRunnable_m_pad_radarObjPort_par_out_local::TChangeableMemPool::_::_::_m_arrayPool::_0_::_elem::port_ens_r_obj_sensor_base::_::_m_movObjectInformation::_0_::STA_OBJECT_INFORMATION_ST::_::_m_ohyObjectType_st::_m_probObstacle_st::_m_probMobile_st::_m_prob1FourPlusWheelerN = 0;
        @sysvar::XCP::RadarFR::_g_PlReCoFw_PlReCoPer_ObjBypassingRunnable_ObjBypassingRunnable_m_pad_radarObjPort_par_out_local::TChangeableMemPool::_::_::_m_arrayPool::_0_::_elem::port_ens_r_obj_sensor_base::_::_m_movObjectInformation::_0_::STA_OBJECT_INFORMATION_ST::_::_m_ohyObjectType_st::_m_probObstacle_st::_m_probMobile_st::_m_prob1PedestrianN = 0;
        @sysvar::XCP::RadarFR::_g_PlReCoFw_PlReCoPer_ObjBypassingRunnable_ObjBypassingRunnable_m_pad_radarObjPort_par_out_local::TChangeableMemPool::_::_::_m_arrayPool::_0_::_elem::port_ens_r_obj_sensor_base::_::_m_movObjectInformation::_0_::STA_OBJECT_INFORMATION_ST::_::_m_ohyObjectType_st::_m_probObstacle_st::_m_probMobile_st::_m_prob1TwoWheelerN = 128;
        @sysvar::XCP::RadarFR::_g_PlReCoFw_PlReCoPer_ObjBypassingRunnable_ObjBypassingRunnable_m_pad_radarObjPort_par_out_local::TChangeableMemPool::_::_::_m_arrayPool::_0_::_elem::port_ens_r_obj_sensor_base::_::_m_movObjectInformation::_0_::STA_OBJECT_INFORMATION_ST::_::_m_ohyObjectType_st::_m_probObstacle_st::_m_probMobile_st::_m_prob1UnknownN = 0;
        @sysvar::XCP::RadarFR::_g_PlReCoFw_PlReCoPer_ObjBypassingRunnable_ObjBypassingRunnable_m_pad_radarObjPort_par_out_local::TChangeableMemPool::_::_::_m_arrayPool::_0_::_elem::port_ens_r_obj_sensor_base::_::_m_movObjectInformation::_0_::STA_OBJECT_INFORMATION_ST::_::_m_ohyObjectType_st::_m_probObstacle_st::_m_probMobile_st::_m_probFourPlusWheeler_st::_m_prob1PassengerCarN = 0;
        @sysvar::XCP::RadarFR::_g_PlReCoFw_PlReCoPer_ObjBypassingRunnable_ObjBypassingRunnable_m_pad_radarObjPort_par_out_local::TChangeableMemPool::_::_::_m_arrayPool::_0_::_elem::port_ens_r_obj_sensor_base::_::_m_movObjectInformation::_0_::STA_OBJECT_INFORMATION_ST::_::_m_ohyObjectType_st::_m_probObstacle_st::_m_probMobile_st::_m_probFourPlusWheeler_st::_m_prob1TruckN = 0;
        @sysvar::XCP::RadarFR::_g_PlReCoFw_PlReCoPer_ObjBypassingRunnable_ObjBypassingRunnable_m_pad_radarObjPort_par_out_local::TChangeableMemPool::_::_::_m_arrayPool::_0_::_elem::port_ens_r_obj_sensor_base::_::_m_movObjectInformation::_0_::STA_OBJECT_INFORMATION_ST::_::_m_ohyObjectType_st::_m_probObstacle_st::_m_probMobile_st::_m_probFourPlusWheeler_st::_m_prob1UnknownN = 128;
        @sysvar::XCP::RadarFR::_g_PlReCoFw_PlReCoPer_ObjBypassingRunnable_ObjBypassingRunnable_m_pad_radarObjPort_par_out_local::TChangeableMemPool::_::_::_m_arrayPool::_0_::_elem::port_ens_r_obj_sensor_base::_::_m_movObjectInformation::_0_::STA_OBJECT_INFORMATION_ST::_::_m_ohyObjectType_st::_m_probObstacle_st::_m_probStationary_st::_m_prob1RoadsideBarrierN = 0;
        @sysvar::XCP::RadarFR::_g_PlReCoFw_PlReCoPer_ObjBypassingRunnable_ObjBypassingRunnable_m_pad_radarObjPort_par_out_local::TChangeableMemPool::_::_::_m_arrayPool::_0_::_elem::port_ens_r_obj_sensor_base::_::_m_movObjectInformation::_0_::STA_OBJECT_INFORMATION_ST::_::_m_ohyObjectType_st::_m_probObstacle_st::_m_probStationary_st::_m_prob1UnknownN = 0;
        @sysvar::XCP::RadarFR::_g_PlReCoFw_PlReCoPer_ObjBypassingRunnable_ObjBypassingRunnable_m_pad_radarObjPort_par_out_local::TChangeableMemPool::_::_::_m_arrayPool::_0_::_elem::port_ens_r_obj_sensor_base::_::_m_movObjectInformation::_0_::_m_dLengthN = 64;
        @sysvar::XCP::RadarFR::_g_PlReCoFw_PlReCoPer_ObjBypassingRunnable_ObjBypassingRunnable_m_pad_radarObjPort_par_out_local::TChangeableMemPool::_::_::_m_arrayPool::_0_::_elem::port_ens_r_obj_sensor_base::_::_m_movObjectInformation::_0_::_m_dWidthN = @Classe_Obj_Sim::obj_data.obj_width[0] * 128;
        break;

      case 4: //"Pedestrian"
        @sysvar::XCP::RadarFR::_g_PlReCoFw_PlReCoPer_ObjBypassingRunnable_ObjBypassingRunnable_m_pad_radarObjPort_par_out_local::TChangeableMemPool::_::_::_m_arrayPool::_0_::_elem::port_ens_r_obj_sensor_base::_::_m_movObjectInformation::_0_::STA_OBJECT_INFORMATION_ST::_::_m_ohyObjectType_st::_m_prob1NonObstacleN = 0;
        @sysvar::XCP::RadarFR::_g_PlReCoFw_PlReCoPer_ObjBypassingRunnable_ObjBypassingRunnable_m_pad_radarObjPort_par_out_local::TChangeableMemPool::_::_::_m_arrayPool::_0_::_elem::port_ens_r_obj_sensor_base::_::_m_movObjectInformation::_0_::STA_OBJECT_INFORMATION_ST::_::_m_ohyObjectType_st::_m_prob1ObstacleN = 128;
        @sysvar::XCP::RadarFR::_g_PlReCoFw_PlReCoPer_ObjBypassingRunnable_ObjBypassingRunnable_m_pad_radarObjPort_par_out_local::TChangeableMemPool::_::_::_m_arrayPool::_0_::_elem::port_ens_r_obj_sensor_base::_::_m_movObjectInformation::_0_::STA_OBJECT_INFORMATION_ST::_::_m_ohyObjectType_st::_m_prob1UnknownN = 0;
        @sysvar::XCP::RadarFR::_g_PlReCoFw_PlReCoPer_ObjBypassingRunnable_ObjBypassingRunnable_m_pad_radarObjPort_par_out_local::TChangeableMemPool::_::_::_m_arrayPool::_0_::_elem::port_ens_r_obj_sensor_base::_::_m_movObjectInformation::_0_::STA_OBJECT_INFORMATION_ST::_::_m_ohyObjectType_st::_m_probObstacle_st::_m_prob1UnknownN = 0;
        @sysvar::XCP::RadarFR::_g_PlReCoFw_PlReCoPer_ObjBypassingRunnable_ObjBypassingRunnable_m_pad_radarObjPort_par_out_local::TChangeableMemPool::_::_::_m_arrayPool::_0_::_elem::port_ens_r_obj_sensor_base::_::_m_movObjectInformation::_0_::STA_OBJECT_INFORMATION_ST::_::_m_ohyObjectType_st::_m_probObstacle_st::_m_probMobile_st::_m_prob1FourPlusWheelerN = 0;
        @sysvar::XCP::RadarFR::_g_PlReCoFw_PlReCoPer_ObjBypassingRunnable_ObjBypassingRunnable_m_pad_radarObjPort_par_out_local::TChangeableMemPool::_::_::_m_arrayPool::_0_::_elem::port_ens_r_obj_sensor_base::_::_m_movObjectInformation::_0_::STA_OBJECT_INFORMATION_ST::_::_m_ohyObjectType_st::_m_probObstacle_st::_m_probMobile_st::_m_prob1PedestrianN = 128;
        @sysvar::XCP::RadarFR::_g_PlReCoFw_PlReCoPer_ObjBypassingRunnable_ObjBypassingRunnable_m_pad_radarObjPort_par_out_local::TChangeableMemPool::_::_::_m_arrayPool::_0_::_elem::port_ens_r_obj_sensor_base::_::_m_movObjectInformation::_0_::STA_OBJECT_INFORMATION_ST::_::_m_ohyObjectType_st::_m_probObstacle_st::_m_probMobile_st::_m_prob1TwoWheelerN = 0;
        @sysvar::XCP::RadarFR::_g_PlReCoFw_PlReCoPer_ObjBypassingRunnable_ObjBypassingRunnable_m_pad_radarObjPort_par_out_local::TChangeableMemPool::_::_::_m_arrayPool::_0_::_elem::port_ens_r_obj_sensor_base::_::_m_movObjectInformation::_0_::STA_OBJECT_INFORMATION_ST::_::_m_ohyObjectType_st::_m_probObstacle_st::_m_probMobile_st::_m_prob1UnknownN = 0;
        @sysvar::XCP::RadarFR::_g_PlReCoFw_PlReCoPer_ObjBypassingRunnable_ObjBypassingRunnable_m_pad_radarObjPort_par_out_local::TChangeableMemPool::_::_::_m_arrayPool::_0_::_elem::port_ens_r_obj_sensor_base::_::_m_movObjectInformation::_0_::STA_OBJECT_INFORMATION_ST::_::_m_ohyObjectType_st::_m_probObstacle_st::_m_probMobile_st::_m_probFourPlusWheeler_st::_m_prob1PassengerCarN = 0;
        @sysvar::XCP::RadarFR::_g_PlReCoFw_PlReCoPer_ObjBypassingRunnable_ObjBypassingRunnable_m_pad_radarObjPort_par_out_local::TChangeableMemPool::_::_::_m_arrayPool::_0_::_elem::port_ens_r_obj_sensor_base::_::_m_movObjectInformation::_0_::STA_OBJECT_INFORMATION_ST::_::_m_ohyObjectType_st::_m_probObstacle_st::_m_probMobile_st::_m_probFourPlusWheeler_st::_m_prob1TruckN = 0;
        @sysvar::XCP::RadarFR::_g_PlReCoFw_PlReCoPer_ObjBypassingRunnable_ObjBypassingRunnable_m_pad_radarObjPort_par_out_local::TChangeableMemPool::_::_::_m_arrayPool::_0_::_elem::port_ens_r_obj_sensor_base::_::_m_movObjectInformation::_0_::STA_OBJECT_INFORMATION_ST::_::_m_ohyObjectType_st::_m_probObstacle_st::_m_probMobile_st::_m_probFourPlusWheeler_st::_m_prob1UnknownN = 128;
        @sysvar::XCP::RadarFR::_g_PlReCoFw_PlReCoPer_ObjBypassingRunnable_ObjBypassingRunnable_m_pad_radarObjPort_par_out_local::TChangeableMemPool::_::_::_m_arrayPool::_0_::_elem::port_ens_r_obj_sensor_base::_::_m_movObjectInformation::_0_::STA_OBJECT_INFORMATION_ST::_::_m_ohyObjectType_st::_m_probObstacle_st::_m_probStationary_st::_m_prob1RoadsideBarrierN = 0;
        @sysvar::XCP::RadarFR::_g_PlReCoFw_PlReCoPer_ObjBypassingRunnable_ObjBypassingRunnable_m_pad_radarObjPort_par_out_local::TChangeableMemPool::_::_::_m_arrayPool::_0_::_elem::port_ens_r_obj_sensor_base::_::_m_movObjectInformation::_0_::STA_OBJECT_INFORMATION_ST::_::_m_ohyObjectType_st::_m_probObstacle_st::_m_probStationary_st::_m_prob1UnknownN = 0;
        @sysvar::XCP::RadarFR::_g_PlReCoFw_PlReCoPer_ObjBypassingRunnable_ObjBypassingRunnable_m_pad_radarObjPort_par_out_local::TChangeableMemPool::_::_::_m_arrayPool::_0_::_elem::port_ens_r_obj_sensor_base::_::_m_movObjectInformation::_0_::_m_dLengthN = 64;
        @sysvar::XCP::RadarFR::_g_PlReCoFw_PlReCoPer_ObjBypassingRunnable_ObjBypassingRunnable_m_pad_radarObjPort_par_out_local::TChangeableMemPool::_::_::_m_arrayPool::_0_::_elem::port_ens_r_obj_sensor_base::_::_m_movObjectInformation::_0_::_m_dWidthN = @Classe_Obj_Sim::obj_data.obj_width[0] * 128;
        break;

      case 5: //"Truck"
        @sysvar::XCP::RadarFR::_g_PlReCoFw_PlReCoPer_ObjBypassingRunnable_ObjBypassingRunnable_m_pad_radarObjPort_par_out_local::TChangeableMemPool::_::_::_m_arrayPool::_0_::_elem::port_ens_r_obj_sensor_base::_::_m_movObjectInformation::_0_::STA_OBJECT_INFORMATION_ST::_::_m_ohyObjectType_st::_m_prob1NonObstacleN = 0;
        @sysvar::XCP::RadarFR::_g_PlReCoFw_PlReCoPer_ObjBypassingRunnable_ObjBypassingRunnable_m_pad_radarObjPort_par_out_local::TChangeableMemPool::_::_::_m_arrayPool::_0_::_elem::port_ens_r_obj_sensor_base::_::_m_movObjectInformation::_0_::STA_OBJECT_INFORMATION_ST::_::_m_ohyObjectType_st::_m_prob1ObstacleN = 128;
        @sysvar::XCP::RadarFR::_g_PlReCoFw_PlReCoPer_ObjBypassingRunnable_ObjBypassingRunnable_m_pad_radarObjPort_par_out_local::TChangeableMemPool::_::_::_m_arrayPool::_0_::_elem::port_ens_r_obj_sensor_base::_::_m_movObjectInformation::_0_::STA_OBJECT_INFORMATION_ST::_::_m_ohyObjectType_st::_m_prob1UnknownN = 0;
        @sysvar::XCP::RadarFR::_g_PlReCoFw_PlReCoPer_ObjBypassingRunnable_ObjBypassingRunnable_m_pad_radarObjPort_par_out_local::TChangeableMemPool::_::_::_m_arrayPool::_0_::_elem::port_ens_r_obj_sensor_base::_::_m_movObjectInformation::_0_::STA_OBJECT_INFORMATION_ST::_::_m_ohyObjectType_st::_m_probObstacle_st::_m_prob1UnknownN = 0;
        @sysvar::XCP::RadarFR::_g_PlReCoFw_PlReCoPer_ObjBypassingRunnable_ObjBypassingRunnable_m_pad_radarObjPort_par_out_local::TChangeableMemPool::_::_::_m_arrayPool::_0_::_elem::port_ens_r_obj_sensor_base::_::_m_movObjectInformation::_0_::STA_OBJECT_INFORMATION_ST::_::_m_ohyObjectType_st::_m_probObstacle_st::_m_probMobile_st::_m_prob1FourPlusWheelerN = 128;
        @sysvar::XCP::RadarFR::_g_PlReCoFw_PlReCoPer_ObjBypassingRunnable_ObjBypassingRunnable_m_pad_radarObjPort_par_out_local::TChangeableMemPool::_::_::_m_arrayPool::_0_::_elem::port_ens_r_obj_sensor_base::_::_m_movObjectInformation::_0_::STA_OBJECT_INFORMATION_ST::_::_m_ohyObjectType_st::_m_probObstacle_st::_m_probMobile_st::_m_prob1PedestrianN = 0;
        @sysvar::XCP::RadarFR::_g_PlReCoFw_PlReCoPer_ObjBypassingRunnable_ObjBypassingRunnable_m_pad_radarObjPort_par_out_local::TChangeableMemPool::_::_::_m_arrayPool::_0_::_elem::port_ens_r_obj_sensor_base::_::_m_movObjectInformation::_0_::STA_OBJECT_INFORMATION_ST::_::_m_ohyObjectType_st::_m_probObstacle_st::_m_probMobile_st::_m_prob1TwoWheelerN = 0;
        @sysvar::XCP::RadarFR::_g_PlReCoFw_PlReCoPer_ObjBypassingRunnable_ObjBypassingRunnable_m_pad_radarObjPort_par_out_local::TChangeableMemPool::_::_::_m_arrayPool::_0_::_elem::port_ens_r_obj_sensor_base::_::_m_movObjectInformation::_0_::STA_OBJECT_INFORMATION_ST::_::_m_ohyObjectType_st::_m_probObstacle_st::_m_probMobile_st::_m_prob1UnknownN = 0;
        @sysvar::XCP::RadarFR::_g_PlReCoFw_PlReCoPer_ObjBypassingRunnable_ObjBypassingRunnable_m_pad_radarObjPort_par_out_local::TChangeableMemPool::_::_::_m_arrayPool::_0_::_elem::port_ens_r_obj_sensor_base::_::_m_movObjectInformation::_0_::STA_OBJECT_INFORMATION_ST::_::_m_ohyObjectType_st::_m_probObstacle_st::_m_probMobile_st::_m_probFourPlusWheeler_st::_m_prob1PassengerCarN = 0;
        @sysvar::XCP::RadarFR::_g_PlReCoFw_PlReCoPer_ObjBypassingRunnable_ObjBypassingRunnable_m_pad_radarObjPort_par_out_local::TChangeableMemPool::_::_::_m_arrayPool::_0_::_elem::port_ens_r_obj_sensor_base::_::_m_movObjectInformation::_0_::STA_OBJECT_INFORMATION_ST::_::_m_ohyObjectType_st::_m_probObstacle_st::_m_probMobile_st::_m_probFourPlusWheeler_st::_m_prob1TruckN = 128;
        @sysvar::XCP::RadarFR::_g_PlReCoFw_PlReCoPer_ObjBypassingRunnable_ObjBypassingRunnable_m_pad_radarObjPort_par_out_local::TChangeableMemPool::_::_::_m_arrayPool::_0_::_elem::port_ens_r_obj_sensor_base::_::_m_movObjectInformation::_0_::STA_OBJECT_INFORMATION_ST::_::_m_ohyObjectType_st::_m_probObstacle_st::_m_probMobile_st::_m_probFourPlusWheeler_st::_m_prob1UnknownN = 0;
        @sysvar::XCP::RadarFR::_g_PlReCoFw_PlReCoPer_ObjBypassingRunnable_ObjBypassingRunnable_m_pad_radarObjPort_par_out_local::TChangeableMemPool::_::_::_m_arrayPool::_0_::_elem::port_ens_r_obj_sensor_base::_::_m_movObjectInformation::_0_::STA_OBJECT_INFORMATION_ST::_::_m_ohyObjectType_st::_m_probObstacle_st::_m_probStationary_st::_m_prob1RoadsideBarrierN = 0;
        @sysvar::XCP::RadarFR::_g_PlReCoFw_PlReCoPer_ObjBypassingRunnable_ObjBypassingRunnable_m_pad_radarObjPort_par_out_local::TChangeableMemPool::_::_::_m_arrayPool::_0_::_elem::port_ens_r_obj_sensor_base::_::_m_movObjectInformation::_0_::STA_OBJECT_INFORMATION_ST::_::_m_ohyObjectType_st::_m_probObstacle_st::_m_probStationary_st::_m_prob1UnknownN = 0;
        @sysvar::XCP::RadarFR::_g_PlReCoFw_PlReCoPer_ObjBypassingRunnable_ObjBypassingRunnable_m_pad_radarObjPort_par_out_local::TChangeableMemPool::_::_::_m_arrayPool::_0_::_elem::port_ens_r_obj_sensor_base::_::_m_movObjectInformation::_0_::_m_dLengthN = 64;
        @sysvar::XCP::RadarFR::_g_PlReCoFw_PlReCoPer_ObjBypassingRunnable_ObjBypassingRunnable_m_pad_radarObjPort_par_out_local::TChangeableMemPool::_::_::_m_arrayPool::_0_::_elem::port_ens_r_obj_sensor_base::_::_m_movObjectInformation::_0_::_m_dWidthN = @Classe_Obj_Sim::obj_data.obj_width[0] * 128;
        break;

      case 6: //"PassengerCar"
        @sysvar::XCP::RadarFR::_g_PlReCoFw_PlReCoPer_ObjBypassingRunnable_ObjBypassingRunnable_m_pad_radarObjPort_par_out_local::TChangeableMemPool::_::_::_m_arrayPool::_0_::_elem::port_ens_r_obj_sensor_base::_::_m_movObjectInformation::_0_::STA_OBJECT_INFORMATION_ST::_::_m_ohyObjectType_st::_m_prob1NonObstacleN = 0;
        @sysvar::XCP::RadarFR::_g_PlReCoFw_PlReCoPer_ObjBypassingRunnable_ObjBypassingRunnable_m_pad_radarObjPort_par_out_local::TChangeableMemPool::_::_::_m_arrayPool::_0_::_elem::port_ens_r_obj_sensor_base::_::_m_movObjectInformation::_0_::STA_OBJECT_INFORMATION_ST::_::_m_ohyObjectType_st::_m_prob1ObstacleN = 128;
        @sysvar::XCP::RadarFR::_g_PlReCoFw_PlReCoPer_ObjBypassingRunnable_ObjBypassingRunnable_m_pad_radarObjPort_par_out_local::TChangeableMemPool::_::_::_m_arrayPool::_0_::_elem::port_ens_r_obj_sensor_base::_::_m_movObjectInformation::_0_::STA_OBJECT_INFORMATION_ST::_::_m_ohyObjectType_st::_m_prob1UnknownN = 0;
        @sysvar::XCP::RadarFR::_g_PlReCoFw_PlReCoPer_ObjBypassingRunnable_ObjBypassingRunnable_m_pad_radarObjPort_par_out_local::TChangeableMemPool::_::_::_m_arrayPool::_0_::_elem::port_ens_r_obj_sensor_base::_::_m_movObjectInformation::_0_::STA_OBJECT_INFORMATION_ST::_::_m_ohyObjectType_st::_m_probObstacle_st::_m_prob1UnknownN = 0;
        @sysvar::XCP::RadarFR::_g_PlReCoFw_PlReCoPer_ObjBypassingRunnable_ObjBypassingRunnable_m_pad_radarObjPort_par_out_local::TChangeableMemPool::_::_::_m_arrayPool::_0_::_elem::port_ens_r_obj_sensor_base::_::_m_movObjectInformation::_0_::STA_OBJECT_INFORMATION_ST::_::_m_ohyObjectType_st::_m_probObstacle_st::_m_probMobile_st::_m_prob1FourPlusWheelerN = 128;
        @sysvar::XCP::RadarFR::_g_PlReCoFw_PlReCoPer_ObjBypassingRunnable_ObjBypassingRunnable_m_pad_radarObjPort_par_out_local::TChangeableMemPool::_::_::_m_arrayPool::_0_::_elem::port_ens_r_obj_sensor_base::_::_m_movObjectInformation::_0_::STA_OBJECT_INFORMATION_ST::_::_m_ohyObjectType_st::_m_probObstacle_st::_m_probMobile_st::_m_prob1PedestrianN = 0;
        @sysvar::XCP::RadarFR::_g_PlReCoFw_PlReCoPer_ObjBypassingRunnable_ObjBypassingRunnable_m_pad_radarObjPort_par_out_local::TChangeableMemPool::_::_::_m_arrayPool::_0_::_elem::port_ens_r_obj_sensor_base::_::_m_movObjectInformation::_0_::STA_OBJECT_INFORMATION_ST::_::_m_ohyObjectType_st::_m_probObstacle_st::_m_probMobile_st::_m_prob1TwoWheelerN = 0;
        @sysvar::XCP::RadarFR::_g_PlReCoFw_PlReCoPer_ObjBypassingRunnable_ObjBypassingRunnable_m_pad_radarObjPort_par_out_local::TChangeableMemPool::_::_::_m_arrayPool::_0_::_elem::port_ens_r_obj_sensor_base::_::_m_movObjectInformation::_0_::STA_OBJECT_INFORMATION_ST::_::_m_ohyObjectType_st::_m_probObstacle_st::_m_probMobile_st::_m_prob1UnknownN = 0;
        @sysvar::XCP::RadarFR::_g_PlReCoFw_PlReCoPer_ObjBypassingRunnable_ObjBypassingRunnable_m_pad_radarObjPort_par_out_local::TChangeableMemPool::_::_::_m_arrayPool::_0_::_elem::port_ens_r_obj_sensor_base::_::_m_movObjectInformation::_0_::STA_OBJECT_INFORMATION_ST::_::_m_ohyObjectType_st::_m_probObstacle_st::_m_probMobile_st::_m_probFourPlusWheeler_st::_m_prob1PassengerCarN = 128;
        @sysvar::XCP::RadarFR::_g_PlReCoFw_PlReCoPer_ObjBypassingRunnable_ObjBypassingRunnable_m_pad_radarObjPort_par_out_local::TChangeableMemPool::_::_::_m_arrayPool::_0_::_elem::port_ens_r_obj_sensor_base::_::_m_movObjectInformation::_0_::STA_OBJECT_INFORMATION_ST::_::_m_ohyObjectType_st::_m_probObstacle_st::_m_probMobile_st::_m_probFourPlusWheeler_st::_m_prob1TruckN = 0;
        @sysvar::XCP::RadarFR::_g_PlReCoFw_PlReCoPer_ObjBypassingRunnable_ObjBypassingRunnable_m_pad_radarObjPort_par_out_local::TChangeableMemPool::_::_::_m_arrayPool::_0_::_elem::port_ens_r_obj_sensor_base::_::_m_movObjectInformation::_0_::STA_OBJECT_INFORMATION_ST::_::_m_ohyObjectType_st::_m_probObstacle_st::_m_probMobile_st::_m_probFourPlusWheeler_st::_m_prob1UnknownN = 0;
        @sysvar::XCP::RadarFR::_g_PlReCoFw_PlReCoPer_ObjBypassingRunnable_ObjBypassingRunnable_m_pad_radarObjPort_par_out_local::TChangeableMemPool::_::_::_m_arrayPool::_0_::_elem::port_ens_r_obj_sensor_base::_::_m_movObjectInformation::_0_::STA_OBJECT_INFORMATION_ST::_::_m_ohyObjectType_st::_m_probObstacle_st::_m_probStationary_st::_m_prob1RoadsideBarrierN = 0;
        @sysvar::XCP::RadarFR::_g_PlReCoFw_PlReCoPer_ObjBypassingRunnable_ObjBypassingRunnable_m_pad_radarObjPort_par_out_local::TChangeableMemPool::_::_::_m_arrayPool::_0_::_elem::port_ens_r_obj_sensor_base::_::_m_movObjectInformation::_0_::STA_OBJECT_INFORMATION_ST::_::_m_ohyObjectType_st::_m_probObstacle_st::_m_probStationary_st::_m_prob1UnknownN = 0;
        @sysvar::XCP::RadarFR::_g_PlReCoFw_PlReCoPer_ObjBypassingRunnable_ObjBypassingRunnable_m_pad_radarObjPort_par_out_local::TChangeableMemPool::_::_::_m_arrayPool::_0_::_elem::port_ens_r_obj_sensor_base::_::_m_movObjectInformation::_0_::_m_dLengthN = 64;
        @sysvar::XCP::RadarFR::_g_PlReCoFw_PlReCoPer_ObjBypassingRunnable_ObjBypassingRunnable_m_pad_radarObjPort_par_out_local::TChangeableMemPool::_::_::_m_arrayPool::_0_::_elem::port_ens_r_obj_sensor_base::_::_m_movObjectInformation::_0_::_m_dWidthN = @Classe_Obj_Sim::obj_data.obj_width[0] * 128;
        break;
    }
    break;

    case 1: //"Object-1"
    //constant
    @sysvar::XCP::RadarFR::_g_PlReCoFw_PlReCoPer_ObjBypassingRunnable_ObjBypassingRunnable_m_pad_radarObjPort_par_out_local::TChangeableMemPool::_::_::_m_arrayPool::_0_::_elem::port_ens_r_obj_sensor_base::_::_m_movObjectInformation::_1_::STA_OBJECT_INFORMATION_ST::_::_Meas_b = 1;
    @sysvar::XCP::RadarFR::_g_PlReCoFw_PlReCoPer_ObjBypassingRunnable_ObjBypassingRunnable_m_pad_radarObjPort_par_out_local::TChangeableMemPool::_::_::_m_arrayPool::_0_::_elem::port_ens_r_obj_sensor_base::_::_m_movObjectInformation::_1_::STA_OBJECT_INFORMATION_ST::_::_Measurable_b = 1;
    @sysvar::XCP::RadarFR::_g_PlReCoFw_PlReCoPer_ObjBypassingRunnable_ObjBypassingRunnable_m_pad_radarObjPort_par_out_local::TChangeableMemPool::_::_::_m_arrayPool::_0_::_elem::port_ens_r_obj_sensor_base::_::_m_movObjectInformation::_1_::STA_OBJECT_INFORMATION_ST::_::_Valid_b = 1;
    @sysvar::XCP::RadarFR::_g_PlReCoFw_PlReCoPer_ObjBypassingRunnable_ObjBypassingRunnable_m_pad_radarObjPort_par_out_local::TChangeableMemPool::_::_::_m_arrayPool::_0_::_elem::port_ens_r_obj_sensor_base::_::_m_movObjectInformation::_1_::_m_covarDxAxN = 0;
    @sysvar::XCP::RadarFR::_g_PlReCoFw_PlReCoPer_ObjBypassingRunnable_ObjBypassingRunnable_m_pad_radarObjPort_par_out_local::TChangeableMemPool::_::_::_m_arrayPool::_0_::_elem::port_ens_r_obj_sensor_base::_::_m_movObjectInformation::_1_::_m_covarDxVxN = 0;
    @sysvar::XCP::RadarFR::_g_PlReCoFw_PlReCoPer_ObjBypassingRunnable_ObjBypassingRunnable_m_pad_radarObjPort_par_out_local::TChangeableMemPool::_::_::_m_arrayPool::_0_::_elem::port_ens_r_obj_sensor_base::_::_m_movObjectInformation::_1_::_m_covarDyVyN = 0;
    @sysvar::XCP::RadarFR::_g_PlReCoFw_PlReCoPer_ObjBypassingRunnable_ObjBypassingRunnable_m_pad_radarObjPort_par_out_local::TChangeableMemPool::_::_::_m_arrayPool::_0_::_elem::port_ens_r_obj_sensor_base::_::_m_movObjectInformation::_1_::_m_covarDyWidthN = 0;
    @sysvar::XCP::RadarFR::_g_PlReCoFw_PlReCoPer_ObjBypassingRunnable_ObjBypassingRunnable_m_pad_radarObjPort_par_out_local::TChangeableMemPool::_::_::_m_arrayPool::_0_::_elem::port_ens_r_obj_sensor_base::_::_m_movObjectInformation::_1_::_m_covarVxAxN = 0;
    @sysvar::XCP::RadarFR::_g_PlReCoFw_PlReCoPer_ObjBypassingRunnable_ObjBypassingRunnable_m_pad_radarObjPort_par_out_local::TChangeableMemPool::_::_::_m_arrayPool::_0_::_elem::port_ens_r_obj_sensor_base::_::_m_movObjectInformation::_1_::_m_varAxN = 0;
    @sysvar::XCP::RadarFR::_g_PlReCoFw_PlReCoPer_ObjBypassingRunnable_ObjBypassingRunnable_m_pad_radarObjPort_par_out_local::TChangeableMemPool::_::_::_m_arrayPool::_0_::_elem::port_ens_r_obj_sensor_base::_::_m_movObjectInformation::_1_::_m_varAyN = 0;
    @sysvar::XCP::RadarFR::_g_PlReCoFw_PlReCoPer_ObjBypassingRunnable_ObjBypassingRunnable_m_pad_radarObjPort_par_out_local::TChangeableMemPool::_::_::_m_arrayPool::_0_::_elem::port_ens_r_obj_sensor_base::_::_m_movObjectInformation::_1_::_m_varVxN = 0;
    @sysvar::XCP::RadarFR::_g_PlReCoFw_PlReCoPer_ObjBypassingRunnable_ObjBypassingRunnable_m_pad_radarObjPort_par_out_local::TChangeableMemPool::_::_::_m_arrayPool::_0_::_elem::port_ens_r_obj_sensor_base::_::_m_movObjectInformation::_1_::_m_varVyN = 0;
    @sysvar::XCP::RadarFR::_g_PlReCoFw_PlReCoPer_ObjBypassingRunnable_ObjBypassingRunnable_m_pad_radarObjPort_par_out_local::TChangeableMemPool::_::_::_m_arrayPool::_0_::_elem::port_ens_r_obj_sensor_base::_::_m_movObjectInformation::_1_::STA_OBJECT_INFORMATION_ST::_::_m_varDxN = 0;
    @sysvar::XCP::RadarFR::_g_PlReCoFw_PlReCoPer_ObjBypassingRunnable_ObjBypassingRunnable_m_pad_radarObjPort_par_out_local::TChangeableMemPool::_::_::_m_arrayPool::_0_::_elem::port_ens_r_obj_sensor_base::_::_m_movObjectInformation::_1_::STA_OBJECT_INFORMATION_ST::_::_m_varDyN = 0;
    @sysvar::XCP::RadarFR::_g_PlReCoFw_PlReCoPer_ObjBypassingRunnable_ObjBypassingRunnable_m_pad_radarObjPort_par_out_local::TChangeableMemPool::_::_::_m_arrayPool::_0_::_elem::port_ens_r_obj_sensor_base::_::_m_movObjectInformation::_1_::_m_dVarLengthN = 0;
    @sysvar::XCP::RadarFR::_g_PlReCoFw_PlReCoPer_ObjBypassingRunnable_ObjBypassingRunnable_m_pad_radarObjPort_par_out_local::TChangeableMemPool::_::_::_m_arrayPool::_0_::_elem::port_ens_r_obj_sensor_base::_::_m_movObjectInformation::_1_::_m_dVarWidthN = 0;
    @sysvar::XCP::RadarFR::_g_PlReCoFw_PlReCoPer_ObjBypassingRunnable_ObjBypassingRunnable_m_pad_radarObjPort_par_out_local::TChangeableMemPool::_::_::_m_arrayPool::_0_::_elem::port_ens_r_obj_sensor_base::_::_m_movObjectInformation::_1_::STA_OBJECT_INFORMATION_ST::_::_m_wExistProbN = 64880;
    @sysvar::XCP::RadarFR::_g_PlReCoFw_PlReCoPer_ObjBypassingRunnable_ObjBypassingRunnable_m_pad_radarObjPort_par_out_local::TChangeableMemPool::_::_::_m_arrayPool::_0_::_elem::port_ens_r_obj_sensor_base::_::_m_movObjectInformation::_1_::_m_referencePtPosIndexN = 10;
    @sysvar::XCP::RadarFR::_g_PlReCoFw_PlReCoPer_ObjBypassingRunnable_ObjBypassingRunnable_m_pad_radarObjPort_par_out_local::TChangeableMemPool::_::_::_m_arrayPool::_0_::_elem::port_ens_r_obj_sensor_base::_::_m_movObjectInformation::_1_::_m_alpPiVarYawAngleN = 0;
    @sysvar::XCP::RadarFR::_g_PlReCoFw_PlReCoPer_ObjBypassingRunnable_ObjBypassingRunnable_m_pad_radarObjPort_par_out_local::TChangeableMemPool::_::_::_m_arrayPool::_0_::_elem::port_ens_r_obj_sensor_base::_::_m_movObjectInformation::_1_::_m_alpPiYawAngleN = 0;

    //target movement

    @sysvar::XCP::RadarFR::_g_PlReCoFw_PlReCoPer_ObjBypassingRunnable_ObjBypassingRunnable_m_pad_radarObjPort_par_out_local::TChangeableMemPool::_::_::_m_arrayPool::_0_::_elem::port_ens_r_obj_sensor_base::_::_m_movObjectInformation::_1_::STA_OBJECT_INFORMATION_ST::_::_m_dxN = @Classe_Obj_Sim::obj_data.obj_dx[1] * 128;
    @sysvar::XCP::RadarFR::_g_PlReCoFw_PlReCoPer_ObjBypassingRunnable_ObjBypassingRunnable_m_pad_radarObjPort_par_out_local::TChangeableMemPool::_::_::_m_arrayPool::_0_::_elem::port_ens_r_obj_sensor_base::_::_m_movObjectInformation::_1_::STA_OBJECT_INFORMATION_ST::_::_m_dyN = @Classe_Obj_Sim::obj_data.obj_dy[1] * 128;
    @sysvar::XCP::RadarFR::_g_PlReCoFw_PlReCoPer_ObjBypassingRunnable_ObjBypassingRunnable_m_pad_radarObjPort_par_out_local::TChangeableMemPool::_::_::_m_arrayPool::_0_::_elem::port_ens_r_obj_sensor_base::_::_m_movObjectInformation::_1_::STA_OBJECT_INFORMATION_ST::_::_m_dzN = 0;
    @sysvar::XCP::RadarFR::_g_PlReCoFw_PlReCoPer_ObjBypassingRunnable_ObjBypassingRunnable_m_pad_radarObjPort_par_out_local::TChangeableMemPool::_::_::_m_arrayPool::_0_::_elem::port_ens_r_obj_sensor_base::_::_m_movObjectInformation::_1_::_m_vxN = @Classe_Obj_Sim::obj_data.obj_relative_vx[1] * 256;
    @sysvar::XCP::RadarFR::_g_PlReCoFw_PlReCoPer_ObjBypassingRunnable_ObjBypassingRunnable_m_pad_radarObjPort_par_out_local::TChangeableMemPool::_::_::_m_arrayPool::_0_::_elem::port_ens_r_obj_sensor_base::_::_m_movObjectInformation::_1_::_m_vyN = @Classe_Obj_Sim::obj_data.obj_relative_vy[1] * 256;
    @sysvar::XCP::RadarFR::_g_PlReCoFw_PlReCoPer_ObjBypassingRunnable_ObjBypassingRunnable_m_pad_radarObjPort_par_out_local::TChangeableMemPool::_::_::_m_arrayPool::_0_::_elem::port_ens_r_obj_sensor_base::_::_m_movObjectInformation::_1_::_m_axN = 0;
    @sysvar::XCP::RadarFR::_g_PlReCoFw_PlReCoPer_ObjBypassingRunnable_ObjBypassingRunnable_m_pad_radarObjPort_par_out_local::TChangeableMemPool::_::_::_m_arrayPool::_0_::_elem::port_ens_r_obj_sensor_base::_::_m_movObjectInformation::_1_::_m_ayN = 0;

    //target object moving or not
    if (abs(@Classe_Obj_Sim::obj_data.obj_relative_vx[1]) != 0)
    {
      @sysvar::XCP::RadarFR::_g_PlReCoFw_PlReCoPer_ObjBypassingRunnable_ObjBypassingRunnable_m_pad_radarObjPort_par_out_local::TChangeableMemPool::_::_::_m_arrayPool::_0_::_elem::port_ens_r_obj_sensor_base::_::_m_movObjectInformation::_1_::STA_OBJECT_INFORMATION_ST::_::_m_prob1HasBeenObservedMovingN = 126;
      @sysvar::XCP::RadarFR::_g_PlReCoFw_PlReCoPer_ObjBypassingRunnable_ObjBypassingRunnable_m_pad_radarObjPort_par_out_local::TChangeableMemPool::_::_::_m_arrayPool::_0_::_elem::port_ens_r_obj_sensor_base::_::_m_movObjectInformation::_1_::STA_OBJECT_INFORMATION_ST::_::_m_prob1MovingN = 126;
      @sysvar::XCP::RadarFR::_g_PlReCoFw_PlReCoPer_ObjBypassingRunnable_ObjBypassingRunnable_m_pad_radarObjPort_par_out_local::TChangeableMemPool::_::_::_m_arrayPool::_0_::_elem::port_ens_r_obj_sensor_base::_::_m_movObjectInformation::_1_::STA_OBJECT_INFORMATION_ST::_::_m_ohyObjectType_st::_m_probObstacle_st::_m_prob1MobileN = 128;
      @sysvar::XCP::RadarFR::_g_PlReCoFw_PlReCoPer_ObjBypassingRunnable_ObjBypassingRunnable_m_pad_radarObjPort_par_out_local::TChangeableMemPool::_::_::_m_arrayPool::_0_::_elem::port_ens_r_obj_sensor_base::_::_m_movObjectInformation::_1_::STA_OBJECT_INFORMATION_ST::_::_m_ohyObjectType_st::_m_probObstacle_st::_m_prob1StationaryN = 0;
    }
    else
    {
      @sysvar::XCP::RadarFR::_g_PlReCoFw_PlReCoPer_ObjBypassingRunnable_ObjBypassingRunnable_m_pad_radarObjPort_par_out_local::TChangeableMemPool::_::_::_m_arrayPool::_0_::_elem::port_ens_r_obj_sensor_base::_::_m_movObjectInformation::_1_::STA_OBJECT_INFORMATION_ST::_::_m_prob1HasBeenObservedMovingN = 0;
      @sysvar::XCP::RadarFR::_g_PlReCoFw_PlReCoPer_ObjBypassingRunnable_ObjBypassingRunnable_m_pad_radarObjPort_par_out_local::TChangeableMemPool::_::_::_m_arrayPool::_0_::_elem::port_ens_r_obj_sensor_base::_::_m_movObjectInformation::_1_::STA_OBJECT_INFORMATION_ST::_::_m_prob1MovingN = 0;
      @sysvar::XCP::RadarFR::_g_PlReCoFw_PlReCoPer_ObjBypassingRunnable_ObjBypassingRunnable_m_pad_radarObjPort_par_out_local::TChangeableMemPool::_::_::_m_arrayPool::_0_::_elem::port_ens_r_obj_sensor_base::_::_m_movObjectInformation::_1_::STA_OBJECT_INFORMATION_ST::_::_m_ohyObjectType_st::_m_probObstacle_st::_m_prob1MobileN = 0;
      @sysvar::XCP::RadarFR::_g_PlReCoFw_PlReCoPer_ObjBypassingRunnable_ObjBypassingRunnable_m_pad_radarObjPort_par_out_local::TChangeableMemPool::_::_::_m_arrayPool::_0_::_elem::port_ens_r_obj_sensor_base::_::_m_movObjectInformation::_1_::STA_OBJECT_INFORMATION_ST::_::_m_ohyObjectType_st::_m_probObstacle_st::_m_prob1StationaryN = 128;
    }

      //object classification
    switch (@Classe_Obj_Sim::obj_data.obj_type[1])
    {
      case 0: //"Non-Obstacle"
        @sysvar::XCP::RadarFR::_g_PlReCoFw_PlReCoPer_ObjBypassingRunnable_ObjBypassingRunnable_m_pad_radarObjPort_par_out_local::TChangeableMemPool::_::_::_m_arrayPool::_0_::_elem::port_ens_r_obj_sensor_base::_::_m_movObjectInformation::_1_::STA_OBJECT_INFORMATION_ST::_::_m_ohyObjectType_st::_m_prob1NonObstacleN = 128;
        @sysvar::XCP::RadarFR::_g_PlReCoFw_PlReCoPer_ObjBypassingRunnable_ObjBypassingRunnable_m_pad_radarObjPort_par_out_local::TChangeableMemPool::_::_::_m_arrayPool::_0_::_elem::port_ens_r_obj_sensor_base::_::_m_movObjectInformation::_1_::STA_OBJECT_INFORMATION_ST::_::_m_ohyObjectType_st::_m_prob1ObstacleN = 0;
        @sysvar::XCP::RadarFR::_g_PlReCoFw_PlReCoPer_ObjBypassingRunnable_ObjBypassingRunnable_m_pad_radarObjPort_par_out_local::TChangeableMemPool::_::_::_m_arrayPool::_0_::_elem::port_ens_r_obj_sensor_base::_::_m_movObjectInformation::_1_::STA_OBJECT_INFORMATION_ST::_::_m_ohyObjectType_st::_m_prob1UnknownN = 0;
        @sysvar::XCP::RadarFR::_g_PlReCoFw_PlReCoPer_ObjBypassingRunnable_ObjBypassingRunnable_m_pad_radarObjPort_par_out_local::TChangeableMemPool::_::_::_m_arrayPool::_0_::_elem::port_ens_r_obj_sensor_base::_::_m_movObjectInformation::_1_::STA_OBJECT_INFORMATION_ST::_::_m_ohyObjectType_st::_m_probObstacle_st::_m_prob1UnknownN = 128;
        @sysvar::XCP::RadarFR::_g_PlReCoFw_PlReCoPer_ObjBypassingRunnable_ObjBypassingRunnable_m_pad_radarObjPort_par_out_local::TChangeableMemPool::_::_::_m_arrayPool::_0_::_elem::port_ens_r_obj_sensor_base::_::_m_movObjectInformation::_1_::STA_OBJECT_INFORMATION_ST::_::_m_ohyObjectType_st::_m_probObstacle_st::_m_probMobile_st::_m_prob1FourPlusWheelerN = 0;
        @sysvar::XCP::RadarFR::_g_PlReCoFw_PlReCoPer_ObjBypassingRunnable_ObjBypassingRunnable_m_pad_radarObjPort_par_out_local::TChangeableMemPool::_::_::_m_arrayPool::_0_::_elem::port_ens_r_obj_sensor_base::_::_m_movObjectInformation::_1_::STA_OBJECT_INFORMATION_ST::_::_m_ohyObjectType_st::_m_probObstacle_st::_m_probMobile_st::_m_prob1PedestrianN = 0;
        @sysvar::XCP::RadarFR::_g_PlReCoFw_PlReCoPer_ObjBypassingRunnable_ObjBypassingRunnable_m_pad_radarObjPort_par_out_local::TChangeableMemPool::_::_::_m_arrayPool::_0_::_elem::port_ens_r_obj_sensor_base::_::_m_movObjectInformation::_1_::STA_OBJECT_INFORMATION_ST::_::_m_ohyObjectType_st::_m_probObstacle_st::_m_probMobile_st::_m_prob1TwoWheelerN = 0;
        @sysvar::XCP::RadarFR::_g_PlReCoFw_PlReCoPer_ObjBypassingRunnable_ObjBypassingRunnable_m_pad_radarObjPort_par_out_local::TChangeableMemPool::_::_::_m_arrayPool::_0_::_elem::port_ens_r_obj_sensor_base::_::_m_movObjectInformation::_1_::STA_OBJECT_INFORMATION_ST::_::_m_ohyObjectType_st::_m_probObstacle_st::_m_probMobile_st::_m_prob1UnknownN = 128;
        @sysvar::XCP::RadarFR::_g_PlReCoFw_PlReCoPer_ObjBypassingRunnable_ObjBypassingRunnable_m_pad_radarObjPort_par_out_local::TChangeableMemPool::_::_::_m_arrayPool::_0_::_elem::port_ens_r_obj_sensor_base::_::_m_movObjectInformation::_1_::STA_OBJECT_INFORMATION_ST::_::_m_ohyObjectType_st::_m_probObstacle_st::_m_probMobile_st::_m_probFourPlusWheeler_st::_m_prob1PassengerCarN = 0;
        @sysvar::XCP::RadarFR::_g_PlReCoFw_PlReCoPer_ObjBypassingRunnable_ObjBypassingRunnable_m_pad_radarObjPort_par_out_local::TChangeableMemPool::_::_::_m_arrayPool::_0_::_elem::port_ens_r_obj_sensor_base::_::_m_movObjectInformation::_1_::STA_OBJECT_INFORMATION_ST::_::_m_ohyObjectType_st::_m_probObstacle_st::_m_probMobile_st::_m_probFourPlusWheeler_st::_m_prob1TruckN = 0;
        @sysvar::XCP::RadarFR::_g_PlReCoFw_PlReCoPer_ObjBypassingRunnable_ObjBypassingRunnable_m_pad_radarObjPort_par_out_local::TChangeableMemPool::_::_::_m_arrayPool::_0_::_elem::port_ens_r_obj_sensor_base::_::_m_movObjectInformation::_1_::STA_OBJECT_INFORMATION_ST::_::_m_ohyObjectType_st::_m_probObstacle_st::_m_probMobile_st::_m_probFourPlusWheeler_st::_m_prob1UnknownN = 128;
        @sysvar::XCP::RadarFR::_g_PlReCoFw_PlReCoPer_ObjBypassingRunnable_ObjBypassingRunnable_m_pad_radarObjPort_par_out_local::TChangeableMemPool::_::_::_m_arrayPool::_0_::_elem::port_ens_r_obj_sensor_base::_::_m_movObjectInformation::_1_::STA_OBJECT_INFORMATION_ST::_::_m_ohyObjectType_st::_m_probObstacle_st::_m_probStationary_st::_m_prob1RoadsideBarrierN = 0;
        @sysvar::XCP::RadarFR::_g_PlReCoFw_PlReCoPer_ObjBypassingRunnable_ObjBypassingRunnable_m_pad_radarObjPort_par_out_local::TChangeableMemPool::_::_::_m_arrayPool::_0_::_elem::port_ens_r_obj_sensor_base::_::_m_movObjectInformation::_1_::STA_OBJECT_INFORMATION_ST::_::_m_ohyObjectType_st::_m_probObstacle_st::_m_probStationary_st::_m_prob1UnknownN = 128;
        @sysvar::XCP::RadarFR::_g_PlReCoFw_PlReCoPer_ObjBypassingRunnable_ObjBypassingRunnable_m_pad_radarObjPort_par_out_local::TChangeableMemPool::_::_::_m_arrayPool::_0_::_elem::port_ens_r_obj_sensor_base::_::_m_movObjectInformation::_1_::_m_dLengthN = 64;
        @sysvar::XCP::RadarFR::_g_PlReCoFw_PlReCoPer_ObjBypassingRunnable_ObjBypassingRunnable_m_pad_radarObjPort_par_out_local::TChangeableMemPool::_::_::_m_arrayPool::_0_::_elem::port_ens_r_obj_sensor_base::_::_m_movObjectInformation::_1_::_m_dWidthN = @Classe_Obj_Sim::obj_data.obj_width[1] * 128;
        break;

      case 1: //"unknown"
        @sysvar::XCP::RadarFR::_g_PlReCoFw_PlReCoPer_ObjBypassingRunnable_ObjBypassingRunnable_m_pad_radarObjPort_par_out_local::TChangeableMemPool::_::_::_m_arrayPool::_0_::_elem::port_ens_r_obj_sensor_base::_::_m_movObjectInformation::_1_::STA_OBJECT_INFORMATION_ST::_::_m_ohyObjectType_st::_m_prob1NonObstacleN = 0;
        @sysvar::XCP::RadarFR::_g_PlReCoFw_PlReCoPer_ObjBypassingRunnable_ObjBypassingRunnable_m_pad_radarObjPort_par_out_local::TChangeableMemPool::_::_::_m_arrayPool::_0_::_elem::port_ens_r_obj_sensor_base::_::_m_movObjectInformation::_1_::STA_OBJECT_INFORMATION_ST::_::_m_ohyObjectType_st::_m_prob1ObstacleN = 0;
        @sysvar::XCP::RadarFR::_g_PlReCoFw_PlReCoPer_ObjBypassingRunnable_ObjBypassingRunnable_m_pad_radarObjPort_par_out_local::TChangeableMemPool::_::_::_m_arrayPool::_0_::_elem::port_ens_r_obj_sensor_base::_::_m_movObjectInformation::_1_::STA_OBJECT_INFORMATION_ST::_::_m_ohyObjectType_st::_m_prob1UnknownN = 128;
        @sysvar::XCP::RadarFR::_g_PlReCoFw_PlReCoPer_ObjBypassingRunnable_ObjBypassingRunnable_m_pad_radarObjPort_par_out_local::TChangeableMemPool::_::_::_m_arrayPool::_0_::_elem::port_ens_r_obj_sensor_base::_::_m_movObjectInformation::_1_::STA_OBJECT_INFORMATION_ST::_::_m_ohyObjectType_st::_m_probObstacle_st::_m_prob1UnknownN = 128;
        @sysvar::XCP::RadarFR::_g_PlReCoFw_PlReCoPer_ObjBypassingRunnable_ObjBypassingRunnable_m_pad_radarObjPort_par_out_local::TChangeableMemPool::_::_::_m_arrayPool::_0_::_elem::port_ens_r_obj_sensor_base::_::_m_movObjectInformation::_1_::STA_OBJECT_INFORMATION_ST::_::_m_ohyObjectType_st::_m_probObstacle_st::_m_probMobile_st::_m_prob1FourPlusWheelerN = 0;
        @sysvar::XCP::RadarFR::_g_PlReCoFw_PlReCoPer_ObjBypassingRunnable_ObjBypassingRunnable_m_pad_radarObjPort_par_out_local::TChangeableMemPool::_::_::_m_arrayPool::_0_::_elem::port_ens_r_obj_sensor_base::_::_m_movObjectInformation::_1_::STA_OBJECT_INFORMATION_ST::_::_m_ohyObjectType_st::_m_probObstacle_st::_m_probMobile_st::_m_prob1PedestrianN = 0;
        @sysvar::XCP::RadarFR::_g_PlReCoFw_PlReCoPer_ObjBypassingRunnable_ObjBypassingRunnable_m_pad_radarObjPort_par_out_local::TChangeableMemPool::_::_::_m_arrayPool::_0_::_elem::port_ens_r_obj_sensor_base::_::_m_movObjectInformation::_1_::STA_OBJECT_INFORMATION_ST::_::_m_ohyObjectType_st::_m_probObstacle_st::_m_probMobile_st::_m_prob1TwoWheelerN = 0;
        @sysvar::XCP::RadarFR::_g_PlReCoFw_PlReCoPer_ObjBypassingRunnable_ObjBypassingRunnable_m_pad_radarObjPort_par_out_local::TChangeableMemPool::_::_::_m_arrayPool::_0_::_elem::port_ens_r_obj_sensor_base::_::_m_movObjectInformation::_1_::STA_OBJECT_INFORMATION_ST::_::_m_ohyObjectType_st::_m_probObstacle_st::_m_probMobile_st::_m_prob1UnknownN = 128;
        @sysvar::XCP::RadarFR::_g_PlReCoFw_PlReCoPer_ObjBypassingRunnable_ObjBypassingRunnable_m_pad_radarObjPort_par_out_local::TChangeableMemPool::_::_::_m_arrayPool::_0_::_elem::port_ens_r_obj_sensor_base::_::_m_movObjectInformation::_1_::STA_OBJECT_INFORMATION_ST::_::_m_ohyObjectType_st::_m_probObstacle_st::_m_probMobile_st::_m_probFourPlusWheeler_st::_m_prob1PassengerCarN = 0;
        @sysvar::XCP::RadarFR::_g_PlReCoFw_PlReCoPer_ObjBypassingRunnable_ObjBypassingRunnable_m_pad_radarObjPort_par_out_local::TChangeableMemPool::_::_::_m_arrayPool::_0_::_elem::port_ens_r_obj_sensor_base::_::_m_movObjectInformation::_1_::STA_OBJECT_INFORMATION_ST::_::_m_ohyObjectType_st::_m_probObstacle_st::_m_probMobile_st::_m_probFourPlusWheeler_st::_m_prob1TruckN = 0;
        @sysvar::XCP::RadarFR::_g_PlReCoFw_PlReCoPer_ObjBypassingRunnable_ObjBypassingRunnable_m_pad_radarObjPort_par_out_local::TChangeableMemPool::_::_::_m_arrayPool::_0_::_elem::port_ens_r_obj_sensor_base::_::_m_movObjectInformation::_1_::STA_OBJECT_INFORMATION_ST::_::_m_ohyObjectType_st::_m_probObstacle_st::_m_probMobile_st::_m_probFourPlusWheeler_st::_m_prob1UnknownN = 128;
        @sysvar::XCP::RadarFR::_g_PlReCoFw_PlReCoPer_ObjBypassingRunnable_ObjBypassingRunnable_m_pad_radarObjPort_par_out_local::TChangeableMemPool::_::_::_m_arrayPool::_0_::_elem::port_ens_r_obj_sensor_base::_::_m_movObjectInformation::_1_::STA_OBJECT_INFORMATION_ST::_::_m_ohyObjectType_st::_m_probObstacle_st::_m_probStationary_st::_m_prob1RoadsideBarrierN = 0;
        @sysvar::XCP::RadarFR::_g_PlReCoFw_PlReCoPer_ObjBypassingRunnable_ObjBypassingRunnable_m_pad_radarObjPort_par_out_local::TChangeableMemPool::_::_::_m_arrayPool::_0_::_elem::port_ens_r_obj_sensor_base::_::_m_movObjectInformation::_1_::STA_OBJECT_INFORMATION_ST::_::_m_ohyObjectType_st::_m_probObstacle_st::_m_probStationary_st::_m_prob1UnknownN = 128;
        @sysvar::XCP::RadarFR::_g_PlReCoFw_PlReCoPer_ObjBypassingRunnable_ObjBypassingRunnable_m_pad_radarObjPort_par_out_local::TChangeableMemPool::_::_::_m_arrayPool::_0_::_elem::port_ens_r_obj_sensor_base::_::_m_movObjectInformation::_1_::_m_dLengthN = 0;
        @sysvar::XCP::RadarFR::_g_PlReCoFw_PlReCoPer_ObjBypassingRunnable_ObjBypassingRunnable_m_pad_radarObjPort_par_out_local::TChangeableMemPool::_::_::_m_arrayPool::_0_::_elem::port_ens_r_obj_sensor_base::_::_m_movObjectInformation::_1_::_m_dWidthN = @Classe_Obj_Sim::obj_data.obj_width[1] * 128;
        break;

      case 2: //"RoadSideBarrier"
        @sysvar::XCP::RadarFR::_g_PlReCoFw_PlReCoPer_ObjBypassingRunnable_ObjBypassingRunnable_m_pad_radarObjPort_par_out_local::TChangeableMemPool::_::_::_m_arrayPool::_0_::_elem::port_ens_r_obj_sensor_base::_::_m_movObjectInformation::_1_::STA_OBJECT_INFORMATION_ST::_::_m_ohyObjectType_st::_m_prob1NonObstacleN = 0;
        @sysvar::XCP::RadarFR::_g_PlReCoFw_PlReCoPer_ObjBypassingRunnable_ObjBypassingRunnable_m_pad_radarObjPort_par_out_local::TChangeableMemPool::_::_::_m_arrayPool::_0_::_elem::port_ens_r_obj_sensor_base::_::_m_movObjectInformation::_1_::STA_OBJECT_INFORMATION_ST::_::_m_ohyObjectType_st::_m_prob1ObstacleN = 128;
        @sysvar::XCP::RadarFR::_g_PlReCoFw_PlReCoPer_ObjBypassingRunnable_ObjBypassingRunnable_m_pad_radarObjPort_par_out_local::TChangeableMemPool::_::_::_m_arrayPool::_0_::_elem::port_ens_r_obj_sensor_base::_::_m_movObjectInformation::_1_::STA_OBJECT_INFORMATION_ST::_::_m_ohyObjectType_st::_m_prob1UnknownN = 0;
        @sysvar::XCP::RadarFR::_g_PlReCoFw_PlReCoPer_ObjBypassingRunnable_ObjBypassingRunnable_m_pad_radarObjPort_par_out_local::TChangeableMemPool::_::_::_m_arrayPool::_0_::_elem::port_ens_r_obj_sensor_base::_::_m_movObjectInformation::_1_::STA_OBJECT_INFORMATION_ST::_::_m_ohyObjectType_st::_m_probObstacle_st::_m_prob1MobileN = 0;
        @sysvar::XCP::RadarFR::_g_PlReCoFw_PlReCoPer_ObjBypassingRunnable_ObjBypassingRunnable_m_pad_radarObjPort_par_out_local::TChangeableMemPool::_::_::_m_arrayPool::_0_::_elem::port_ens_r_obj_sensor_base::_::_m_movObjectInformation::_1_::STA_OBJECT_INFORMATION_ST::_::_m_ohyObjectType_st::_m_probObstacle_st::_m_prob1StationaryN = 128;
        @sysvar::XCP::RadarFR::_g_PlReCoFw_PlReCoPer_ObjBypassingRunnable_ObjBypassingRunnable_m_pad_radarObjPort_par_out_local::TChangeableMemPool::_::_::_m_arrayPool::_0_::_elem::port_ens_r_obj_sensor_base::_::_m_movObjectInformation::_1_::STA_OBJECT_INFORMATION_ST::_::_m_ohyObjectType_st::_m_probObstacle_st::_m_prob1UnknownN = 0;
        @sysvar::XCP::RadarFR::_g_PlReCoFw_PlReCoPer_ObjBypassingRunnable_ObjBypassingRunnable_m_pad_radarObjPort_par_out_local::TChangeableMemPool::_::_::_m_arrayPool::_0_::_elem::port_ens_r_obj_sensor_base::_::_m_movObjectInformation::_1_::STA_OBJECT_INFORMATION_ST::_::_m_ohyObjectType_st::_m_probObstacle_st::_m_probMobile_st::_m_prob1FourPlusWheelerN = 0;
        @sysvar::XCP::RadarFR::_g_PlReCoFw_PlReCoPer_ObjBypassingRunnable_ObjBypassingRunnable_m_pad_radarObjPort_par_out_local::TChangeableMemPool::_::_::_m_arrayPool::_0_::_elem::port_ens_r_obj_sensor_base::_::_m_movObjectInformation::_1_::STA_OBJECT_INFORMATION_ST::_::_m_ohyObjectType_st::_m_probObstacle_st::_m_probMobile_st::_m_prob1PedestrianN = 0;
        @sysvar::XCP::RadarFR::_g_PlReCoFw_PlReCoPer_ObjBypassingRunnable_ObjBypassingRunnable_m_pad_radarObjPort_par_out_local::TChangeableMemPool::_::_::_m_arrayPool::_0_::_elem::port_ens_r_obj_sensor_base::_::_m_movObjectInformation::_1_::STA_OBJECT_INFORMATION_ST::_::_m_ohyObjectType_st::_m_probObstacle_st::_m_probMobile_st::_m_prob1TwoWheelerN = 0;
        @sysvar::XCP::RadarFR::_g_PlReCoFw_PlReCoPer_ObjBypassingRunnable_ObjBypassingRunnable_m_pad_radarObjPort_par_out_local::TChangeableMemPool::_::_::_m_arrayPool::_0_::_elem::port_ens_r_obj_sensor_base::_::_m_movObjectInformation::_1_::STA_OBJECT_INFORMATION_ST::_::_m_ohyObjectType_st::_m_probObstacle_st::_m_probMobile_st::_m_prob1UnknownN = 0;
        @sysvar::XCP::RadarFR::_g_PlReCoFw_PlReCoPer_ObjBypassingRunnable_ObjBypassingRunnable_m_pad_radarObjPort_par_out_local::TChangeableMemPool::_::_::_m_arrayPool::_0_::_elem::port_ens_r_obj_sensor_base::_::_m_movObjectInformation::_1_::STA_OBJECT_INFORMATION_ST::_::_m_ohyObjectType_st::_m_probObstacle_st::_m_probMobile_st::_m_probFourPlusWheeler_st::_m_prob1PassengerCarN = 0;
        @sysvar::XCP::RadarFR::_g_PlReCoFw_PlReCoPer_ObjBypassingRunnable_ObjBypassingRunnable_m_pad_radarObjPort_par_out_local::TChangeableMemPool::_::_::_m_arrayPool::_0_::_elem::port_ens_r_obj_sensor_base::_::_m_movObjectInformation::_1_::STA_OBJECT_INFORMATION_ST::_::_m_ohyObjectType_st::_m_probObstacle_st::_m_probMobile_st::_m_probFourPlusWheeler_st::_m_prob1TruckN = 0;
        @sysvar::XCP::RadarFR::_g_PlReCoFw_PlReCoPer_ObjBypassingRunnable_ObjBypassingRunnable_m_pad_radarObjPort_par_out_local::TChangeableMemPool::_::_::_m_arrayPool::_0_::_elem::port_ens_r_obj_sensor_base::_::_m_movObjectInformation::_1_::STA_OBJECT_INFORMATION_ST::_::_m_ohyObjectType_st::_m_probObstacle_st::_m_probMobile_st::_m_probFourPlusWheeler_st::_m_prob1UnknownN = 0;
        @sysvar::XCP::RadarFR::_g_PlReCoFw_PlReCoPer_ObjBypassingRunnable_ObjBypassingRunnable_m_pad_radarObjPort_par_out_local::TChangeableMemPool::_::_::_m_arrayPool::_0_::_elem::port_ens_r_obj_sensor_base::_::_m_movObjectInformation::_1_::STA_OBJECT_INFORMATION_ST::_::_m_ohyObjectType_st::_m_probObstacle_st::_m_probStationary_st::_m_prob1RoadsideBarrierN = 128;
        @sysvar::XCP::RadarFR::_g_PlReCoFw_PlReCoPer_ObjBypassingRunnable_ObjBypassingRunnable_m_pad_radarObjPort_par_out_local::TChangeableMemPool::_::_::_m_arrayPool::_0_::_elem::port_ens_r_obj_sensor_base::_::_m_movObjectInformation::_1_::STA_OBJECT_INFORMATION_ST::_::_m_ohyObjectType_st::_m_probObstacle_st::_m_probStationary_st::_m_prob1UnknownN = 0;
        @sysvar::XCP::RadarFR::_g_PlReCoFw_PlReCoPer_ObjBypassingRunnable_ObjBypassingRunnable_m_pad_radarObjPort_par_out_local::TChangeableMemPool::_::_::_m_arrayPool::_0_::_elem::port_ens_r_obj_sensor_base::_::_m_movObjectInformation::_1_::_m_dLengthN = 64;
        @sysvar::XCP::RadarFR::_g_PlReCoFw_PlReCoPer_ObjBypassingRunnable_ObjBypassingRunnable_m_pad_radarObjPort_par_out_local::TChangeableMemPool::_::_::_m_arrayPool::_0_::_elem::port_ens_r_obj_sensor_base::_::_m_movObjectInformation::_1_::_m_dWidthN = @Classe_Obj_Sim::obj_data.obj_width[1] * 128;
        break;

      case 3: //"2Wheeler"
        @sysvar::XCP::RadarFR::_g_PlReCoFw_PlReCoPer_ObjBypassingRunnable_ObjBypassingRunnable_m_pad_radarObjPort_par_out_local::TChangeableMemPool::_::_::_m_arrayPool::_0_::_elem::port_ens_r_obj_sensor_base::_::_m_movObjectInformation::_1_::STA_OBJECT_INFORMATION_ST::_::_m_ohyObjectType_st::_m_prob1NonObstacleN = 0;
        @sysvar::XCP::RadarFR::_g_PlReCoFw_PlReCoPer_ObjBypassingRunnable_ObjBypassingRunnable_m_pad_radarObjPort_par_out_local::TChangeableMemPool::_::_::_m_arrayPool::_0_::_elem::port_ens_r_obj_sensor_base::_::_m_movObjectInformation::_1_::STA_OBJECT_INFORMATION_ST::_::_m_ohyObjectType_st::_m_prob1ObstacleN = 128;
        @sysvar::XCP::RadarFR::_g_PlReCoFw_PlReCoPer_ObjBypassingRunnable_ObjBypassingRunnable_m_pad_radarObjPort_par_out_local::TChangeableMemPool::_::_::_m_arrayPool::_0_::_elem::port_ens_r_obj_sensor_base::_::_m_movObjectInformation::_1_::STA_OBJECT_INFORMATION_ST::_::_m_ohyObjectType_st::_m_prob1UnknownN = 0;
        @sysvar::XCP::RadarFR::_g_PlReCoFw_PlReCoPer_ObjBypassingRunnable_ObjBypassingRunnable_m_pad_radarObjPort_par_out_local::TChangeableMemPool::_::_::_m_arrayPool::_0_::_elem::port_ens_r_obj_sensor_base::_::_m_movObjectInformation::_1_::STA_OBJECT_INFORMATION_ST::_::_m_ohyObjectType_st::_m_probObstacle_st::_m_prob1UnknownN = 0;
        @sysvar::XCP::RadarFR::_g_PlReCoFw_PlReCoPer_ObjBypassingRunnable_ObjBypassingRunnable_m_pad_radarObjPort_par_out_local::TChangeableMemPool::_::_::_m_arrayPool::_0_::_elem::port_ens_r_obj_sensor_base::_::_m_movObjectInformation::_1_::STA_OBJECT_INFORMATION_ST::_::_m_ohyObjectType_st::_m_probObstacle_st::_m_probMobile_st::_m_prob1FourPlusWheelerN = 0;
        @sysvar::XCP::RadarFR::_g_PlReCoFw_PlReCoPer_ObjBypassingRunnable_ObjBypassingRunnable_m_pad_radarObjPort_par_out_local::TChangeableMemPool::_::_::_m_arrayPool::_0_::_elem::port_ens_r_obj_sensor_base::_::_m_movObjectInformation::_1_::STA_OBJECT_INFORMATION_ST::_::_m_ohyObjectType_st::_m_probObstacle_st::_m_probMobile_st::_m_prob1PedestrianN = 0;
        @sysvar::XCP::RadarFR::_g_PlReCoFw_PlReCoPer_ObjBypassingRunnable_ObjBypassingRunnable_m_pad_radarObjPort_par_out_local::TChangeableMemPool::_::_::_m_arrayPool::_0_::_elem::port_ens_r_obj_sensor_base::_::_m_movObjectInformation::_1_::STA_OBJECT_INFORMATION_ST::_::_m_ohyObjectType_st::_m_probObstacle_st::_m_probMobile_st::_m_prob1TwoWheelerN = 128;
        @sysvar::XCP::RadarFR::_g_PlReCoFw_PlReCoPer_ObjBypassingRunnable_ObjBypassingRunnable_m_pad_radarObjPort_par_out_local::TChangeableMemPool::_::_::_m_arrayPool::_0_::_elem::port_ens_r_obj_sensor_base::_::_m_movObjectInformation::_1_::STA_OBJECT_INFORMATION_ST::_::_m_ohyObjectType_st::_m_probObstacle_st::_m_probMobile_st::_m_prob1UnknownN = 0;
        @sysvar::XCP::RadarFR::_g_PlReCoFw_PlReCoPer_ObjBypassingRunnable_ObjBypassingRunnable_m_pad_radarObjPort_par_out_local::TChangeableMemPool::_::_::_m_arrayPool::_0_::_elem::port_ens_r_obj_sensor_base::_::_m_movObjectInformation::_1_::STA_OBJECT_INFORMATION_ST::_::_m_ohyObjectType_st::_m_probObstacle_st::_m_probMobile_st::_m_probFourPlusWheeler_st::_m_prob1PassengerCarN = 0;
        @sysvar::XCP::RadarFR::_g_PlReCoFw_PlReCoPer_ObjBypassingRunnable_ObjBypassingRunnable_m_pad_radarObjPort_par_out_local::TChangeableMemPool::_::_::_m_arrayPool::_0_::_elem::port_ens_r_obj_sensor_base::_::_m_movObjectInformation::_1_::STA_OBJECT_INFORMATION_ST::_::_m_ohyObjectType_st::_m_probObstacle_st::_m_probMobile_st::_m_probFourPlusWheeler_st::_m_prob1TruckN = 0;
        @sysvar::XCP::RadarFR::_g_PlReCoFw_PlReCoPer_ObjBypassingRunnable_ObjBypassingRunnable_m_pad_radarObjPort_par_out_local::TChangeableMemPool::_::_::_m_arrayPool::_0_::_elem::port_ens_r_obj_sensor_base::_::_m_movObjectInformation::_1_::STA_OBJECT_INFORMATION_ST::_::_m_ohyObjectType_st::_m_probObstacle_st::_m_probMobile_st::_m_probFourPlusWheeler_st::_m_prob1UnknownN = 128;
        @sysvar::XCP::RadarFR::_g_PlReCoFw_PlReCoPer_ObjBypassingRunnable_ObjBypassingRunnable_m_pad_radarObjPort_par_out_local::TChangeableMemPool::_::_::_m_arrayPool::_0_::_elem::port_ens_r_obj_sensor_base::_::_m_movObjectInformation::_1_::STA_OBJECT_INFORMATION_ST::_::_m_ohyObjectType_st::_m_probObstacle_st::_m_probStationary_st::_m_prob1RoadsideBarrierN = 0;
        @sysvar::XCP::RadarFR::_g_PlReCoFw_PlReCoPer_ObjBypassingRunnable_ObjBypassingRunnable_m_pad_radarObjPort_par_out_local::TChangeableMemPool::_::_::_m_arrayPool::_0_::_elem::port_ens_r_obj_sensor_base::_::_m_movObjectInformation::_1_::STA_OBJECT_INFORMATION_ST::_::_m_ohyObjectType_st::_m_probObstacle_st::_m_probStationary_st::_m_prob1UnknownN = 0;
        @sysvar::XCP::RadarFR::_g_PlReCoFw_PlReCoPer_ObjBypassingRunnable_ObjBypassingRunnable_m_pad_radarObjPort_par_out_local::TChangeableMemPool::_::_::_m_arrayPool::_0_::_elem::port_ens_r_obj_sensor_base::_::_m_movObjectInformation::_1_::_m_dLengthN = 64;
        @sysvar::XCP::RadarFR::_g_PlReCoFw_PlReCoPer_ObjBypassingRunnable_ObjBypassingRunnable_m_pad_radarObjPort_par_out_local::TChangeableMemPool::_::_::_m_arrayPool::_0_::_elem::port_ens_r_obj_sensor_base::_::_m_movObjectInformation::_1_::_m_dWidthN = @Classe_Obj_Sim::obj_data.obj_width[1] * 128;
        break;

      case 4: //"Pedestrian"
        @sysvar::XCP::RadarFR::_g_PlReCoFw_PlReCoPer_ObjBypassingRunnable_ObjBypassingRunnable_m_pad_radarObjPort_par_out_local::TChangeableMemPool::_::_::_m_arrayPool::_0_::_elem::port_ens_r_obj_sensor_base::_::_m_movObjectInformation::_1_::STA_OBJECT_INFORMATION_ST::_::_m_ohyObjectType_st::_m_prob1NonObstacleN = 0;
        @sysvar::XCP::RadarFR::_g_PlReCoFw_PlReCoPer_ObjBypassingRunnable_ObjBypassingRunnable_m_pad_radarObjPort_par_out_local::TChangeableMemPool::_::_::_m_arrayPool::_0_::_elem::port_ens_r_obj_sensor_base::_::_m_movObjectInformation::_1_::STA_OBJECT_INFORMATION_ST::_::_m_ohyObjectType_st::_m_prob1ObstacleN = 128;
        @sysvar::XCP::RadarFR::_g_PlReCoFw_PlReCoPer_ObjBypassingRunnable_ObjBypassingRunnable_m_pad_radarObjPort_par_out_local::TChangeableMemPool::_::_::_m_arrayPool::_0_::_elem::port_ens_r_obj_sensor_base::_::_m_movObjectInformation::_1_::STA_OBJECT_INFORMATION_ST::_::_m_ohyObjectType_st::_m_prob1UnknownN = 0;
        @sysvar::XCP::RadarFR::_g_PlReCoFw_PlReCoPer_ObjBypassingRunnable_ObjBypassingRunnable_m_pad_radarObjPort_par_out_local::TChangeableMemPool::_::_::_m_arrayPool::_0_::_elem::port_ens_r_obj_sensor_base::_::_m_movObjectInformation::_1_::STA_OBJECT_INFORMATION_ST::_::_m_ohyObjectType_st::_m_probObstacle_st::_m_prob1UnknownN = 0;
        @sysvar::XCP::RadarFR::_g_PlReCoFw_PlReCoPer_ObjBypassingRunnable_ObjBypassingRunnable_m_pad_radarObjPort_par_out_local::TChangeableMemPool::_::_::_m_arrayPool::_0_::_elem::port_ens_r_obj_sensor_base::_::_m_movObjectInformation::_1_::STA_OBJECT_INFORMATION_ST::_::_m_ohyObjectType_st::_m_probObstacle_st::_m_probMobile_st::_m_prob1FourPlusWheelerN = 0;
        @sysvar::XCP::RadarFR::_g_PlReCoFw_PlReCoPer_ObjBypassingRunnable_ObjBypassingRunnable_m_pad_radarObjPort_par_out_local::TChangeableMemPool::_::_::_m_arrayPool::_0_::_elem::port_ens_r_obj_sensor_base::_::_m_movObjectInformation::_1_::STA_OBJECT_INFORMATION_ST::_::_m_ohyObjectType_st::_m_probObstacle_st::_m_probMobile_st::_m_prob1PedestrianN = 128;
        @sysvar::XCP::RadarFR::_g_PlReCoFw_PlReCoPer_ObjBypassingRunnable_ObjBypassingRunnable_m_pad_radarObjPort_par_out_local::TChangeableMemPool::_::_::_m_arrayPool::_0_::_elem::port_ens_r_obj_sensor_base::_::_m_movObjectInformation::_1_::STA_OBJECT_INFORMATION_ST::_::_m_ohyObjectType_st::_m_probObstacle_st::_m_probMobile_st::_m_prob1TwoWheelerN = 0;
        @sysvar::XCP::RadarFR::_g_PlReCoFw_PlReCoPer_ObjBypassingRunnable_ObjBypassingRunnable_m_pad_radarObjPort_par_out_local::TChangeableMemPool::_::_::_m_arrayPool::_0_::_elem::port_ens_r_obj_sensor_base::_::_m_movObjectInformation::_1_::STA_OBJECT_INFORMATION_ST::_::_m_ohyObjectType_st::_m_probObstacle_st::_m_probMobile_st::_m_prob1UnknownN = 0;
        @sysvar::XCP::RadarFR::_g_PlReCoFw_PlReCoPer_ObjBypassingRunnable_ObjBypassingRunnable_m_pad_radarObjPort_par_out_local::TChangeableMemPool::_::_::_m_arrayPool::_0_::_elem::port_ens_r_obj_sensor_base::_::_m_movObjectInformation::_1_::STA_OBJECT_INFORMATION_ST::_::_m_ohyObjectType_st::_m_probObstacle_st::_m_probMobile_st::_m_probFourPlusWheeler_st::_m_prob1PassengerCarN = 0;
        @sysvar::XCP::RadarFR::_g_PlReCoFw_PlReCoPer_ObjBypassingRunnable_ObjBypassingRunnable_m_pad_radarObjPort_par_out_local::TChangeableMemPool::_::_::_m_arrayPool::_0_::_elem::port_ens_r_obj_sensor_base::_::_m_movObjectInformation::_1_::STA_OBJECT_INFORMATION_ST::_::_m_ohyObjectType_st::_m_probObstacle_st::_m_probMobile_st::_m_probFourPlusWheeler_st::_m_prob1TruckN = 0;
        @sysvar::XCP::RadarFR::_g_PlReCoFw_PlReCoPer_ObjBypassingRunnable_ObjBypassingRunnable_m_pad_radarObjPort_par_out_local::TChangeableMemPool::_::_::_m_arrayPool::_0_::_elem::port_ens_r_obj_sensor_base::_::_m_movObjectInformation::_1_::STA_OBJECT_INFORMATION_ST::_::_m_ohyObjectType_st::_m_probObstacle_st::_m_probMobile_st::_m_probFourPlusWheeler_st::_m_prob1UnknownN = 128;
        @sysvar::XCP::RadarFR::_g_PlReCoFw_PlReCoPer_ObjBypassingRunnable_ObjBypassingRunnable_m_pad_radarObjPort_par_out_local::TChangeableMemPool::_::_::_m_arrayPool::_0_::_elem::port_ens_r_obj_sensor_base::_::_m_movObjectInformation::_1_::STA_OBJECT_INFORMATION_ST::_::_m_ohyObjectType_st::_m_probObstacle_st::_m_probStationary_st::_m_prob1RoadsideBarrierN = 0;
        @sysvar::XCP::RadarFR::_g_PlReCoFw_PlReCoPer_ObjBypassingRunnable_ObjBypassingRunnable_m_pad_radarObjPort_par_out_local::TChangeableMemPool::_::_::_m_arrayPool::_0_::_elem::port_ens_r_obj_sensor_base::_::_m_movObjectInformation::_1_::STA_OBJECT_INFORMATION_ST::_::_m_ohyObjectType_st::_m_probObstacle_st::_m_probStationary_st::_m_prob1UnknownN = 0;
        @sysvar::XCP::RadarFR::_g_PlReCoFw_PlReCoPer_ObjBypassingRunnable_ObjBypassingRunnable_m_pad_radarObjPort_par_out_local::TChangeableMemPool::_::_::_m_arrayPool::_0_::_elem::port_ens_r_obj_sensor_base::_::_m_movObjectInformation::_1_::_m_dLengthN = 64;
        @sysvar::XCP::RadarFR::_g_PlReCoFw_PlReCoPer_ObjBypassingRunnable_ObjBypassingRunnable_m_pad_radarObjPort_par_out_local::TChangeableMemPool::_::_::_m_arrayPool::_0_::_elem::port_ens_r_obj_sensor_base::_::_m_movObjectInformation::_1_::_m_dWidthN = @Classe_Obj_Sim::obj_data.obj_width[1] * 128;
        break;

      case 5: //"Truck"
        @sysvar::XCP::RadarFR::_g_PlReCoFw_PlReCoPer_ObjBypassingRunnable_ObjBypassingRunnable_m_pad_radarObjPort_par_out_local::TChangeableMemPool::_::_::_m_arrayPool::_0_::_elem::port_ens_r_obj_sensor_base::_::_m_movObjectInformation::_1_::STA_OBJECT_INFORMATION_ST::_::_m_ohyObjectType_st::_m_prob1NonObstacleN = 0;
        @sysvar::XCP::RadarFR::_g_PlReCoFw_PlReCoPer_ObjBypassingRunnable_ObjBypassingRunnable_m_pad_radarObjPort_par_out_local::TChangeableMemPool::_::_::_m_arrayPool::_0_::_elem::port_ens_r_obj_sensor_base::_::_m_movObjectInformation::_1_::STA_OBJECT_INFORMATION_ST::_::_m_ohyObjectType_st::_m_prob1ObstacleN = 128;
        @sysvar::XCP::RadarFR::_g_PlReCoFw_PlReCoPer_ObjBypassingRunnable_ObjBypassingRunnable_m_pad_radarObjPort_par_out_local::TChangeableMemPool::_::_::_m_arrayPool::_0_::_elem::port_ens_r_obj_sensor_base::_::_m_movObjectInformation::_1_::STA_OBJECT_INFORMATION_ST::_::_m_ohyObjectType_st::_m_prob1UnknownN = 0;
        @sysvar::XCP::RadarFR::_g_PlReCoFw_PlReCoPer_ObjBypassingRunnable_ObjBypassingRunnable_m_pad_radarObjPort_par_out_local::TChangeableMemPool::_::_::_m_arrayPool::_0_::_elem::port_ens_r_obj_sensor_base::_::_m_movObjectInformation::_1_::STA_OBJECT_INFORMATION_ST::_::_m_ohyObjectType_st::_m_probObstacle_st::_m_prob1UnknownN = 0;
        @sysvar::XCP::RadarFR::_g_PlReCoFw_PlReCoPer_ObjBypassingRunnable_ObjBypassingRunnable_m_pad_radarObjPort_par_out_local::TChangeableMemPool::_::_::_m_arrayPool::_0_::_elem::port_ens_r_obj_sensor_base::_::_m_movObjectInformation::_1_::STA_OBJECT_INFORMATION_ST::_::_m_ohyObjectType_st::_m_probObstacle_st::_m_probMobile_st::_m_prob1FourPlusWheelerN = 128;
        @sysvar::XCP::RadarFR::_g_PlReCoFw_PlReCoPer_ObjBypassingRunnable_ObjBypassingRunnable_m_pad_radarObjPort_par_out_local::TChangeableMemPool::_::_::_m_arrayPool::_0_::_elem::port_ens_r_obj_sensor_base::_::_m_movObjectInformation::_1_::STA_OBJECT_INFORMATION_ST::_::_m_ohyObjectType_st::_m_probObstacle_st::_m_probMobile_st::_m_prob1PedestrianN = 0;
        @sysvar::XCP::RadarFR::_g_PlReCoFw_PlReCoPer_ObjBypassingRunnable_ObjBypassingRunnable_m_pad_radarObjPort_par_out_local::TChangeableMemPool::_::_::_m_arrayPool::_0_::_elem::port_ens_r_obj_sensor_base::_::_m_movObjectInformation::_1_::STA_OBJECT_INFORMATION_ST::_::_m_ohyObjectType_st::_m_probObstacle_st::_m_probMobile_st::_m_prob1TwoWheelerN = 0;
        @sysvar::XCP::RadarFR::_g_PlReCoFw_PlReCoPer_ObjBypassingRunnable_ObjBypassingRunnable_m_pad_radarObjPort_par_out_local::TChangeableMemPool::_::_::_m_arrayPool::_0_::_elem::port_ens_r_obj_sensor_base::_::_m_movObjectInformation::_1_::STA_OBJECT_INFORMATION_ST::_::_m_ohyObjectType_st::_m_probObstacle_st::_m_probMobile_st::_m_prob1UnknownN = 0;
        @sysvar::XCP::RadarFR::_g_PlReCoFw_PlReCoPer_ObjBypassingRunnable_ObjBypassingRunnable_m_pad_radarObjPort_par_out_local::TChangeableMemPool::_::_::_m_arrayPool::_0_::_elem::port_ens_r_obj_sensor_base::_::_m_movObjectInformation::_1_::STA_OBJECT_INFORMATION_ST::_::_m_ohyObjectType_st::_m_probObstacle_st::_m_probMobile_st::_m_probFourPlusWheeler_st::_m_prob1PassengerCarN = 0;
        @sysvar::XCP::RadarFR::_g_PlReCoFw_PlReCoPer_ObjBypassingRunnable_ObjBypassingRunnable_m_pad_radarObjPort_par_out_local::TChangeableMemPool::_::_::_m_arrayPool::_0_::_elem::port_ens_r_obj_sensor_base::_::_m_movObjectInformation::_1_::STA_OBJECT_INFORMATION_ST::_::_m_ohyObjectType_st::_m_probObstacle_st::_m_probMobile_st::_m_probFourPlusWheeler_st::_m_prob1TruckN = 128;
        @sysvar::XCP::RadarFR::_g_PlReCoFw_PlReCoPer_ObjBypassingRunnable_ObjBypassingRunnable_m_pad_radarObjPort_par_out_local::TChangeableMemPool::_::_::_m_arrayPool::_0_::_elem::port_ens_r_obj_sensor_base::_::_m_movObjectInformation::_1_::STA_OBJECT_INFORMATION_ST::_::_m_ohyObjectType_st::_m_probObstacle_st::_m_probMobile_st::_m_probFourPlusWheeler_st::_m_prob1UnknownN = 0;
        @sysvar::XCP::RadarFR::_g_PlReCoFw_PlReCoPer_ObjBypassingRunnable_ObjBypassingRunnable_m_pad_radarObjPort_par_out_local::TChangeableMemPool::_::_::_m_arrayPool::_0_::_elem::port_ens_r_obj_sensor_base::_::_m_movObjectInformation::_1_::STA_OBJECT_INFORMATION_ST::_::_m_ohyObjectType_st::_m_probObstacle_st::_m_probStationary_st::_m_prob1RoadsideBarrierN = 0;
        @sysvar::XCP::RadarFR::_g_PlReCoFw_PlReCoPer_ObjBypassingRunnable_ObjBypassingRunnable_m_pad_radarObjPort_par_out_local::TChangeableMemPool::_::_::_m_arrayPool::_0_::_elem::port_ens_r_obj_sensor_base::_::_m_movObjectInformation::_1_::STA_OBJECT_INFORMATION_ST::_::_m_ohyObjectType_st::_m_probObstacle_st::_m_probStationary_st::_m_prob1UnknownN = 0;
        @sysvar::XCP::RadarFR::_g_PlReCoFw_PlReCoPer_ObjBypassingRunnable_ObjBypassingRunnable_m_pad_radarObjPort_par_out_local::TChangeableMemPool::_::_::_m_arrayPool::_0_::_elem::port_ens_r_obj_sensor_base::_::_m_movObjectInformation::_1_::_m_dLengthN = 64;
        @sysvar::XCP::RadarFR::_g_PlReCoFw_PlReCoPer_ObjBypassingRunnable_ObjBypassingRunnable_m_pad_radarObjPort_par_out_local::TChangeableMemPool::_::_::_m_arrayPool::_0_::_elem::port_ens_r_obj_sensor_base::_::_m_movObjectInformation::_1_::_m_dWidthN = @Classe_Obj_Sim::obj_data.obj_width[1] * 128;
        break;

      case 6: //"PassengerCar"
        @sysvar::XCP::RadarFR::_g_PlReCoFw_PlReCoPer_ObjBypassingRunnable_ObjBypassingRunnable_m_pad_radarObjPort_par_out_local::TChangeableMemPool::_::_::_m_arrayPool::_0_::_elem::port_ens_r_obj_sensor_base::_::_m_movObjectInformation::_1_::STA_OBJECT_INFORMATION_ST::_::_m_ohyObjectType_st::_m_prob1NonObstacleN = 0;
        @sysvar::XCP::RadarFR::_g_PlReCoFw_PlReCoPer_ObjBypassingRunnable_ObjBypassingRunnable_m_pad_radarObjPort_par_out_local::TChangeableMemPool::_::_::_m_arrayPool::_0_::_elem::port_ens_r_obj_sensor_base::_::_m_movObjectInformation::_1_::STA_OBJECT_INFORMATION_ST::_::_m_ohyObjectType_st::_m_prob1ObstacleN = 128;
        @sysvar::XCP::RadarFR::_g_PlReCoFw_PlReCoPer_ObjBypassingRunnable_ObjBypassingRunnable_m_pad_radarObjPort_par_out_local::TChangeableMemPool::_::_::_m_arrayPool::_0_::_elem::port_ens_r_obj_sensor_base::_::_m_movObjectInformation::_1_::STA_OBJECT_INFORMATION_ST::_::_m_ohyObjectType_st::_m_prob1UnknownN = 0;
        @sysvar::XCP::RadarFR::_g_PlReCoFw_PlReCoPer_ObjBypassingRunnable_ObjBypassingRunnable_m_pad_radarObjPort_par_out_local::TChangeableMemPool::_::_::_m_arrayPool::_0_::_elem::port_ens_r_obj_sensor_base::_::_m_movObjectInformation::_1_::STA_OBJECT_INFORMATION_ST::_::_m_ohyObjectType_st::_m_probObstacle_st::_m_prob1UnknownN = 0;
        @sysvar::XCP::RadarFR::_g_PlReCoFw_PlReCoPer_ObjBypassingRunnable_ObjBypassingRunnable_m_pad_radarObjPort_par_out_local::TChangeableMemPool::_::_::_m_arrayPool::_0_::_elem::port_ens_r_obj_sensor_base::_::_m_movObjectInformation::_1_::STA_OBJECT_INFORMATION_ST::_::_m_ohyObjectType_st::_m_probObstacle_st::_m_probMobile_st::_m_prob1FourPlusWheelerN = 128;
        @sysvar::XCP::RadarFR::_g_PlReCoFw_PlReCoPer_ObjBypassingRunnable_ObjBypassingRunnable_m_pad_radarObjPort_par_out_local::TChangeableMemPool::_::_::_m_arrayPool::_0_::_elem::port_ens_r_obj_sensor_base::_::_m_movObjectInformation::_1_::STA_OBJECT_INFORMATION_ST::_::_m_ohyObjectType_st::_m_probObstacle_st::_m_probMobile_st::_m_prob1PedestrianN = 0;
        @sysvar::XCP::RadarFR::_g_PlReCoFw_PlReCoPer_ObjBypassingRunnable_ObjBypassingRunnable_m_pad_radarObjPort_par_out_local::TChangeableMemPool::_::_::_m_arrayPool::_0_::_elem::port_ens_r_obj_sensor_base::_::_m_movObjectInformation::_1_::STA_OBJECT_INFORMATION_ST::_::_m_ohyObjectType_st::_m_probObstacle_st::_m_probMobile_st::_m_prob1TwoWheelerN = 0;
        @sysvar::XCP::RadarFR::_g_PlReCoFw_PlReCoPer_ObjBypassingRunnable_ObjBypassingRunnable_m_pad_radarObjPort_par_out_local::TChangeableMemPool::_::_::_m_arrayPool::_0_::_elem::port_ens_r_obj_sensor_base::_::_m_movObjectInformation::_1_::STA_OBJECT_INFORMATION_ST::_::_m_ohyObjectType_st::_m_probObstacle_st::_m_probMobile_st::_m_prob1UnknownN = 0;
        @sysvar::XCP::RadarFR::_g_PlReCoFw_PlReCoPer_ObjBypassingRunnable_ObjBypassingRunnable_m_pad_radarObjPort_par_out_local::TChangeableMemPool::_::_::_m_arrayPool::_0_::_elem::port_ens_r_obj_sensor_base::_::_m_movObjectInformation::_1_::STA_OBJECT_INFORMATION_ST::_::_m_ohyObjectType_st::_m_probObstacle_st::_m_probMobile_st::_m_probFourPlusWheeler_st::_m_prob1PassengerCarN = 128;
        @sysvar::XCP::RadarFR::_g_PlReCoFw_PlReCoPer_ObjBypassingRunnable_ObjBypassingRunnable_m_pad_radarObjPort_par_out_local::TChangeableMemPool::_::_::_m_arrayPool::_0_::_elem::port_ens_r_obj_sensor_base::_::_m_movObjectInformation::_1_::STA_OBJECT_INFORMATION_ST::_::_m_ohyObjectType_st::_m_probObstacle_st::_m_probMobile_st::_m_probFourPlusWheeler_st::_m_prob1TruckN = 0;
        @sysvar::XCP::RadarFR::_g_PlReCoFw_PlReCoPer_ObjBypassingRunnable_ObjBypassingRunnable_m_pad_radarObjPort_par_out_local::TChangeableMemPool::_::_::_m_arrayPool::_0_::_elem::port_ens_r_obj_sensor_base::_::_m_movObjectInformation::_1_::STA_OBJECT_INFORMATION_ST::_::_m_ohyObjectType_st::_m_probObstacle_st::_m_probMobile_st::_m_probFourPlusWheeler_st::_m_prob1UnknownN = 0;
        @sysvar::XCP::RadarFR::_g_PlReCoFw_PlReCoPer_ObjBypassingRunnable_ObjBypassingRunnable_m_pad_radarObjPort_par_out_local::TChangeableMemPool::_::_::_m_arrayPool::_0_::_elem::port_ens_r_obj_sensor_base::_::_m_movObjectInformation::_1_::STA_OBJECT_INFORMATION_ST::_::_m_ohyObjectType_st::_m_probObstacle_st::_m_probStationary_st::_m_prob1RoadsideBarrierN = 0;
        @sysvar::XCP::RadarFR::_g_PlReCoFw_PlReCoPer_ObjBypassingRunnable_ObjBypassingRunnable_m_pad_radarObjPort_par_out_local::TChangeableMemPool::_::_::_m_arrayPool::_0_::_elem::port_ens_r_obj_sensor_base::_::_m_movObjectInformation::_1_::STA_OBJECT_INFORMATION_ST::_::_m_ohyObjectType_st::_m_probObstacle_st::_m_probStationary_st::_m_prob1UnknownN = 0;
        @sysvar::XCP::RadarFR::_g_PlReCoFw_PlReCoPer_ObjBypassingRunnable_ObjBypassingRunnable_m_pad_radarObjPort_par_out_local::TChangeableMemPool::_::_::_m_arrayPool::_0_::_elem::port_ens_r_obj_sensor_base::_::_m_movObjectInformation::_1_::_m_dLengthN = 64;
        @sysvar::XCP::RadarFR::_g_PlReCoFw_PlReCoPer_ObjBypassingRunnable_ObjBypassingRunnable_m_pad_radarObjPort_par_out_local::TChangeableMemPool::_::_::_m_arrayPool::_0_::_elem::port_ens_r_obj_sensor_base::_::_m_movObjectInformation::_1_::_m_dWidthN = @Classe_Obj_Sim::obj_data.obj_width[1] * 128;
        break;
    }
    break;

    case 2: //"Object-2"
    //constant
    @sysvar::XCP::RadarFR::_g_PlReCoFw_PlReCoPer_ObjBypassingRunnable_ObjBypassingRunnable_m_pad_radarObjPort_par_out_local::TChangeableMemPool::_::_::_m_arrayPool::_0_::_elem::port_ens_r_obj_sensor_base::_::_m_movObjectInformation::_2_::STA_OBJECT_INFORMATION_ST::_::_Meas_b = 1;
    @sysvar::XCP::RadarFR::_g_PlReCoFw_PlReCoPer_ObjBypassingRunnable_ObjBypassingRunnable_m_pad_radarObjPort_par_out_local::TChangeableMemPool::_::_::_m_arrayPool::_0_::_elem::port_ens_r_obj_sensor_base::_::_m_movObjectInformation::_2_::STA_OBJECT_INFORMATION_ST::_::_Measurable_b = 1;
    @sysvar::XCP::RadarFR::_g_PlReCoFw_PlReCoPer_ObjBypassingRunnable_ObjBypassingRunnable_m_pad_radarObjPort_par_out_local::TChangeableMemPool::_::_::_m_arrayPool::_0_::_elem::port_ens_r_obj_sensor_base::_::_m_movObjectInformation::_2_::STA_OBJECT_INFORMATION_ST::_::_Valid_b = 1;
    @sysvar::XCP::RadarFR::_g_PlReCoFw_PlReCoPer_ObjBypassingRunnable_ObjBypassingRunnable_m_pad_radarObjPort_par_out_local::TChangeableMemPool::_::_::_m_arrayPool::_0_::_elem::port_ens_r_obj_sensor_base::_::_m_movObjectInformation::_2_::_m_covarDxAxN = 0;
    @sysvar::XCP::RadarFR::_g_PlReCoFw_PlReCoPer_ObjBypassingRunnable_ObjBypassingRunnable_m_pad_radarObjPort_par_out_local::TChangeableMemPool::_::_::_m_arrayPool::_0_::_elem::port_ens_r_obj_sensor_base::_::_m_movObjectInformation::_2_::_m_covarDxVxN = 0;
    @sysvar::XCP::RadarFR::_g_PlReCoFw_PlReCoPer_ObjBypassingRunnable_ObjBypassingRunnable_m_pad_radarObjPort_par_out_local::TChangeableMemPool::_::_::_m_arrayPool::_0_::_elem::port_ens_r_obj_sensor_base::_::_m_movObjectInformation::_2_::_m_covarDyVyN = 0;
    @sysvar::XCP::RadarFR::_g_PlReCoFw_PlReCoPer_ObjBypassingRunnable_ObjBypassingRunnable_m_pad_radarObjPort_par_out_local::TChangeableMemPool::_::_::_m_arrayPool::_0_::_elem::port_ens_r_obj_sensor_base::_::_m_movObjectInformation::_2_::_m_covarDyWidthN = 0;
    @sysvar::XCP::RadarFR::_g_PlReCoFw_PlReCoPer_ObjBypassingRunnable_ObjBypassingRunnable_m_pad_radarObjPort_par_out_local::TChangeableMemPool::_::_::_m_arrayPool::_0_::_elem::port_ens_r_obj_sensor_base::_::_m_movObjectInformation::_2_::_m_covarVxAxN = 0;
    @sysvar::XCP::RadarFR::_g_PlReCoFw_PlReCoPer_ObjBypassingRunnable_ObjBypassingRunnable_m_pad_radarObjPort_par_out_local::TChangeableMemPool::_::_::_m_arrayPool::_0_::_elem::port_ens_r_obj_sensor_base::_::_m_movObjectInformation::_2_::_m_varAxN = 0;
    @sysvar::XCP::RadarFR::_g_PlReCoFw_PlReCoPer_ObjBypassingRunnable_ObjBypassingRunnable_m_pad_radarObjPort_par_out_local::TChangeableMemPool::_::_::_m_arrayPool::_0_::_elem::port_ens_r_obj_sensor_base::_::_m_movObjectInformation::_2_::_m_varAyN = 0;
    @sysvar::XCP::RadarFR::_g_PlReCoFw_PlReCoPer_ObjBypassingRunnable_ObjBypassingRunnable_m_pad_radarObjPort_par_out_local::TChangeableMemPool::_::_::_m_arrayPool::_0_::_elem::port_ens_r_obj_sensor_base::_::_m_movObjectInformation::_2_::_m_varVxN = 0;
    @sysvar::XCP::RadarFR::_g_PlReCoFw_PlReCoPer_ObjBypassingRunnable_ObjBypassingRunnable_m_pad_radarObjPort_par_out_local::TChangeableMemPool::_::_::_m_arrayPool::_0_::_elem::port_ens_r_obj_sensor_base::_::_m_movObjectInformation::_2_::_m_varVyN = 0;
    @sysvar::XCP::RadarFR::_g_PlReCoFw_PlReCoPer_ObjBypassingRunnable_ObjBypassingRunnable_m_pad_radarObjPort_par_out_local::TChangeableMemPool::_::_::_m_arrayPool::_0_::_elem::port_ens_r_obj_sensor_base::_::_m_movObjectInformation::_2_::STA_OBJECT_INFORMATION_ST::_::_m_varDxN = 0;
    @sysvar::XCP::RadarFR::_g_PlReCoFw_PlReCoPer_ObjBypassingRunnable_ObjBypassingRunnable_m_pad_radarObjPort_par_out_local::TChangeableMemPool::_::_::_m_arrayPool::_0_::_elem::port_ens_r_obj_sensor_base::_::_m_movObjectInformation::_2_::STA_OBJECT_INFORMATION_ST::_::_m_varDyN = 0;
    @sysvar::XCP::RadarFR::_g_PlReCoFw_PlReCoPer_ObjBypassingRunnable_ObjBypassingRunnable_m_pad_radarObjPort_par_out_local::TChangeableMemPool::_::_::_m_arrayPool::_0_::_elem::port_ens_r_obj_sensor_base::_::_m_movObjectInformation::_2_::_m_dVarLengthN = 0;
    @sysvar::XCP::RadarFR::_g_PlReCoFw_PlReCoPer_ObjBypassingRunnable_ObjBypassingRunnable_m_pad_radarObjPort_par_out_local::TChangeableMemPool::_::_::_m_arrayPool::_0_::_elem::port_ens_r_obj_sensor_base::_::_m_movObjectInformation::_2_::_m_dVarWidthN = 0;
    @sysvar::XCP::RadarFR::_g_PlReCoFw_PlReCoPer_ObjBypassingRunnable_ObjBypassingRunnable_m_pad_radarObjPort_par_out_local::TChangeableMemPool::_::_::_m_arrayPool::_0_::_elem::port_ens_r_obj_sensor_base::_::_m_movObjectInformation::_2_::STA_OBJECT_INFORMATION_ST::_::_m_wExistProbN = 64880;
    @sysvar::XCP::RadarFR::_g_PlReCoFw_PlReCoPer_ObjBypassingRunnable_ObjBypassingRunnable_m_pad_radarObjPort_par_out_local::TChangeableMemPool::_::_::_m_arrayPool::_0_::_elem::port_ens_r_obj_sensor_base::_::_m_movObjectInformation::_2_::_m_referencePtPosIndexN = 10;
    @sysvar::XCP::RadarFR::_g_PlReCoFw_PlReCoPer_ObjBypassingRunnable_ObjBypassingRunnable_m_pad_radarObjPort_par_out_local::TChangeableMemPool::_::_::_m_arrayPool::_0_::_elem::port_ens_r_obj_sensor_base::_::_m_movObjectInformation::_2_::_m_alpPiVarYawAngleN = 0;
    @sysvar::XCP::RadarFR::_g_PlReCoFw_PlReCoPer_ObjBypassingRunnable_ObjBypassingRunnable_m_pad_radarObjPort_par_out_local::TChangeableMemPool::_::_::_m_arrayPool::_0_::_elem::port_ens_r_obj_sensor_base::_::_m_movObjectInformation::_2_::_m_alpPiYawAngleN = 0;

    //target movement

    @sysvar::XCP::RadarFR::_g_PlReCoFw_PlReCoPer_ObjBypassingRunnable_ObjBypassingRunnable_m_pad_radarObjPort_par_out_local::TChangeableMemPool::_::_::_m_arrayPool::_0_::_elem::port_ens_r_obj_sensor_base::_::_m_movObjectInformation::_2_::STA_OBJECT_INFORMATION_ST::_::_m_dxN = @Classe_Obj_Sim::obj_data.obj_dx[2] * 128;
    @sysvar::XCP::RadarFR::_g_PlReCoFw_PlReCoPer_ObjBypassingRunnable_ObjBypassingRunnable_m_pad_radarObjPort_par_out_local::TChangeableMemPool::_::_::_m_arrayPool::_0_::_elem::port_ens_r_obj_sensor_base::_::_m_movObjectInformation::_2_::STA_OBJECT_INFORMATION_ST::_::_m_dyN = @Classe_Obj_Sim::obj_data.obj_dy[2] * 128;
    @sysvar::XCP::RadarFR::_g_PlReCoFw_PlReCoPer_ObjBypassingRunnable_ObjBypassingRunnable_m_pad_radarObjPort_par_out_local::TChangeableMemPool::_::_::_m_arrayPool::_0_::_elem::port_ens_r_obj_sensor_base::_::_m_movObjectInformation::_2_::STA_OBJECT_INFORMATION_ST::_::_m_dzN = 0;
    @sysvar::XCP::RadarFR::_g_PlReCoFw_PlReCoPer_ObjBypassingRunnable_ObjBypassingRunnable_m_pad_radarObjPort_par_out_local::TChangeableMemPool::_::_::_m_arrayPool::_0_::_elem::port_ens_r_obj_sensor_base::_::_m_movObjectInformation::_2_::_m_vxN = @Classe_Obj_Sim::obj_data.obj_relative_vx[2] * 256;
    @sysvar::XCP::RadarFR::_g_PlReCoFw_PlReCoPer_ObjBypassingRunnable_ObjBypassingRunnable_m_pad_radarObjPort_par_out_local::TChangeableMemPool::_::_::_m_arrayPool::_0_::_elem::port_ens_r_obj_sensor_base::_::_m_movObjectInformation::_2_::_m_vyN = @Classe_Obj_Sim::obj_data.obj_relative_vy[2] * 256;
    @sysvar::XCP::RadarFR::_g_PlReCoFw_PlReCoPer_ObjBypassingRunnable_ObjBypassingRunnable_m_pad_radarObjPort_par_out_local::TChangeableMemPool::_::_::_m_arrayPool::_0_::_elem::port_ens_r_obj_sensor_base::_::_m_movObjectInformation::_2_::_m_axN = 0;
    @sysvar::XCP::RadarFR::_g_PlReCoFw_PlReCoPer_ObjBypassingRunnable_ObjBypassingRunnable_m_pad_radarObjPort_par_out_local::TChangeableMemPool::_::_::_m_arrayPool::_0_::_elem::port_ens_r_obj_sensor_base::_::_m_movObjectInformation::_2_::_m_ayN = 0;

    //target object moving or not
    if (abs(@Classe_Obj_Sim::obj_data.obj_relative_vx[2]) != 0)
    {
      @sysvar::XCP::RadarFR::_g_PlReCoFw_PlReCoPer_ObjBypassingRunnable_ObjBypassingRunnable_m_pad_radarObjPort_par_out_local::TChangeableMemPool::_::_::_m_arrayPool::_0_::_elem::port_ens_r_obj_sensor_base::_::_m_movObjectInformation::_2_::STA_OBJECT_INFORMATION_ST::_::_m_prob1HasBeenObservedMovingN = 126;
      @sysvar::XCP::RadarFR::_g_PlReCoFw_PlReCoPer_ObjBypassingRunnable_ObjBypassingRunnable_m_pad_radarObjPort_par_out_local::TChangeableMemPool::_::_::_m_arrayPool::_0_::_elem::port_ens_r_obj_sensor_base::_::_m_movObjectInformation::_2_::STA_OBJECT_INFORMATION_ST::_::_m_prob1MovingN = 126;
      @sysvar::XCP::RadarFR::_g_PlReCoFw_PlReCoPer_ObjBypassingRunnable_ObjBypassingRunnable_m_pad_radarObjPort_par_out_local::TChangeableMemPool::_::_::_m_arrayPool::_0_::_elem::port_ens_r_obj_sensor_base::_::_m_movObjectInformation::_2_::STA_OBJECT_INFORMATION_ST::_::_m_ohyObjectType_st::_m_probObstacle_st::_m_prob1MobileN = 128;
      @sysvar::XCP::RadarFR::_g_PlReCoFw_PlReCoPer_ObjBypassingRunnable_ObjBypassingRunnable_m_pad_radarObjPort_par_out_local::TChangeableMemPool::_::_::_m_arrayPool::_0_::_elem::port_ens_r_obj_sensor_base::_::_m_movObjectInformation::_2_::STA_OBJECT_INFORMATION_ST::_::_m_ohyObjectType_st::_m_probObstacle_st::_m_prob1StationaryN = 0;
    }
    else
    {
      @sysvar::XCP::RadarFR::_g_PlReCoFw_PlReCoPer_ObjBypassingRunnable_ObjBypassingRunnable_m_pad_radarObjPort_par_out_local::TChangeableMemPool::_::_::_m_arrayPool::_0_::_elem::port_ens_r_obj_sensor_base::_::_m_movObjectInformation::_2_::STA_OBJECT_INFORMATION_ST::_::_m_prob1HasBeenObservedMovingN = 0;
      @sysvar::XCP::RadarFR::_g_PlReCoFw_PlReCoPer_ObjBypassingRunnable_ObjBypassingRunnable_m_pad_radarObjPort_par_out_local::TChangeableMemPool::_::_::_m_arrayPool::_0_::_elem::port_ens_r_obj_sensor_base::_::_m_movObjectInformation::_2_::STA_OBJECT_INFORMATION_ST::_::_m_prob1MovingN = 0;
      @sysvar::XCP::RadarFR::_g_PlReCoFw_PlReCoPer_ObjBypassingRunnable_ObjBypassingRunnable_m_pad_radarObjPort_par_out_local::TChangeableMemPool::_::_::_m_arrayPool::_0_::_elem::port_ens_r_obj_sensor_base::_::_m_movObjectInformation::_2_::STA_OBJECT_INFORMATION_ST::_::_m_ohyObjectType_st::_m_probObstacle_st::_m_prob1MobileN = 0;
      @sysvar::XCP::RadarFR::_g_PlReCoFw_PlReCoPer_ObjBypassingRunnable_ObjBypassingRunnable_m_pad_radarObjPort_par_out_local::TChangeableMemPool::_::_::_m_arrayPool::_0_::_elem::port_ens_r_obj_sensor_base::_::_m_movObjectInformation::_2_::STA_OBJECT_INFORMATION_ST::_::_m_ohyObjectType_st::_m_probObstacle_st::_m_prob1StationaryN = 128;
    }

      //object classification
    switch (@Classe_Obj_Sim::obj_data.obj_type[2])
    {
      case 0: //"Non-Obstacle"
        @sysvar::XCP::RadarFR::_g_PlReCoFw_PlReCoPer_ObjBypassingRunnable_ObjBypassingRunnable_m_pad_radarObjPort_par_out_local::TChangeableMemPool::_::_::_m_arrayPool::_0_::_elem::port_ens_r_obj_sensor_base::_::_m_movObjectInformation::_2_::STA_OBJECT_INFORMATION_ST::_::_m_ohyObjectType_st::_m_prob1NonObstacleN = 128;
        @sysvar::XCP::RadarFR::_g_PlReCoFw_PlReCoPer_ObjBypassingRunnable_ObjBypassingRunnable_m_pad_radarObjPort_par_out_local::TChangeableMemPool::_::_::_m_arrayPool::_0_::_elem::port_ens_r_obj_sensor_base::_::_m_movObjectInformation::_2_::STA_OBJECT_INFORMATION_ST::_::_m_ohyObjectType_st::_m_prob1ObstacleN = 0;
        @sysvar::XCP::RadarFR::_g_PlReCoFw_PlReCoPer_ObjBypassingRunnable_ObjBypassingRunnable_m_pad_radarObjPort_par_out_local::TChangeableMemPool::_::_::_m_arrayPool::_0_::_elem::port_ens_r_obj_sensor_base::_::_m_movObjectInformation::_2_::STA_OBJECT_INFORMATION_ST::_::_m_ohyObjectType_st::_m_prob1UnknownN = 0;
        @sysvar::XCP::RadarFR::_g_PlReCoFw_PlReCoPer_ObjBypassingRunnable_ObjBypassingRunnable_m_pad_radarObjPort_par_out_local::TChangeableMemPool::_::_::_m_arrayPool::_0_::_elem::port_ens_r_obj_sensor_base::_::_m_movObjectInformation::_2_::STA_OBJECT_INFORMATION_ST::_::_m_ohyObjectType_st::_m_probObstacle_st::_m_prob1UnknownN = 128;
        @sysvar::XCP::RadarFR::_g_PlReCoFw_PlReCoPer_ObjBypassingRunnable_ObjBypassingRunnable_m_pad_radarObjPort_par_out_local::TChangeableMemPool::_::_::_m_arrayPool::_0_::_elem::port_ens_r_obj_sensor_base::_::_m_movObjectInformation::_2_::STA_OBJECT_INFORMATION_ST::_::_m_ohyObjectType_st::_m_probObstacle_st::_m_probMobile_st::_m_prob1FourPlusWheelerN = 0;
        @sysvar::XCP::RadarFR::_g_PlReCoFw_PlReCoPer_ObjBypassingRunnable_ObjBypassingRunnable_m_pad_radarObjPort_par_out_local::TChangeableMemPool::_::_::_m_arrayPool::_0_::_elem::port_ens_r_obj_sensor_base::_::_m_movObjectInformation::_2_::STA_OBJECT_INFORMATION_ST::_::_m_ohyObjectType_st::_m_probObstacle_st::_m_probMobile_st::_m_prob1PedestrianN = 0;
        @sysvar::XCP::RadarFR::_g_PlReCoFw_PlReCoPer_ObjBypassingRunnable_ObjBypassingRunnable_m_pad_radarObjPort_par_out_local::TChangeableMemPool::_::_::_m_arrayPool::_0_::_elem::port_ens_r_obj_sensor_base::_::_m_movObjectInformation::_2_::STA_OBJECT_INFORMATION_ST::_::_m_ohyObjectType_st::_m_probObstacle_st::_m_probMobile_st::_m_prob1TwoWheelerN = 0;
        @sysvar::XCP::RadarFR::_g_PlReCoFw_PlReCoPer_ObjBypassingRunnable_ObjBypassingRunnable_m_pad_radarObjPort_par_out_local::TChangeableMemPool::_::_::_m_arrayPool::_0_::_elem::port_ens_r_obj_sensor_base::_::_m_movObjectInformation::_2_::STA_OBJECT_INFORMATION_ST::_::_m_ohyObjectType_st::_m_probObstacle_st::_m_probMobile_st::_m_prob1UnknownN = 128;
        @sysvar::XCP::RadarFR::_g_PlReCoFw_PlReCoPer_ObjBypassingRunnable_ObjBypassingRunnable_m_pad_radarObjPort_par_out_local::TChangeableMemPool::_::_::_m_arrayPool::_0_::_elem::port_ens_r_obj_sensor_base::_::_m_movObjectInformation::_2_::STA_OBJECT_INFORMATION_ST::_::_m_ohyObjectType_st::_m_probObstacle_st::_m_probMobile_st::_m_probFourPlusWheeler_st::_m_prob1PassengerCarN = 0;
        @sysvar::XCP::RadarFR::_g_PlReCoFw_PlReCoPer_ObjBypassingRunnable_ObjBypassingRunnable_m_pad_radarObjPort_par_out_local::TChangeableMemPool::_::_::_m_arrayPool::_0_::_elem::port_ens_r_obj_sensor_base::_::_m_movObjectInformation::_2_::STA_OBJECT_INFORMATION_ST::_::_m_ohyObjectType_st::_m_probObstacle_st::_m_probMobile_st::_m_probFourPlusWheeler_st::_m_prob1TruckN = 0;
        @sysvar::XCP::RadarFR::_g_PlReCoFw_PlReCoPer_ObjBypassingRunnable_ObjBypassingRunnable_m_pad_radarObjPort_par_out_local::TChangeableMemPool::_::_::_m_arrayPool::_0_::_elem::port_ens_r_obj_sensor_base::_::_m_movObjectInformation::_2_::STA_OBJECT_INFORMATION_ST::_::_m_ohyObjectType_st::_m_probObstacle_st::_m_probMobile_st::_m_probFourPlusWheeler_st::_m_prob1UnknownN = 128;
        @sysvar::XCP::RadarFR::_g_PlReCoFw_PlReCoPer_ObjBypassingRunnable_ObjBypassingRunnable_m_pad_radarObjPort_par_out_local::TChangeableMemPool::_::_::_m_arrayPool::_0_::_elem::port_ens_r_obj_sensor_base::_::_m_movObjectInformation::_2_::STA_OBJECT_INFORMATION_ST::_::_m_ohyObjectType_st::_m_probObstacle_st::_m_probStationary_st::_m_prob1RoadsideBarrierN = 0;
        @sysvar::XCP::RadarFR::_g_PlReCoFw_PlReCoPer_ObjBypassingRunnable_ObjBypassingRunnable_m_pad_radarObjPort_par_out_local::TChangeableMemPool::_::_::_m_arrayPool::_0_::_elem::port_ens_r_obj_sensor_base::_::_m_movObjectInformation::_2_::STA_OBJECT_INFORMATION_ST::_::_m_ohyObjectType_st::_m_probObstacle_st::_m_probStationary_st::_m_prob1UnknownN = 128;
        @sysvar::XCP::RadarFR::_g_PlReCoFw_PlReCoPer_ObjBypassingRunnable_ObjBypassingRunnable_m_pad_radarObjPort_par_out_local::TChangeableMemPool::_::_::_m_arrayPool::_0_::_elem::port_ens_r_obj_sensor_base::_::_m_movObjectInformation::_2_::_m_dLengthN = 64;
        @sysvar::XCP::RadarFR::_g_PlReCoFw_PlReCoPer_ObjBypassingRunnable_ObjBypassingRunnable_m_pad_radarObjPort_par_out_local::TChangeableMemPool::_::_::_m_arrayPool::_0_::_elem::port_ens_r_obj_sensor_base::_::_m_movObjectInformation::_2_::_m_dWidthN = @Classe_Obj_Sim::obj_data.obj_width[2] * 128;
        break;

      case 1: //"unknown"
        @sysvar::XCP::RadarFR::_g_PlReCoFw_PlReCoPer_ObjBypassingRunnable_ObjBypassingRunnable_m_pad_radarObjPort_par_out_local::TChangeableMemPool::_::_::_m_arrayPool::_0_::_elem::port_ens_r_obj_sensor_base::_::_m_movObjectInformation::_2_::STA_OBJECT_INFORMATION_ST::_::_m_ohyObjectType_st::_m_prob1NonObstacleN = 0;
        @sysvar::XCP::RadarFR::_g_PlReCoFw_PlReCoPer_ObjBypassingRunnable_ObjBypassingRunnable_m_pad_radarObjPort_par_out_local::TChangeableMemPool::_::_::_m_arrayPool::_0_::_elem::port_ens_r_obj_sensor_base::_::_m_movObjectInformation::_2_::STA_OBJECT_INFORMATION_ST::_::_m_ohyObjectType_st::_m_prob1ObstacleN = 0;
        @sysvar::XCP::RadarFR::_g_PlReCoFw_PlReCoPer_ObjBypassingRunnable_ObjBypassingRunnable_m_pad_radarObjPort_par_out_local::TChangeableMemPool::_::_::_m_arrayPool::_0_::_elem::port_ens_r_obj_sensor_base::_::_m_movObjectInformation::_2_::STA_OBJECT_INFORMATION_ST::_::_m_ohyObjectType_st::_m_prob1UnknownN = 128;
        @sysvar::XCP::RadarFR::_g_PlReCoFw_PlReCoPer_ObjBypassingRunnable_ObjBypassingRunnable_m_pad_radarObjPort_par_out_local::TChangeableMemPool::_::_::_m_arrayPool::_0_::_elem::port_ens_r_obj_sensor_base::_::_m_movObjectInformation::_2_::STA_OBJECT_INFORMATION_ST::_::_m_ohyObjectType_st::_m_probObstacle_st::_m_prob1UnknownN = 128;
        @sysvar::XCP::RadarFR::_g_PlReCoFw_PlReCoPer_ObjBypassingRunnable_ObjBypassingRunnable_m_pad_radarObjPort_par_out_local::TChangeableMemPool::_::_::_m_arrayPool::_0_::_elem::port_ens_r_obj_sensor_base::_::_m_movObjectInformation::_2_::STA_OBJECT_INFORMATION_ST::_::_m_ohyObjectType_st::_m_probObstacle_st::_m_probMobile_st::_m_prob1FourPlusWheelerN = 0;
        @sysvar::XCP::RadarFR::_g_PlReCoFw_PlReCoPer_ObjBypassingRunnable_ObjBypassingRunnable_m_pad_radarObjPort_par_out_local::TChangeableMemPool::_::_::_m_arrayPool::_0_::_elem::port_ens_r_obj_sensor_base::_::_m_movObjectInformation::_2_::STA_OBJECT_INFORMATION_ST::_::_m_ohyObjectType_st::_m_probObstacle_st::_m_probMobile_st::_m_prob1PedestrianN = 0;
        @sysvar::XCP::RadarFR::_g_PlReCoFw_PlReCoPer_ObjBypassingRunnable_ObjBypassingRunnable_m_pad_radarObjPort_par_out_local::TChangeableMemPool::_::_::_m_arrayPool::_0_::_elem::port_ens_r_obj_sensor_base::_::_m_movObjectInformation::_2_::STA_OBJECT_INFORMATION_ST::_::_m_ohyObjectType_st::_m_probObstacle_st::_m_probMobile_st::_m_prob1TwoWheelerN = 0;
        @sysvar::XCP::RadarFR::_g_PlReCoFw_PlReCoPer_ObjBypassingRunnable_ObjBypassingRunnable_m_pad_radarObjPort_par_out_local::TChangeableMemPool::_::_::_m_arrayPool::_0_::_elem::port_ens_r_obj_sensor_base::_::_m_movObjectInformation::_2_::STA_OBJECT_INFORMATION_ST::_::_m_ohyObjectType_st::_m_probObstacle_st::_m_probMobile_st::_m_prob1UnknownN = 128;
        @sysvar::XCP::RadarFR::_g_PlReCoFw_PlReCoPer_ObjBypassingRunnable_ObjBypassingRunnable_m_pad_radarObjPort_par_out_local::TChangeableMemPool::_::_::_m_arrayPool::_0_::_elem::port_ens_r_obj_sensor_base::_::_m_movObjectInformation::_2_::STA_OBJECT_INFORMATION_ST::_::_m_ohyObjectType_st::_m_probObstacle_st::_m_probMobile_st::_m_probFourPlusWheeler_st::_m_prob1PassengerCarN = 0;
        @sysvar::XCP::RadarFR::_g_PlReCoFw_PlReCoPer_ObjBypassingRunnable_ObjBypassingRunnable_m_pad_radarObjPort_par_out_local::TChangeableMemPool::_::_::_m_arrayPool::_0_::_elem::port_ens_r_obj_sensor_base::_::_m_movObjectInformation::_2_::STA_OBJECT_INFORMATION_ST::_::_m_ohyObjectType_st::_m_probObstacle_st::_m_probMobile_st::_m_probFourPlusWheeler_st::_m_prob1TruckN = 0;
        @sysvar::XCP::RadarFR::_g_PlReCoFw_PlReCoPer_ObjBypassingRunnable_ObjBypassingRunnable_m_pad_radarObjPort_par_out_local::TChangeableMemPool::_::_::_m_arrayPool::_0_::_elem::port_ens_r_obj_sensor_base::_::_m_movObjectInformation::_2_::STA_OBJECT_INFORMATION_ST::_::_m_ohyObjectType_st::_m_probObstacle_st::_m_probMobile_st::_m_probFourPlusWheeler_st::_m_prob1UnknownN = 128;
        @sysvar::XCP::RadarFR::_g_PlReCoFw_PlReCoPer_ObjBypassingRunnable_ObjBypassingRunnable_m_pad_radarObjPort_par_out_local::TChangeableMemPool::_::_::_m_arrayPool::_0_::_elem::port_ens_r_obj_sensor_base::_::_m_movObjectInformation::_2_::STA_OBJECT_INFORMATION_ST::_::_m_ohyObjectType_st::_m_probObstacle_st::_m_probStationary_st::_m_prob1RoadsideBarrierN = 0;
        @sysvar::XCP::RadarFR::_g_PlReCoFw_PlReCoPer_ObjBypassingRunnable_ObjBypassingRunnable_m_pad_radarObjPort_par_out_local::TChangeableMemPool::_::_::_m_arrayPool::_0_::_elem::port_ens_r_obj_sensor_base::_::_m_movObjectInformation::_2_::STA_OBJECT_INFORMATION_ST::_::_m_ohyObjectType_st::_m_probObstacle_st::_m_probStationary_st::_m_prob1UnknownN = 128;
        @sysvar::XCP::RadarFR::_g_PlReCoFw_PlReCoPer_ObjBypassingRunnable_ObjBypassingRunnable_m_pad_radarObjPort_par_out_local::TChangeableMemPool::_::_::_m_arrayPool::_0_::_elem::port_ens_r_obj_sensor_base::_::_m_movObjectInformation::_2_::_m_dLengthN = 0;
        @sysvar::XCP::RadarFR::_g_PlReCoFw_PlReCoPer_ObjBypassingRunnable_ObjBypassingRunnable_m_pad_radarObjPort_par_out_local::TChangeableMemPool::_::_::_m_arrayPool::_0_::_elem::port_ens_r_obj_sensor_base::_::_m_movObjectInformation::_2_::_m_dWidthN = @Classe_Obj_Sim::obj_data.obj_width[2] * 128;
        break;

      case 2: //"RoadSideBarrier"
        @sysvar::XCP::RadarFR::_g_PlReCoFw_PlReCoPer_ObjBypassingRunnable_ObjBypassingRunnable_m_pad_radarObjPort_par_out_local::TChangeableMemPool::_::_::_m_arrayPool::_0_::_elem::port_ens_r_obj_sensor_base::_::_m_movObjectInformation::_2_::STA_OBJECT_INFORMATION_ST::_::_m_ohyObjectType_st::_m_prob1NonObstacleN = 0;
        @sysvar::XCP::RadarFR::_g_PlReCoFw_PlReCoPer_ObjBypassingRunnable_ObjBypassingRunnable_m_pad_radarObjPort_par_out_local::TChangeableMemPool::_::_::_m_arrayPool::_0_::_elem::port_ens_r_obj_sensor_base::_::_m_movObjectInformation::_2_::STA_OBJECT_INFORMATION_ST::_::_m_ohyObjectType_st::_m_prob1ObstacleN = 128;
        @sysvar::XCP::RadarFR::_g_PlReCoFw_PlReCoPer_ObjBypassingRunnable_ObjBypassingRunnable_m_pad_radarObjPort_par_out_local::TChangeableMemPool::_::_::_m_arrayPool::_0_::_elem::port_ens_r_obj_sensor_base::_::_m_movObjectInformation::_2_::STA_OBJECT_INFORMATION_ST::_::_m_ohyObjectType_st::_m_prob1UnknownN = 0;
        @sysvar::XCP::RadarFR::_g_PlReCoFw_PlReCoPer_ObjBypassingRunnable_ObjBypassingRunnable_m_pad_radarObjPort_par_out_local::TChangeableMemPool::_::_::_m_arrayPool::_0_::_elem::port_ens_r_obj_sensor_base::_::_m_movObjectInformation::_2_::STA_OBJECT_INFORMATION_ST::_::_m_ohyObjectType_st::_m_probObstacle_st::_m_prob1MobileN = 0;
        @sysvar::XCP::RadarFR::_g_PlReCoFw_PlReCoPer_ObjBypassingRunnable_ObjBypassingRunnable_m_pad_radarObjPort_par_out_local::TChangeableMemPool::_::_::_m_arrayPool::_0_::_elem::port_ens_r_obj_sensor_base::_::_m_movObjectInformation::_2_::STA_OBJECT_INFORMATION_ST::_::_m_ohyObjectType_st::_m_probObstacle_st::_m_prob1StationaryN = 128;
        @sysvar::XCP::RadarFR::_g_PlReCoFw_PlReCoPer_ObjBypassingRunnable_ObjBypassingRunnable_m_pad_radarObjPort_par_out_local::TChangeableMemPool::_::_::_m_arrayPool::_0_::_elem::port_ens_r_obj_sensor_base::_::_m_movObjectInformation::_2_::STA_OBJECT_INFORMATION_ST::_::_m_ohyObjectType_st::_m_probObstacle_st::_m_prob1UnknownN = 0;
        @sysvar::XCP::RadarFR::_g_PlReCoFw_PlReCoPer_ObjBypassingRunnable_ObjBypassingRunnable_m_pad_radarObjPort_par_out_local::TChangeableMemPool::_::_::_m_arrayPool::_0_::_elem::port_ens_r_obj_sensor_base::_::_m_movObjectInformation::_2_::STA_OBJECT_INFORMATION_ST::_::_m_ohyObjectType_st::_m_probObstacle_st::_m_probMobile_st::_m_prob1FourPlusWheelerN = 0;
        @sysvar::XCP::RadarFR::_g_PlReCoFw_PlReCoPer_ObjBypassingRunnable_ObjBypassingRunnable_m_pad_radarObjPort_par_out_local::TChangeableMemPool::_::_::_m_arrayPool::_0_::_elem::port_ens_r_obj_sensor_base::_::_m_movObjectInformation::_2_::STA_OBJECT_INFORMATION_ST::_::_m_ohyObjectType_st::_m_probObstacle_st::_m_probMobile_st::_m_prob1PedestrianN = 0;
        @sysvar::XCP::RadarFR::_g_PlReCoFw_PlReCoPer_ObjBypassingRunnable_ObjBypassingRunnable_m_pad_radarObjPort_par_out_local::TChangeableMemPool::_::_::_m_arrayPool::_0_::_elem::port_ens_r_obj_sensor_base::_::_m_movObjectInformation::_2_::STA_OBJECT_INFORMATION_ST::_::_m_ohyObjectType_st::_m_probObstacle_st::_m_probMobile_st::_m_prob1TwoWheelerN = 0;
        @sysvar::XCP::RadarFR::_g_PlReCoFw_PlReCoPer_ObjBypassingRunnable_ObjBypassingRunnable_m_pad_radarObjPort_par_out_local::TChangeableMemPool::_::_::_m_arrayPool::_0_::_elem::port_ens_r_obj_sensor_base::_::_m_movObjectInformation::_2_::STA_OBJECT_INFORMATION_ST::_::_m_ohyObjectType_st::_m_probObstacle_st::_m_probMobile_st::_m_prob1UnknownN = 0;
        @sysvar::XCP::RadarFR::_g_PlReCoFw_PlReCoPer_ObjBypassingRunnable_ObjBypassingRunnable_m_pad_radarObjPort_par_out_local::TChangeableMemPool::_::_::_m_arrayPool::_0_::_elem::port_ens_r_obj_sensor_base::_::_m_movObjectInformation::_2_::STA_OBJECT_INFORMATION_ST::_::_m_ohyObjectType_st::_m_probObstacle_st::_m_probMobile_st::_m_probFourPlusWheeler_st::_m_prob1PassengerCarN = 0;
        @sysvar::XCP::RadarFR::_g_PlReCoFw_PlReCoPer_ObjBypassingRunnable_ObjBypassingRunnable_m_pad_radarObjPort_par_out_local::TChangeableMemPool::_::_::_m_arrayPool::_0_::_elem::port_ens_r_obj_sensor_base::_::_m_movObjectInformation::_2_::STA_OBJECT_INFORMATION_ST::_::_m_ohyObjectType_st::_m_probObstacle_st::_m_probMobile_st::_m_probFourPlusWheeler_st::_m_prob1TruckN = 0;
        @sysvar::XCP::RadarFR::_g_PlReCoFw_PlReCoPer_ObjBypassingRunnable_ObjBypassingRunnable_m_pad_radarObjPort_par_out_local::TChangeableMemPool::_::_::_m_arrayPool::_0_::_elem::port_ens_r_obj_sensor_base::_::_m_movObjectInformation::_2_::STA_OBJECT_INFORMATION_ST::_::_m_ohyObjectType_st::_m_probObstacle_st::_m_probMobile_st::_m_probFourPlusWheeler_st::_m_prob1UnknownN = 0;
        @sysvar::XCP::RadarFR::_g_PlReCoFw_PlReCoPer_ObjBypassingRunnable_ObjBypassingRunnable_m_pad_radarObjPort_par_out_local::TChangeableMemPool::_::_::_m_arrayPool::_0_::_elem::port_ens_r_obj_sensor_base::_::_m_movObjectInformation::_2_::STA_OBJECT_INFORMATION_ST::_::_m_ohyObjectType_st::_m_probObstacle_st::_m_probStationary_st::_m_prob1RoadsideBarrierN = 128;
        @sysvar::XCP::RadarFR::_g_PlReCoFw_PlReCoPer_ObjBypassingRunnable_ObjBypassingRunnable_m_pad_radarObjPort_par_out_local::TChangeableMemPool::_::_::_m_arrayPool::_0_::_elem::port_ens_r_obj_sensor_base::_::_m_movObjectInformation::_2_::STA_OBJECT_INFORMATION_ST::_::_m_ohyObjectType_st::_m_probObstacle_st::_m_probStationary_st::_m_prob1UnknownN = 0;
        @sysvar::XCP::RadarFR::_g_PlReCoFw_PlReCoPer_ObjBypassingRunnable_ObjBypassingRunnable_m_pad_radarObjPort_par_out_local::TChangeableMemPool::_::_::_m_arrayPool::_0_::_elem::port_ens_r_obj_sensor_base::_::_m_movObjectInformation::_2_::_m_dLengthN = 64;
        @sysvar::XCP::RadarFR::_g_PlReCoFw_PlReCoPer_ObjBypassingRunnable_ObjBypassingRunnable_m_pad_radarObjPort_par_out_local::TChangeableMemPool::_::_::_m_arrayPool::_0_::_elem::port_ens_r_obj_sensor_base::_::_m_movObjectInformation::_2_::_m_dWidthN = @Classe_Obj_Sim::obj_data.obj_width[2] * 128;
        break;

      case 3: //"2Wheeler"
        @sysvar::XCP::RadarFR::_g_PlReCoFw_PlReCoPer_ObjBypassingRunnable_ObjBypassingRunnable_m_pad_radarObjPort_par_out_local::TChangeableMemPool::_::_::_m_arrayPool::_0_::_elem::port_ens_r_obj_sensor_base::_::_m_movObjectInformation::_2_::STA_OBJECT_INFORMATION_ST::_::_m_ohyObjectType_st::_m_prob1NonObstacleN = 0;
        @sysvar::XCP::RadarFR::_g_PlReCoFw_PlReCoPer_ObjBypassingRunnable_ObjBypassingRunnable_m_pad_radarObjPort_par_out_local::TChangeableMemPool::_::_::_m_arrayPool::_0_::_elem::port_ens_r_obj_sensor_base::_::_m_movObjectInformation::_2_::STA_OBJECT_INFORMATION_ST::_::_m_ohyObjectType_st::_m_prob1ObstacleN = 128;
        @sysvar::XCP::RadarFR::_g_PlReCoFw_PlReCoPer_ObjBypassingRunnable_ObjBypassingRunnable_m_pad_radarObjPort_par_out_local::TChangeableMemPool::_::_::_m_arrayPool::_0_::_elem::port_ens_r_obj_sensor_base::_::_m_movObjectInformation::_2_::STA_OBJECT_INFORMATION_ST::_::_m_ohyObjectType_st::_m_prob1UnknownN = 0;
        @sysvar::XCP::RadarFR::_g_PlReCoFw_PlReCoPer_ObjBypassingRunnable_ObjBypassingRunnable_m_pad_radarObjPort_par_out_local::TChangeableMemPool::_::_::_m_arrayPool::_0_::_elem::port_ens_r_obj_sensor_base::_::_m_movObjectInformation::_2_::STA_OBJECT_INFORMATION_ST::_::_m_ohyObjectType_st::_m_probObstacle_st::_m_prob1UnknownN = 0;
        @sysvar::XCP::RadarFR::_g_PlReCoFw_PlReCoPer_ObjBypassingRunnable_ObjBypassingRunnable_m_pad_radarObjPort_par_out_local::TChangeableMemPool::_::_::_m_arrayPool::_0_::_elem::port_ens_r_obj_sensor_base::_::_m_movObjectInformation::_2_::STA_OBJECT_INFORMATION_ST::_::_m_ohyObjectType_st::_m_probObstacle_st::_m_probMobile_st::_m_prob1FourPlusWheelerN = 0;
        @sysvar::XCP::RadarFR::_g_PlReCoFw_PlReCoPer_ObjBypassingRunnable_ObjBypassingRunnable_m_pad_radarObjPort_par_out_local::TChangeableMemPool::_::_::_m_arrayPool::_0_::_elem::port_ens_r_obj_sensor_base::_::_m_movObjectInformation::_2_::STA_OBJECT_INFORMATION_ST::_::_m_ohyObjectType_st::_m_probObstacle_st::_m_probMobile_st::_m_prob1PedestrianN = 0;
        @sysvar::XCP::RadarFR::_g_PlReCoFw_PlReCoPer_ObjBypassingRunnable_ObjBypassingRunnable_m_pad_radarObjPort_par_out_local::TChangeableMemPool::_::_::_m_arrayPool::_0_::_elem::port_ens_r_obj_sensor_base::_::_m_movObjectInformation::_2_::STA_OBJECT_INFORMATION_ST::_::_m_ohyObjectType_st::_m_probObstacle_st::_m_probMobile_st::_m_prob1TwoWheelerN = 128;
        @sysvar::XCP::RadarFR::_g_PlReCoFw_PlReCoPer_ObjBypassingRunnable_ObjBypassingRunnable_m_pad_radarObjPort_par_out_local::TChangeableMemPool::_::_::_m_arrayPool::_0_::_elem::port_ens_r_obj_sensor_base::_::_m_movObjectInformation::_2_::STA_OBJECT_INFORMATION_ST::_::_m_ohyObjectType_st::_m_probObstacle_st::_m_probMobile_st::_m_prob1UnknownN = 0;
        @sysvar::XCP::RadarFR::_g_PlReCoFw_PlReCoPer_ObjBypassingRunnable_ObjBypassingRunnable_m_pad_radarObjPort_par_out_local::TChangeableMemPool::_::_::_m_arrayPool::_0_::_elem::port_ens_r_obj_sensor_base::_::_m_movObjectInformation::_2_::STA_OBJECT_INFORMATION_ST::_::_m_ohyObjectType_st::_m_probObstacle_st::_m_probMobile_st::_m_probFourPlusWheeler_st::_m_prob1PassengerCarN = 0;
        @sysvar::XCP::RadarFR::_g_PlReCoFw_PlReCoPer_ObjBypassingRunnable_ObjBypassingRunnable_m_pad_radarObjPort_par_out_local::TChangeableMemPool::_::_::_m_arrayPool::_0_::_elem::port_ens_r_obj_sensor_base::_::_m_movObjectInformation::_2_::STA_OBJECT_INFORMATION_ST::_::_m_ohyObjectType_st::_m_probObstacle_st::_m_probMobile_st::_m_probFourPlusWheeler_st::_m_prob1TruckN = 0;
        @sysvar::XCP::RadarFR::_g_PlReCoFw_PlReCoPer_ObjBypassingRunnable_ObjBypassingRunnable_m_pad_radarObjPort_par_out_local::TChangeableMemPool::_::_::_m_arrayPool::_0_::_elem::port_ens_r_obj_sensor_base::_::_m_movObjectInformation::_2_::STA_OBJECT_INFORMATION_ST::_::_m_ohyObjectType_st::_m_probObstacle_st::_m_probMobile_st::_m_probFourPlusWheeler_st::_m_prob1UnknownN = 128;
        @sysvar::XCP::RadarFR::_g_PlReCoFw_PlReCoPer_ObjBypassingRunnable_ObjBypassingRunnable_m_pad_radarObjPort_par_out_local::TChangeableMemPool::_::_::_m_arrayPool::_0_::_elem::port_ens_r_obj_sensor_base::_::_m_movObjectInformation::_2_::STA_OBJECT_INFORMATION_ST::_::_m_ohyObjectType_st::_m_probObstacle_st::_m_probStationary_st::_m_prob1RoadsideBarrierN = 0;
        @sysvar::XCP::RadarFR::_g_PlReCoFw_PlReCoPer_ObjBypassingRunnable_ObjBypassingRunnable_m_pad_radarObjPort_par_out_local::TChangeableMemPool::_::_::_m_arrayPool::_0_::_elem::port_ens_r_obj_sensor_base::_::_m_movObjectInformation::_2_::STA_OBJECT_INFORMATION_ST::_::_m_ohyObjectType_st::_m_probObstacle_st::_m_probStationary_st::_m_prob1UnknownN = 0;
        @sysvar::XCP::RadarFR::_g_PlReCoFw_PlReCoPer_ObjBypassingRunnable_ObjBypassingRunnable_m_pad_radarObjPort_par_out_local::TChangeableMemPool::_::_::_m_arrayPool::_0_::_elem::port_ens_r_obj_sensor_base::_::_m_movObjectInformation::_2_::_m_dLengthN = 64;
        @sysvar::XCP::RadarFR::_g_PlReCoFw_PlReCoPer_ObjBypassingRunnable_ObjBypassingRunnable_m_pad_radarObjPort_par_out_local::TChangeableMemPool::_::_::_m_arrayPool::_0_::_elem::port_ens_r_obj_sensor_base::_::_m_movObjectInformation::_2_::_m_dWidthN = @Classe_Obj_Sim::obj_data.obj_width[2] * 128;
        break;

      case 4: //"Pedestrian"
        @sysvar::XCP::RadarFR::_g_PlReCoFw_PlReCoPer_ObjBypassingRunnable_ObjBypassingRunnable_m_pad_radarObjPort_par_out_local::TChangeableMemPool::_::_::_m_arrayPool::_0_::_elem::port_ens_r_obj_sensor_base::_::_m_movObjectInformation::_2_::STA_OBJECT_INFORMATION_ST::_::_m_ohyObjectType_st::_m_prob1NonObstacleN = 0;
        @sysvar::XCP::RadarFR::_g_PlReCoFw_PlReCoPer_ObjBypassingRunnable_ObjBypassingRunnable_m_pad_radarObjPort_par_out_local::TChangeableMemPool::_::_::_m_arrayPool::_0_::_elem::port_ens_r_obj_sensor_base::_::_m_movObjectInformation::_2_::STA_OBJECT_INFORMATION_ST::_::_m_ohyObjectType_st::_m_prob1ObstacleN = 128;
        @sysvar::XCP::RadarFR::_g_PlReCoFw_PlReCoPer_ObjBypassingRunnable_ObjBypassingRunnable_m_pad_radarObjPort_par_out_local::TChangeableMemPool::_::_::_m_arrayPool::_0_::_elem::port_ens_r_obj_sensor_base::_::_m_movObjectInformation::_2_::STA_OBJECT_INFORMATION_ST::_::_m_ohyObjectType_st::_m_prob1UnknownN = 0;
        @sysvar::XCP::RadarFR::_g_PlReCoFw_PlReCoPer_ObjBypassingRunnable_ObjBypassingRunnable_m_pad_radarObjPort_par_out_local::TChangeableMemPool::_::_::_m_arrayPool::_0_::_elem::port_ens_r_obj_sensor_base::_::_m_movObjectInformation::_2_::STA_OBJECT_INFORMATION_ST::_::_m_ohyObjectType_st::_m_probObstacle_st::_m_prob1UnknownN = 0;
        @sysvar::XCP::RadarFR::_g_PlReCoFw_PlReCoPer_ObjBypassingRunnable_ObjBypassingRunnable_m_pad_radarObjPort_par_out_local::TChangeableMemPool::_::_::_m_arrayPool::_0_::_elem::port_ens_r_obj_sensor_base::_::_m_movObjectInformation::_2_::STA_OBJECT_INFORMATION_ST::_::_m_ohyObjectType_st::_m_probObstacle_st::_m_probMobile_st::_m_prob1FourPlusWheelerN = 0;
        @sysvar::XCP::RadarFR::_g_PlReCoFw_PlReCoPer_ObjBypassingRunnable_ObjBypassingRunnable_m_pad_radarObjPort_par_out_local::TChangeableMemPool::_::_::_m_arrayPool::_0_::_elem::port_ens_r_obj_sensor_base::_::_m_movObjectInformation::_2_::STA_OBJECT_INFORMATION_ST::_::_m_ohyObjectType_st::_m_probObstacle_st::_m_probMobile_st::_m_prob1PedestrianN = 128;
        @sysvar::XCP::RadarFR::_g_PlReCoFw_PlReCoPer_ObjBypassingRunnable_ObjBypassingRunnable_m_pad_radarObjPort_par_out_local::TChangeableMemPool::_::_::_m_arrayPool::_0_::_elem::port_ens_r_obj_sensor_base::_::_m_movObjectInformation::_2_::STA_OBJECT_INFORMATION_ST::_::_m_ohyObjectType_st::_m_probObstacle_st::_m_probMobile_st::_m_prob1TwoWheelerN = 0;
        @sysvar::XCP::RadarFR::_g_PlReCoFw_PlReCoPer_ObjBypassingRunnable_ObjBypassingRunnable_m_pad_radarObjPort_par_out_local::TChangeableMemPool::_::_::_m_arrayPool::_0_::_elem::port_ens_r_obj_sensor_base::_::_m_movObjectInformation::_2_::STA_OBJECT_INFORMATION_ST::_::_m_ohyObjectType_st::_m_probObstacle_st::_m_probMobile_st::_m_prob1UnknownN = 0;
        @sysvar::XCP::RadarFR::_g_PlReCoFw_PlReCoPer_ObjBypassingRunnable_ObjBypassingRunnable_m_pad_radarObjPort_par_out_local::TChangeableMemPool::_::_::_m_arrayPool::_0_::_elem::port_ens_r_obj_sensor_base::_::_m_movObjectInformation::_2_::STA_OBJECT_INFORMATION_ST::_::_m_ohyObjectType_st::_m_probObstacle_st::_m_probMobile_st::_m_probFourPlusWheeler_st::_m_prob1PassengerCarN = 0;
        @sysvar::XCP::RadarFR::_g_PlReCoFw_PlReCoPer_ObjBypassingRunnable_ObjBypassingRunnable_m_pad_radarObjPort_par_out_local::TChangeableMemPool::_::_::_m_arrayPool::_0_::_elem::port_ens_r_obj_sensor_base::_::_m_movObjectInformation::_2_::STA_OBJECT_INFORMATION_ST::_::_m_ohyObjectType_st::_m_probObstacle_st::_m_probMobile_st::_m_probFourPlusWheeler_st::_m_prob1TruckN = 0;
        @sysvar::XCP::RadarFR::_g_PlReCoFw_PlReCoPer_ObjBypassingRunnable_ObjBypassingRunnable_m_pad_radarObjPort_par_out_local::TChangeableMemPool::_::_::_m_arrayPool::_0_::_elem::port_ens_r_obj_sensor_base::_::_m_movObjectInformation::_2_::STA_OBJECT_INFORMATION_ST::_::_m_ohyObjectType_st::_m_probObstacle_st::_m_probMobile_st::_m_probFourPlusWheeler_st::_m_prob1UnknownN = 128;
        @sysvar::XCP::RadarFR::_g_PlReCoFw_PlReCoPer_ObjBypassingRunnable_ObjBypassingRunnable_m_pad_radarObjPort_par_out_local::TChangeableMemPool::_::_::_m_arrayPool::_0_::_elem::port_ens_r_obj_sensor_base::_::_m_movObjectInformation::_2_::STA_OBJECT_INFORMATION_ST::_::_m_ohyObjectType_st::_m_probObstacle_st::_m_probStationary_st::_m_prob1RoadsideBarrierN = 0;
        @sysvar::XCP::RadarFR::_g_PlReCoFw_PlReCoPer_ObjBypassingRunnable_ObjBypassingRunnable_m_pad_radarObjPort_par_out_local::TChangeableMemPool::_::_::_m_arrayPool::_0_::_elem::port_ens_r_obj_sensor_base::_::_m_movObjectInformation::_2_::STA_OBJECT_INFORMATION_ST::_::_m_ohyObjectType_st::_m_probObstacle_st::_m_probStationary_st::_m_prob1UnknownN = 0;
        @sysvar::XCP::RadarFR::_g_PlReCoFw_PlReCoPer_ObjBypassingRunnable_ObjBypassingRunnable_m_pad_radarObjPort_par_out_local::TChangeableMemPool::_::_::_m_arrayPool::_0_::_elem::port_ens_r_obj_sensor_base::_::_m_movObjectInformation::_2_::_m_dLengthN = 64;
        @sysvar::XCP::RadarFR::_g_PlReCoFw_PlReCoPer_ObjBypassingRunnable_ObjBypassingRunnable_m_pad_radarObjPort_par_out_local::TChangeableMemPool::_::_::_m_arrayPool::_0_::_elem::port_ens_r_obj_sensor_base::_::_m_movObjectInformation::_2_::_m_dWidthN = @Classe_Obj_Sim::obj_data.obj_width[2] * 128;
        break;

      case 5: //"Truck"
        @sysvar::XCP::RadarFR::_g_PlReCoFw_PlReCoPer_ObjBypassingRunnable_ObjBypassingRunnable_m_pad_radarObjPort_par_out_local::TChangeableMemPool::_::_::_m_arrayPool::_0_::_elem::port_ens_r_obj_sensor_base::_::_m_movObjectInformation::_2_::STA_OBJECT_INFORMATION_ST::_::_m_ohyObjectType_st::_m_prob1NonObstacleN = 0;
        @sysvar::XCP::RadarFR::_g_PlReCoFw_PlReCoPer_ObjBypassingRunnable_ObjBypassingRunnable_m_pad_radarObjPort_par_out_local::TChangeableMemPool::_::_::_m_arrayPool::_0_::_elem::port_ens_r_obj_sensor_base::_::_m_movObjectInformation::_2_::STA_OBJECT_INFORMATION_ST::_::_m_ohyObjectType_st::_m_prob1ObstacleN = 128;
        @sysvar::XCP::RadarFR::_g_PlReCoFw_PlReCoPer_ObjBypassingRunnable_ObjBypassingRunnable_m_pad_radarObjPort_par_out_local::TChangeableMemPool::_::_::_m_arrayPool::_0_::_elem::port_ens_r_obj_sensor_base::_::_m_movObjectInformation::_2_::STA_OBJECT_INFORMATION_ST::_::_m_ohyObjectType_st::_m_prob1UnknownN = 0;
        @sysvar::XCP::RadarFR::_g_PlReCoFw_PlReCoPer_ObjBypassingRunnable_ObjBypassingRunnable_m_pad_radarObjPort_par_out_local::TChangeableMemPool::_::_::_m_arrayPool::_0_::_elem::port_ens_r_obj_sensor_base::_::_m_movObjectInformation::_2_::STA_OBJECT_INFORMATION_ST::_::_m_ohyObjectType_st::_m_probObstacle_st::_m_prob1UnknownN = 0;
        @sysvar::XCP::RadarFR::_g_PlReCoFw_PlReCoPer_ObjBypassingRunnable_ObjBypassingRunnable_m_pad_radarObjPort_par_out_local::TChangeableMemPool::_::_::_m_arrayPool::_0_::_elem::port_ens_r_obj_sensor_base::_::_m_movObjectInformation::_2_::STA_OBJECT_INFORMATION_ST::_::_m_ohyObjectType_st::_m_probObstacle_st::_m_probMobile_st::_m_prob1FourPlusWheelerN = 128;
        @sysvar::XCP::RadarFR::_g_PlReCoFw_PlReCoPer_ObjBypassingRunnable_ObjBypassingRunnable_m_pad_radarObjPort_par_out_local::TChangeableMemPool::_::_::_m_arrayPool::_0_::_elem::port_ens_r_obj_sensor_base::_::_m_movObjectInformation::_2_::STA_OBJECT_INFORMATION_ST::_::_m_ohyObjectType_st::_m_probObstacle_st::_m_probMobile_st::_m_prob1PedestrianN = 0;
        @sysvar::XCP::RadarFR::_g_PlReCoFw_PlReCoPer_ObjBypassingRunnable_ObjBypassingRunnable_m_pad_radarObjPort_par_out_local::TChangeableMemPool::_::_::_m_arrayPool::_0_::_elem::port_ens_r_obj_sensor_base::_::_m_movObjectInformation::_2_::STA_OBJECT_INFORMATION_ST::_::_m_ohyObjectType_st::_m_probObstacle_st::_m_probMobile_st::_m_prob1TwoWheelerN = 0;
        @sysvar::XCP::RadarFR::_g_PlReCoFw_PlReCoPer_ObjBypassingRunnable_ObjBypassingRunnable_m_pad_radarObjPort_par_out_local::TChangeableMemPool::_::_::_m_arrayPool::_0_::_elem::port_ens_r_obj_sensor_base::_::_m_movObjectInformation::_2_::STA_OBJECT_INFORMATION_ST::_::_m_ohyObjectType_st::_m_probObstacle_st::_m_probMobile_st::_m_prob1UnknownN = 0;
        @sysvar::XCP::RadarFR::_g_PlReCoFw_PlReCoPer_ObjBypassingRunnable_ObjBypassingRunnable_m_pad_radarObjPort_par_out_local::TChangeableMemPool::_::_::_m_arrayPool::_0_::_elem::port_ens_r_obj_sensor_base::_::_m_movObjectInformation::_2_::STA_OBJECT_INFORMATION_ST::_::_m_ohyObjectType_st::_m_probObstacle_st::_m_probMobile_st::_m_probFourPlusWheeler_st::_m_prob1PassengerCarN = 0;
        @sysvar::XCP::RadarFR::_g_PlReCoFw_PlReCoPer_ObjBypassingRunnable_ObjBypassingRunnable_m_pad_radarObjPort_par_out_local::TChangeableMemPool::_::_::_m_arrayPool::_0_::_elem::port_ens_r_obj_sensor_base::_::_m_movObjectInformation::_2_::STA_OBJECT_INFORMATION_ST::_::_m_ohyObjectType_st::_m_probObstacle_st::_m_probMobile_st::_m_probFourPlusWheeler_st::_m_prob1TruckN = 128;
        @sysvar::XCP::RadarFR::_g_PlReCoFw_PlReCoPer_ObjBypassingRunnable_ObjBypassingRunnable_m_pad_radarObjPort_par_out_local::TChangeableMemPool::_::_::_m_arrayPool::_0_::_elem::port_ens_r_obj_sensor_base::_::_m_movObjectInformation::_2_::STA_OBJECT_INFORMATION_ST::_::_m_ohyObjectType_st::_m_probObstacle_st::_m_probMobile_st::_m_probFourPlusWheeler_st::_m_prob1UnknownN = 0;
        @sysvar::XCP::RadarFR::_g_PlReCoFw_PlReCoPer_ObjBypassingRunnable_ObjBypassingRunnable_m_pad_radarObjPort_par_out_local::TChangeableMemPool::_::_::_m_arrayPool::_0_::_elem::port_ens_r_obj_sensor_base::_::_m_movObjectInformation::_2_::STA_OBJECT_INFORMATION_ST::_::_m_ohyObjectType_st::_m_probObstacle_st::_m_probStationary_st::_m_prob1RoadsideBarrierN = 0;
        @sysvar::XCP::RadarFR::_g_PlReCoFw_PlReCoPer_ObjBypassingRunnable_ObjBypassingRunnable_m_pad_radarObjPort_par_out_local::TChangeableMemPool::_::_::_m_arrayPool::_0_::_elem::port_ens_r_obj_sensor_base::_::_m_movObjectInformation::_2_::STA_OBJECT_INFORMATION_ST::_::_m_ohyObjectType_st::_m_probObstacle_st::_m_probStationary_st::_m_prob1UnknownN = 0;
        @sysvar::XCP::RadarFR::_g_PlReCoFw_PlReCoPer_ObjBypassingRunnable_ObjBypassingRunnable_m_pad_radarObjPort_par_out_local::TChangeableMemPool::_::_::_m_arrayPool::_0_::_elem::port_ens_r_obj_sensor_base::_::_m_movObjectInformation::_2_::_m_dLengthN = 64;
        @sysvar::XCP::RadarFR::_g_PlReCoFw_PlReCoPer_ObjBypassingRunnable_ObjBypassingRunnable_m_pad_radarObjPort_par_out_local::TChangeableMemPool::_::_::_m_arrayPool::_0_::_elem::port_ens_r_obj_sensor_base::_::_m_movObjectInformation::_2_::_m_dWidthN = @Classe_Obj_Sim::obj_data.obj_width[2] * 128;
        break;

      case 6: //"PassengerCar"
        @sysvar::XCP::RadarFR::_g_PlReCoFw_PlReCoPer_ObjBypassingRunnable_ObjBypassingRunnable_m_pad_radarObjPort_par_out_local::TChangeableMemPool::_::_::_m_arrayPool::_0_::_elem::port_ens_r_obj_sensor_base::_::_m_movObjectInformation::_2_::STA_OBJECT_INFORMATION_ST::_::_m_ohyObjectType_st::_m_prob1NonObstacleN = 0;
        @sysvar::XCP::RadarFR::_g_PlReCoFw_PlReCoPer_ObjBypassingRunnable_ObjBypassingRunnable_m_pad_radarObjPort_par_out_local::TChangeableMemPool::_::_::_m_arrayPool::_0_::_elem::port_ens_r_obj_sensor_base::_::_m_movObjectInformation::_2_::STA_OBJECT_INFORMATION_ST::_::_m_ohyObjectType_st::_m_prob1ObstacleN = 128;
        @sysvar::XCP::RadarFR::_g_PlReCoFw_PlReCoPer_ObjBypassingRunnable_ObjBypassingRunnable_m_pad_radarObjPort_par_out_local::TChangeableMemPool::_::_::_m_arrayPool::_0_::_elem::port_ens_r_obj_sensor_base::_::_m_movObjectInformation::_2_::STA_OBJECT_INFORMATION_ST::_::_m_ohyObjectType_st::_m_prob1UnknownN = 0;
        @sysvar::XCP::RadarFR::_g_PlReCoFw_PlReCoPer_ObjBypassingRunnable_ObjBypassingRunnable_m_pad_radarObjPort_par_out_local::TChangeableMemPool::_::_::_m_arrayPool::_0_::_elem::port_ens_r_obj_sensor_base::_::_m_movObjectInformation::_2_::STA_OBJECT_INFORMATION_ST::_::_m_ohyObjectType_st::_m_probObstacle_st::_m_prob1UnknownN = 0;
        @sysvar::XCP::RadarFR::_g_PlReCoFw_PlReCoPer_ObjBypassingRunnable_ObjBypassingRunnable_m_pad_radarObjPort_par_out_local::TChangeableMemPool::_::_::_m_arrayPool::_0_::_elem::port_ens_r_obj_sensor_base::_::_m_movObjectInformation::_2_::STA_OBJECT_INFORMATION_ST::_::_m_ohyObjectType_st::_m_probObstacle_st::_m_probMobile_st::_m_prob1FourPlusWheelerN = 128;
        @sysvar::XCP::RadarFR::_g_PlReCoFw_PlReCoPer_ObjBypassingRunnable_ObjBypassingRunnable_m_pad_radarObjPort_par_out_local::TChangeableMemPool::_::_::_m_arrayPool::_0_::_elem::port_ens_r_obj_sensor_base::_::_m_movObjectInformation::_2_::STA_OBJECT_INFORMATION_ST::_::_m_ohyObjectType_st::_m_probObstacle_st::_m_probMobile_st::_m_prob1PedestrianN = 0;
        @sysvar::XCP::RadarFR::_g_PlReCoFw_PlReCoPer_ObjBypassingRunnable_ObjBypassingRunnable_m_pad_radarObjPort_par_out_local::TChangeableMemPool::_::_::_m_arrayPool::_0_::_elem::port_ens_r_obj_sensor_base::_::_m_movObjectInformation::_2_::STA_OBJECT_INFORMATION_ST::_::_m_ohyObjectType_st::_m_probObstacle_st::_m_probMobile_st::_m_prob1TwoWheelerN = 0;
        @sysvar::XCP::RadarFR::_g_PlReCoFw_PlReCoPer_ObjBypassingRunnable_ObjBypassingRunnable_m_pad_radarObjPort_par_out_local::TChangeableMemPool::_::_::_m_arrayPool::_0_::_elem::port_ens_r_obj_sensor_base::_::_m_movObjectInformation::_2_::STA_OBJECT_INFORMATION_ST::_::_m_ohyObjectType_st::_m_probObstacle_st::_m_probMobile_st::_m_prob1UnknownN = 0;
        @sysvar::XCP::RadarFR::_g_PlReCoFw_PlReCoPer_ObjBypassingRunnable_ObjBypassingRunnable_m_pad_radarObjPort_par_out_local::TChangeableMemPool::_::_::_m_arrayPool::_0_::_elem::port_ens_r_obj_sensor_base::_::_m_movObjectInformation::_2_::STA_OBJECT_INFORMATION_ST::_::_m_ohyObjectType_st::_m_probObstacle_st::_m_probMobile_st::_m_probFourPlusWheeler_st::_m_prob1PassengerCarN = 128;
        @sysvar::XCP::RadarFR::_g_PlReCoFw_PlReCoPer_ObjBypassingRunnable_ObjBypassingRunnable_m_pad_radarObjPort_par_out_local::TChangeableMemPool::_::_::_m_arrayPool::_0_::_elem::port_ens_r_obj_sensor_base::_::_m_movObjectInformation::_2_::STA_OBJECT_INFORMATION_ST::_::_m_ohyObjectType_st::_m_probObstacle_st::_m_probMobile_st::_m_probFourPlusWheeler_st::_m_prob1TruckN = 0;
        @sysvar::XCP::RadarFR::_g_PlReCoFw_PlReCoPer_ObjBypassingRunnable_ObjBypassingRunnable_m_pad_radarObjPort_par_out_local::TChangeableMemPool::_::_::_m_arrayPool::_0_::_elem::port_ens_r_obj_sensor_base::_::_m_movObjectInformation::_2_::STA_OBJECT_INFORMATION_ST::_::_m_ohyObjectType_st::_m_probObstacle_st::_m_probMobile_st::_m_probFourPlusWheeler_st::_m_prob1UnknownN = 0;
        @sysvar::XCP::RadarFR::_g_PlReCoFw_PlReCoPer_ObjBypassingRunnable_ObjBypassingRunnable_m_pad_radarObjPort_par_out_local::TChangeableMemPool::_::_::_m_arrayPool::_0_::_elem::port_ens_r_obj_sensor_base::_::_m_movObjectInformation::_2_::STA_OBJECT_INFORMATION_ST::_::_m_ohyObjectType_st::_m_probObstacle_st::_m_probStationary_st::_m_prob1RoadsideBarrierN = 0;
        @sysvar::XCP::RadarFR::_g_PlReCoFw_PlReCoPer_ObjBypassingRunnable_ObjBypassingRunnable_m_pad_radarObjPort_par_out_local::TChangeableMemPool::_::_::_m_arrayPool::_0_::_elem::port_ens_r_obj_sensor_base::_::_m_movObjectInformation::_2_::STA_OBJECT_INFORMATION_ST::_::_m_ohyObjectType_st::_m_probObstacle_st::_m_probStationary_st::_m_prob1UnknownN = 0;
        @sysvar::XCP::RadarFR::_g_PlReCoFw_PlReCoPer_ObjBypassingRunnable_ObjBypassingRunnable_m_pad_radarObjPort_par_out_local::TChangeableMemPool::_::_::_m_arrayPool::_0_::_elem::port_ens_r_obj_sensor_base::_::_m_movObjectInformation::_2_::_m_dLengthN = 64;
        @sysvar::XCP::RadarFR::_g_PlReCoFw_PlReCoPer_ObjBypassingRunnable_ObjBypassingRunnable_m_pad_radarObjPort_par_out_local::TChangeableMemPool::_::_::_m_arrayPool::_0_::_elem::port_ens_r_obj_sensor_base::_::_m_movObjectInformation::_2_::_m_dWidthN = @Classe_Obj_Sim::obj_data.obj_width[2] * 128;
        break;
    }
    break;

    case 3: //"Object-3"
    //constant
    @sysvar::XCP::RadarFR::_g_PlReCoFw_PlReCoPer_ObjBypassingRunnable_ObjBypassingRunnable_m_pad_radarObjPort_par_out_local::TChangeableMemPool::_::_::_m_arrayPool::_0_::_elem::port_ens_r_obj_sensor_base::_::_m_movObjectInformation::_3_::STA_OBJECT_INFORMATION_ST::_::_Meas_b = 1;
    @sysvar::XCP::RadarFR::_g_PlReCoFw_PlReCoPer_ObjBypassingRunnable_ObjBypassingRunnable_m_pad_radarObjPort_par_out_local::TChangeableMemPool::_::_::_m_arrayPool::_0_::_elem::port_ens_r_obj_sensor_base::_::_m_movObjectInformation::_3_::STA_OBJECT_INFORMATION_ST::_::_Measurable_b = 1;
    @sysvar::XCP::RadarFR::_g_PlReCoFw_PlReCoPer_ObjBypassingRunnable_ObjBypassingRunnable_m_pad_radarObjPort_par_out_local::TChangeableMemPool::_::_::_m_arrayPool::_0_::_elem::port_ens_r_obj_sensor_base::_::_m_movObjectInformation::_3_::STA_OBJECT_INFORMATION_ST::_::_Valid_b = 1;
    @sysvar::XCP::RadarFR::_g_PlReCoFw_PlReCoPer_ObjBypassingRunnable_ObjBypassingRunnable_m_pad_radarObjPort_par_out_local::TChangeableMemPool::_::_::_m_arrayPool::_0_::_elem::port_ens_r_obj_sensor_base::_::_m_movObjectInformation::_3_::_m_covarDxAxN = 0;
    @sysvar::XCP::RadarFR::_g_PlReCoFw_PlReCoPer_ObjBypassingRunnable_ObjBypassingRunnable_m_pad_radarObjPort_par_out_local::TChangeableMemPool::_::_::_m_arrayPool::_0_::_elem::port_ens_r_obj_sensor_base::_::_m_movObjectInformation::_3_::_m_covarDxVxN = 0;
    @sysvar::XCP::RadarFR::_g_PlReCoFw_PlReCoPer_ObjBypassingRunnable_ObjBypassingRunnable_m_pad_radarObjPort_par_out_local::TChangeableMemPool::_::_::_m_arrayPool::_0_::_elem::port_ens_r_obj_sensor_base::_::_m_movObjectInformation::_3_::_m_covarDyVyN = 0;
    @sysvar::XCP::RadarFR::_g_PlReCoFw_PlReCoPer_ObjBypassingRunnable_ObjBypassingRunnable_m_pad_radarObjPort_par_out_local::TChangeableMemPool::_::_::_m_arrayPool::_0_::_elem::port_ens_r_obj_sensor_base::_::_m_movObjectInformation::_3_::_m_covarDyWidthN = 0;
    @sysvar::XCP::RadarFR::_g_PlReCoFw_PlReCoPer_ObjBypassingRunnable_ObjBypassingRunnable_m_pad_radarObjPort_par_out_local::TChangeableMemPool::_::_::_m_arrayPool::_0_::_elem::port_ens_r_obj_sensor_base::_::_m_movObjectInformation::_3_::_m_covarVxAxN = 0;
    @sysvar::XCP::RadarFR::_g_PlReCoFw_PlReCoPer_ObjBypassingRunnable_ObjBypassingRunnable_m_pad_radarObjPort_par_out_local::TChangeableMemPool::_::_::_m_arrayPool::_0_::_elem::port_ens_r_obj_sensor_base::_::_m_movObjectInformation::_3_::_m_varAxN = 0;
    @sysvar::XCP::RadarFR::_g_PlReCoFw_PlReCoPer_ObjBypassingRunnable_ObjBypassingRunnable_m_pad_radarObjPort_par_out_local::TChangeableMemPool::_::_::_m_arrayPool::_0_::_elem::port_ens_r_obj_sensor_base::_::_m_movObjectInformation::_3_::_m_varAyN = 0;
    @sysvar::XCP::RadarFR::_g_PlReCoFw_PlReCoPer_ObjBypassingRunnable_ObjBypassingRunnable_m_pad_radarObjPort_par_out_local::TChangeableMemPool::_::_::_m_arrayPool::_0_::_elem::port_ens_r_obj_sensor_base::_::_m_movObjectInformation::_3_::_m_varVxN = 0;
    @sysvar::XCP::RadarFR::_g_PlReCoFw_PlReCoPer_ObjBypassingRunnable_ObjBypassingRunnable_m_pad_radarObjPort_par_out_local::TChangeableMemPool::_::_::_m_arrayPool::_0_::_elem::port_ens_r_obj_sensor_base::_::_m_movObjectInformation::_3_::_m_varVyN = 0;
    @sysvar::XCP::RadarFR::_g_PlReCoFw_PlReCoPer_ObjBypassingRunnable_ObjBypassingRunnable_m_pad_radarObjPort_par_out_local::TChangeableMemPool::_::_::_m_arrayPool::_0_::_elem::port_ens_r_obj_sensor_base::_::_m_movObjectInformation::_3_::STA_OBJECT_INFORMATION_ST::_::_m_varDxN = 0;
    @sysvar::XCP::RadarFR::_g_PlReCoFw_PlReCoPer_ObjBypassingRunnable_ObjBypassingRunnable_m_pad_radarObjPort_par_out_local::TChangeableMemPool::_::_::_m_arrayPool::_0_::_elem::port_ens_r_obj_sensor_base::_::_m_movObjectInformation::_3_::STA_OBJECT_INFORMATION_ST::_::_m_varDyN = 0;
    @sysvar::XCP::RadarFR::_g_PlReCoFw_PlReCoPer_ObjBypassingRunnable_ObjBypassingRunnable_m_pad_radarObjPort_par_out_local::TChangeableMemPool::_::_::_m_arrayPool::_0_::_elem::port_ens_r_obj_sensor_base::_::_m_movObjectInformation::_3_::_m_dVarLengthN = 0;
    @sysvar::XCP::RadarFR::_g_PlReCoFw_PlReCoPer_ObjBypassingRunnable_ObjBypassingRunnable_m_pad_radarObjPort_par_out_local::TChangeableMemPool::_::_::_m_arrayPool::_0_::_elem::port_ens_r_obj_sensor_base::_::_m_movObjectInformation::_3_::_m_dVarWidthN = 0;
    @sysvar::XCP::RadarFR::_g_PlReCoFw_PlReCoPer_ObjBypassingRunnable_ObjBypassingRunnable_m_pad_radarObjPort_par_out_local::TChangeableMemPool::_::_::_m_arrayPool::_0_::_elem::port_ens_r_obj_sensor_base::_::_m_movObjectInformation::_3_::STA_OBJECT_INFORMATION_ST::_::_m_wExistProbN = 64880;
    @sysvar::XCP::RadarFR::_g_PlReCoFw_PlReCoPer_ObjBypassingRunnable_ObjBypassingRunnable_m_pad_radarObjPort_par_out_local::TChangeableMemPool::_::_::_m_arrayPool::_0_::_elem::port_ens_r_obj_sensor_base::_::_m_movObjectInformation::_3_::_m_referencePtPosIndexN = 10;
    @sysvar::XCP::RadarFR::_g_PlReCoFw_PlReCoPer_ObjBypassingRunnable_ObjBypassingRunnable_m_pad_radarObjPort_par_out_local::TChangeableMemPool::_::_::_m_arrayPool::_0_::_elem::port_ens_r_obj_sensor_base::_::_m_movObjectInformation::_3_::_m_alpPiVarYawAngleN = 0;
    @sysvar::XCP::RadarFR::_g_PlReCoFw_PlReCoPer_ObjBypassingRunnable_ObjBypassingRunnable_m_pad_radarObjPort_par_out_local::TChangeableMemPool::_::_::_m_arrayPool::_0_::_elem::port_ens_r_obj_sensor_base::_::_m_movObjectInformation::_3_::_m_alpPiYawAngleN = 0;

    //target movement

    @sysvar::XCP::RadarFR::_g_PlReCoFw_PlReCoPer_ObjBypassingRunnable_ObjBypassingRunnable_m_pad_radarObjPort_par_out_local::TChangeableMemPool::_::_::_m_arrayPool::_0_::_elem::port_ens_r_obj_sensor_base::_::_m_movObjectInformation::_3_::STA_OBJECT_INFORMATION_ST::_::_m_dxN = @Classe_Obj_Sim::obj_data.obj_dx[3] * 128;
    @sysvar::XCP::RadarFR::_g_PlReCoFw_PlReCoPer_ObjBypassingRunnable_ObjBypassingRunnable_m_pad_radarObjPort_par_out_local::TChangeableMemPool::_::_::_m_arrayPool::_0_::_elem::port_ens_r_obj_sensor_base::_::_m_movObjectInformation::_3_::STA_OBJECT_INFORMATION_ST::_::_m_dyN = @Classe_Obj_Sim::obj_data.obj_dy[3] * 128;
    @sysvar::XCP::RadarFR::_g_PlReCoFw_PlReCoPer_ObjBypassingRunnable_ObjBypassingRunnable_m_pad_radarObjPort_par_out_local::TChangeableMemPool::_::_::_m_arrayPool::_0_::_elem::port_ens_r_obj_sensor_base::_::_m_movObjectInformation::_3_::STA_OBJECT_INFORMATION_ST::_::_m_dzN = 0;
    @sysvar::XCP::RadarFR::_g_PlReCoFw_PlReCoPer_ObjBypassingRunnable_ObjBypassingRunnable_m_pad_radarObjPort_par_out_local::TChangeableMemPool::_::_::_m_arrayPool::_0_::_elem::port_ens_r_obj_sensor_base::_::_m_movObjectInformation::_3_::_m_vxN = @Classe_Obj_Sim::obj_data.obj_relative_vx[3] * 256;
    @sysvar::XCP::RadarFR::_g_PlReCoFw_PlReCoPer_ObjBypassingRunnable_ObjBypassingRunnable_m_pad_radarObjPort_par_out_local::TChangeableMemPool::_::_::_m_arrayPool::_0_::_elem::port_ens_r_obj_sensor_base::_::_m_movObjectInformation::_3_::_m_vyN = @Classe_Obj_Sim::obj_data.obj_relative_vy[3] * 256;
    @sysvar::XCP::RadarFR::_g_PlReCoFw_PlReCoPer_ObjBypassingRunnable_ObjBypassingRunnable_m_pad_radarObjPort_par_out_local::TChangeableMemPool::_::_::_m_arrayPool::_0_::_elem::port_ens_r_obj_sensor_base::_::_m_movObjectInformation::_3_::_m_axN = 0;
    @sysvar::XCP::RadarFR::_g_PlReCoFw_PlReCoPer_ObjBypassingRunnable_ObjBypassingRunnable_m_pad_radarObjPort_par_out_local::TChangeableMemPool::_::_::_m_arrayPool::_0_::_elem::port_ens_r_obj_sensor_base::_::_m_movObjectInformation::_3_::_m_ayN = 0;

    //target object moving or not
    if (abs(@Classe_Obj_Sim::obj_data.obj_relative_vx[3]) != 0)
    {
      @sysvar::XCP::RadarFR::_g_PlReCoFw_PlReCoPer_ObjBypassingRunnable_ObjBypassingRunnable_m_pad_radarObjPort_par_out_local::TChangeableMemPool::_::_::_m_arrayPool::_0_::_elem::port_ens_r_obj_sensor_base::_::_m_movObjectInformation::_3_::STA_OBJECT_INFORMATION_ST::_::_m_prob1HasBeenObservedMovingN = 126;
      @sysvar::XCP::RadarFR::_g_PlReCoFw_PlReCoPer_ObjBypassingRunnable_ObjBypassingRunnable_m_pad_radarObjPort_par_out_local::TChangeableMemPool::_::_::_m_arrayPool::_0_::_elem::port_ens_r_obj_sensor_base::_::_m_movObjectInformation::_3_::STA_OBJECT_INFORMATION_ST::_::_m_prob1MovingN = 126;
      @sysvar::XCP::RadarFR::_g_PlReCoFw_PlReCoPer_ObjBypassingRunnable_ObjBypassingRunnable_m_pad_radarObjPort_par_out_local::TChangeableMemPool::_::_::_m_arrayPool::_0_::_elem::port_ens_r_obj_sensor_base::_::_m_movObjectInformation::_3_::STA_OBJECT_INFORMATION_ST::_::_m_ohyObjectType_st::_m_probObstacle_st::_m_prob1MobileN = 128;
      @sysvar::XCP::RadarFR::_g_PlReCoFw_PlReCoPer_ObjBypassingRunnable_ObjBypassingRunnable_m_pad_radarObjPort_par_out_local::TChangeableMemPool::_::_::_m_arrayPool::_0_::_elem::port_ens_r_obj_sensor_base::_::_m_movObjectInformation::_3_::STA_OBJECT_INFORMATION_ST::_::_m_ohyObjectType_st::_m_probObstacle_st::_m_prob1StationaryN = 0;
    }
    else
    {
      @sysvar::XCP::RadarFR::_g_PlReCoFw_PlReCoPer_ObjBypassingRunnable_ObjBypassingRunnable_m_pad_radarObjPort_par_out_local::TChangeableMemPool::_::_::_m_arrayPool::_0_::_elem::port_ens_r_obj_sensor_base::_::_m_movObjectInformation::_3_::STA_OBJECT_INFORMATION_ST::_::_m_prob1HasBeenObservedMovingN = 0;
      @sysvar::XCP::RadarFR::_g_PlReCoFw_PlReCoPer_ObjBypassingRunnable_ObjBypassingRunnable_m_pad_radarObjPort_par_out_local::TChangeableMemPool::_::_::_m_arrayPool::_0_::_elem::port_ens_r_obj_sensor_base::_::_m_movObjectInformation::_3_::STA_OBJECT_INFORMATION_ST::_::_m_prob1MovingN = 0;
      @sysvar::XCP::RadarFR::_g_PlReCoFw_PlReCoPer_ObjBypassingRunnable_ObjBypassingRunnable_m_pad_radarObjPort_par_out_local::TChangeableMemPool::_::_::_m_arrayPool::_0_::_elem::port_ens_r_obj_sensor_base::_::_m_movObjectInformation::_3_::STA_OBJECT_INFORMATION_ST::_::_m_ohyObjectType_st::_m_probObstacle_st::_m_prob1MobileN = 0;
      @sysvar::XCP::RadarFR::_g_PlReCoFw_PlReCoPer_ObjBypassingRunnable_ObjBypassingRunnable_m_pad_radarObjPort_par_out_local::TChangeableMemPool::_::_::_m_arrayPool::_0_::_elem::port_ens_r_obj_sensor_base::_::_m_movObjectInformation::_3_::STA_OBJECT_INFORMATION_ST::_::_m_ohyObjectType_st::_m_probObstacle_st::_m_prob1StationaryN = 128;
    }

      //object classification
    switch (@Classe_Obj_Sim::obj_data.obj_type[3])
    {
      case 0: //"Non-Obstacle"
        @sysvar::XCP::RadarFR::_g_PlReCoFw_PlReCoPer_ObjBypassingRunnable_ObjBypassingRunnable_m_pad_radarObjPort_par_out_local::TChangeableMemPool::_::_::_m_arrayPool::_0_::_elem::port_ens_r_obj_sensor_base::_::_m_movObjectInformation::_3_::STA_OBJECT_INFORMATION_ST::_::_m_ohyObjectType_st::_m_prob1NonObstacleN = 128;
        @sysvar::XCP::RadarFR::_g_PlReCoFw_PlReCoPer_ObjBypassingRunnable_ObjBypassingRunnable_m_pad_radarObjPort_par_out_local::TChangeableMemPool::_::_::_m_arrayPool::_0_::_elem::port_ens_r_obj_sensor_base::_::_m_movObjectInformation::_3_::STA_OBJECT_INFORMATION_ST::_::_m_ohyObjectType_st::_m_prob1ObstacleN = 0;
        @sysvar::XCP::RadarFR::_g_PlReCoFw_PlReCoPer_ObjBypassingRunnable_ObjBypassingRunnable_m_pad_radarObjPort_par_out_local::TChangeableMemPool::_::_::_m_arrayPool::_0_::_elem::port_ens_r_obj_sensor_base::_::_m_movObjectInformation::_3_::STA_OBJECT_INFORMATION_ST::_::_m_ohyObjectType_st::_m_prob1UnknownN = 0;
        @sysvar::XCP::RadarFR::_g_PlReCoFw_PlReCoPer_ObjBypassingRunnable_ObjBypassingRunnable_m_pad_radarObjPort_par_out_local::TChangeableMemPool::_::_::_m_arrayPool::_0_::_elem::port_ens_r_obj_sensor_base::_::_m_movObjectInformation::_3_::STA_OBJECT_INFORMATION_ST::_::_m_ohyObjectType_st::_m_probObstacle_st::_m_prob1UnknownN = 128;
        @sysvar::XCP::RadarFR::_g_PlReCoFw_PlReCoPer_ObjBypassingRunnable_ObjBypassingRunnable_m_pad_radarObjPort_par_out_local::TChangeableMemPool::_::_::_m_arrayPool::_0_::_elem::port_ens_r_obj_sensor_base::_::_m_movObjectInformation::_3_::STA_OBJECT_INFORMATION_ST::_::_m_ohyObjectType_st::_m_probObstacle_st::_m_probMobile_st::_m_prob1FourPlusWheelerN = 0;
        @sysvar::XCP::RadarFR::_g_PlReCoFw_PlReCoPer_ObjBypassingRunnable_ObjBypassingRunnable_m_pad_radarObjPort_par_out_local::TChangeableMemPool::_::_::_m_arrayPool::_0_::_elem::port_ens_r_obj_sensor_base::_::_m_movObjectInformation::_3_::STA_OBJECT_INFORMATION_ST::_::_m_ohyObjectType_st::_m_probObstacle_st::_m_probMobile_st::_m_prob1PedestrianN = 0;
        @sysvar::XCP::RadarFR::_g_PlReCoFw_PlReCoPer_ObjBypassingRunnable_ObjBypassingRunnable_m_pad_radarObjPort_par_out_local::TChangeableMemPool::_::_::_m_arrayPool::_0_::_elem::port_ens_r_obj_sensor_base::_::_m_movObjectInformation::_3_::STA_OBJECT_INFORMATION_ST::_::_m_ohyObjectType_st::_m_probObstacle_st::_m_probMobile_st::_m_prob1TwoWheelerN = 0;
        @sysvar::XCP::RadarFR::_g_PlReCoFw_PlReCoPer_ObjBypassingRunnable_ObjBypassingRunnable_m_pad_radarObjPort_par_out_local::TChangeableMemPool::_::_::_m_arrayPool::_0_::_elem::port_ens_r_obj_sensor_base::_::_m_movObjectInformation::_3_::STA_OBJECT_INFORMATION_ST::_::_m_ohyObjectType_st::_m_probObstacle_st::_m_probMobile_st::_m_prob1UnknownN = 128;
        @sysvar::XCP::RadarFR::_g_PlReCoFw_PlReCoPer_ObjBypassingRunnable_ObjBypassingRunnable_m_pad_radarObjPort_par_out_local::TChangeableMemPool::_::_::_m_arrayPool::_0_::_elem::port_ens_r_obj_sensor_base::_::_m_movObjectInformation::_3_::STA_OBJECT_INFORMATION_ST::_::_m_ohyObjectType_st::_m_probObstacle_st::_m_probMobile_st::_m_probFourPlusWheeler_st::_m_prob1PassengerCarN = 0;
        @sysvar::XCP::RadarFR::_g_PlReCoFw_PlReCoPer_ObjBypassingRunnable_ObjBypassingRunnable_m_pad_radarObjPort_par_out_local::TChangeableMemPool::_::_::_m_arrayPool::_0_::_elem::port_ens_r_obj_sensor_base::_::_m_movObjectInformation::_3_::STA_OBJECT_INFORMATION_ST::_::_m_ohyObjectType_st::_m_probObstacle_st::_m_probMobile_st::_m_probFourPlusWheeler_st::_m_prob1TruckN = 0;
        @sysvar::XCP::RadarFR::_g_PlReCoFw_PlReCoPer_ObjBypassingRunnable_ObjBypassingRunnable_m_pad_radarObjPort_par_out_local::TChangeableMemPool::_::_::_m_arrayPool::_0_::_elem::port_ens_r_obj_sensor_base::_::_m_movObjectInformation::_3_::STA_OBJECT_INFORMATION_ST::_::_m_ohyObjectType_st::_m_probObstacle_st::_m_probMobile_st::_m_probFourPlusWheeler_st::_m_prob1UnknownN = 128;
        @sysvar::XCP::RadarFR::_g_PlReCoFw_PlReCoPer_ObjBypassingRunnable_ObjBypassingRunnable_m_pad_radarObjPort_par_out_local::TChangeableMemPool::_::_::_m_arrayPool::_0_::_elem::port_ens_r_obj_sensor_base::_::_m_movObjectInformation::_3_::STA_OBJECT_INFORMATION_ST::_::_m_ohyObjectType_st::_m_probObstacle_st::_m_probStationary_st::_m_prob1RoadsideBarrierN = 0;
        @sysvar::XCP::RadarFR::_g_PlReCoFw_PlReCoPer_ObjBypassingRunnable_ObjBypassingRunnable_m_pad_radarObjPort_par_out_local::TChangeableMemPool::_::_::_m_arrayPool::_0_::_elem::port_ens_r_obj_sensor_base::_::_m_movObjectInformation::_3_::STA_OBJECT_INFORMATION_ST::_::_m_ohyObjectType_st::_m_probObstacle_st::_m_probStationary_st::_m_prob1UnknownN = 128;
        @sysvar::XCP::RadarFR::_g_PlReCoFw_PlReCoPer_ObjBypassingRunnable_ObjBypassingRunnable_m_pad_radarObjPort_par_out_local::TChangeableMemPool::_::_::_m_arrayPool::_0_::_elem::port_ens_r_obj_sensor_base::_::_m_movObjectInformation::_3_::_m_dLengthN = 64;
        @sysvar::XCP::RadarFR::_g_PlReCoFw_PlReCoPer_ObjBypassingRunnable_ObjBypassingRunnable_m_pad_radarObjPort_par_out_local::TChangeableMemPool::_::_::_m_arrayPool::_0_::_elem::port_ens_r_obj_sensor_base::_::_m_movObjectInformation::_3_::_m_dWidthN = @Classe_Obj_Sim::obj_data.obj_width[3] * 128;
        break;

      case 1: //"unknown"
        @sysvar::XCP::RadarFR::_g_PlReCoFw_PlReCoPer_ObjBypassingRunnable_ObjBypassingRunnable_m_pad_radarObjPort_par_out_local::TChangeableMemPool::_::_::_m_arrayPool::_0_::_elem::port_ens_r_obj_sensor_base::_::_m_movObjectInformation::_3_::STA_OBJECT_INFORMATION_ST::_::_m_ohyObjectType_st::_m_prob1NonObstacleN = 0;
        @sysvar::XCP::RadarFR::_g_PlReCoFw_PlReCoPer_ObjBypassingRunnable_ObjBypassingRunnable_m_pad_radarObjPort_par_out_local::TChangeableMemPool::_::_::_m_arrayPool::_0_::_elem::port_ens_r_obj_sensor_base::_::_m_movObjectInformation::_3_::STA_OBJECT_INFORMATION_ST::_::_m_ohyObjectType_st::_m_prob1ObstacleN = 0;
        @sysvar::XCP::RadarFR::_g_PlReCoFw_PlReCoPer_ObjBypassingRunnable_ObjBypassingRunnable_m_pad_radarObjPort_par_out_local::TChangeableMemPool::_::_::_m_arrayPool::_0_::_elem::port_ens_r_obj_sensor_base::_::_m_movObjectInformation::_3_::STA_OBJECT_INFORMATION_ST::_::_m_ohyObjectType_st::_m_prob1UnknownN = 128;
        @sysvar::XCP::RadarFR::_g_PlReCoFw_PlReCoPer_ObjBypassingRunnable_ObjBypassingRunnable_m_pad_radarObjPort_par_out_local::TChangeableMemPool::_::_::_m_arrayPool::_0_::_elem::port_ens_r_obj_sensor_base::_::_m_movObjectInformation::_3_::STA_OBJECT_INFORMATION_ST::_::_m_ohyObjectType_st::_m_probObstacle_st::_m_prob1UnknownN = 128;
        @sysvar::XCP::RadarFR::_g_PlReCoFw_PlReCoPer_ObjBypassingRunnable_ObjBypassingRunnable_m_pad_radarObjPort_par_out_local::TChangeableMemPool::_::_::_m_arrayPool::_0_::_elem::port_ens_r_obj_sensor_base::_::_m_movObjectInformation::_3_::STA_OBJECT_INFORMATION_ST::_::_m_ohyObjectType_st::_m_probObstacle_st::_m_probMobile_st::_m_prob1FourPlusWheelerN = 0;
        @sysvar::XCP::RadarFR::_g_PlReCoFw_PlReCoPer_ObjBypassingRunnable_ObjBypassingRunnable_m_pad_radarObjPort_par_out_local::TChangeableMemPool::_::_::_m_arrayPool::_0_::_elem::port_ens_r_obj_sensor_base::_::_m_movObjectInformation::_3_::STA_OBJECT_INFORMATION_ST::_::_m_ohyObjectType_st::_m_probObstacle_st::_m_probMobile_st::_m_prob1PedestrianN = 0;
        @sysvar::XCP::RadarFR::_g_PlReCoFw_PlReCoPer_ObjBypassingRunnable_ObjBypassingRunnable_m_pad_radarObjPort_par_out_local::TChangeableMemPool::_::_::_m_arrayPool::_0_::_elem::port_ens_r_obj_sensor_base::_::_m_movObjectInformation::_3_::STA_OBJECT_INFORMATION_ST::_::_m_ohyObjectType_st::_m_probObstacle_st::_m_probMobile_st::_m_prob1TwoWheelerN = 0;
        @sysvar::XCP::RadarFR::_g_PlReCoFw_PlReCoPer_ObjBypassingRunnable_ObjBypassingRunnable_m_pad_radarObjPort_par_out_local::TChangeableMemPool::_::_::_m_arrayPool::_0_::_elem::port_ens_r_obj_sensor_base::_::_m_movObjectInformation::_3_::STA_OBJECT_INFORMATION_ST::_::_m_ohyObjectType_st::_m_probObstacle_st::_m_probMobile_st::_m_prob1UnknownN = 128;
        @sysvar::XCP::RadarFR::_g_PlReCoFw_PlReCoPer_ObjBypassingRunnable_ObjBypassingRunnable_m_pad_radarObjPort_par_out_local::TChangeableMemPool::_::_::_m_arrayPool::_0_::_elem::port_ens_r_obj_sensor_base::_::_m_movObjectInformation::_3_::STA_OBJECT_INFORMATION_ST::_::_m_ohyObjectType_st::_m_probObstacle_st::_m_probMobile_st::_m_probFourPlusWheeler_st::_m_prob1PassengerCarN = 0;
        @sysvar::XCP::RadarFR::_g_PlReCoFw_PlReCoPer_ObjBypassingRunnable_ObjBypassingRunnable_m_pad_radarObjPort_par_out_local::TChangeableMemPool::_::_::_m_arrayPool::_0_::_elem::port_ens_r_obj_sensor_base::_::_m_movObjectInformation::_3_::STA_OBJECT_INFORMATION_ST::_::_m_ohyObjectType_st::_m_probObstacle_st::_m_probMobile_st::_m_probFourPlusWheeler_st::_m_prob1TruckN = 0;
        @sysvar::XCP::RadarFR::_g_PlReCoFw_PlReCoPer_ObjBypassingRunnable_ObjBypassingRunnable_m_pad_radarObjPort_par_out_local::TChangeableMemPool::_::_::_m_arrayPool::_0_::_elem::port_ens_r_obj_sensor_base::_::_m_movObjectInformation::_3_::STA_OBJECT_INFORMATION_ST::_::_m_ohyObjectType_st::_m_probObstacle_st::_m_probMobile_st::_m_probFourPlusWheeler_st::_m_prob1UnknownN = 128;
        @sysvar::XCP::RadarFR::_g_PlReCoFw_PlReCoPer_ObjBypassingRunnable_ObjBypassingRunnable_m_pad_radarObjPort_par_out_local::TChangeableMemPool::_::_::_m_arrayPool::_0_::_elem::port_ens_r_obj_sensor_base::_::_m_movObjectInformation::_3_::STA_OBJECT_INFORMATION_ST::_::_m_ohyObjectType_st::_m_probObstacle_st::_m_probStationary_st::_m_prob1RoadsideBarrierN = 0;
        @sysvar::XCP::RadarFR::_g_PlReCoFw_PlReCoPer_ObjBypassingRunnable_ObjBypassingRunnable_m_pad_radarObjPort_par_out_local::TChangeableMemPool::_::_::_m_arrayPool::_0_::_elem::port_ens_r_obj_sensor_base::_::_m_movObjectInformation::_3_::STA_OBJECT_INFORMATION_ST::_::_m_ohyObjectType_st::_m_probObstacle_st::_m_probStationary_st::_m_prob1UnknownN = 128;
        @sysvar::XCP::RadarFR::_g_PlReCoFw_PlReCoPer_ObjBypassingRunnable_ObjBypassingRunnable_m_pad_radarObjPort_par_out_local::TChangeableMemPool::_::_::_m_arrayPool::_0_::_elem::port_ens_r_obj_sensor_base::_::_m_movObjectInformation::_3_::_m_dLengthN = 0;
        @sysvar::XCP::RadarFR::_g_PlReCoFw_PlReCoPer_ObjBypassingRunnable_ObjBypassingRunnable_m_pad_radarObjPort_par_out_local::TChangeableMemPool::_::_::_m_arrayPool::_0_::_elem::port_ens_r_obj_sensor_base::_::_m_movObjectInformation::_3_::_m_dWidthN = @Classe_Obj_Sim::obj_data.obj_width[3] * 128;
        break;

      case 2: //"RoadSideBarrier"
        @sysvar::XCP::RadarFR::_g_PlReCoFw_PlReCoPer_ObjBypassingRunnable_ObjBypassingRunnable_m_pad_radarObjPort_par_out_local::TChangeableMemPool::_::_::_m_arrayPool::_0_::_elem::port_ens_r_obj_sensor_base::_::_m_movObjectInformation::_3_::STA_OBJECT_INFORMATION_ST::_::_m_ohyObjectType_st::_m_prob1NonObstacleN = 0;
        @sysvar::XCP::RadarFR::_g_PlReCoFw_PlReCoPer_ObjBypassingRunnable_ObjBypassingRunnable_m_pad_radarObjPort_par_out_local::TChangeableMemPool::_::_::_m_arrayPool::_0_::_elem::port_ens_r_obj_sensor_base::_::_m_movObjectInformation::_3_::STA_OBJECT_INFORMATION_ST::_::_m_ohyObjectType_st::_m_prob1ObstacleN = 128;
        @sysvar::XCP::RadarFR::_g_PlReCoFw_PlReCoPer_ObjBypassingRunnable_ObjBypassingRunnable_m_pad_radarObjPort_par_out_local::TChangeableMemPool::_::_::_m_arrayPool::_0_::_elem::port_ens_r_obj_sensor_base::_::_m_movObjectInformation::_3_::STA_OBJECT_INFORMATION_ST::_::_m_ohyObjectType_st::_m_prob1UnknownN = 0;
        @sysvar::XCP::RadarFR::_g_PlReCoFw_PlReCoPer_ObjBypassingRunnable_ObjBypassingRunnable_m_pad_radarObjPort_par_out_local::TChangeableMemPool::_::_::_m_arrayPool::_0_::_elem::port_ens_r_obj_sensor_base::_::_m_movObjectInformation::_3_::STA_OBJECT_INFORMATION_ST::_::_m_ohyObjectType_st::_m_probObstacle_st::_m_prob1MobileN = 0;
        @sysvar::XCP::RadarFR::_g_PlReCoFw_PlReCoPer_ObjBypassingRunnable_ObjBypassingRunnable_m_pad_radarObjPort_par_out_local::TChangeableMemPool::_::_::_m_arrayPool::_0_::_elem::port_ens_r_obj_sensor_base::_::_m_movObjectInformation::_3_::STA_OBJECT_INFORMATION_ST::_::_m_ohyObjectType_st::_m_probObstacle_st::_m_prob1StationaryN = 128;
        @sysvar::XCP::RadarFR::_g_PlReCoFw_PlReCoPer_ObjBypassingRunnable_ObjBypassingRunnable_m_pad_radarObjPort_par_out_local::TChangeableMemPool::_::_::_m_arrayPool::_0_::_elem::port_ens_r_obj_sensor_base::_::_m_movObjectInformation::_3_::STA_OBJECT_INFORMATION_ST::_::_m_ohyObjectType_st::_m_probObstacle_st::_m_prob1UnknownN = 0;
        @sysvar::XCP::RadarFR::_g_PlReCoFw_PlReCoPer_ObjBypassingRunnable_ObjBypassingRunnable_m_pad_radarObjPort_par_out_local::TChangeableMemPool::_::_::_m_arrayPool::_0_::_elem::port_ens_r_obj_sensor_base::_::_m_movObjectInformation::_3_::STA_OBJECT_INFORMATION_ST::_::_m_ohyObjectType_st::_m_probObstacle_st::_m_probMobile_st::_m_prob1FourPlusWheelerN = 0;
        @sysvar::XCP::RadarFR::_g_PlReCoFw_PlReCoPer_ObjBypassingRunnable_ObjBypassingRunnable_m_pad_radarObjPort_par_out_local::TChangeableMemPool::_::_::_m_arrayPool::_0_::_elem::port_ens_r_obj_sensor_base::_::_m_movObjectInformation::_3_::STA_OBJECT_INFORMATION_ST::_::_m_ohyObjectType_st::_m_probObstacle_st::_m_probMobile_st::_m_prob1PedestrianN = 0;
        @sysvar::XCP::RadarFR::_g_PlReCoFw_PlReCoPer_ObjBypassingRunnable_ObjBypassingRunnable_m_pad_radarObjPort_par_out_local::TChangeableMemPool::_::_::_m_arrayPool::_0_::_elem::port_ens_r_obj_sensor_base::_::_m_movObjectInformation::_3_::STA_OBJECT_INFORMATION_ST::_::_m_ohyObjectType_st::_m_probObstacle_st::_m_probMobile_st::_m_prob1TwoWheelerN = 0;
        @sysvar::XCP::RadarFR::_g_PlReCoFw_PlReCoPer_ObjBypassingRunnable_ObjBypassingRunnable_m_pad_radarObjPort_par_out_local::TChangeableMemPool::_::_::_m_arrayPool::_0_::_elem::port_ens_r_obj_sensor_base::_::_m_movObjectInformation::_3_::STA_OBJECT_INFORMATION_ST::_::_m_ohyObjectType_st::_m_probObstacle_st::_m_probMobile_st::_m_prob1UnknownN = 0;
        @sysvar::XCP::RadarFR::_g_PlReCoFw_PlReCoPer_ObjBypassingRunnable_ObjBypassingRunnable_m_pad_radarObjPort_par_out_local::TChangeableMemPool::_::_::_m_arrayPool::_0_::_elem::port_ens_r_obj_sensor_base::_::_m_movObjectInformation::_3_::STA_OBJECT_INFORMATION_ST::_::_m_ohyObjectType_st::_m_probObstacle_st::_m_probMobile_st::_m_probFourPlusWheeler_st::_m_prob1PassengerCarN = 0;
        @sysvar::XCP::RadarFR::_g_PlReCoFw_PlReCoPer_ObjBypassingRunnable_ObjBypassingRunnable_m_pad_radarObjPort_par_out_local::TChangeableMemPool::_::_::_m_arrayPool::_0_::_elem::port_ens_r_obj_sensor_base::_::_m_movObjectInformation::_3_::STA_OBJECT_INFORMATION_ST::_::_m_ohyObjectType_st::_m_probObstacle_st::_m_probMobile_st::_m_probFourPlusWheeler_st::_m_prob1TruckN = 0;
        @sysvar::XCP::RadarFR::_g_PlReCoFw_PlReCoPer_ObjBypassingRunnable_ObjBypassingRunnable_m_pad_radarObjPort_par_out_local::TChangeableMemPool::_::_::_m_arrayPool::_0_::_elem::port_ens_r_obj_sensor_base::_::_m_movObjectInformation::_3_::STA_OBJECT_INFORMATION_ST::_::_m_ohyObjectType_st::_m_probObstacle_st::_m_probMobile_st::_m_probFourPlusWheeler_st::_m_prob1UnknownN = 0;
        @sysvar::XCP::RadarFR::_g_PlReCoFw_PlReCoPer_ObjBypassingRunnable_ObjBypassingRunnable_m_pad_radarObjPort_par_out_local::TChangeableMemPool::_::_::_m_arrayPool::_0_::_elem::port_ens_r_obj_sensor_base::_::_m_movObjectInformation::_3_::STA_OBJECT_INFORMATION_ST::_::_m_ohyObjectType_st::_m_probObstacle_st::_m_probStationary_st::_m_prob1RoadsideBarrierN = 128;
        @sysvar::XCP::RadarFR::_g_PlReCoFw_PlReCoPer_ObjBypassingRunnable_ObjBypassingRunnable_m_pad_radarObjPort_par_out_local::TChangeableMemPool::_::_::_m_arrayPool::_0_::_elem::port_ens_r_obj_sensor_base::_::_m_movObjectInformation::_3_::STA_OBJECT_INFORMATION_ST::_::_m_ohyObjectType_st::_m_probObstacle_st::_m_probStationary_st::_m_prob1UnknownN = 0;
        @sysvar::XCP::RadarFR::_g_PlReCoFw_PlReCoPer_ObjBypassingRunnable_ObjBypassingRunnable_m_pad_radarObjPort_par_out_local::TChangeableMemPool::_::_::_m_arrayPool::_0_::_elem::port_ens_r_obj_sensor_base::_::_m_movObjectInformation::_3_::_m_dLengthN = 64;
        @sysvar::XCP::RadarFR::_g_PlReCoFw_PlReCoPer_ObjBypassingRunnable_ObjBypassingRunnable_m_pad_radarObjPort_par_out_local::TChangeableMemPool::_::_::_m_arrayPool::_0_::_elem::port_ens_r_obj_sensor_base::_::_m_movObjectInformation::_3_::_m_dWidthN = @Classe_Obj_Sim::obj_data.obj_width[3] * 128;
        break;

      case 3: //"2Wheeler"
        @sysvar::XCP::RadarFR::_g_PlReCoFw_PlReCoPer_ObjBypassingRunnable_ObjBypassingRunnable_m_pad_radarObjPort_par_out_local::TChangeableMemPool::_::_::_m_arrayPool::_0_::_elem::port_ens_r_obj_sensor_base::_::_m_movObjectInformation::_3_::STA_OBJECT_INFORMATION_ST::_::_m_ohyObjectType_st::_m_prob1NonObstacleN = 0;
        @sysvar::XCP::RadarFR::_g_PlReCoFw_PlReCoPer_ObjBypassingRunnable_ObjBypassingRunnable_m_pad_radarObjPort_par_out_local::TChangeableMemPool::_::_::_m_arrayPool::_0_::_elem::port_ens_r_obj_sensor_base::_::_m_movObjectInformation::_3_::STA_OBJECT_INFORMATION_ST::_::_m_ohyObjectType_st::_m_prob1ObstacleN = 128;
        @sysvar::XCP::RadarFR::_g_PlReCoFw_PlReCoPer_ObjBypassingRunnable_ObjBypassingRunnable_m_pad_radarObjPort_par_out_local::TChangeableMemPool::_::_::_m_arrayPool::_0_::_elem::port_ens_r_obj_sensor_base::_::_m_movObjectInformation::_3_::STA_OBJECT_INFORMATION_ST::_::_m_ohyObjectType_st::_m_prob1UnknownN = 0;
        @sysvar::XCP::RadarFR::_g_PlReCoFw_PlReCoPer_ObjBypassingRunnable_ObjBypassingRunnable_m_pad_radarObjPort_par_out_local::TChangeableMemPool::_::_::_m_arrayPool::_0_::_elem::port_ens_r_obj_sensor_base::_::_m_movObjectInformation::_3_::STA_OBJECT_INFORMATION_ST::_::_m_ohyObjectType_st::_m_probObstacle_st::_m_prob1UnknownN = 0;
        @sysvar::XCP::RadarFR::_g_PlReCoFw_PlReCoPer_ObjBypassingRunnable_ObjBypassingRunnable_m_pad_radarObjPort_par_out_local::TChangeableMemPool::_::_::_m_arrayPool::_0_::_elem::port_ens_r_obj_sensor_base::_::_m_movObjectInformation::_3_::STA_OBJECT_INFORMATION_ST::_::_m_ohyObjectType_st::_m_probObstacle_st::_m_probMobile_st::_m_prob1FourPlusWheelerN = 0;
        @sysvar::XCP::RadarFR::_g_PlReCoFw_PlReCoPer_ObjBypassingRunnable_ObjBypassingRunnable_m_pad_radarObjPort_par_out_local::TChangeableMemPool::_::_::_m_arrayPool::_0_::_elem::port_ens_r_obj_sensor_base::_::_m_movObjectInformation::_3_::STA_OBJECT_INFORMATION_ST::_::_m_ohyObjectType_st::_m_probObstacle_st::_m_probMobile_st::_m_prob1PedestrianN = 0;
        @sysvar::XCP::RadarFR::_g_PlReCoFw_PlReCoPer_ObjBypassingRunnable_ObjBypassingRunnable_m_pad_radarObjPort_par_out_local::TChangeableMemPool::_::_::_m_arrayPool::_0_::_elem::port_ens_r_obj_sensor_base::_::_m_movObjectInformation::_3_::STA_OBJECT_INFORMATION_ST::_::_m_ohyObjectType_st::_m_probObstacle_st::_m_probMobile_st::_m_prob1TwoWheelerN = 128;
        @sysvar::XCP::RadarFR::_g_PlReCoFw_PlReCoPer_ObjBypassingRunnable_ObjBypassingRunnable_m_pad_radarObjPort_par_out_local::TChangeableMemPool::_::_::_m_arrayPool::_0_::_elem::port_ens_r_obj_sensor_base::_::_m_movObjectInformation::_3_::STA_OBJECT_INFORMATION_ST::_::_m_ohyObjectType_st::_m_probObstacle_st::_m_probMobile_st::_m_prob1UnknownN = 0;
        @sysvar::XCP::RadarFR::_g_PlReCoFw_PlReCoPer_ObjBypassingRunnable_ObjBypassingRunnable_m_pad_radarObjPort_par_out_local::TChangeableMemPool::_::_::_m_arrayPool::_0_::_elem::port_ens_r_obj_sensor_base::_::_m_movObjectInformation::_3_::STA_OBJECT_INFORMATION_ST::_::_m_ohyObjectType_st::_m_probObstacle_st::_m_probMobile_st::_m_probFourPlusWheeler_st::_m_prob1PassengerCarN = 0;
        @sysvar::XCP::RadarFR::_g_PlReCoFw_PlReCoPer_ObjBypassingRunnable_ObjBypassingRunnable_m_pad_radarObjPort_par_out_local::TChangeableMemPool::_::_::_m_arrayPool::_0_::_elem::port_ens_r_obj_sensor_base::_::_m_movObjectInformation::_3_::STA_OBJECT_INFORMATION_ST::_::_m_ohyObjectType_st::_m_probObstacle_st::_m_probMobile_st::_m_probFourPlusWheeler_st::_m_prob1TruckN = 0;
        @sysvar::XCP::RadarFR::_g_PlReCoFw_PlReCoPer_ObjBypassingRunnable_ObjBypassingRunnable_m_pad_radarObjPort_par_out_local::TChangeableMemPool::_::_::_m_arrayPool::_0_::_elem::port_ens_r_obj_sensor_base::_::_m_movObjectInformation::_3_::STA_OBJECT_INFORMATION_ST::_::_m_ohyObjectType_st::_m_probObstacle_st::_m_probMobile_st::_m_probFourPlusWheeler_st::_m_prob1UnknownN = 128;
        @sysvar::XCP::RadarFR::_g_PlReCoFw_PlReCoPer_ObjBypassingRunnable_ObjBypassingRunnable_m_pad_radarObjPort_par_out_local::TChangeableMemPool::_::_::_m_arrayPool::_0_::_elem::port_ens_r_obj_sensor_base::_::_m_movObjectInformation::_3_::STA_OBJECT_INFORMATION_ST::_::_m_ohyObjectType_st::_m_probObstacle_st::_m_probStationary_st::_m_prob1RoadsideBarrierN = 0;
        @sysvar::XCP::RadarFR::_g_PlReCoFw_PlReCoPer_ObjBypassingRunnable_ObjBypassingRunnable_m_pad_radarObjPort_par_out_local::TChangeableMemPool::_::_::_m_arrayPool::_0_::_elem::port_ens_r_obj_sensor_base::_::_m_movObjectInformation::_3_::STA_OBJECT_INFORMATION_ST::_::_m_ohyObjectType_st::_m_probObstacle_st::_m_probStationary_st::_m_prob1UnknownN = 0;
        @sysvar::XCP::RadarFR::_g_PlReCoFw_PlReCoPer_ObjBypassingRunnable_ObjBypassingRunnable_m_pad_radarObjPort_par_out_local::TChangeableMemPool::_::_::_m_arrayPool::_0_::_elem::port_ens_r_obj_sensor_base::_::_m_movObjectInformation::_3_::_m_dLengthN = 64;
        @sysvar::XCP::RadarFR::_g_PlReCoFw_PlReCoPer_ObjBypassingRunnable_ObjBypassingRunnable_m_pad_radarObjPort_par_out_local::TChangeableMemPool::_::_::_m_arrayPool::_0_::_elem::port_ens_r_obj_sensor_base::_::_m_movObjectInformation::_3_::_m_dWidthN = @Classe_Obj_Sim::obj_data.obj_width[3] * 128;
        break;

      case 4: //"Pedestrian"
        @sysvar::XCP::RadarFR::_g_PlReCoFw_PlReCoPer_ObjBypassingRunnable_ObjBypassingRunnable_m_pad_radarObjPort_par_out_local::TChangeableMemPool::_::_::_m_arrayPool::_0_::_elem::port_ens_r_obj_sensor_base::_::_m_movObjectInformation::_3_::STA_OBJECT_INFORMATION_ST::_::_m_ohyObjectType_st::_m_prob1NonObstacleN = 0;
        @sysvar::XCP::RadarFR::_g_PlReCoFw_PlReCoPer_ObjBypassingRunnable_ObjBypassingRunnable_m_pad_radarObjPort_par_out_local::TChangeableMemPool::_::_::_m_arrayPool::_0_::_elem::port_ens_r_obj_sensor_base::_::_m_movObjectInformation::_3_::STA_OBJECT_INFORMATION_ST::_::_m_ohyObjectType_st::_m_prob1ObstacleN = 128;
        @sysvar::XCP::RadarFR::_g_PlReCoFw_PlReCoPer_ObjBypassingRunnable_ObjBypassingRunnable_m_pad_radarObjPort_par_out_local::TChangeableMemPool::_::_::_m_arrayPool::_0_::_elem::port_ens_r_obj_sensor_base::_::_m_movObjectInformation::_3_::STA_OBJECT_INFORMATION_ST::_::_m_ohyObjectType_st::_m_prob1UnknownN = 0;
        @sysvar::XCP::RadarFR::_g_PlReCoFw_PlReCoPer_ObjBypassingRunnable_ObjBypassingRunnable_m_pad_radarObjPort_par_out_local::TChangeableMemPool::_::_::_m_arrayPool::_0_::_elem::port_ens_r_obj_sensor_base::_::_m_movObjectInformation::_3_::STA_OBJECT_INFORMATION_ST::_::_m_ohyObjectType_st::_m_probObstacle_st::_m_prob1UnknownN = 0;
        @sysvar::XCP::RadarFR::_g_PlReCoFw_PlReCoPer_ObjBypassingRunnable_ObjBypassingRunnable_m_pad_radarObjPort_par_out_local::TChangeableMemPool::_::_::_m_arrayPool::_0_::_elem::port_ens_r_obj_sensor_base::_::_m_movObjectInformation::_3_::STA_OBJECT_INFORMATION_ST::_::_m_ohyObjectType_st::_m_probObstacle_st::_m_probMobile_st::_m_prob1FourPlusWheelerN = 0;
        @sysvar::XCP::RadarFR::_g_PlReCoFw_PlReCoPer_ObjBypassingRunnable_ObjBypassingRunnable_m_pad_radarObjPort_par_out_local::TChangeableMemPool::_::_::_m_arrayPool::_0_::_elem::port_ens_r_obj_sensor_base::_::_m_movObjectInformation::_3_::STA_OBJECT_INFORMATION_ST::_::_m_ohyObjectType_st::_m_probObstacle_st::_m_probMobile_st::_m_prob1PedestrianN = 128;
        @sysvar::XCP::RadarFR::_g_PlReCoFw_PlReCoPer_ObjBypassingRunnable_ObjBypassingRunnable_m_pad_radarObjPort_par_out_local::TChangeableMemPool::_::_::_m_arrayPool::_0_::_elem::port_ens_r_obj_sensor_base::_::_m_movObjectInformation::_3_::STA_OBJECT_INFORMATION_ST::_::_m_ohyObjectType_st::_m_probObstacle_st::_m_probMobile_st::_m_prob1TwoWheelerN = 0;
        @sysvar::XCP::RadarFR::_g_PlReCoFw_PlReCoPer_ObjBypassingRunnable_ObjBypassingRunnable_m_pad_radarObjPort_par_out_local::TChangeableMemPool::_::_::_m_arrayPool::_0_::_elem::port_ens_r_obj_sensor_base::_::_m_movObjectInformation::_3_::STA_OBJECT_INFORMATION_ST::_::_m_ohyObjectType_st::_m_probObstacle_st::_m_probMobile_st::_m_prob1UnknownN = 0;
        @sysvar::XCP::RadarFR::_g_PlReCoFw_PlReCoPer_ObjBypassingRunnable_ObjBypassingRunnable_m_pad_radarObjPort_par_out_local::TChangeableMemPool::_::_::_m_arrayPool::_0_::_elem::port_ens_r_obj_sensor_base::_::_m_movObjectInformation::_3_::STA_OBJECT_INFORMATION_ST::_::_m_ohyObjectType_st::_m_probObstacle_st::_m_probMobile_st::_m_probFourPlusWheeler_st::_m_prob1PassengerCarN = 0;
        @sysvar::XCP::RadarFR::_g_PlReCoFw_PlReCoPer_ObjBypassingRunnable_ObjBypassingRunnable_m_pad_radarObjPort_par_out_local::TChangeableMemPool::_::_::_m_arrayPool::_0_::_elem::port_ens_r_obj_sensor_base::_::_m_movObjectInformation::_3_::STA_OBJECT_INFORMATION_ST::_::_m_ohyObjectType_st::_m_probObstacle_st::_m_probMobile_st::_m_probFourPlusWheeler_st::_m_prob1TruckN = 0;
        @sysvar::XCP::RadarFR::_g_PlReCoFw_PlReCoPer_ObjBypassingRunnable_ObjBypassingRunnable_m_pad_radarObjPort_par_out_local::TChangeableMemPool::_::_::_m_arrayPool::_0_::_elem::port_ens_r_obj_sensor_base::_::_m_movObjectInformation::_3_::STA_OBJECT_INFORMATION_ST::_::_m_ohyObjectType_st::_m_probObstacle_st::_m_probMobile_st::_m_probFourPlusWheeler_st::_m_prob1UnknownN = 128;
        @sysvar::XCP::RadarFR::_g_PlReCoFw_PlReCoPer_ObjBypassingRunnable_ObjBypassingRunnable_m_pad_radarObjPort_par_out_local::TChangeableMemPool::_::_::_m_arrayPool::_0_::_elem::port_ens_r_obj_sensor_base::_::_m_movObjectInformation::_3_::STA_OBJECT_INFORMATION_ST::_::_m_ohyObjectType_st::_m_probObstacle_st::_m_probStationary_st::_m_prob1RoadsideBarrierN = 0;
        @sysvar::XCP::RadarFR::_g_PlReCoFw_PlReCoPer_ObjBypassingRunnable_ObjBypassingRunnable_m_pad_radarObjPort_par_out_local::TChangeableMemPool::_::_::_m_arrayPool::_0_::_elem::port_ens_r_obj_sensor_base::_::_m_movObjectInformation::_3_::STA_OBJECT_INFORMATION_ST::_::_m_ohyObjectType_st::_m_probObstacle_st::_m_probStationary_st::_m_prob1UnknownN = 0;
        @sysvar::XCP::RadarFR::_g_PlReCoFw_PlReCoPer_ObjBypassingRunnable_ObjBypassingRunnable_m_pad_radarObjPort_par_out_local::TChangeableMemPool::_::_::_m_arrayPool::_0_::_elem::port_ens_r_obj_sensor_base::_::_m_movObjectInformation::_3_::_m_dLengthN = 64;
        @sysvar::XCP::RadarFR::_g_PlReCoFw_PlReCoPer_ObjBypassingRunnable_ObjBypassingRunnable_m_pad_radarObjPort_par_out_local::TChangeableMemPool::_::_::_m_arrayPool::_0_::_elem::port_ens_r_obj_sensor_base::_::_m_movObjectInformation::_3_::_m_dWidthN = @Classe_Obj_Sim::obj_data.obj_width[3] * 128;
        break;

      case 5: //"Truck"
        @sysvar::XCP::RadarFR::_g_PlReCoFw_PlReCoPer_ObjBypassingRunnable_ObjBypassingRunnable_m_pad_radarObjPort_par_out_local::TChangeableMemPool::_::_::_m_arrayPool::_0_::_elem::port_ens_r_obj_sensor_base::_::_m_movObjectInformation::_3_::STA_OBJECT_INFORMATION_ST::_::_m_ohyObjectType_st::_m_prob1NonObstacleN = 0;
        @sysvar::XCP::RadarFR::_g_PlReCoFw_PlReCoPer_ObjBypassingRunnable_ObjBypassingRunnable_m_pad_radarObjPort_par_out_local::TChangeableMemPool::_::_::_m_arrayPool::_0_::_elem::port_ens_r_obj_sensor_base::_::_m_movObjectInformation::_3_::STA_OBJECT_INFORMATION_ST::_::_m_ohyObjectType_st::_m_prob1ObstacleN = 128;
        @sysvar::XCP::RadarFR::_g_PlReCoFw_PlReCoPer_ObjBypassingRunnable_ObjBypassingRunnable_m_pad_radarObjPort_par_out_local::TChangeableMemPool::_::_::_m_arrayPool::_0_::_elem::port_ens_r_obj_sensor_base::_::_m_movObjectInformation::_3_::STA_OBJECT_INFORMATION_ST::_::_m_ohyObjectType_st::_m_prob1UnknownN = 0;
        @sysvar::XCP::RadarFR::_g_PlReCoFw_PlReCoPer_ObjBypassingRunnable_ObjBypassingRunnable_m_pad_radarObjPort_par_out_local::TChangeableMemPool::_::_::_m_arrayPool::_0_::_elem::port_ens_r_obj_sensor_base::_::_m_movObjectInformation::_3_::STA_OBJECT_INFORMATION_ST::_::_m_ohyObjectType_st::_m_probObstacle_st::_m_prob1UnknownN = 0;
        @sysvar::XCP::RadarFR::_g_PlReCoFw_PlReCoPer_ObjBypassingRunnable_ObjBypassingRunnable_m_pad_radarObjPort_par_out_local::TChangeableMemPool::_::_::_m_arrayPool::_0_::_elem::port_ens_r_obj_sensor_base::_::_m_movObjectInformation::_3_::STA_OBJECT_INFORMATION_ST::_::_m_ohyObjectType_st::_m_probObstacle_st::_m_probMobile_st::_m_prob1FourPlusWheelerN = 128;
        @sysvar::XCP::RadarFR::_g_PlReCoFw_PlReCoPer_ObjBypassingRunnable_ObjBypassingRunnable_m_pad_radarObjPort_par_out_local::TChangeableMemPool::_::_::_m_arrayPool::_0_::_elem::port_ens_r_obj_sensor_base::_::_m_movObjectInformation::_3_::STA_OBJECT_INFORMATION_ST::_::_m_ohyObjectType_st::_m_probObstacle_st::_m_probMobile_st::_m_prob1PedestrianN = 0;
        @sysvar::XCP::RadarFR::_g_PlReCoFw_PlReCoPer_ObjBypassingRunnable_ObjBypassingRunnable_m_pad_radarObjPort_par_out_local::TChangeableMemPool::_::_::_m_arrayPool::_0_::_elem::port_ens_r_obj_sensor_base::_::_m_movObjectInformation::_3_::STA_OBJECT_INFORMATION_ST::_::_m_ohyObjectType_st::_m_probObstacle_st::_m_probMobile_st::_m_prob1TwoWheelerN = 0;
        @sysvar::XCP::RadarFR::_g_PlReCoFw_PlReCoPer_ObjBypassingRunnable_ObjBypassingRunnable_m_pad_radarObjPort_par_out_local::TChangeableMemPool::_::_::_m_arrayPool::_0_::_elem::port_ens_r_obj_sensor_base::_::_m_movObjectInformation::_3_::STA_OBJECT_INFORMATION_ST::_::_m_ohyObjectType_st::_m_probObstacle_st::_m_probMobile_st::_m_prob1UnknownN = 0;
        @sysvar::XCP::RadarFR::_g_PlReCoFw_PlReCoPer_ObjBypassingRunnable_ObjBypassingRunnable_m_pad_radarObjPort_par_out_local::TChangeableMemPool::_::_::_m_arrayPool::_0_::_elem::port_ens_r_obj_sensor_base::_::_m_movObjectInformation::_3_::STA_OBJECT_INFORMATION_ST::_::_m_ohyObjectType_st::_m_probObstacle_st::_m_probMobile_st::_m_probFourPlusWheeler_st::_m_prob1PassengerCarN = 0;
        @sysvar::XCP::RadarFR::_g_PlReCoFw_PlReCoPer_ObjBypassingRunnable_ObjBypassingRunnable_m_pad_radarObjPort_par_out_local::TChangeableMemPool::_::_::_m_arrayPool::_0_::_elem::port_ens_r_obj_sensor_base::_::_m_movObjectInformation::_3_::STA_OBJECT_INFORMATION_ST::_::_m_ohyObjectType_st::_m_probObstacle_st::_m_probMobile_st::_m_probFourPlusWheeler_st::_m_prob1TruckN = 128;
        @sysvar::XCP::RadarFR::_g_PlReCoFw_PlReCoPer_ObjBypassingRunnable_ObjBypassingRunnable_m_pad_radarObjPort_par_out_local::TChangeableMemPool::_::_::_m_arrayPool::_0_::_elem::port_ens_r_obj_sensor_base::_::_m_movObjectInformation::_3_::STA_OBJECT_INFORMATION_ST::_::_m_ohyObjectType_st::_m_probObstacle_st::_m_probMobile_st::_m_probFourPlusWheeler_st::_m_prob1UnknownN = 0;
        @sysvar::XCP::RadarFR::_g_PlReCoFw_PlReCoPer_ObjBypassingRunnable_ObjBypassingRunnable_m_pad_radarObjPort_par_out_local::TChangeableMemPool::_::_::_m_arrayPool::_0_::_elem::port_ens_r_obj_sensor_base::_::_m_movObjectInformation::_3_::STA_OBJECT_INFORMATION_ST::_::_m_ohyObjectType_st::_m_probObstacle_st::_m_probStationary_st::_m_prob1RoadsideBarrierN = 0;
        @sysvar::XCP::RadarFR::_g_PlReCoFw_PlReCoPer_ObjBypassingRunnable_ObjBypassingRunnable_m_pad_radarObjPort_par_out_local::TChangeableMemPool::_::_::_m_arrayPool::_0_::_elem::port_ens_r_obj_sensor_base::_::_m_movObjectInformation::_3_::STA_OBJECT_INFORMATION_ST::_::_m_ohyObjectType_st::_m_probObstacle_st::_m_probStationary_st::_m_prob1UnknownN = 0;
        @sysvar::XCP::RadarFR::_g_PlReCoFw_PlReCoPer_ObjBypassingRunnable_ObjBypassingRunnable_m_pad_radarObjPort_par_out_local::TChangeableMemPool::_::_::_m_arrayPool::_0_::_elem::port_ens_r_obj_sensor_base::_::_m_movObjectInformation::_3_::_m_dLengthN = 64;
        @sysvar::XCP::RadarFR::_g_PlReCoFw_PlReCoPer_ObjBypassingRunnable_ObjBypassingRunnable_m_pad_radarObjPort_par_out_local::TChangeableMemPool::_::_::_m_arrayPool::_0_::_elem::port_ens_r_obj_sensor_base::_::_m_movObjectInformation::_3_::_m_dWidthN = @Classe_Obj_Sim::obj_data.obj_width[3] * 128;
        break;

      case 6: //"PassengerCar"
        @sysvar::XCP::RadarFR::_g_PlReCoFw_PlReCoPer_ObjBypassingRunnable_ObjBypassingRunnable_m_pad_radarObjPort_par_out_local::TChangeableMemPool::_::_::_m_arrayPool::_0_::_elem::port_ens_r_obj_sensor_base::_::_m_movObjectInformation::_3_::STA_OBJECT_INFORMATION_ST::_::_m_ohyObjectType_st::_m_prob1NonObstacleN = 0;
        @sysvar::XCP::RadarFR::_g_PlReCoFw_PlReCoPer_ObjBypassingRunnable_ObjBypassingRunnable_m_pad_radarObjPort_par_out_local::TChangeableMemPool::_::_::_m_arrayPool::_0_::_elem::port_ens_r_obj_sensor_base::_::_m_movObjectInformation::_3_::STA_OBJECT_INFORMATION_ST::_::_m_ohyObjectType_st::_m_prob1ObstacleN = 128;
        @sysvar::XCP::RadarFR::_g_PlReCoFw_PlReCoPer_ObjBypassingRunnable_ObjBypassingRunnable_m_pad_radarObjPort_par_out_local::TChangeableMemPool::_::_::_m_arrayPool::_0_::_elem::port_ens_r_obj_sensor_base::_::_m_movObjectInformation::_3_::STA_OBJECT_INFORMATION_ST::_::_m_ohyObjectType_st::_m_prob1UnknownN = 0;
        @sysvar::XCP::RadarFR::_g_PlReCoFw_PlReCoPer_ObjBypassingRunnable_ObjBypassingRunnable_m_pad_radarObjPort_par_out_local::TChangeableMemPool::_::_::_m_arrayPool::_0_::_elem::port_ens_r_obj_sensor_base::_::_m_movObjectInformation::_3_::STA_OBJECT_INFORMATION_ST::_::_m_ohyObjectType_st::_m_probObstacle_st::_m_prob1UnknownN = 0;
        @sysvar::XCP::RadarFR::_g_PlReCoFw_PlReCoPer_ObjBypassingRunnable_ObjBypassingRunnable_m_pad_radarObjPort_par_out_local::TChangeableMemPool::_::_::_m_arrayPool::_0_::_elem::port_ens_r_obj_sensor_base::_::_m_movObjectInformation::_3_::STA_OBJECT_INFORMATION_ST::_::_m_ohyObjectType_st::_m_probObstacle_st::_m_probMobile_st::_m_prob1FourPlusWheelerN = 128;
        @sysvar::XCP::RadarFR::_g_PlReCoFw_PlReCoPer_ObjBypassingRunnable_ObjBypassingRunnable_m_pad_radarObjPort_par_out_local::TChangeableMemPool::_::_::_m_arrayPool::_0_::_elem::port_ens_r_obj_sensor_base::_::_m_movObjectInformation::_3_::STA_OBJECT_INFORMATION_ST::_::_m_ohyObjectType_st::_m_probObstacle_st::_m_probMobile_st::_m_prob1PedestrianN = 0;
        @sysvar::XCP::RadarFR::_g_PlReCoFw_PlReCoPer_ObjBypassingRunnable_ObjBypassingRunnable_m_pad_radarObjPort_par_out_local::TChangeableMemPool::_::_::_m_arrayPool::_0_::_elem::port_ens_r_obj_sensor_base::_::_m_movObjectInformation::_3_::STA_OBJECT_INFORMATION_ST::_::_m_ohyObjectType_st::_m_probObstacle_st::_m_probMobile_st::_m_prob1TwoWheelerN = 0;
        @sysvar::XCP::RadarFR::_g_PlReCoFw_PlReCoPer_ObjBypassingRunnable_ObjBypassingRunnable_m_pad_radarObjPort_par_out_local::TChangeableMemPool::_::_::_m_arrayPool::_0_::_elem::port_ens_r_obj_sensor_base::_::_m_movObjectInformation::_3_::STA_OBJECT_INFORMATION_ST::_::_m_ohyObjectType_st::_m_probObstacle_st::_m_probMobile_st::_m_prob1UnknownN = 0;
        @sysvar::XCP::RadarFR::_g_PlReCoFw_PlReCoPer_ObjBypassingRunnable_ObjBypassingRunnable_m_pad_radarObjPort_par_out_local::TChangeableMemPool::_::_::_m_arrayPool::_0_::_elem::port_ens_r_obj_sensor_base::_::_m_movObjectInformation::_3_::STA_OBJECT_INFORMATION_ST::_::_m_ohyObjectType_st::_m_probObstacle_st::_m_probMobile_st::_m_probFourPlusWheeler_st::_m_prob1PassengerCarN = 128;
        @sysvar::XCP::RadarFR::_g_PlReCoFw_PlReCoPer_ObjBypassingRunnable_ObjBypassingRunnable_m_pad_radarObjPort_par_out_local::TChangeableMemPool::_::_::_m_arrayPool::_0_::_elem::port_ens_r_obj_sensor_base::_::_m_movObjectInformation::_3_::STA_OBJECT_INFORMATION_ST::_::_m_ohyObjectType_st::_m_probObstacle_st::_m_probMobile_st::_m_probFourPlusWheeler_st::_m_prob1TruckN = 0;
        @sysvar::XCP::RadarFR::_g_PlReCoFw_PlReCoPer_ObjBypassingRunnable_ObjBypassingRunnable_m_pad_radarObjPort_par_out_local::TChangeableMemPool::_::_::_m_arrayPool::_0_::_elem::port_ens_r_obj_sensor_base::_::_m_movObjectInformation::_3_::STA_OBJECT_INFORMATION_ST::_::_m_ohyObjectType_st::_m_probObstacle_st::_m_probMobile_st::_m_probFourPlusWheeler_st::_m_prob1UnknownN = 0;
        @sysvar::XCP::RadarFR::_g_PlReCoFw_PlReCoPer_ObjBypassingRunnable_ObjBypassingRunnable_m_pad_radarObjPort_par_out_local::TChangeableMemPool::_::_::_m_arrayPool::_0_::_elem::port_ens_r_obj_sensor_base::_::_m_movObjectInformation::_3_::STA_OBJECT_INFORMATION_ST::_::_m_ohyObjectType_st::_m_probObstacle_st::_m_probStationary_st::_m_prob1RoadsideBarrierN = 0;
        @sysvar::XCP::RadarFR::_g_PlReCoFw_PlReCoPer_ObjBypassingRunnable_ObjBypassingRunnable_m_pad_radarObjPort_par_out_local::TChangeableMemPool::_::_::_m_arrayPool::_0_::_elem::port_ens_r_obj_sensor_base::_::_m_movObjectInformation::_3_::STA_OBJECT_INFORMATION_ST::_::_m_ohyObjectType_st::_m_probObstacle_st::_m_probStationary_st::_m_prob1UnknownN = 0;
        @sysvar::XCP::RadarFR::_g_PlReCoFw_PlReCoPer_ObjBypassingRunnable_ObjBypassingRunnable_m_pad_radarObjPort_par_out_local::TChangeableMemPool::_::_::_m_arrayPool::_0_::_elem::port_ens_r_obj_sensor_base::_::_m_movObjectInformation::_3_::_m_dLengthN = 64;
        @sysvar::XCP::RadarFR::_g_PlReCoFw_PlReCoPer_ObjBypassingRunnable_ObjBypassingRunnable_m_pad_radarObjPort_par_out_local::TChangeableMemPool::_::_::_m_arrayPool::_0_::_elem::port_ens_r_obj_sensor_base::_::_m_movObjectInformation::_3_::_m_dWidthN = @Classe_Obj_Sim::obj_data.obj_width[3] * 128;
        break;
    }
    break;

    case 4: //"Object-4"
    //constant
    @sysvar::XCP::RadarFR::_g_PlReCoFw_PlReCoPer_ObjBypassingRunnable_ObjBypassingRunnable_m_pad_radarObjPort_par_out_local::TChangeableMemPool::_::_::_m_arrayPool::_0_::_elem::port_ens_r_obj_sensor_base::_::_m_movObjectInformation::_4_::STA_OBJECT_INFORMATION_ST::_::_Meas_b = 1;
    @sysvar::XCP::RadarFR::_g_PlReCoFw_PlReCoPer_ObjBypassingRunnable_ObjBypassingRunnable_m_pad_radarObjPort_par_out_local::TChangeableMemPool::_::_::_m_arrayPool::_0_::_elem::port_ens_r_obj_sensor_base::_::_m_movObjectInformation::_4_::STA_OBJECT_INFORMATION_ST::_::_Measurable_b = 1;
    @sysvar::XCP::RadarFR::_g_PlReCoFw_PlReCoPer_ObjBypassingRunnable_ObjBypassingRunnable_m_pad_radarObjPort_par_out_local::TChangeableMemPool::_::_::_m_arrayPool::_0_::_elem::port_ens_r_obj_sensor_base::_::_m_movObjectInformation::_4_::STA_OBJECT_INFORMATION_ST::_::_Valid_b = 1;
    @sysvar::XCP::RadarFR::_g_PlReCoFw_PlReCoPer_ObjBypassingRunnable_ObjBypassingRunnable_m_pad_radarObjPort_par_out_local::TChangeableMemPool::_::_::_m_arrayPool::_0_::_elem::port_ens_r_obj_sensor_base::_::_m_movObjectInformation::_4_::_m_covarDxAxN = 0;
    @sysvar::XCP::RadarFR::_g_PlReCoFw_PlReCoPer_ObjBypassingRunnable_ObjBypassingRunnable_m_pad_radarObjPort_par_out_local::TChangeableMemPool::_::_::_m_arrayPool::_0_::_elem::port_ens_r_obj_sensor_base::_::_m_movObjectInformation::_4_::_m_covarDxVxN = 0;
    @sysvar::XCP::RadarFR::_g_PlReCoFw_PlReCoPer_ObjBypassingRunnable_ObjBypassingRunnable_m_pad_radarObjPort_par_out_local::TChangeableMemPool::_::_::_m_arrayPool::_0_::_elem::port_ens_r_obj_sensor_base::_::_m_movObjectInformation::_4_::_m_covarDyVyN = 0;
    @sysvar::XCP::RadarFR::_g_PlReCoFw_PlReCoPer_ObjBypassingRunnable_ObjBypassingRunnable_m_pad_radarObjPort_par_out_local::TChangeableMemPool::_::_::_m_arrayPool::_0_::_elem::port_ens_r_obj_sensor_base::_::_m_movObjectInformation::_4_::_m_covarDyWidthN = 0;
    @sysvar::XCP::RadarFR::_g_PlReCoFw_PlReCoPer_ObjBypassingRunnable_ObjBypassingRunnable_m_pad_radarObjPort_par_out_local::TChangeableMemPool::_::_::_m_arrayPool::_0_::_elem::port_ens_r_obj_sensor_base::_::_m_movObjectInformation::_4_::_m_covarVxAxN = 0;
    @sysvar::XCP::RadarFR::_g_PlReCoFw_PlReCoPer_ObjBypassingRunnable_ObjBypassingRunnable_m_pad_radarObjPort_par_out_local::TChangeableMemPool::_::_::_m_arrayPool::_0_::_elem::port_ens_r_obj_sensor_base::_::_m_movObjectInformation::_4_::_m_varAxN = 0;
    @sysvar::XCP::RadarFR::_g_PlReCoFw_PlReCoPer_ObjBypassingRunnable_ObjBypassingRunnable_m_pad_radarObjPort_par_out_local::TChangeableMemPool::_::_::_m_arrayPool::_0_::_elem::port_ens_r_obj_sensor_base::_::_m_movObjectInformation::_4_::_m_varAyN = 0;
    @sysvar::XCP::RadarFR::_g_PlReCoFw_PlReCoPer_ObjBypassingRunnable_ObjBypassingRunnable_m_pad_radarObjPort_par_out_local::TChangeableMemPool::_::_::_m_arrayPool::_0_::_elem::port_ens_r_obj_sensor_base::_::_m_movObjectInformation::_4_::_m_varVxN = 0;
    @sysvar::XCP::RadarFR::_g_PlReCoFw_PlReCoPer_ObjBypassingRunnable_ObjBypassingRunnable_m_pad_radarObjPort_par_out_local::TChangeableMemPool::_::_::_m_arrayPool::_0_::_elem::port_ens_r_obj_sensor_base::_::_m_movObjectInformation::_4_::_m_varVyN = 0;
    @sysvar::XCP::RadarFR::_g_PlReCoFw_PlReCoPer_ObjBypassingRunnable_ObjBypassingRunnable_m_pad_radarObjPort_par_out_local::TChangeableMemPool::_::_::_m_arrayPool::_0_::_elem::port_ens_r_obj_sensor_base::_::_m_movObjectInformation::_4_::STA_OBJECT_INFORMATION_ST::_::_m_varDxN = 0;
    @sysvar::XCP::RadarFR::_g_PlReCoFw_PlReCoPer_ObjBypassingRunnable_ObjBypassingRunnable_m_pad_radarObjPort_par_out_local::TChangeableMemPool::_::_::_m_arrayPool::_0_::_elem::port_ens_r_obj_sensor_base::_::_m_movObjectInformation::_4_::STA_OBJECT_INFORMATION_ST::_::_m_varDyN = 0;
    @sysvar::XCP::RadarFR::_g_PlReCoFw_PlReCoPer_ObjBypassingRunnable_ObjBypassingRunnable_m_pad_radarObjPort_par_out_local::TChangeableMemPool::_::_::_m_arrayPool::_0_::_elem::port_ens_r_obj_sensor_base::_::_m_movObjectInformation::_4_::_m_dVarLengthN = 0;
    @sysvar::XCP::RadarFR::_g_PlReCoFw_PlReCoPer_ObjBypassingRunnable_ObjBypassingRunnable_m_pad_radarObjPort_par_out_local::TChangeableMemPool::_::_::_m_arrayPool::_0_::_elem::port_ens_r_obj_sensor_base::_::_m_movObjectInformation::_4_::_m_dVarWidthN = 0;
    @sysvar::XCP::RadarFR::_g_PlReCoFw_PlReCoPer_ObjBypassingRunnable_ObjBypassingRunnable_m_pad_radarObjPort_par_out_local::TChangeableMemPool::_::_::_m_arrayPool::_0_::_elem::port_ens_r_obj_sensor_base::_::_m_movObjectInformation::_4_::STA_OBJECT_INFORMATION_ST::_::_m_wExistProbN = 64880;
    @sysvar::XCP::RadarFR::_g_PlReCoFw_PlReCoPer_ObjBypassingRunnable_ObjBypassingRunnable_m_pad_radarObjPort_par_out_local::TChangeableMemPool::_::_::_m_arrayPool::_0_::_elem::port_ens_r_obj_sensor_base::_::_m_movObjectInformation::_4_::_m_referencePtPosIndexN = 10;
    @sysvar::XCP::RadarFR::_g_PlReCoFw_PlReCoPer_ObjBypassingRunnable_ObjBypassingRunnable_m_pad_radarObjPort_par_out_local::TChangeableMemPool::_::_::_m_arrayPool::_0_::_elem::port_ens_r_obj_sensor_base::_::_m_movObjectInformation::_4_::_m_alpPiVarYawAngleN = 0;
    @sysvar::XCP::RadarFR::_g_PlReCoFw_PlReCoPer_ObjBypassingRunnable_ObjBypassingRunnable_m_pad_radarObjPort_par_out_local::TChangeableMemPool::_::_::_m_arrayPool::_0_::_elem::port_ens_r_obj_sensor_base::_::_m_movObjectInformation::_4_::_m_alpPiYawAngleN = 0;

    //target movement

    @sysvar::XCP::RadarFR::_g_PlReCoFw_PlReCoPer_ObjBypassingRunnable_ObjBypassingRunnable_m_pad_radarObjPort_par_out_local::TChangeableMemPool::_::_::_m_arrayPool::_0_::_elem::port_ens_r_obj_sensor_base::_::_m_movObjectInformation::_4_::STA_OBJECT_INFORMATION_ST::_::_m_dxN = @Classe_Obj_Sim::obj_data.obj_dx[4] * 128;
    @sysvar::XCP::RadarFR::_g_PlReCoFw_PlReCoPer_ObjBypassingRunnable_ObjBypassingRunnable_m_pad_radarObjPort_par_out_local::TChangeableMemPool::_::_::_m_arrayPool::_0_::_elem::port_ens_r_obj_sensor_base::_::_m_movObjectInformation::_4_::STA_OBJECT_INFORMATION_ST::_::_m_dyN = @Classe_Obj_Sim::obj_data.obj_dy[4] * 128;
    @sysvar::XCP::RadarFR::_g_PlReCoFw_PlReCoPer_ObjBypassingRunnable_ObjBypassingRunnable_m_pad_radarObjPort_par_out_local::TChangeableMemPool::_::_::_m_arrayPool::_0_::_elem::port_ens_r_obj_sensor_base::_::_m_movObjectInformation::_4_::STA_OBJECT_INFORMATION_ST::_::_m_dzN = 0;
    @sysvar::XCP::RadarFR::_g_PlReCoFw_PlReCoPer_ObjBypassingRunnable_ObjBypassingRunnable_m_pad_radarObjPort_par_out_local::TChangeableMemPool::_::_::_m_arrayPool::_0_::_elem::port_ens_r_obj_sensor_base::_::_m_movObjectInformation::_4_::_m_vxN = @Classe_Obj_Sim::obj_data.obj_relative_vx[4] * 256;
    @sysvar::XCP::RadarFR::_g_PlReCoFw_PlReCoPer_ObjBypassingRunnable_ObjBypassingRunnable_m_pad_radarObjPort_par_out_local::TChangeableMemPool::_::_::_m_arrayPool::_0_::_elem::port_ens_r_obj_sensor_base::_::_m_movObjectInformation::_4_::_m_vyN = @Classe_Obj_Sim::obj_data.obj_relative_vy[4] * 256;
    @sysvar::XCP::RadarFR::_g_PlReCoFw_PlReCoPer_ObjBypassingRunnable_ObjBypassingRunnable_m_pad_radarObjPort_par_out_local::TChangeableMemPool::_::_::_m_arrayPool::_0_::_elem::port_ens_r_obj_sensor_base::_::_m_movObjectInformation::_4_::_m_axN = 0;
    @sysvar::XCP::RadarFR::_g_PlReCoFw_PlReCoPer_ObjBypassingRunnable_ObjBypassingRunnable_m_pad_radarObjPort_par_out_local::TChangeableMemPool::_::_::_m_arrayPool::_0_::_elem::port_ens_r_obj_sensor_base::_::_m_movObjectInformation::_4_::_m_ayN = 0;

    //target object moving or not
    if (abs(@Classe_Obj_Sim::obj_data.obj_relative_vx[4]) != 0)
    {
      @sysvar::XCP::RadarFR::_g_PlReCoFw_PlReCoPer_ObjBypassingRunnable_ObjBypassingRunnable_m_pad_radarObjPort_par_out_local::TChangeableMemPool::_::_::_m_arrayPool::_0_::_elem::port_ens_r_obj_sensor_base::_::_m_movObjectInformation::_4_::STA_OBJECT_INFORMATION_ST::_::_m_prob1HasBeenObservedMovingN = 126;
      @sysvar::XCP::RadarFR::_g_PlReCoFw_PlReCoPer_ObjBypassingRunnable_ObjBypassingRunnable_m_pad_radarObjPort_par_out_local::TChangeableMemPool::_::_::_m_arrayPool::_0_::_elem::port_ens_r_obj_sensor_base::_::_m_movObjectInformation::_4_::STA_OBJECT_INFORMATION_ST::_::_m_prob1MovingN = 126;
      @sysvar::XCP::RadarFR::_g_PlReCoFw_PlReCoPer_ObjBypassingRunnable_ObjBypassingRunnable_m_pad_radarObjPort_par_out_local::TChangeableMemPool::_::_::_m_arrayPool::_0_::_elem::port_ens_r_obj_sensor_base::_::_m_movObjectInformation::_4_::STA_OBJECT_INFORMATION_ST::_::_m_ohyObjectType_st::_m_probObstacle_st::_m_prob1MobileN = 128;
      @sysvar::XCP::RadarFR::_g_PlReCoFw_PlReCoPer_ObjBypassingRunnable_ObjBypassingRunnable_m_pad_radarObjPort_par_out_local::TChangeableMemPool::_::_::_m_arrayPool::_0_::_elem::port_ens_r_obj_sensor_base::_::_m_movObjectInformation::_4_::STA_OBJECT_INFORMATION_ST::_::_m_ohyObjectType_st::_m_probObstacle_st::_m_prob1StationaryN = 0;
    }
    else
    {
      @sysvar::XCP::RadarFR::_g_PlReCoFw_PlReCoPer_ObjBypassingRunnable_ObjBypassingRunnable_m_pad_radarObjPort_par_out_local::TChangeableMemPool::_::_::_m_arrayPool::_0_::_elem::port_ens_r_obj_sensor_base::_::_m_movObjectInformation::_4_::STA_OBJECT_INFORMATION_ST::_::_m_prob1HasBeenObservedMovingN = 0;
      @sysvar::XCP::RadarFR::_g_PlReCoFw_PlReCoPer_ObjBypassingRunnable_ObjBypassingRunnable_m_pad_radarObjPort_par_out_local::TChangeableMemPool::_::_::_m_arrayPool::_0_::_elem::port_ens_r_obj_sensor_base::_::_m_movObjectInformation::_4_::STA_OBJECT_INFORMATION_ST::_::_m_prob1MovingN = 0;
      @sysvar::XCP::RadarFR::_g_PlReCoFw_PlReCoPer_ObjBypassingRunnable_ObjBypassingRunnable_m_pad_radarObjPort_par_out_local::TChangeableMemPool::_::_::_m_arrayPool::_0_::_elem::port_ens_r_obj_sensor_base::_::_m_movObjectInformation::_4_::STA_OBJECT_INFORMATION_ST::_::_m_ohyObjectType_st::_m_probObstacle_st::_m_prob1MobileN = 0;
      @sysvar::XCP::RadarFR::_g_PlReCoFw_PlReCoPer_ObjBypassingRunnable_ObjBypassingRunnable_m_pad_radarObjPort_par_out_local::TChangeableMemPool::_::_::_m_arrayPool::_0_::_elem::port_ens_r_obj_sensor_base::_::_m_movObjectInformation::_4_::STA_OBJECT_INFORMATION_ST::_::_m_ohyObjectType_st::_m_probObstacle_st::_m_prob1StationaryN = 128;
    }

      //object classification
    switch (@Classe_Obj_Sim::obj_data.obj_type[4])
    {
      case 0: //"Non-Obstacle"
        @sysvar::XCP::RadarFR::_g_PlReCoFw_PlReCoPer_ObjBypassingRunnable_ObjBypassingRunnable_m_pad_radarObjPort_par_out_local::TChangeableMemPool::_::_::_m_arrayPool::_0_::_elem::port_ens_r_obj_sensor_base::_::_m_movObjectInformation::_4_::STA_OBJECT_INFORMATION_ST::_::_m_ohyObjectType_st::_m_prob1NonObstacleN = 128;
        @sysvar::XCP::RadarFR::_g_PlReCoFw_PlReCoPer_ObjBypassingRunnable_ObjBypassingRunnable_m_pad_radarObjPort_par_out_local::TChangeableMemPool::_::_::_m_arrayPool::_0_::_elem::port_ens_r_obj_sensor_base::_::_m_movObjectInformation::_4_::STA_OBJECT_INFORMATION_ST::_::_m_ohyObjectType_st::_m_prob1ObstacleN = 0;
        @sysvar::XCP::RadarFR::_g_PlReCoFw_PlReCoPer_ObjBypassingRunnable_ObjBypassingRunnable_m_pad_radarObjPort_par_out_local::TChangeableMemPool::_::_::_m_arrayPool::_0_::_elem::port_ens_r_obj_sensor_base::_::_m_movObjectInformation::_4_::STA_OBJECT_INFORMATION_ST::_::_m_ohyObjectType_st::_m_prob1UnknownN = 0;
        @sysvar::XCP::RadarFR::_g_PlReCoFw_PlReCoPer_ObjBypassingRunnable_ObjBypassingRunnable_m_pad_radarObjPort_par_out_local::TChangeableMemPool::_::_::_m_arrayPool::_0_::_elem::port_ens_r_obj_sensor_base::_::_m_movObjectInformation::_4_::STA_OBJECT_INFORMATION_ST::_::_m_ohyObjectType_st::_m_probObstacle_st::_m_prob1UnknownN = 128;
        @sysvar::XCP::RadarFR::_g_PlReCoFw_PlReCoPer_ObjBypassingRunnable_ObjBypassingRunnable_m_pad_radarObjPort_par_out_local::TChangeableMemPool::_::_::_m_arrayPool::_0_::_elem::port_ens_r_obj_sensor_base::_::_m_movObjectInformation::_4_::STA_OBJECT_INFORMATION_ST::_::_m_ohyObjectType_st::_m_probObstacle_st::_m_probMobile_st::_m_prob1FourPlusWheelerN = 0;
        @sysvar::XCP::RadarFR::_g_PlReCoFw_PlReCoPer_ObjBypassingRunnable_ObjBypassingRunnable_m_pad_radarObjPort_par_out_local::TChangeableMemPool::_::_::_m_arrayPool::_0_::_elem::port_ens_r_obj_sensor_base::_::_m_movObjectInformation::_4_::STA_OBJECT_INFORMATION_ST::_::_m_ohyObjectType_st::_m_probObstacle_st::_m_probMobile_st::_m_prob1PedestrianN = 0;
        @sysvar::XCP::RadarFR::_g_PlReCoFw_PlReCoPer_ObjBypassingRunnable_ObjBypassingRunnable_m_pad_radarObjPort_par_out_local::TChangeableMemPool::_::_::_m_arrayPool::_0_::_elem::port_ens_r_obj_sensor_base::_::_m_movObjectInformation::_4_::STA_OBJECT_INFORMATION_ST::_::_m_ohyObjectType_st::_m_probObstacle_st::_m_probMobile_st::_m_prob1TwoWheelerN = 0;
        @sysvar::XCP::RadarFR::_g_PlReCoFw_PlReCoPer_ObjBypassingRunnable_ObjBypassingRunnable_m_pad_radarObjPort_par_out_local::TChangeableMemPool::_::_::_m_arrayPool::_0_::_elem::port_ens_r_obj_sensor_base::_::_m_movObjectInformation::_4_::STA_OBJECT_INFORMATION_ST::_::_m_ohyObjectType_st::_m_probObstacle_st::_m_probMobile_st::_m_prob1UnknownN = 128;
        @sysvar::XCP::RadarFR::_g_PlReCoFw_PlReCoPer_ObjBypassingRunnable_ObjBypassingRunnable_m_pad_radarObjPort_par_out_local::TChangeableMemPool::_::_::_m_arrayPool::_0_::_elem::port_ens_r_obj_sensor_base::_::_m_movObjectInformation::_4_::STA_OBJECT_INFORMATION_ST::_::_m_ohyObjectType_st::_m_probObstacle_st::_m_probMobile_st::_m_probFourPlusWheeler_st::_m_prob1PassengerCarN = 0;
        @sysvar::XCP::RadarFR::_g_PlReCoFw_PlReCoPer_ObjBypassingRunnable_ObjBypassingRunnable_m_pad_radarObjPort_par_out_local::TChangeableMemPool::_::_::_m_arrayPool::_0_::_elem::port_ens_r_obj_sensor_base::_::_m_movObjectInformation::_4_::STA_OBJECT_INFORMATION_ST::_::_m_ohyObjectType_st::_m_probObstacle_st::_m_probMobile_st::_m_probFourPlusWheeler_st::_m_prob1TruckN = 0;
        @sysvar::XCP::RadarFR::_g_PlReCoFw_PlReCoPer_ObjBypassingRunnable_ObjBypassingRunnable_m_pad_radarObjPort_par_out_local::TChangeableMemPool::_::_::_m_arrayPool::_0_::_elem::port_ens_r_obj_sensor_base::_::_m_movObjectInformation::_4_::STA_OBJECT_INFORMATION_ST::_::_m_ohyObjectType_st::_m_probObstacle_st::_m_probMobile_st::_m_probFourPlusWheeler_st::_m_prob1UnknownN = 128;
        @sysvar::XCP::RadarFR::_g_PlReCoFw_PlReCoPer_ObjBypassingRunnable_ObjBypassingRunnable_m_pad_radarObjPort_par_out_local::TChangeableMemPool::_::_::_m_arrayPool::_0_::_elem::port_ens_r_obj_sensor_base::_::_m_movObjectInformation::_4_::STA_OBJECT_INFORMATION_ST::_::_m_ohyObjectType_st::_m_probObstacle_st::_m_probStationary_st::_m_prob1RoadsideBarrierN = 0;
        @sysvar::XCP::RadarFR::_g_PlReCoFw_PlReCoPer_ObjBypassingRunnable_ObjBypassingRunnable_m_pad_radarObjPort_par_out_local::TChangeableMemPool::_::_::_m_arrayPool::_0_::_elem::port_ens_r_obj_sensor_base::_::_m_movObjectInformation::_4_::STA_OBJECT_INFORMATION_ST::_::_m_ohyObjectType_st::_m_probObstacle_st::_m_probStationary_st::_m_prob1UnknownN = 128;
        @sysvar::XCP::RadarFR::_g_PlReCoFw_PlReCoPer_ObjBypassingRunnable_ObjBypassingRunnable_m_pad_radarObjPort_par_out_local::TChangeableMemPool::_::_::_m_arrayPool::_0_::_elem::port_ens_r_obj_sensor_base::_::_m_movObjectInformation::_4_::_m_dLengthN = 64;
        @sysvar::XCP::RadarFR::_g_PlReCoFw_PlReCoPer_ObjBypassingRunnable_ObjBypassingRunnable_m_pad_radarObjPort_par_out_local::TChangeableMemPool::_::_::_m_arrayPool::_0_::_elem::port_ens_r_obj_sensor_base::_::_m_movObjectInformation::_4_::_m_dWidthN = @Classe_Obj_Sim::obj_data.obj_width[4] * 128;
        break;

      case 1: //"unknown"
        @sysvar::XCP::RadarFR::_g_PlReCoFw_PlReCoPer_ObjBypassingRunnable_ObjBypassingRunnable_m_pad_radarObjPort_par_out_local::TChangeableMemPool::_::_::_m_arrayPool::_0_::_elem::port_ens_r_obj_sensor_base::_::_m_movObjectInformation::_4_::STA_OBJECT_INFORMATION_ST::_::_m_ohyObjectType_st::_m_prob1NonObstacleN = 0;
        @sysvar::XCP::RadarFR::_g_PlReCoFw_PlReCoPer_ObjBypassingRunnable_ObjBypassingRunnable_m_pad_radarObjPort_par_out_local::TChangeableMemPool::_::_::_m_arrayPool::_0_::_elem::port_ens_r_obj_sensor_base::_::_m_movObjectInformation::_4_::STA_OBJECT_INFORMATION_ST::_::_m_ohyObjectType_st::_m_prob1ObstacleN = 0;
        @sysvar::XCP::RadarFR::_g_PlReCoFw_PlReCoPer_ObjBypassingRunnable_ObjBypassingRunnable_m_pad_radarObjPort_par_out_local::TChangeableMemPool::_::_::_m_arrayPool::_0_::_elem::port_ens_r_obj_sensor_base::_::_m_movObjectInformation::_4_::STA_OBJECT_INFORMATION_ST::_::_m_ohyObjectType_st::_m_prob1UnknownN = 128;
        @sysvar::XCP::RadarFR::_g_PlReCoFw_PlReCoPer_ObjBypassingRunnable_ObjBypassingRunnable_m_pad_radarObjPort_par_out_local::TChangeableMemPool::_::_::_m_arrayPool::_0_::_elem::port_ens_r_obj_sensor_base::_::_m_movObjectInformation::_4_::STA_OBJECT_INFORMATION_ST::_::_m_ohyObjectType_st::_m_probObstacle_st::_m_prob1UnknownN = 128;
        @sysvar::XCP::RadarFR::_g_PlReCoFw_PlReCoPer_ObjBypassingRunnable_ObjBypassingRunnable_m_pad_radarObjPort_par_out_local::TChangeableMemPool::_::_::_m_arrayPool::_0_::_elem::port_ens_r_obj_sensor_base::_::_m_movObjectInformation::_4_::STA_OBJECT_INFORMATION_ST::_::_m_ohyObjectType_st::_m_probObstacle_st::_m_probMobile_st::_m_prob1FourPlusWheelerN = 0;
        @sysvar::XCP::RadarFR::_g_PlReCoFw_PlReCoPer_ObjBypassingRunnable_ObjBypassingRunnable_m_pad_radarObjPort_par_out_local::TChangeableMemPool::_::_::_m_arrayPool::_0_::_elem::port_ens_r_obj_sensor_base::_::_m_movObjectInformation::_4_::STA_OBJECT_INFORMATION_ST::_::_m_ohyObjectType_st::_m_probObstacle_st::_m_probMobile_st::_m_prob1PedestrianN = 0;
        @sysvar::XCP::RadarFR::_g_PlReCoFw_PlReCoPer_ObjBypassingRunnable_ObjBypassingRunnable_m_pad_radarObjPort_par_out_local::TChangeableMemPool::_::_::_m_arrayPool::_0_::_elem::port_ens_r_obj_sensor_base::_::_m_movObjectInformation::_4_::STA_OBJECT_INFORMATION_ST::_::_m_ohyObjectType_st::_m_probObstacle_st::_m_probMobile_st::_m_prob1TwoWheelerN = 0;
        @sysvar::XCP::RadarFR::_g_PlReCoFw_PlReCoPer_ObjBypassingRunnable_ObjBypassingRunnable_m_pad_radarObjPort_par_out_local::TChangeableMemPool::_::_::_m_arrayPool::_0_::_elem::port_ens_r_obj_sensor_base::_::_m_movObjectInformation::_4_::STA_OBJECT_INFORMATION_ST::_::_m_ohyObjectType_st::_m_probObstacle_st::_m_probMobile_st::_m_prob1UnknownN = 128;
        @sysvar::XCP::RadarFR::_g_PlReCoFw_PlReCoPer_ObjBypassingRunnable_ObjBypassingRunnable_m_pad_radarObjPort_par_out_local::TChangeableMemPool::_::_::_m_arrayPool::_0_::_elem::port_ens_r_obj_sensor_base::_::_m_movObjectInformation::_4_::STA_OBJECT_INFORMATION_ST::_::_m_ohyObjectType_st::_m_probObstacle_st::_m_probMobile_st::_m_probFourPlusWheeler_st::_m_prob1PassengerCarN = 0;
        @sysvar::XCP::RadarFR::_g_PlReCoFw_PlReCoPer_ObjBypassingRunnable_ObjBypassingRunnable_m_pad_radarObjPort_par_out_local::TChangeableMemPool::_::_::_m_arrayPool::_0_::_elem::port_ens_r_obj_sensor_base::_::_m_movObjectInformation::_4_::STA_OBJECT_INFORMATION_ST::_::_m_ohyObjectType_st::_m_probObstacle_st::_m_probMobile_st::_m_probFourPlusWheeler_st::_m_prob1TruckN = 0;
        @sysvar::XCP::RadarFR::_g_PlReCoFw_PlReCoPer_ObjBypassingRunnable_ObjBypassingRunnable_m_pad_radarObjPort_par_out_local::TChangeableMemPool::_::_::_m_arrayPool::_0_::_elem::port_ens_r_obj_sensor_base::_::_m_movObjectInformation::_4_::STA_OBJECT_INFORMATION_ST::_::_m_ohyObjectType_st::_m_probObstacle_st::_m_probMobile_st::_m_probFourPlusWheeler_st::_m_prob1UnknownN = 128;
        @sysvar::XCP::RadarFR::_g_PlReCoFw_PlReCoPer_ObjBypassingRunnable_ObjBypassingRunnable_m_pad_radarObjPort_par_out_local::TChangeableMemPool::_::_::_m_arrayPool::_0_::_elem::port_ens_r_obj_sensor_base::_::_m_movObjectInformation::_4_::STA_OBJECT_INFORMATION_ST::_::_m_ohyObjectType_st::_m_probObstacle_st::_m_probStationary_st::_m_prob1RoadsideBarrierN = 0;
        @sysvar::XCP::RadarFR::_g_PlReCoFw_PlReCoPer_ObjBypassingRunnable_ObjBypassingRunnable_m_pad_radarObjPort_par_out_local::TChangeableMemPool::_::_::_m_arrayPool::_0_::_elem::port_ens_r_obj_sensor_base::_::_m_movObjectInformation::_4_::STA_OBJECT_INFORMATION_ST::_::_m_ohyObjectType_st::_m_probObstacle_st::_m_probStationary_st::_m_prob1UnknownN = 128;
        @sysvar::XCP::RadarFR::_g_PlReCoFw_PlReCoPer_ObjBypassingRunnable_ObjBypassingRunnable_m_pad_radarObjPort_par_out_local::TChangeableMemPool::_::_::_m_arrayPool::_0_::_elem::port_ens_r_obj_sensor_base::_::_m_movObjectInformation::_4_::_m_dLengthN = 0;
        @sysvar::XCP::RadarFR::_g_PlReCoFw_PlReCoPer_ObjBypassingRunnable_ObjBypassingRunnable_m_pad_radarObjPort_par_out_local::TChangeableMemPool::_::_::_m_arrayPool::_0_::_elem::port_ens_r_obj_sensor_base::_::_m_movObjectInformation::_4_::_m_dWidthN = @Classe_Obj_Sim::obj_data.obj_width[4] * 128;
        break;

      case 2: //"RoadSideBarrier"
        @sysvar::XCP::RadarFR::_g_PlReCoFw_PlReCoPer_ObjBypassingRunnable_ObjBypassingRunnable_m_pad_radarObjPort_par_out_local::TChangeableMemPool::_::_::_m_arrayPool::_0_::_elem::port_ens_r_obj_sensor_base::_::_m_movObjectInformation::_4_::STA_OBJECT_INFORMATION_ST::_::_m_ohyObjectType_st::_m_prob1NonObstacleN = 0;
        @sysvar::XCP::RadarFR::_g_PlReCoFw_PlReCoPer_ObjBypassingRunnable_ObjBypassingRunnable_m_pad_radarObjPort_par_out_local::TChangeableMemPool::_::_::_m_arrayPool::_0_::_elem::port_ens_r_obj_sensor_base::_::_m_movObjectInformation::_4_::STA_OBJECT_INFORMATION_ST::_::_m_ohyObjectType_st::_m_prob1ObstacleN = 128;
        @sysvar::XCP::RadarFR::_g_PlReCoFw_PlReCoPer_ObjBypassingRunnable_ObjBypassingRunnable_m_pad_radarObjPort_par_out_local::TChangeableMemPool::_::_::_m_arrayPool::_0_::_elem::port_ens_r_obj_sensor_base::_::_m_movObjectInformation::_4_::STA_OBJECT_INFORMATION_ST::_::_m_ohyObjectType_st::_m_prob1UnknownN = 0;
        @sysvar::XCP::RadarFR::_g_PlReCoFw_PlReCoPer_ObjBypassingRunnable_ObjBypassingRunnable_m_pad_radarObjPort_par_out_local::TChangeableMemPool::_::_::_m_arrayPool::_0_::_elem::port_ens_r_obj_sensor_base::_::_m_movObjectInformation::_4_::STA_OBJECT_INFORMATION_ST::_::_m_ohyObjectType_st::_m_probObstacle_st::_m_prob1MobileN = 0;
        @sysvar::XCP::RadarFR::_g_PlReCoFw_PlReCoPer_ObjBypassingRunnable_ObjBypassingRunnable_m_pad_radarObjPort_par_out_local::TChangeableMemPool::_::_::_m_arrayPool::_0_::_elem::port_ens_r_obj_sensor_base::_::_m_movObjectInformation::_4_::STA_OBJECT_INFORMATION_ST::_::_m_ohyObjectType_st::_m_probObstacle_st::_m_prob1StationaryN = 128;
        @sysvar::XCP::RadarFR::_g_PlReCoFw_PlReCoPer_ObjBypassingRunnable_ObjBypassingRunnable_m_pad_radarObjPort_par_out_local::TChangeableMemPool::_::_::_m_arrayPool::_0_::_elem::port_ens_r_obj_sensor_base::_::_m_movObjectInformation::_4_::STA_OBJECT_INFORMATION_ST::_::_m_ohyObjectType_st::_m_probObstacle_st::_m_prob1UnknownN = 0;
        @sysvar::XCP::RadarFR::_g_PlReCoFw_PlReCoPer_ObjBypassingRunnable_ObjBypassingRunnable_m_pad_radarObjPort_par_out_local::TChangeableMemPool::_::_::_m_arrayPool::_0_::_elem::port_ens_r_obj_sensor_base::_::_m_movObjectInformation::_4_::STA_OBJECT_INFORMATION_ST::_::_m_ohyObjectType_st::_m_probObstacle_st::_m_probMobile_st::_m_prob1FourPlusWheelerN = 0;
        @sysvar::XCP::RadarFR::_g_PlReCoFw_PlReCoPer_ObjBypassingRunnable_ObjBypassingRunnable_m_pad_radarObjPort_par_out_local::TChangeableMemPool::_::_::_m_arrayPool::_0_::_elem::port_ens_r_obj_sensor_base::_::_m_movObjectInformation::_4_::STA_OBJECT_INFORMATION_ST::_::_m_ohyObjectType_st::_m_probObstacle_st::_m_probMobile_st::_m_prob1PedestrianN = 0;
        @sysvar::XCP::RadarFR::_g_PlReCoFw_PlReCoPer_ObjBypassingRunnable_ObjBypassingRunnable_m_pad_radarObjPort_par_out_local::TChangeableMemPool::_::_::_m_arrayPool::_0_::_elem::port_ens_r_obj_sensor_base::_::_m_movObjectInformation::_4_::STA_OBJECT_INFORMATION_ST::_::_m_ohyObjectType_st::_m_probObstacle_st::_m_probMobile_st::_m_prob1TwoWheelerN = 0;
        @sysvar::XCP::RadarFR::_g_PlReCoFw_PlReCoPer_ObjBypassingRunnable_ObjBypassingRunnable_m_pad_radarObjPort_par_out_local::TChangeableMemPool::_::_::_m_arrayPool::_0_::_elem::port_ens_r_obj_sensor_base::_::_m_movObjectInformation::_4_::STA_OBJECT_INFORMATION_ST::_::_m_ohyObjectType_st::_m_probObstacle_st::_m_probMobile_st::_m_prob1UnknownN = 0;
        @sysvar::XCP::RadarFR::_g_PlReCoFw_PlReCoPer_ObjBypassingRunnable_ObjBypassingRunnable_m_pad_radarObjPort_par_out_local::TChangeableMemPool::_::_::_m_arrayPool::_0_::_elem::port_ens_r_obj_sensor_base::_::_m_movObjectInformation::_4_::STA_OBJECT_INFORMATION_ST::_::_m_ohyObjectType_st::_m_probObstacle_st::_m_probMobile_st::_m_probFourPlusWheeler_st::_m_prob1PassengerCarN = 0;
        @sysvar::XCP::RadarFR::_g_PlReCoFw_PlReCoPer_ObjBypassingRunnable_ObjBypassingRunnable_m_pad_radarObjPort_par_out_local::TChangeableMemPool::_::_::_m_arrayPool::_0_::_elem::port_ens_r_obj_sensor_base::_::_m_movObjectInformation::_4_::STA_OBJECT_INFORMATION_ST::_::_m_ohyObjectType_st::_m_probObstacle_st::_m_probMobile_st::_m_probFourPlusWheeler_st::_m_prob1TruckN = 0;
        @sysvar::XCP::RadarFR::_g_PlReCoFw_PlReCoPer_ObjBypassingRunnable_ObjBypassingRunnable_m_pad_radarObjPort_par_out_local::TChangeableMemPool::_::_::_m_arrayPool::_0_::_elem::port_ens_r_obj_sensor_base::_::_m_movObjectInformation::_4_::STA_OBJECT_INFORMATION_ST::_::_m_ohyObjectType_st::_m_probObstacle_st::_m_probMobile_st::_m_probFourPlusWheeler_st::_m_prob1UnknownN = 0;
        @sysvar::XCP::RadarFR::_g_PlReCoFw_PlReCoPer_ObjBypassingRunnable_ObjBypassingRunnable_m_pad_radarObjPort_par_out_local::TChangeableMemPool::_::_::_m_arrayPool::_0_::_elem::port_ens_r_obj_sensor_base::_::_m_movObjectInformation::_4_::STA_OBJECT_INFORMATION_ST::_::_m_ohyObjectType_st::_m_probObstacle_st::_m_probStationary_st::_m_prob1RoadsideBarrierN = 128;
        @sysvar::XCP::RadarFR::_g_PlReCoFw_PlReCoPer_ObjBypassingRunnable_ObjBypassingRunnable_m_pad_radarObjPort_par_out_local::TChangeableMemPool::_::_::_m_arrayPool::_0_::_elem::port_ens_r_obj_sensor_base::_::_m_movObjectInformation::_4_::STA_OBJECT_INFORMATION_ST::_::_m_ohyObjectType_st::_m_probObstacle_st::_m_probStationary_st::_m_prob1UnknownN = 0;
        @sysvar::XCP::RadarFR::_g_PlReCoFw_PlReCoPer_ObjBypassingRunnable_ObjBypassingRunnable_m_pad_radarObjPort_par_out_local::TChangeableMemPool::_::_::_m_arrayPool::_0_::_elem::port_ens_r_obj_sensor_base::_::_m_movObjectInformation::_4_::_m_dLengthN = 64;
        @sysvar::XCP::RadarFR::_g_PlReCoFw_PlReCoPer_ObjBypassingRunnable_ObjBypassingRunnable_m_pad_radarObjPort_par_out_local::TChangeableMemPool::_::_::_m_arrayPool::_0_::_elem::port_ens_r_obj_sensor_base::_::_m_movObjectInformation::_4_::_m_dWidthN = @Classe_Obj_Sim::obj_data.obj_width[4] * 128;
        break;

      case 3: //"2Wheeler"
        @sysvar::XCP::RadarFR::_g_PlReCoFw_PlReCoPer_ObjBypassingRunnable_ObjBypassingRunnable_m_pad_radarObjPort_par_out_local::TChangeableMemPool::_::_::_m_arrayPool::_0_::_elem::port_ens_r_obj_sensor_base::_::_m_movObjectInformation::_4_::STA_OBJECT_INFORMATION_ST::_::_m_ohyObjectType_st::_m_prob1NonObstacleN = 0;
        @sysvar::XCP::RadarFR::_g_PlReCoFw_PlReCoPer_ObjBypassingRunnable_ObjBypassingRunnable_m_pad_radarObjPort_par_out_local::TChangeableMemPool::_::_::_m_arrayPool::_0_::_elem::port_ens_r_obj_sensor_base::_::_m_movObjectInformation::_4_::STA_OBJECT_INFORMATION_ST::_::_m_ohyObjectType_st::_m_prob1ObstacleN = 128;
        @sysvar::XCP::RadarFR::_g_PlReCoFw_PlReCoPer_ObjBypassingRunnable_ObjBypassingRunnable_m_pad_radarObjPort_par_out_local::TChangeableMemPool::_::_::_m_arrayPool::_0_::_elem::port_ens_r_obj_sensor_base::_::_m_movObjectInformation::_4_::STA_OBJECT_INFORMATION_ST::_::_m_ohyObjectType_st::_m_prob1UnknownN = 0;
        @sysvar::XCP::RadarFR::_g_PlReCoFw_PlReCoPer_ObjBypassingRunnable_ObjBypassingRunnable_m_pad_radarObjPort_par_out_local::TChangeableMemPool::_::_::_m_arrayPool::_0_::_elem::port_ens_r_obj_sensor_base::_::_m_movObjectInformation::_4_::STA_OBJECT_INFORMATION_ST::_::_m_ohyObjectType_st::_m_probObstacle_st::_m_prob1UnknownN = 0;
        @sysvar::XCP::RadarFR::_g_PlReCoFw_PlReCoPer_ObjBypassingRunnable_ObjBypassingRunnable_m_pad_radarObjPort_par_out_local::TChangeableMemPool::_::_::_m_arrayPool::_0_::_elem::port_ens_r_obj_sensor_base::_::_m_movObjectInformation::_4_::STA_OBJECT_INFORMATION_ST::_::_m_ohyObjectType_st::_m_probObstacle_st::_m_probMobile_st::_m_prob1FourPlusWheelerN = 0;
        @sysvar::XCP::RadarFR::_g_PlReCoFw_PlReCoPer_ObjBypassingRunnable_ObjBypassingRunnable_m_pad_radarObjPort_par_out_local::TChangeableMemPool::_::_::_m_arrayPool::_0_::_elem::port_ens_r_obj_sensor_base::_::_m_movObjectInformation::_4_::STA_OBJECT_INFORMATION_ST::_::_m_ohyObjectType_st::_m_probObstacle_st::_m_probMobile_st::_m_prob1PedestrianN = 0;
        @sysvar::XCP::RadarFR::_g_PlReCoFw_PlReCoPer_ObjBypassingRunnable_ObjBypassingRunnable_m_pad_radarObjPort_par_out_local::TChangeableMemPool::_::_::_m_arrayPool::_0_::_elem::port_ens_r_obj_sensor_base::_::_m_movObjectInformation::_4_::STA_OBJECT_INFORMATION_ST::_::_m_ohyObjectType_st::_m_probObstacle_st::_m_probMobile_st::_m_prob1TwoWheelerN = 128;
        @sysvar::XCP::RadarFR::_g_PlReCoFw_PlReCoPer_ObjBypassingRunnable_ObjBypassingRunnable_m_pad_radarObjPort_par_out_local::TChangeableMemPool::_::_::_m_arrayPool::_0_::_elem::port_ens_r_obj_sensor_base::_::_m_movObjectInformation::_4_::STA_OBJECT_INFORMATION_ST::_::_m_ohyObjectType_st::_m_probObstacle_st::_m_probMobile_st::_m_prob1UnknownN = 0;
        @sysvar::XCP::RadarFR::_g_PlReCoFw_PlReCoPer_ObjBypassingRunnable_ObjBypassingRunnable_m_pad_radarObjPort_par_out_local::TChangeableMemPool::_::_::_m_arrayPool::_0_::_elem::port_ens_r_obj_sensor_base::_::_m_movObjectInformation::_4_::STA_OBJECT_INFORMATION_ST::_::_m_ohyObjectType_st::_m_probObstacle_st::_m_probMobile_st::_m_probFourPlusWheeler_st::_m_prob1PassengerCarN = 0;
        @sysvar::XCP::RadarFR::_g_PlReCoFw_PlReCoPer_ObjBypassingRunnable_ObjBypassingRunnable_m_pad_radarObjPort_par_out_local::TChangeableMemPool::_::_::_m_arrayPool::_0_::_elem::port_ens_r_obj_sensor_base::_::_m_movObjectInformation::_4_::STA_OBJECT_INFORMATION_ST::_::_m_ohyObjectType_st::_m_probObstacle_st::_m_probMobile_st::_m_probFourPlusWheeler_st::_m_prob1TruckN = 0;
        @sysvar::XCP::RadarFR::_g_PlReCoFw_PlReCoPer_ObjBypassingRunnable_ObjBypassingRunnable_m_pad_radarObjPort_par_out_local::TChangeableMemPool::_::_::_m_arrayPool::_0_::_elem::port_ens_r_obj_sensor_base::_::_m_movObjectInformation::_4_::STA_OBJECT_INFORMATION_ST::_::_m_ohyObjectType_st::_m_probObstacle_st::_m_probMobile_st::_m_probFourPlusWheeler_st::_m_prob1UnknownN = 128;
        @sysvar::XCP::RadarFR::_g_PlReCoFw_PlReCoPer_ObjBypassingRunnable_ObjBypassingRunnable_m_pad_radarObjPort_par_out_local::TChangeableMemPool::_::_::_m_arrayPool::_0_::_elem::port_ens_r_obj_sensor_base::_::_m_movObjectInformation::_4_::STA_OBJECT_INFORMATION_ST::_::_m_ohyObjectType_st::_m_probObstacle_st::_m_probStationary_st::_m_prob1RoadsideBarrierN = 0;
        @sysvar::XCP::RadarFR::_g_PlReCoFw_PlReCoPer_ObjBypassingRunnable_ObjBypassingRunnable_m_pad_radarObjPort_par_out_local::TChangeableMemPool::_::_::_m_arrayPool::_0_::_elem::port_ens_r_obj_sensor_base::_::_m_movObjectInformation::_4_::STA_OBJECT_INFORMATION_ST::_::_m_ohyObjectType_st::_m_probObstacle_st::_m_probStationary_st::_m_prob1UnknownN = 0;
        @sysvar::XCP::RadarFR::_g_PlReCoFw_PlReCoPer_ObjBypassingRunnable_ObjBypassingRunnable_m_pad_radarObjPort_par_out_local::TChangeableMemPool::_::_::_m_arrayPool::_0_::_elem::port_ens_r_obj_sensor_base::_::_m_movObjectInformation::_4_::_m_dLengthN = 64;
        @sysvar::XCP::RadarFR::_g_PlReCoFw_PlReCoPer_ObjBypassingRunnable_ObjBypassingRunnable_m_pad_radarObjPort_par_out_local::TChangeableMemPool::_::_::_m_arrayPool::_0_::_elem::port_ens_r_obj_sensor_base::_::_m_movObjectInformation::_4_::_m_dWidthN = @Classe_Obj_Sim::obj_data.obj_width[4] * 128;
        break;

      case 4: //"Pedestrian"
        @sysvar::XCP::RadarFR::_g_PlReCoFw_PlReCoPer_ObjBypassingRunnable_ObjBypassingRunnable_m_pad_radarObjPort_par_out_local::TChangeableMemPool::_::_::_m_arrayPool::_0_::_elem::port_ens_r_obj_sensor_base::_::_m_movObjectInformation::_4_::STA_OBJECT_INFORMATION_ST::_::_m_ohyObjectType_st::_m_prob1NonObstacleN = 0;
        @sysvar::XCP::RadarFR::_g_PlReCoFw_PlReCoPer_ObjBypassingRunnable_ObjBypassingRunnable_m_pad_radarObjPort_par_out_local::TChangeableMemPool::_::_::_m_arrayPool::_0_::_elem::port_ens_r_obj_sensor_base::_::_m_movObjectInformation::_4_::STA_OBJECT_INFORMATION_ST::_::_m_ohyObjectType_st::_m_prob1ObstacleN = 128;
        @sysvar::XCP::RadarFR::_g_PlReCoFw_PlReCoPer_ObjBypassingRunnable_ObjBypassingRunnable_m_pad_radarObjPort_par_out_local::TChangeableMemPool::_::_::_m_arrayPool::_0_::_elem::port_ens_r_obj_sensor_base::_::_m_movObjectInformation::_4_::STA_OBJECT_INFORMATION_ST::_::_m_ohyObjectType_st::_m_prob1UnknownN = 0;
        @sysvar::XCP::RadarFR::_g_PlReCoFw_PlReCoPer_ObjBypassingRunnable_ObjBypassingRunnable_m_pad_radarObjPort_par_out_local::TChangeableMemPool::_::_::_m_arrayPool::_0_::_elem::port_ens_r_obj_sensor_base::_::_m_movObjectInformation::_4_::STA_OBJECT_INFORMATION_ST::_::_m_ohyObjectType_st::_m_probObstacle_st::_m_prob1UnknownN = 0;
        @sysvar::XCP::RadarFR::_g_PlReCoFw_PlReCoPer_ObjBypassingRunnable_ObjBypassingRunnable_m_pad_radarObjPort_par_out_local::TChangeableMemPool::_::_::_m_arrayPool::_0_::_elem::port_ens_r_obj_sensor_base::_::_m_movObjectInformation::_4_::STA_OBJECT_INFORMATION_ST::_::_m_ohyObjectType_st::_m_probObstacle_st::_m_probMobile_st::_m_prob1FourPlusWheelerN = 0;
        @sysvar::XCP::RadarFR::_g_PlReCoFw_PlReCoPer_ObjBypassingRunnable_ObjBypassingRunnable_m_pad_radarObjPort_par_out_local::TChangeableMemPool::_::_::_m_arrayPool::_0_::_elem::port_ens_r_obj_sensor_base::_::_m_movObjectInformation::_4_::STA_OBJECT_INFORMATION_ST::_::_m_ohyObjectType_st::_m_probObstacle_st::_m_probMobile_st::_m_prob1PedestrianN = 128;
        @sysvar::XCP::RadarFR::_g_PlReCoFw_PlReCoPer_ObjBypassingRunnable_ObjBypassingRunnable_m_pad_radarObjPort_par_out_local::TChangeableMemPool::_::_::_m_arrayPool::_0_::_elem::port_ens_r_obj_sensor_base::_::_m_movObjectInformation::_4_::STA_OBJECT_INFORMATION_ST::_::_m_ohyObjectType_st::_m_probObstacle_st::_m_probMobile_st::_m_prob1TwoWheelerN = 0;
        @sysvar::XCP::RadarFR::_g_PlReCoFw_PlReCoPer_ObjBypassingRunnable_ObjBypassingRunnable_m_pad_radarObjPort_par_out_local::TChangeableMemPool::_::_::_m_arrayPool::_0_::_elem::port_ens_r_obj_sensor_base::_::_m_movObjectInformation::_4_::STA_OBJECT_INFORMATION_ST::_::_m_ohyObjectType_st::_m_probObstacle_st::_m_probMobile_st::_m_prob1UnknownN = 0;
        @sysvar::XCP::RadarFR::_g_PlReCoFw_PlReCoPer_ObjBypassingRunnable_ObjBypassingRunnable_m_pad_radarObjPort_par_out_local::TChangeableMemPool::_::_::_m_arrayPool::_0_::_elem::port_ens_r_obj_sensor_base::_::_m_movObjectInformation::_4_::STA_OBJECT_INFORMATION_ST::_::_m_ohyObjectType_st::_m_probObstacle_st::_m_probMobile_st::_m_probFourPlusWheeler_st::_m_prob1PassengerCarN = 0;
        @sysvar::XCP::RadarFR::_g_PlReCoFw_PlReCoPer_ObjBypassingRunnable_ObjBypassingRunnable_m_pad_radarObjPort_par_out_local::TChangeableMemPool::_::_::_m_arrayPool::_0_::_elem::port_ens_r_obj_sensor_base::_::_m_movObjectInformation::_4_::STA_OBJECT_INFORMATION_ST::_::_m_ohyObjectType_st::_m_probObstacle_st::_m_probMobile_st::_m_probFourPlusWheeler_st::_m_prob1TruckN = 0;
        @sysvar::XCP::RadarFR::_g_PlReCoFw_PlReCoPer_ObjBypassingRunnable_ObjBypassingRunnable_m_pad_radarObjPort_par_out_local::TChangeableMemPool::_::_::_m_arrayPool::_0_::_elem::port_ens_r_obj_sensor_base::_::_m_movObjectInformation::_4_::STA_OBJECT_INFORMATION_ST::_::_m_ohyObjectType_st::_m_probObstacle_st::_m_probMobile_st::_m_probFourPlusWheeler_st::_m_prob1UnknownN = 128;
        @sysvar::XCP::RadarFR::_g_PlReCoFw_PlReCoPer_ObjBypassingRunnable_ObjBypassingRunnable_m_pad_radarObjPort_par_out_local::TChangeableMemPool::_::_::_m_arrayPool::_0_::_elem::port_ens_r_obj_sensor_base::_::_m_movObjectInformation::_4_::STA_OBJECT_INFORMATION_ST::_::_m_ohyObjectType_st::_m_probObstacle_st::_m_probStationary_st::_m_prob1RoadsideBarrierN = 0;
        @sysvar::XCP::RadarFR::_g_PlReCoFw_PlReCoPer_ObjBypassingRunnable_ObjBypassingRunnable_m_pad_radarObjPort_par_out_local::TChangeableMemPool::_::_::_m_arrayPool::_0_::_elem::port_ens_r_obj_sensor_base::_::_m_movObjectInformation::_4_::STA_OBJECT_INFORMATION_ST::_::_m_ohyObjectType_st::_m_probObstacle_st::_m_probStationary_st::_m_prob1UnknownN = 0;
        @sysvar::XCP::RadarFR::_g_PlReCoFw_PlReCoPer_ObjBypassingRunnable_ObjBypassingRunnable_m_pad_radarObjPort_par_out_local::TChangeableMemPool::_::_::_m_arrayPool::_0_::_elem::port_ens_r_obj_sensor_base::_::_m_movObjectInformation::_4_::_m_dLengthN = 64;
        @sysvar::XCP::RadarFR::_g_PlReCoFw_PlReCoPer_ObjBypassingRunnable_ObjBypassingRunnable_m_pad_radarObjPort_par_out_local::TChangeableMemPool::_::_::_m_arrayPool::_0_::_elem::port_ens_r_obj_sensor_base::_::_m_movObjectInformation::_4_::_m_dWidthN = @Classe_Obj_Sim::obj_data.obj_width[4] * 128;
        break;

      case 5: //"Truck"
        @sysvar::XCP::RadarFR::_g_PlReCoFw_PlReCoPer_ObjBypassingRunnable_ObjBypassingRunnable_m_pad_radarObjPort_par_out_local::TChangeableMemPool::_::_::_m_arrayPool::_0_::_elem::port_ens_r_obj_sensor_base::_::_m_movObjectInformation::_4_::STA_OBJECT_INFORMATION_ST::_::_m_ohyObjectType_st::_m_prob1NonObstacleN = 0;
        @sysvar::XCP::RadarFR::_g_PlReCoFw_PlReCoPer_ObjBypassingRunnable_ObjBypassingRunnable_m_pad_radarObjPort_par_out_local::TChangeableMemPool::_::_::_m_arrayPool::_0_::_elem::port_ens_r_obj_sensor_base::_::_m_movObjectInformation::_4_::STA_OBJECT_INFORMATION_ST::_::_m_ohyObjectType_st::_m_prob1ObstacleN = 128;
        @sysvar::XCP::RadarFR::_g_PlReCoFw_PlReCoPer_ObjBypassingRunnable_ObjBypassingRunnable_m_pad_radarObjPort_par_out_local::TChangeableMemPool::_::_::_m_arrayPool::_0_::_elem::port_ens_r_obj_sensor_base::_::_m_movObjectInformation::_4_::STA_OBJECT_INFORMATION_ST::_::_m_ohyObjectType_st::_m_prob1UnknownN = 0;
        @sysvar::XCP::RadarFR::_g_PlReCoFw_PlReCoPer_ObjBypassingRunnable_ObjBypassingRunnable_m_pad_radarObjPort_par_out_local::TChangeableMemPool::_::_::_m_arrayPool::_0_::_elem::port_ens_r_obj_sensor_base::_::_m_movObjectInformation::_4_::STA_OBJECT_INFORMATION_ST::_::_m_ohyObjectType_st::_m_probObstacle_st::_m_prob1UnknownN = 0;
        @sysvar::XCP::RadarFR::_g_PlReCoFw_PlReCoPer_ObjBypassingRunnable_ObjBypassingRunnable_m_pad_radarObjPort_par_out_local::TChangeableMemPool::_::_::_m_arrayPool::_0_::_elem::port_ens_r_obj_sensor_base::_::_m_movObjectInformation::_4_::STA_OBJECT_INFORMATION_ST::_::_m_ohyObjectType_st::_m_probObstacle_st::_m_probMobile_st::_m_prob1FourPlusWheelerN = 128;
        @sysvar::XCP::RadarFR::_g_PlReCoFw_PlReCoPer_ObjBypassingRunnable_ObjBypassingRunnable_m_pad_radarObjPort_par_out_local::TChangeableMemPool::_::_::_m_arrayPool::_0_::_elem::port_ens_r_obj_sensor_base::_::_m_movObjectInformation::_4_::STA_OBJECT_INFORMATION_ST::_::_m_ohyObjectType_st::_m_probObstacle_st::_m_probMobile_st::_m_prob1PedestrianN = 0;
        @sysvar::XCP::RadarFR::_g_PlReCoFw_PlReCoPer_ObjBypassingRunnable_ObjBypassingRunnable_m_pad_radarObjPort_par_out_local::TChangeableMemPool::_::_::_m_arrayPool::_0_::_elem::port_ens_r_obj_sensor_base::_::_m_movObjectInformation::_4_::STA_OBJECT_INFORMATION_ST::_::_m_ohyObjectType_st::_m_probObstacle_st::_m_probMobile_st::_m_prob1TwoWheelerN = 0;
        @sysvar::XCP::RadarFR::_g_PlReCoFw_PlReCoPer_ObjBypassingRunnable_ObjBypassingRunnable_m_pad_radarObjPort_par_out_local::TChangeableMemPool::_::_::_m_arrayPool::_0_::_elem::port_ens_r_obj_sensor_base::_::_m_movObjectInformation::_4_::STA_OBJECT_INFORMATION_ST::_::_m_ohyObjectType_st::_m_probObstacle_st::_m_probMobile_st::_m_prob1UnknownN = 0;
        @sysvar::XCP::RadarFR::_g_PlReCoFw_PlReCoPer_ObjBypassingRunnable_ObjBypassingRunnable_m_pad_radarObjPort_par_out_local::TChangeableMemPool::_::_::_m_arrayPool::_0_::_elem::port_ens_r_obj_sensor_base::_::_m_movObjectInformation::_4_::STA_OBJECT_INFORMATION_ST::_::_m_ohyObjectType_st::_m_probObstacle_st::_m_probMobile_st::_m_probFourPlusWheeler_st::_m_prob1PassengerCarN = 0;
        @sysvar::XCP::RadarFR::_g_PlReCoFw_PlReCoPer_ObjBypassingRunnable_ObjBypassingRunnable_m_pad_radarObjPort_par_out_local::TChangeableMemPool::_::_::_m_arrayPool::_0_::_elem::port_ens_r_obj_sensor_base::_::_m_movObjectInformation::_4_::STA_OBJECT_INFORMATION_ST::_::_m_ohyObjectType_st::_m_probObstacle_st::_m_probMobile_st::_m_probFourPlusWheeler_st::_m_prob1TruckN = 128;
        @sysvar::XCP::RadarFR::_g_PlReCoFw_PlReCoPer_ObjBypassingRunnable_ObjBypassingRunnable_m_pad_radarObjPort_par_out_local::TChangeableMemPool::_::_::_m_arrayPool::_0_::_elem::port_ens_r_obj_sensor_base::_::_m_movObjectInformation::_4_::STA_OBJECT_INFORMATION_ST::_::_m_ohyObjectType_st::_m_probObstacle_st::_m_probMobile_st::_m_probFourPlusWheeler_st::_m_prob1UnknownN = 0;
        @sysvar::XCP::RadarFR::_g_PlReCoFw_PlReCoPer_ObjBypassingRunnable_ObjBypassingRunnable_m_pad_radarObjPort_par_out_local::TChangeableMemPool::_::_::_m_arrayPool::_0_::_elem::port_ens_r_obj_sensor_base::_::_m_movObjectInformation::_4_::STA_OBJECT_INFORMATION_ST::_::_m_ohyObjectType_st::_m_probObstacle_st::_m_probStationary_st::_m_prob1RoadsideBarrierN = 0;
        @sysvar::XCP::RadarFR::_g_PlReCoFw_PlReCoPer_ObjBypassingRunnable_ObjBypassingRunnable_m_pad_radarObjPort_par_out_local::TChangeableMemPool::_::_::_m_arrayPool::_0_::_elem::port_ens_r_obj_sensor_base::_::_m_movObjectInformation::_4_::STA_OBJECT_INFORMATION_ST::_::_m_ohyObjectType_st::_m_probObstacle_st::_m_probStationary_st::_m_prob1UnknownN = 0;
        @sysvar::XCP::RadarFR::_g_PlReCoFw_PlReCoPer_ObjBypassingRunnable_ObjBypassingRunnable_m_pad_radarObjPort_par_out_local::TChangeableMemPool::_::_::_m_arrayPool::_0_::_elem::port_ens_r_obj_sensor_base::_::_m_movObjectInformation::_4_::_m_dLengthN = 64;
        @sysvar::XCP::RadarFR::_g_PlReCoFw_PlReCoPer_ObjBypassingRunnable_ObjBypassingRunnable_m_pad_radarObjPort_par_out_local::TChangeableMemPool::_::_::_m_arrayPool::_0_::_elem::port_ens_r_obj_sensor_base::_::_m_movObjectInformation::_4_::_m_dWidthN = @Classe_Obj_Sim::obj_data.obj_width[4] * 128;
        break;

      case 6: //"PassengerCar"
        @sysvar::XCP::RadarFR::_g_PlReCoFw_PlReCoPer_ObjBypassingRunnable_ObjBypassingRunnable_m_pad_radarObjPort_par_out_local::TChangeableMemPool::_::_::_m_arrayPool::_0_::_elem::port_ens_r_obj_sensor_base::_::_m_movObjectInformation::_4_::STA_OBJECT_INFORMATION_ST::_::_m_ohyObjectType_st::_m_prob1NonObstacleN = 0;
        @sysvar::XCP::RadarFR::_g_PlReCoFw_PlReCoPer_ObjBypassingRunnable_ObjBypassingRunnable_m_pad_radarObjPort_par_out_local::TChangeableMemPool::_::_::_m_arrayPool::_0_::_elem::port_ens_r_obj_sensor_base::_::_m_movObjectInformation::_4_::STA_OBJECT_INFORMATION_ST::_::_m_ohyObjectType_st::_m_prob1ObstacleN = 128;
        @sysvar::XCP::RadarFR::_g_PlReCoFw_PlReCoPer_ObjBypassingRunnable_ObjBypassingRunnable_m_pad_radarObjPort_par_out_local::TChangeableMemPool::_::_::_m_arrayPool::_0_::_elem::port_ens_r_obj_sensor_base::_::_m_movObjectInformation::_4_::STA_OBJECT_INFORMATION_ST::_::_m_ohyObjectType_st::_m_prob1UnknownN = 0;
        @sysvar::XCP::RadarFR::_g_PlReCoFw_PlReCoPer_ObjBypassingRunnable_ObjBypassingRunnable_m_pad_radarObjPort_par_out_local::TChangeableMemPool::_::_::_m_arrayPool::_0_::_elem::port_ens_r_obj_sensor_base::_::_m_movObjectInformation::_4_::STA_OBJECT_INFORMATION_ST::_::_m_ohyObjectType_st::_m_probObstacle_st::_m_prob1UnknownN = 0;
        @sysvar::XCP::RadarFR::_g_PlReCoFw_PlReCoPer_ObjBypassingRunnable_ObjBypassingRunnable_m_pad_radarObjPort_par_out_local::TChangeableMemPool::_::_::_m_arrayPool::_0_::_elem::port_ens_r_obj_sensor_base::_::_m_movObjectInformation::_4_::STA_OBJECT_INFORMATION_ST::_::_m_ohyObjectType_st::_m_probObstacle_st::_m_probMobile_st::_m_prob1FourPlusWheelerN = 128;
        @sysvar::XCP::RadarFR::_g_PlReCoFw_PlReCoPer_ObjBypassingRunnable_ObjBypassingRunnable_m_pad_radarObjPort_par_out_local::TChangeableMemPool::_::_::_m_arrayPool::_0_::_elem::port_ens_r_obj_sensor_base::_::_m_movObjectInformation::_4_::STA_OBJECT_INFORMATION_ST::_::_m_ohyObjectType_st::_m_probObstacle_st::_m_probMobile_st::_m_prob1PedestrianN = 0;
        @sysvar::XCP::RadarFR::_g_PlReCoFw_PlReCoPer_ObjBypassingRunnable_ObjBypassingRunnable_m_pad_radarObjPort_par_out_local::TChangeableMemPool::_::_::_m_arrayPool::_0_::_elem::port_ens_r_obj_sensor_base::_::_m_movObjectInformation::_4_::STA_OBJECT_INFORMATION_ST::_::_m_ohyObjectType_st::_m_probObstacle_st::_m_probMobile_st::_m_prob1TwoWheelerN = 0;
        @sysvar::XCP::RadarFR::_g_PlReCoFw_PlReCoPer_ObjBypassingRunnable_ObjBypassingRunnable_m_pad_radarObjPort_par_out_local::TChangeableMemPool::_::_::_m_arrayPool::_0_::_elem::port_ens_r_obj_sensor_base::_::_m_movObjectInformation::_4_::STA_OBJECT_INFORMATION_ST::_::_m_ohyObjectType_st::_m_probObstacle_st::_m_probMobile_st::_m_prob1UnknownN = 0;
        @sysvar::XCP::RadarFR::_g_PlReCoFw_PlReCoPer_ObjBypassingRunnable_ObjBypassingRunnable_m_pad_radarObjPort_par_out_local::TChangeableMemPool::_::_::_m_arrayPool::_0_::_elem::port_ens_r_obj_sensor_base::_::_m_movObjectInformation::_4_::STA_OBJECT_INFORMATION_ST::_::_m_ohyObjectType_st::_m_probObstacle_st::_m_probMobile_st::_m_probFourPlusWheeler_st::_m_prob1PassengerCarN = 128;
        @sysvar::XCP::RadarFR::_g_PlReCoFw_PlReCoPer_ObjBypassingRunnable_ObjBypassingRunnable_m_pad_radarObjPort_par_out_local::TChangeableMemPool::_::_::_m_arrayPool::_0_::_elem::port_ens_r_obj_sensor_base::_::_m_movObjectInformation::_4_::STA_OBJECT_INFORMATION_ST::_::_m_ohyObjectType_st::_m_probObstacle_st::_m_probMobile_st::_m_probFourPlusWheeler_st::_m_prob1TruckN = 0;
        @sysvar::XCP::RadarFR::_g_PlReCoFw_PlReCoPer_ObjBypassingRunnable_ObjBypassingRunnable_m_pad_radarObjPort_par_out_local::TChangeableMemPool::_::_::_m_arrayPool::_0_::_elem::port_ens_r_obj_sensor_base::_::_m_movObjectInformation::_4_::STA_OBJECT_INFORMATION_ST::_::_m_ohyObjectType_st::_m_probObstacle_st::_m_probMobile_st::_m_probFourPlusWheeler_st::_m_prob1UnknownN = 0;
        @sysvar::XCP::RadarFR::_g_PlReCoFw_PlReCoPer_ObjBypassingRunnable_ObjBypassingRunnable_m_pad_radarObjPort_par_out_local::TChangeableMemPool::_::_::_m_arrayPool::_0_::_elem::port_ens_r_obj_sensor_base::_::_m_movObjectInformation::_4_::STA_OBJECT_INFORMATION_ST::_::_m_ohyObjectType_st::_m_probObstacle_st::_m_probStationary_st::_m_prob1RoadsideBarrierN = 0;
        @sysvar::XCP::RadarFR::_g_PlReCoFw_PlReCoPer_ObjBypassingRunnable_ObjBypassingRunnable_m_pad_radarObjPort_par_out_local::TChangeableMemPool::_::_::_m_arrayPool::_0_::_elem::port_ens_r_obj_sensor_base::_::_m_movObjectInformation::_4_::STA_OBJECT_INFORMATION_ST::_::_m_ohyObjectType_st::_m_probObstacle_st::_m_probStationary_st::_m_prob1UnknownN = 0;
        @sysvar::XCP::RadarFR::_g_PlReCoFw_PlReCoPer_ObjBypassingRunnable_ObjBypassingRunnable_m_pad_radarObjPort_par_out_local::TChangeableMemPool::_::_::_m_arrayPool::_0_::_elem::port_ens_r_obj_sensor_base::_::_m_movObjectInformation::_4_::_m_dLengthN = 64;
        @sysvar::XCP::RadarFR::_g_PlReCoFw_PlReCoPer_ObjBypassingRunnable_ObjBypassingRunnable_m_pad_radarObjPort_par_out_local::TChangeableMemPool::_::_::_m_arrayPool::_0_::_elem::port_ens_r_obj_sensor_base::_::_m_movObjectInformation::_4_::_m_dWidthN = @Classe_Obj_Sim::obj_data.obj_width[4] * 128;
        break;
    }
    break;

    case 5: //"Object-5"
    //constant
    @sysvar::XCP::RadarFR::_g_PlReCoFw_PlReCoPer_ObjBypassingRunnable_ObjBypassingRunnable_m_pad_radarObjPort_par_out_local::TChangeableMemPool::_::_::_m_arrayPool::_0_::_elem::port_ens_r_obj_sensor_base::_::_m_movObjectInformation::_5_::STA_OBJECT_INFORMATION_ST::_::_Meas_b = 1;
    @sysvar::XCP::RadarFR::_g_PlReCoFw_PlReCoPer_ObjBypassingRunnable_ObjBypassingRunnable_m_pad_radarObjPort_par_out_local::TChangeableMemPool::_::_::_m_arrayPool::_0_::_elem::port_ens_r_obj_sensor_base::_::_m_movObjectInformation::_5_::STA_OBJECT_INFORMATION_ST::_::_Measurable_b = 1;
    @sysvar::XCP::RadarFR::_g_PlReCoFw_PlReCoPer_ObjBypassingRunnable_ObjBypassingRunnable_m_pad_radarObjPort_par_out_local::TChangeableMemPool::_::_::_m_arrayPool::_0_::_elem::port_ens_r_obj_sensor_base::_::_m_movObjectInformation::_5_::STA_OBJECT_INFORMATION_ST::_::_Valid_b = 1;
    @sysvar::XCP::RadarFR::_g_PlReCoFw_PlReCoPer_ObjBypassingRunnable_ObjBypassingRunnable_m_pad_radarObjPort_par_out_local::TChangeableMemPool::_::_::_m_arrayPool::_0_::_elem::port_ens_r_obj_sensor_base::_::_m_movObjectInformation::_5_::_m_covarDxAxN = 0;
    @sysvar::XCP::RadarFR::_g_PlReCoFw_PlReCoPer_ObjBypassingRunnable_ObjBypassingRunnable_m_pad_radarObjPort_par_out_local::TChangeableMemPool::_::_::_m_arrayPool::_0_::_elem::port_ens_r_obj_sensor_base::_::_m_movObjectInformation::_5_::_m_covarDxVxN = 0;
    @sysvar::XCP::RadarFR::_g_PlReCoFw_PlReCoPer_ObjBypassingRunnable_ObjBypassingRunnable_m_pad_radarObjPort_par_out_local::TChangeableMemPool::_::_::_m_arrayPool::_0_::_elem::port_ens_r_obj_sensor_base::_::_m_movObjectInformation::_5_::_m_covarDyVyN = 0;
    @sysvar::XCP::RadarFR::_g_PlReCoFw_PlReCoPer_ObjBypassingRunnable_ObjBypassingRunnable_m_pad_radarObjPort_par_out_local::TChangeableMemPool::_::_::_m_arrayPool::_0_::_elem::port_ens_r_obj_sensor_base::_::_m_movObjectInformation::_5_::_m_covarDyWidthN = 0;
    @sysvar::XCP::RadarFR::_g_PlReCoFw_PlReCoPer_ObjBypassingRunnable_ObjBypassingRunnable_m_pad_radarObjPort_par_out_local::TChangeableMemPool::_::_::_m_arrayPool::_0_::_elem::port_ens_r_obj_sensor_base::_::_m_movObjectInformation::_5_::_m_covarVxAxN = 0;
    @sysvar::XCP::RadarFR::_g_PlReCoFw_PlReCoPer_ObjBypassingRunnable_ObjBypassingRunnable_m_pad_radarObjPort_par_out_local::TChangeableMemPool::_::_::_m_arrayPool::_0_::_elem::port_ens_r_obj_sensor_base::_::_m_movObjectInformation::_5_::_m_varAxN = 0;
    @sysvar::XCP::RadarFR::_g_PlReCoFw_PlReCoPer_ObjBypassingRunnable_ObjBypassingRunnable_m_pad_radarObjPort_par_out_local::TChangeableMemPool::_::_::_m_arrayPool::_0_::_elem::port_ens_r_obj_sensor_base::_::_m_movObjectInformation::_5_::_m_varAyN = 0;
    @sysvar::XCP::RadarFR::_g_PlReCoFw_PlReCoPer_ObjBypassingRunnable_ObjBypassingRunnable_m_pad_radarObjPort_par_out_local::TChangeableMemPool::_::_::_m_arrayPool::_0_::_elem::port_ens_r_obj_sensor_base::_::_m_movObjectInformation::_5_::_m_varVxN = 0;
    @sysvar::XCP::RadarFR::_g_PlReCoFw_PlReCoPer_ObjBypassingRunnable_ObjBypassingRunnable_m_pad_radarObjPort_par_out_local::TChangeableMemPool::_::_::_m_arrayPool::_0_::_elem::port_ens_r_obj_sensor_base::_::_m_movObjectInformation::_5_::_m_varVyN = 0;
    @sysvar::XCP::RadarFR::_g_PlReCoFw_PlReCoPer_ObjBypassingRunnable_ObjBypassingRunnable_m_pad_radarObjPort_par_out_local::TChangeableMemPool::_::_::_m_arrayPool::_0_::_elem::port_ens_r_obj_sensor_base::_::_m_movObjectInformation::_5_::STA_OBJECT_INFORMATION_ST::_::_m_varDxN = 0;
    @sysvar::XCP::RadarFR::_g_PlReCoFw_PlReCoPer_ObjBypassingRunnable_ObjBypassingRunnable_m_pad_radarObjPort_par_out_local::TChangeableMemPool::_::_::_m_arrayPool::_0_::_elem::port_ens_r_obj_sensor_base::_::_m_movObjectInformation::_5_::STA_OBJECT_INFORMATION_ST::_::_m_varDyN = 0;
    @sysvar::XCP::RadarFR::_g_PlReCoFw_PlReCoPer_ObjBypassingRunnable_ObjBypassingRunnable_m_pad_radarObjPort_par_out_local::TChangeableMemPool::_::_::_m_arrayPool::_0_::_elem::port_ens_r_obj_sensor_base::_::_m_movObjectInformation::_5_::_m_dVarLengthN = 0;
    @sysvar::XCP::RadarFR::_g_PlReCoFw_PlReCoPer_ObjBypassingRunnable_ObjBypassingRunnable_m_pad_radarObjPort_par_out_local::TChangeableMemPool::_::_::_m_arrayPool::_0_::_elem::port_ens_r_obj_sensor_base::_::_m_movObjectInformation::_5_::_m_dVarWidthN = 0;
    @sysvar::XCP::RadarFR::_g_PlReCoFw_PlReCoPer_ObjBypassingRunnable_ObjBypassingRunnable_m_pad_radarObjPort_par_out_local::TChangeableMemPool::_::_::_m_arrayPool::_0_::_elem::port_ens_r_obj_sensor_base::_::_m_movObjectInformation::_5_::STA_OBJECT_INFORMATION_ST::_::_m_wExistProbN = 64880;
    @sysvar::XCP::RadarFR::_g_PlReCoFw_PlReCoPer_ObjBypassingRunnable_ObjBypassingRunnable_m_pad_radarObjPort_par_out_local::TChangeableMemPool::_::_::_m_arrayPool::_0_::_elem::port_ens_r_obj_sensor_base::_::_m_movObjectInformation::_5_::_m_referencePtPosIndexN = 10;
    @sysvar::XCP::RadarFR::_g_PlReCoFw_PlReCoPer_ObjBypassingRunnable_ObjBypassingRunnable_m_pad_radarObjPort_par_out_local::TChangeableMemPool::_::_::_m_arrayPool::_0_::_elem::port_ens_r_obj_sensor_base::_::_m_movObjectInformation::_5_::_m_alpPiVarYawAngleN = 0;
    @sysvar::XCP::RadarFR::_g_PlReCoFw_PlReCoPer_ObjBypassingRunnable_ObjBypassingRunnable_m_pad_radarObjPort_par_out_local::TChangeableMemPool::_::_::_m_arrayPool::_0_::_elem::port_ens_r_obj_sensor_base::_::_m_movObjectInformation::_5_::_m_alpPiYawAngleN = 0;

    //target movement

    @sysvar::XCP::RadarFR::_g_PlReCoFw_PlReCoPer_ObjBypassingRunnable_ObjBypassingRunnable_m_pad_radarObjPort_par_out_local::TChangeableMemPool::_::_::_m_arrayPool::_0_::_elem::port_ens_r_obj_sensor_base::_::_m_movObjectInformation::_5_::STA_OBJECT_INFORMATION_ST::_::_m_dxN = @Classe_Obj_Sim::obj_data.obj_dx[5] * 128;
    @sysvar::XCP::RadarFR::_g_PlReCoFw_PlReCoPer_ObjBypassingRunnable_ObjBypassingRunnable_m_pad_radarObjPort_par_out_local::TChangeableMemPool::_::_::_m_arrayPool::_0_::_elem::port_ens_r_obj_sensor_base::_::_m_movObjectInformation::_5_::STA_OBJECT_INFORMATION_ST::_::_m_dyN = @Classe_Obj_Sim::obj_data.obj_dy[5] * 128;
    @sysvar::XCP::RadarFR::_g_PlReCoFw_PlReCoPer_ObjBypassingRunnable_ObjBypassingRunnable_m_pad_radarObjPort_par_out_local::TChangeableMemPool::_::_::_m_arrayPool::_0_::_elem::port_ens_r_obj_sensor_base::_::_m_movObjectInformation::_5_::STA_OBJECT_INFORMATION_ST::_::_m_dzN = 0;
    @sysvar::XCP::RadarFR::_g_PlReCoFw_PlReCoPer_ObjBypassingRunnable_ObjBypassingRunnable_m_pad_radarObjPort_par_out_local::TChangeableMemPool::_::_::_m_arrayPool::_0_::_elem::port_ens_r_obj_sensor_base::_::_m_movObjectInformation::_5_::_m_vxN = @Classe_Obj_Sim::obj_data.obj_relative_vx[5] * 256;
    @sysvar::XCP::RadarFR::_g_PlReCoFw_PlReCoPer_ObjBypassingRunnable_ObjBypassingRunnable_m_pad_radarObjPort_par_out_local::TChangeableMemPool::_::_::_m_arrayPool::_0_::_elem::port_ens_r_obj_sensor_base::_::_m_movObjectInformation::_5_::_m_vyN = @Classe_Obj_Sim::obj_data.obj_relative_vy[5] * 256;
    @sysvar::XCP::RadarFR::_g_PlReCoFw_PlReCoPer_ObjBypassingRunnable_ObjBypassingRunnable_m_pad_radarObjPort_par_out_local::TChangeableMemPool::_::_::_m_arrayPool::_0_::_elem::port_ens_r_obj_sensor_base::_::_m_movObjectInformation::_5_::_m_axN = 0;
    @sysvar::XCP::RadarFR::_g_PlReCoFw_PlReCoPer_ObjBypassingRunnable_ObjBypassingRunnable_m_pad_radarObjPort_par_out_local::TChangeableMemPool::_::_::_m_arrayPool::_0_::_elem::port_ens_r_obj_sensor_base::_::_m_movObjectInformation::_5_::_m_ayN = 0;

    //target object moving or not
    if (abs(@Classe_Obj_Sim::obj_data.obj_relative_vx[5]) != 0)
    {
      @sysvar::XCP::RadarFR::_g_PlReCoFw_PlReCoPer_ObjBypassingRunnable_ObjBypassingRunnable_m_pad_radarObjPort_par_out_local::TChangeableMemPool::_::_::_m_arrayPool::_0_::_elem::port_ens_r_obj_sensor_base::_::_m_movObjectInformation::_5_::STA_OBJECT_INFORMATION_ST::_::_m_prob1HasBeenObservedMovingN = 126;
      @sysvar::XCP::RadarFR::_g_PlReCoFw_PlReCoPer_ObjBypassingRunnable_ObjBypassingRunnable_m_pad_radarObjPort_par_out_local::TChangeableMemPool::_::_::_m_arrayPool::_0_::_elem::port_ens_r_obj_sensor_base::_::_m_movObjectInformation::_5_::STA_OBJECT_INFORMATION_ST::_::_m_prob1MovingN = 126;
      @sysvar::XCP::RadarFR::_g_PlReCoFw_PlReCoPer_ObjBypassingRunnable_ObjBypassingRunnable_m_pad_radarObjPort_par_out_local::TChangeableMemPool::_::_::_m_arrayPool::_0_::_elem::port_ens_r_obj_sensor_base::_::_m_movObjectInformation::_5_::STA_OBJECT_INFORMATION_ST::_::_m_ohyObjectType_st::_m_probObstacle_st::_m_prob1MobileN = 128;
      @sysvar::XCP::RadarFR::_g_PlReCoFw_PlReCoPer_ObjBypassingRunnable_ObjBypassingRunnable_m_pad_radarObjPort_par_out_local::TChangeableMemPool::_::_::_m_arrayPool::_0_::_elem::port_ens_r_obj_sensor_base::_::_m_movObjectInformation::_5_::STA_OBJECT_INFORMATION_ST::_::_m_ohyObjectType_st::_m_probObstacle_st::_m_prob1StationaryN = 0;
    }
    else
    {
      @sysvar::XCP::RadarFR::_g_PlReCoFw_PlReCoPer_ObjBypassingRunnable_ObjBypassingRunnable_m_pad_radarObjPort_par_out_local::TChangeableMemPool::_::_::_m_arrayPool::_0_::_elem::port_ens_r_obj_sensor_base::_::_m_movObjectInformation::_5_::STA_OBJECT_INFORMATION_ST::_::_m_prob1HasBeenObservedMovingN = 0;
      @sysvar::XCP::RadarFR::_g_PlReCoFw_PlReCoPer_ObjBypassingRunnable_ObjBypassingRunnable_m_pad_radarObjPort_par_out_local::TChangeableMemPool::_::_::_m_arrayPool::_0_::_elem::port_ens_r_obj_sensor_base::_::_m_movObjectInformation::_5_::STA_OBJECT_INFORMATION_ST::_::_m_prob1MovingN = 0;
      @sysvar::XCP::RadarFR::_g_PlReCoFw_PlReCoPer_ObjBypassingRunnable_ObjBypassingRunnable_m_pad_radarObjPort_par_out_local::TChangeableMemPool::_::_::_m_arrayPool::_0_::_elem::port_ens_r_obj_sensor_base::_::_m_movObjectInformation::_5_::STA_OBJECT_INFORMATION_ST::_::_m_ohyObjectType_st::_m_probObstacle_st::_m_prob1MobileN = 0;
      @sysvar::XCP::RadarFR::_g_PlReCoFw_PlReCoPer_ObjBypassingRunnable_ObjBypassingRunnable_m_pad_radarObjPort_par_out_local::TChangeableMemPool::_::_::_m_arrayPool::_0_::_elem::port_ens_r_obj_sensor_base::_::_m_movObjectInformation::_5_::STA_OBJECT_INFORMATION_ST::_::_m_ohyObjectType_st::_m_probObstacle_st::_m_prob1StationaryN = 128;
    }

      //object classification
    switch (@Classe_Obj_Sim::obj_data.obj_type[5])
    {
      case 0: //"Non-Obstacle"
        @sysvar::XCP::RadarFR::_g_PlReCoFw_PlReCoPer_ObjBypassingRunnable_ObjBypassingRunnable_m_pad_radarObjPort_par_out_local::TChangeableMemPool::_::_::_m_arrayPool::_0_::_elem::port_ens_r_obj_sensor_base::_::_m_movObjectInformation::_5_::STA_OBJECT_INFORMATION_ST::_::_m_ohyObjectType_st::_m_prob1NonObstacleN = 128;
        @sysvar::XCP::RadarFR::_g_PlReCoFw_PlReCoPer_ObjBypassingRunnable_ObjBypassingRunnable_m_pad_radarObjPort_par_out_local::TChangeableMemPool::_::_::_m_arrayPool::_0_::_elem::port_ens_r_obj_sensor_base::_::_m_movObjectInformation::_5_::STA_OBJECT_INFORMATION_ST::_::_m_ohyObjectType_st::_m_prob1ObstacleN = 0;
        @sysvar::XCP::RadarFR::_g_PlReCoFw_PlReCoPer_ObjBypassingRunnable_ObjBypassingRunnable_m_pad_radarObjPort_par_out_local::TChangeableMemPool::_::_::_m_arrayPool::_0_::_elem::port_ens_r_obj_sensor_base::_::_m_movObjectInformation::_5_::STA_OBJECT_INFORMATION_ST::_::_m_ohyObjectType_st::_m_prob1UnknownN = 0;
        @sysvar::XCP::RadarFR::_g_PlReCoFw_PlReCoPer_ObjBypassingRunnable_ObjBypassingRunnable_m_pad_radarObjPort_par_out_local::TChangeableMemPool::_::_::_m_arrayPool::_0_::_elem::port_ens_r_obj_sensor_base::_::_m_movObjectInformation::_5_::STA_OBJECT_INFORMATION_ST::_::_m_ohyObjectType_st::_m_probObstacle_st::_m_prob1UnknownN = 128;
        @sysvar::XCP::RadarFR::_g_PlReCoFw_PlReCoPer_ObjBypassingRunnable_ObjBypassingRunnable_m_pad_radarObjPort_par_out_local::TChangeableMemPool::_::_::_m_arrayPool::_0_::_elem::port_ens_r_obj_sensor_base::_::_m_movObjectInformation::_5_::STA_OBJECT_INFORMATION_ST::_::_m_ohyObjectType_st::_m_probObstacle_st::_m_probMobile_st::_m_prob1FourPlusWheelerN = 0;
        @sysvar::XCP::RadarFR::_g_PlReCoFw_PlReCoPer_ObjBypassingRunnable_ObjBypassingRunnable_m_pad_radarObjPort_par_out_local::TChangeableMemPool::_::_::_m_arrayPool::_0_::_elem::port_ens_r_obj_sensor_base::_::_m_movObjectInformation::_5_::STA_OBJECT_INFORMATION_ST::_::_m_ohyObjectType_st::_m_probObstacle_st::_m_probMobile_st::_m_prob1PedestrianN = 0;
        @sysvar::XCP::RadarFR::_g_PlReCoFw_PlReCoPer_ObjBypassingRunnable_ObjBypassingRunnable_m_pad_radarObjPort_par_out_local::TChangeableMemPool::_::_::_m_arrayPool::_0_::_elem::port_ens_r_obj_sensor_base::_::_m_movObjectInformation::_5_::STA_OBJECT_INFORMATION_ST::_::_m_ohyObjectType_st::_m_probObstacle_st::_m_probMobile_st::_m_prob1TwoWheelerN = 0;
        @sysvar::XCP::RadarFR::_g_PlReCoFw_PlReCoPer_ObjBypassingRunnable_ObjBypassingRunnable_m_pad_radarObjPort_par_out_local::TChangeableMemPool::_::_::_m_arrayPool::_0_::_elem::port_ens_r_obj_sensor_base::_::_m_movObjectInformation::_5_::STA_OBJECT_INFORMATION_ST::_::_m_ohyObjectType_st::_m_probObstacle_st::_m_probMobile_st::_m_prob1UnknownN = 128;
        @sysvar::XCP::RadarFR::_g_PlReCoFw_PlReCoPer_ObjBypassingRunnable_ObjBypassingRunnable_m_pad_radarObjPort_par_out_local::TChangeableMemPool::_::_::_m_arrayPool::_0_::_elem::port_ens_r_obj_sensor_base::_::_m_movObjectInformation::_5_::STA_OBJECT_INFORMATION_ST::_::_m_ohyObjectType_st::_m_probObstacle_st::_m_probMobile_st::_m_probFourPlusWheeler_st::_m_prob1PassengerCarN = 0;
        @sysvar::XCP::RadarFR::_g_PlReCoFw_PlReCoPer_ObjBypassingRunnable_ObjBypassingRunnable_m_pad_radarObjPort_par_out_local::TChangeableMemPool::_::_::_m_arrayPool::_0_::_elem::port_ens_r_obj_sensor_base::_::_m_movObjectInformation::_5_::STA_OBJECT_INFORMATION_ST::_::_m_ohyObjectType_st::_m_probObstacle_st::_m_probMobile_st::_m_probFourPlusWheeler_st::_m_prob1TruckN = 0;
        @sysvar::XCP::RadarFR::_g_PlReCoFw_PlReCoPer_ObjBypassingRunnable_ObjBypassingRunnable_m_pad_radarObjPort_par_out_local::TChangeableMemPool::_::_::_m_arrayPool::_0_::_elem::port_ens_r_obj_sensor_base::_::_m_movObjectInformation::_5_::STA_OBJECT_INFORMATION_ST::_::_m_ohyObjectType_st::_m_probObstacle_st::_m_probMobile_st::_m_probFourPlusWheeler_st::_m_prob1UnknownN = 128;
        @sysvar::XCP::RadarFR::_g_PlReCoFw_PlReCoPer_ObjBypassingRunnable_ObjBypassingRunnable_m_pad_radarObjPort_par_out_local::TChangeableMemPool::_::_::_m_arrayPool::_0_::_elem::port_ens_r_obj_sensor_base::_::_m_movObjectInformation::_5_::STA_OBJECT_INFORMATION_ST::_::_m_ohyObjectType_st::_m_probObstacle_st::_m_probStationary_st::_m_prob1RoadsideBarrierN = 0;
        @sysvar::XCP::RadarFR::_g_PlReCoFw_PlReCoPer_ObjBypassingRunnable_ObjBypassingRunnable_m_pad_radarObjPort_par_out_local::TChangeableMemPool::_::_::_m_arrayPool::_0_::_elem::port_ens_r_obj_sensor_base::_::_m_movObjectInformation::_5_::STA_OBJECT_INFORMATION_ST::_::_m_ohyObjectType_st::_m_probObstacle_st::_m_probStationary_st::_m_prob1UnknownN = 128;
        @sysvar::XCP::RadarFR::_g_PlReCoFw_PlReCoPer_ObjBypassingRunnable_ObjBypassingRunnable_m_pad_radarObjPort_par_out_local::TChangeableMemPool::_::_::_m_arrayPool::_0_::_elem::port_ens_r_obj_sensor_base::_::_m_movObjectInformation::_5_::_m_dLengthN = 64;
        @sysvar::XCP::RadarFR::_g_PlReCoFw_PlReCoPer_ObjBypassingRunnable_ObjBypassingRunnable_m_pad_radarObjPort_par_out_local::TChangeableMemPool::_::_::_m_arrayPool::_0_::_elem::port_ens_r_obj_sensor_base::_::_m_movObjectInformation::_5_::_m_dWidthN = @Classe_Obj_Sim::obj_data.obj_width[5] * 128;
        break;

      case 1: //"unknown"
        @sysvar::XCP::RadarFR::_g_PlReCoFw_PlReCoPer_ObjBypassingRunnable_ObjBypassingRunnable_m_pad_radarObjPort_par_out_local::TChangeableMemPool::_::_::_m_arrayPool::_0_::_elem::port_ens_r_obj_sensor_base::_::_m_movObjectInformation::_5_::STA_OBJECT_INFORMATION_ST::_::_m_ohyObjectType_st::_m_prob1NonObstacleN = 0;
        @sysvar::XCP::RadarFR::_g_PlReCoFw_PlReCoPer_ObjBypassingRunnable_ObjBypassingRunnable_m_pad_radarObjPort_par_out_local::TChangeableMemPool::_::_::_m_arrayPool::_0_::_elem::port_ens_r_obj_sensor_base::_::_m_movObjectInformation::_5_::STA_OBJECT_INFORMATION_ST::_::_m_ohyObjectType_st::_m_prob1ObstacleN = 0;
        @sysvar::XCP::RadarFR::_g_PlReCoFw_PlReCoPer_ObjBypassingRunnable_ObjBypassingRunnable_m_pad_radarObjPort_par_out_local::TChangeableMemPool::_::_::_m_arrayPool::_0_::_elem::port_ens_r_obj_sensor_base::_::_m_movObjectInformation::_5_::STA_OBJECT_INFORMATION_ST::_::_m_ohyObjectType_st::_m_prob1UnknownN = 128;
        @sysvar::XCP::RadarFR::_g_PlReCoFw_PlReCoPer_ObjBypassingRunnable_ObjBypassingRunnable_m_pad_radarObjPort_par_out_local::TChangeableMemPool::_::_::_m_arrayPool::_0_::_elem::port_ens_r_obj_sensor_base::_::_m_movObjectInformation::_5_::STA_OBJECT_INFORMATION_ST::_::_m_ohyObjectType_st::_m_probObstacle_st::_m_prob1UnknownN = 128;
        @sysvar::XCP::RadarFR::_g_PlReCoFw_PlReCoPer_ObjBypassingRunnable_ObjBypassingRunnable_m_pad_radarObjPort_par_out_local::TChangeableMemPool::_::_::_m_arrayPool::_0_::_elem::port_ens_r_obj_sensor_base::_::_m_movObjectInformation::_5_::STA_OBJECT_INFORMATION_ST::_::_m_ohyObjectType_st::_m_probObstacle_st::_m_probMobile_st::_m_prob1FourPlusWheelerN = 0;
        @sysvar::XCP::RadarFR::_g_PlReCoFw_PlReCoPer_ObjBypassingRunnable_ObjBypassingRunnable_m_pad_radarObjPort_par_out_local::TChangeableMemPool::_::_::_m_arrayPool::_0_::_elem::port_ens_r_obj_sensor_base::_::_m_movObjectInformation::_5_::STA_OBJECT_INFORMATION_ST::_::_m_ohyObjectType_st::_m_probObstacle_st::_m_probMobile_st::_m_prob1PedestrianN = 0;
        @sysvar::XCP::RadarFR::_g_PlReCoFw_PlReCoPer_ObjBypassingRunnable_ObjBypassingRunnable_m_pad_radarObjPort_par_out_local::TChangeableMemPool::_::_::_m_arrayPool::_0_::_elem::port_ens_r_obj_sensor_base::_::_m_movObjectInformation::_5_::STA_OBJECT_INFORMATION_ST::_::_m_ohyObjectType_st::_m_probObstacle_st::_m_probMobile_st::_m_prob1TwoWheelerN = 0;
        @sysvar::XCP::RadarFR::_g_PlReCoFw_PlReCoPer_ObjBypassingRunnable_ObjBypassingRunnable_m_pad_radarObjPort_par_out_local::TChangeableMemPool::_::_::_m_arrayPool::_0_::_elem::port_ens_r_obj_sensor_base::_::_m_movObjectInformation::_5_::STA_OBJECT_INFORMATION_ST::_::_m_ohyObjectType_st::_m_probObstacle_st::_m_probMobile_st::_m_prob1UnknownN = 128;
        @sysvar::XCP::RadarFR::_g_PlReCoFw_PlReCoPer_ObjBypassingRunnable_ObjBypassingRunnable_m_pad_radarObjPort_par_out_local::TChangeableMemPool::_::_::_m_arrayPool::_0_::_elem::port_ens_r_obj_sensor_base::_::_m_movObjectInformation::_5_::STA_OBJECT_INFORMATION_ST::_::_m_ohyObjectType_st::_m_probObstacle_st::_m_probMobile_st::_m_probFourPlusWheeler_st::_m_prob1PassengerCarN = 0;
        @sysvar::XCP::RadarFR::_g_PlReCoFw_PlReCoPer_ObjBypassingRunnable_ObjBypassingRunnable_m_pad_radarObjPort_par_out_local::TChangeableMemPool::_::_::_m_arrayPool::_0_::_elem::port_ens_r_obj_sensor_base::_::_m_movObjectInformation::_5_::STA_OBJECT_INFORMATION_ST::_::_m_ohyObjectType_st::_m_probObstacle_st::_m_probMobile_st::_m_probFourPlusWheeler_st::_m_prob1TruckN = 0;
        @sysvar::XCP::RadarFR::_g_PlReCoFw_PlReCoPer_ObjBypassingRunnable_ObjBypassingRunnable_m_pad_radarObjPort_par_out_local::TChangeableMemPool::_::_::_m_arrayPool::_0_::_elem::port_ens_r_obj_sensor_base::_::_m_movObjectInformation::_5_::STA_OBJECT_INFORMATION_ST::_::_m_ohyObjectType_st::_m_probObstacle_st::_m_probMobile_st::_m_probFourPlusWheeler_st::_m_prob1UnknownN = 128;
        @sysvar::XCP::RadarFR::_g_PlReCoFw_PlReCoPer_ObjBypassingRunnable_ObjBypassingRunnable_m_pad_radarObjPort_par_out_local::TChangeableMemPool::_::_::_m_arrayPool::_0_::_elem::port_ens_r_obj_sensor_base::_::_m_movObjectInformation::_5_::STA_OBJECT_INFORMATION_ST::_::_m_ohyObjectType_st::_m_probObstacle_st::_m_probStationary_st::_m_prob1RoadsideBarrierN = 0;
        @sysvar::XCP::RadarFR::_g_PlReCoFw_PlReCoPer_ObjBypassingRunnable_ObjBypassingRunnable_m_pad_radarObjPort_par_out_local::TChangeableMemPool::_::_::_m_arrayPool::_0_::_elem::port_ens_r_obj_sensor_base::_::_m_movObjectInformation::_5_::STA_OBJECT_INFORMATION_ST::_::_m_ohyObjectType_st::_m_probObstacle_st::_m_probStationary_st::_m_prob1UnknownN = 128;
        @sysvar::XCP::RadarFR::_g_PlReCoFw_PlReCoPer_ObjBypassingRunnable_ObjBypassingRunnable_m_pad_radarObjPort_par_out_local::TChangeableMemPool::_::_::_m_arrayPool::_0_::_elem::port_ens_r_obj_sensor_base::_::_m_movObjectInformation::_5_::_m_dLengthN = 0;
        @sysvar::XCP::RadarFR::_g_PlReCoFw_PlReCoPer_ObjBypassingRunnable_ObjBypassingRunnable_m_pad_radarObjPort_par_out_local::TChangeableMemPool::_::_::_m_arrayPool::_0_::_elem::port_ens_r_obj_sensor_base::_::_m_movObjectInformation::_5_::_m_dWidthN = @Classe_Obj_Sim::obj_data.obj_width[5] * 128;
        break;

      case 2: //"RoadSideBarrier"
        @sysvar::XCP::RadarFR::_g_PlReCoFw_PlReCoPer_ObjBypassingRunnable_ObjBypassingRunnable_m_pad_radarObjPort_par_out_local::TChangeableMemPool::_::_::_m_arrayPool::_0_::_elem::port_ens_r_obj_sensor_base::_::_m_movObjectInformation::_5_::STA_OBJECT_INFORMATION_ST::_::_m_ohyObjectType_st::_m_prob1NonObstacleN = 0;
        @sysvar::XCP::RadarFR::_g_PlReCoFw_PlReCoPer_ObjBypassingRunnable_ObjBypassingRunnable_m_pad_radarObjPort_par_out_local::TChangeableMemPool::_::_::_m_arrayPool::_0_::_elem::port_ens_r_obj_sensor_base::_::_m_movObjectInformation::_5_::STA_OBJECT_INFORMATION_ST::_::_m_ohyObjectType_st::_m_prob1ObstacleN = 128;
        @sysvar::XCP::RadarFR::_g_PlReCoFw_PlReCoPer_ObjBypassingRunnable_ObjBypassingRunnable_m_pad_radarObjPort_par_out_local::TChangeableMemPool::_::_::_m_arrayPool::_0_::_elem::port_ens_r_obj_sensor_base::_::_m_movObjectInformation::_5_::STA_OBJECT_INFORMATION_ST::_::_m_ohyObjectType_st::_m_prob1UnknownN = 0;
        @sysvar::XCP::RadarFR::_g_PlReCoFw_PlReCoPer_ObjBypassingRunnable_ObjBypassingRunnable_m_pad_radarObjPort_par_out_local::TChangeableMemPool::_::_::_m_arrayPool::_0_::_elem::port_ens_r_obj_sensor_base::_::_m_movObjectInformation::_5_::STA_OBJECT_INFORMATION_ST::_::_m_ohyObjectType_st::_m_probObstacle_st::_m_prob1MobileN = 0;
        @sysvar::XCP::RadarFR::_g_PlReCoFw_PlReCoPer_ObjBypassingRunnable_ObjBypassingRunnable_m_pad_radarObjPort_par_out_local::TChangeableMemPool::_::_::_m_arrayPool::_0_::_elem::port_ens_r_obj_sensor_base::_::_m_movObjectInformation::_5_::STA_OBJECT_INFORMATION_ST::_::_m_ohyObjectType_st::_m_probObstacle_st::_m_prob1StationaryN = 128;
        @sysvar::XCP::RadarFR::_g_PlReCoFw_PlReCoPer_ObjBypassingRunnable_ObjBypassingRunnable_m_pad_radarObjPort_par_out_local::TChangeableMemPool::_::_::_m_arrayPool::_0_::_elem::port_ens_r_obj_sensor_base::_::_m_movObjectInformation::_5_::STA_OBJECT_INFORMATION_ST::_::_m_ohyObjectType_st::_m_probObstacle_st::_m_prob1UnknownN = 0;
        @sysvar::XCP::RadarFR::_g_PlReCoFw_PlReCoPer_ObjBypassingRunnable_ObjBypassingRunnable_m_pad_radarObjPort_par_out_local::TChangeableMemPool::_::_::_m_arrayPool::_0_::_elem::port_ens_r_obj_sensor_base::_::_m_movObjectInformation::_5_::STA_OBJECT_INFORMATION_ST::_::_m_ohyObjectType_st::_m_probObstacle_st::_m_probMobile_st::_m_prob1FourPlusWheelerN = 0;
        @sysvar::XCP::RadarFR::_g_PlReCoFw_PlReCoPer_ObjBypassingRunnable_ObjBypassingRunnable_m_pad_radarObjPort_par_out_local::TChangeableMemPool::_::_::_m_arrayPool::_0_::_elem::port_ens_r_obj_sensor_base::_::_m_movObjectInformation::_5_::STA_OBJECT_INFORMATION_ST::_::_m_ohyObjectType_st::_m_probObstacle_st::_m_probMobile_st::_m_prob1PedestrianN = 0;
        @sysvar::XCP::RadarFR::_g_PlReCoFw_PlReCoPer_ObjBypassingRunnable_ObjBypassingRunnable_m_pad_radarObjPort_par_out_local::TChangeableMemPool::_::_::_m_arrayPool::_0_::_elem::port_ens_r_obj_sensor_base::_::_m_movObjectInformation::_5_::STA_OBJECT_INFORMATION_ST::_::_m_ohyObjectType_st::_m_probObstacle_st::_m_probMobile_st::_m_prob1TwoWheelerN = 0;
        @sysvar::XCP::RadarFR::_g_PlReCoFw_PlReCoPer_ObjBypassingRunnable_ObjBypassingRunnable_m_pad_radarObjPort_par_out_local::TChangeableMemPool::_::_::_m_arrayPool::_0_::_elem::port_ens_r_obj_sensor_base::_::_m_movObjectInformation::_5_::STA_OBJECT_INFORMATION_ST::_::_m_ohyObjectType_st::_m_probObstacle_st::_m_probMobile_st::_m_prob1UnknownN = 0;
        @sysvar::XCP::RadarFR::_g_PlReCoFw_PlReCoPer_ObjBypassingRunnable_ObjBypassingRunnable_m_pad_radarObjPort_par_out_local::TChangeableMemPool::_::_::_m_arrayPool::_0_::_elem::port_ens_r_obj_sensor_base::_::_m_movObjectInformation::_5_::STA_OBJECT_INFORMATION_ST::_::_m_ohyObjectType_st::_m_probObstacle_st::_m_probMobile_st::_m_probFourPlusWheeler_st::_m_prob1PassengerCarN = 0;
        @sysvar::XCP::RadarFR::_g_PlReCoFw_PlReCoPer_ObjBypassingRunnable_ObjBypassingRunnable_m_pad_radarObjPort_par_out_local::TChangeableMemPool::_::_::_m_arrayPool::_0_::_elem::port_ens_r_obj_sensor_base::_::_m_movObjectInformation::_5_::STA_OBJECT_INFORMATION_ST::_::_m_ohyObjectType_st::_m_probObstacle_st::_m_probMobile_st::_m_probFourPlusWheeler_st::_m_prob1TruckN = 0;
        @sysvar::XCP::RadarFR::_g_PlReCoFw_PlReCoPer_ObjBypassingRunnable_ObjBypassingRunnable_m_pad_radarObjPort_par_out_local::TChangeableMemPool::_::_::_m_arrayPool::_0_::_elem::port_ens_r_obj_sensor_base::_::_m_movObjectInformation::_5_::STA_OBJECT_INFORMATION_ST::_::_m_ohyObjectType_st::_m_probObstacle_st::_m_probMobile_st::_m_probFourPlusWheeler_st::_m_prob1UnknownN = 0;
        @sysvar::XCP::RadarFR::_g_PlReCoFw_PlReCoPer_ObjBypassingRunnable_ObjBypassingRunnable_m_pad_radarObjPort_par_out_local::TChangeableMemPool::_::_::_m_arrayPool::_0_::_elem::port_ens_r_obj_sensor_base::_::_m_movObjectInformation::_5_::STA_OBJECT_INFORMATION_ST::_::_m_ohyObjectType_st::_m_probObstacle_st::_m_probStationary_st::_m_prob1RoadsideBarrierN = 128;
        @sysvar::XCP::RadarFR::_g_PlReCoFw_PlReCoPer_ObjBypassingRunnable_ObjBypassingRunnable_m_pad_radarObjPort_par_out_local::TChangeableMemPool::_::_::_m_arrayPool::_0_::_elem::port_ens_r_obj_sensor_base::_::_m_movObjectInformation::_5_::STA_OBJECT_INFORMATION_ST::_::_m_ohyObjectType_st::_m_probObstacle_st::_m_probStationary_st::_m_prob1UnknownN = 0;
        @sysvar::XCP::RadarFR::_g_PlReCoFw_PlReCoPer_ObjBypassingRunnable_ObjBypassingRunnable_m_pad_radarObjPort_par_out_local::TChangeableMemPool::_::_::_m_arrayPool::_0_::_elem::port_ens_r_obj_sensor_base::_::_m_movObjectInformation::_5_::_m_dLengthN = 64;
        @sysvar::XCP::RadarFR::_g_PlReCoFw_PlReCoPer_ObjBypassingRunnable_ObjBypassingRunnable_m_pad_radarObjPort_par_out_local::TChangeableMemPool::_::_::_m_arrayPool::_0_::_elem::port_ens_r_obj_sensor_base::_::_m_movObjectInformation::_5_::_m_dWidthN = @Classe_Obj_Sim::obj_data.obj_width[5] * 128;
        break;

      case 3: //"2Wheeler"
        @sysvar::XCP::RadarFR::_g_PlReCoFw_PlReCoPer_ObjBypassingRunnable_ObjBypassingRunnable_m_pad_radarObjPort_par_out_local::TChangeableMemPool::_::_::_m_arrayPool::_0_::_elem::port_ens_r_obj_sensor_base::_::_m_movObjectInformation::_5_::STA_OBJECT_INFORMATION_ST::_::_m_ohyObjectType_st::_m_prob1NonObstacleN = 0;
        @sysvar::XCP::RadarFR::_g_PlReCoFw_PlReCoPer_ObjBypassingRunnable_ObjBypassingRunnable_m_pad_radarObjPort_par_out_local::TChangeableMemPool::_::_::_m_arrayPool::_0_::_elem::port_ens_r_obj_sensor_base::_::_m_movObjectInformation::_5_::STA_OBJECT_INFORMATION_ST::_::_m_ohyObjectType_st::_m_prob1ObstacleN = 128;
        @sysvar::XCP::RadarFR::_g_PlReCoFw_PlReCoPer_ObjBypassingRunnable_ObjBypassingRunnable_m_pad_radarObjPort_par_out_local::TChangeableMemPool::_::_::_m_arrayPool::_0_::_elem::port_ens_r_obj_sensor_base::_::_m_movObjectInformation::_5_::STA_OBJECT_INFORMATION_ST::_::_m_ohyObjectType_st::_m_prob1UnknownN = 0;
        @sysvar::XCP::RadarFR::_g_PlReCoFw_PlReCoPer_ObjBypassingRunnable_ObjBypassingRunnable_m_pad_radarObjPort_par_out_local::TChangeableMemPool::_::_::_m_arrayPool::_0_::_elem::port_ens_r_obj_sensor_base::_::_m_movObjectInformation::_5_::STA_OBJECT_INFORMATION_ST::_::_m_ohyObjectType_st::_m_probObstacle_st::_m_prob1UnknownN = 0;
        @sysvar::XCP::RadarFR::_g_PlReCoFw_PlReCoPer_ObjBypassingRunnable_ObjBypassingRunnable_m_pad_radarObjPort_par_out_local::TChangeableMemPool::_::_::_m_arrayPool::_0_::_elem::port_ens_r_obj_sensor_base::_::_m_movObjectInformation::_5_::STA_OBJECT_INFORMATION_ST::_::_m_ohyObjectType_st::_m_probObstacle_st::_m_probMobile_st::_m_prob1FourPlusWheelerN = 0;
        @sysvar::XCP::RadarFR::_g_PlReCoFw_PlReCoPer_ObjBypassingRunnable_ObjBypassingRunnable_m_pad_radarObjPort_par_out_local::TChangeableMemPool::_::_::_m_arrayPool::_0_::_elem::port_ens_r_obj_sensor_base::_::_m_movObjectInformation::_5_::STA_OBJECT_INFORMATION_ST::_::_m_ohyObjectType_st::_m_probObstacle_st::_m_probMobile_st::_m_prob1PedestrianN = 0;
        @sysvar::XCP::RadarFR::_g_PlReCoFw_PlReCoPer_ObjBypassingRunnable_ObjBypassingRunnable_m_pad_radarObjPort_par_out_local::TChangeableMemPool::_::_::_m_arrayPool::_0_::_elem::port_ens_r_obj_sensor_base::_::_m_movObjectInformation::_5_::STA_OBJECT_INFORMATION_ST::_::_m_ohyObjectType_st::_m_probObstacle_st::_m_probMobile_st::_m_prob1TwoWheelerN = 128;
        @sysvar::XCP::RadarFR::_g_PlReCoFw_PlReCoPer_ObjBypassingRunnable_ObjBypassingRunnable_m_pad_radarObjPort_par_out_local::TChangeableMemPool::_::_::_m_arrayPool::_0_::_elem::port_ens_r_obj_sensor_base::_::_m_movObjectInformation::_5_::STA_OBJECT_INFORMATION_ST::_::_m_ohyObjectType_st::_m_probObstacle_st::_m_probMobile_st::_m_prob1UnknownN = 0;
        @sysvar::XCP::RadarFR::_g_PlReCoFw_PlReCoPer_ObjBypassingRunnable_ObjBypassingRunnable_m_pad_radarObjPort_par_out_local::TChangeableMemPool::_::_::_m_arrayPool::_0_::_elem::port_ens_r_obj_sensor_base::_::_m_movObjectInformation::_5_::STA_OBJECT_INFORMATION_ST::_::_m_ohyObjectType_st::_m_probObstacle_st::_m_probMobile_st::_m_probFourPlusWheeler_st::_m_prob1PassengerCarN = 0;
        @sysvar::XCP::RadarFR::_g_PlReCoFw_PlReCoPer_ObjBypassingRunnable_ObjBypassingRunnable_m_pad_radarObjPort_par_out_local::TChangeableMemPool::_::_::_m_arrayPool::_0_::_elem::port_ens_r_obj_sensor_base::_::_m_movObjectInformation::_5_::STA_OBJECT_INFORMATION_ST::_::_m_ohyObjectType_st::_m_probObstacle_st::_m_probMobile_st::_m_probFourPlusWheeler_st::_m_prob1TruckN = 0;
        @sysvar::XCP::RadarFR::_g_PlReCoFw_PlReCoPer_ObjBypassingRunnable_ObjBypassingRunnable_m_pad_radarObjPort_par_out_local::TChangeableMemPool::_::_::_m_arrayPool::_0_::_elem::port_ens_r_obj_sensor_base::_::_m_movObjectInformation::_5_::STA_OBJECT_INFORMATION_ST::_::_m_ohyObjectType_st::_m_probObstacle_st::_m_probMobile_st::_m_probFourPlusWheeler_st::_m_prob1UnknownN = 128;
        @sysvar::XCP::RadarFR::_g_PlReCoFw_PlReCoPer_ObjBypassingRunnable_ObjBypassingRunnable_m_pad_radarObjPort_par_out_local::TChangeableMemPool::_::_::_m_arrayPool::_0_::_elem::port_ens_r_obj_sensor_base::_::_m_movObjectInformation::_5_::STA_OBJECT_INFORMATION_ST::_::_m_ohyObjectType_st::_m_probObstacle_st::_m_probStationary_st::_m_prob1RoadsideBarrierN = 0;
        @sysvar::XCP::RadarFR::_g_PlReCoFw_PlReCoPer_ObjBypassingRunnable_ObjBypassingRunnable_m_pad_radarObjPort_par_out_local::TChangeableMemPool::_::_::_m_arrayPool::_0_::_elem::port_ens_r_obj_sensor_base::_::_m_movObjectInformation::_5_::STA_OBJECT_INFORMATION_ST::_::_m_ohyObjectType_st::_m_probObstacle_st::_m_probStationary_st::_m_prob1UnknownN = 0;
        @sysvar::XCP::RadarFR::_g_PlReCoFw_PlReCoPer_ObjBypassingRunnable_ObjBypassingRunnable_m_pad_radarObjPort_par_out_local::TChangeableMemPool::_::_::_m_arrayPool::_0_::_elem::port_ens_r_obj_sensor_base::_::_m_movObjectInformation::_5_::_m_dLengthN = 64;
        @sysvar::XCP::RadarFR::_g_PlReCoFw_PlReCoPer_ObjBypassingRunnable_ObjBypassingRunnable_m_pad_radarObjPort_par_out_local::TChangeableMemPool::_::_::_m_arrayPool::_0_::_elem::port_ens_r_obj_sensor_base::_::_m_movObjectInformation::_5_::_m_dWidthN = @Classe_Obj_Sim::obj_data.obj_width[5] * 128;
        break;

      case 4: //"Pedestrian"
        @sysvar::XCP::RadarFR::_g_PlReCoFw_PlReCoPer_ObjBypassingRunnable_ObjBypassingRunnable_m_pad_radarObjPort_par_out_local::TChangeableMemPool::_::_::_m_arrayPool::_0_::_elem::port_ens_r_obj_sensor_base::_::_m_movObjectInformation::_5_::STA_OBJECT_INFORMATION_ST::_::_m_ohyObjectType_st::_m_prob1NonObstacleN = 0;
        @sysvar::XCP::RadarFR::_g_PlReCoFw_PlReCoPer_ObjBypassingRunnable_ObjBypassingRunnable_m_pad_radarObjPort_par_out_local::TChangeableMemPool::_::_::_m_arrayPool::_0_::_elem::port_ens_r_obj_sensor_base::_::_m_movObjectInformation::_5_::STA_OBJECT_INFORMATION_ST::_::_m_ohyObjectType_st::_m_prob1ObstacleN = 128;
        @sysvar::XCP::RadarFR::_g_PlReCoFw_PlReCoPer_ObjBypassingRunnable_ObjBypassingRunnable_m_pad_radarObjPort_par_out_local::TChangeableMemPool::_::_::_m_arrayPool::_0_::_elem::port_ens_r_obj_sensor_base::_::_m_movObjectInformation::_5_::STA_OBJECT_INFORMATION_ST::_::_m_ohyObjectType_st::_m_prob1UnknownN = 0;
        @sysvar::XCP::RadarFR::_g_PlReCoFw_PlReCoPer_ObjBypassingRunnable_ObjBypassingRunnable_m_pad_radarObjPort_par_out_local::TChangeableMemPool::_::_::_m_arrayPool::_0_::_elem::port_ens_r_obj_sensor_base::_::_m_movObjectInformation::_5_::STA_OBJECT_INFORMATION_ST::_::_m_ohyObjectType_st::_m_probObstacle_st::_m_prob1UnknownN = 0;
        @sysvar::XCP::RadarFR::_g_PlReCoFw_PlReCoPer_ObjBypassingRunnable_ObjBypassingRunnable_m_pad_radarObjPort_par_out_local::TChangeableMemPool::_::_::_m_arrayPool::_0_::_elem::port_ens_r_obj_sensor_base::_::_m_movObjectInformation::_5_::STA_OBJECT_INFORMATION_ST::_::_m_ohyObjectType_st::_m_probObstacle_st::_m_probMobile_st::_m_prob1FourPlusWheelerN = 0;
        @sysvar::XCP::RadarFR::_g_PlReCoFw_PlReCoPer_ObjBypassingRunnable_ObjBypassingRunnable_m_pad_radarObjPort_par_out_local::TChangeableMemPool::_::_::_m_arrayPool::_0_::_elem::port_ens_r_obj_sensor_base::_::_m_movObjectInformation::_5_::STA_OBJECT_INFORMATION_ST::_::_m_ohyObjectType_st::_m_probObstacle_st::_m_probMobile_st::_m_prob1PedestrianN = 128;
        @sysvar::XCP::RadarFR::_g_PlReCoFw_PlReCoPer_ObjBypassingRunnable_ObjBypassingRunnable_m_pad_radarObjPort_par_out_local::TChangeableMemPool::_::_::_m_arrayPool::_0_::_elem::port_ens_r_obj_sensor_base::_::_m_movObjectInformation::_5_::STA_OBJECT_INFORMATION_ST::_::_m_ohyObjectType_st::_m_probObstacle_st::_m_probMobile_st::_m_prob1TwoWheelerN = 0;
        @sysvar::XCP::RadarFR::_g_PlReCoFw_PlReCoPer_ObjBypassingRunnable_ObjBypassingRunnable_m_pad_radarObjPort_par_out_local::TChangeableMemPool::_::_::_m_arrayPool::_0_::_elem::port_ens_r_obj_sensor_base::_::_m_movObjectInformation::_5_::STA_OBJECT_INFORMATION_ST::_::_m_ohyObjectType_st::_m_probObstacle_st::_m_probMobile_st::_m_prob1UnknownN = 0;
        @sysvar::XCP::RadarFR::_g_PlReCoFw_PlReCoPer_ObjBypassingRunnable_ObjBypassingRunnable_m_pad_radarObjPort_par_out_local::TChangeableMemPool::_::_::_m_arrayPool::_0_::_elem::port_ens_r_obj_sensor_base::_::_m_movObjectInformation::_5_::STA_OBJECT_INFORMATION_ST::_::_m_ohyObjectType_st::_m_probObstacle_st::_m_probMobile_st::_m_probFourPlusWheeler_st::_m_prob1PassengerCarN = 0;
        @sysvar::XCP::RadarFR::_g_PlReCoFw_PlReCoPer_ObjBypassingRunnable_ObjBypassingRunnable_m_pad_radarObjPort_par_out_local::TChangeableMemPool::_::_::_m_arrayPool::_0_::_elem::port_ens_r_obj_sensor_base::_::_m_movObjectInformation::_5_::STA_OBJECT_INFORMATION_ST::_::_m_ohyObjectType_st::_m_probObstacle_st::_m_probMobile_st::_m_probFourPlusWheeler_st::_m_prob1TruckN = 0;
        @sysvar::XCP::RadarFR::_g_PlReCoFw_PlReCoPer_ObjBypassingRunnable_ObjBypassingRunnable_m_pad_radarObjPort_par_out_local::TChangeableMemPool::_::_::_m_arrayPool::_0_::_elem::port_ens_r_obj_sensor_base::_::_m_movObjectInformation::_5_::STA_OBJECT_INFORMATION_ST::_::_m_ohyObjectType_st::_m_probObstacle_st::_m_probMobile_st::_m_probFourPlusWheeler_st::_m_prob1UnknownN = 128;
        @sysvar::XCP::RadarFR::_g_PlReCoFw_PlReCoPer_ObjBypassingRunnable_ObjBypassingRunnable_m_pad_radarObjPort_par_out_local::TChangeableMemPool::_::_::_m_arrayPool::_0_::_elem::port_ens_r_obj_sensor_base::_::_m_movObjectInformation::_5_::STA_OBJECT_INFORMATION_ST::_::_m_ohyObjectType_st::_m_probObstacle_st::_m_probStationary_st::_m_prob1RoadsideBarrierN = 0;
        @sysvar::XCP::RadarFR::_g_PlReCoFw_PlReCoPer_ObjBypassingRunnable_ObjBypassingRunnable_m_pad_radarObjPort_par_out_local::TChangeableMemPool::_::_::_m_arrayPool::_0_::_elem::port_ens_r_obj_sensor_base::_::_m_movObjectInformation::_5_::STA_OBJECT_INFORMATION_ST::_::_m_ohyObjectType_st::_m_probObstacle_st::_m_probStationary_st::_m_prob1UnknownN = 0;
        @sysvar::XCP::RadarFR::_g_PlReCoFw_PlReCoPer_ObjBypassingRunnable_ObjBypassingRunnable_m_pad_radarObjPort_par_out_local::TChangeableMemPool::_::_::_m_arrayPool::_0_::_elem::port_ens_r_obj_sensor_base::_::_m_movObjectInformation::_5_::_m_dLengthN = 64;
        @sysvar::XCP::RadarFR::_g_PlReCoFw_PlReCoPer_ObjBypassingRunnable_ObjBypassingRunnable_m_pad_radarObjPort_par_out_local::TChangeableMemPool::_::_::_m_arrayPool::_0_::_elem::port_ens_r_obj_sensor_base::_::_m_movObjectInformation::_5_::_m_dWidthN = @Classe_Obj_Sim::obj_data.obj_width[5] * 128;
        break;

      case 5: //"Truck"
        @sysvar::XCP::RadarFR::_g_PlReCoFw_PlReCoPer_ObjBypassingRunnable_ObjBypassingRunnable_m_pad_radarObjPort_par_out_local::TChangeableMemPool::_::_::_m_arrayPool::_0_::_elem::port_ens_r_obj_sensor_base::_::_m_movObjectInformation::_5_::STA_OBJECT_INFORMATION_ST::_::_m_ohyObjectType_st::_m_prob1NonObstacleN = 0;
        @sysvar::XCP::RadarFR::_g_PlReCoFw_PlReCoPer_ObjBypassingRunnable_ObjBypassingRunnable_m_pad_radarObjPort_par_out_local::TChangeableMemPool::_::_::_m_arrayPool::_0_::_elem::port_ens_r_obj_sensor_base::_::_m_movObjectInformation::_5_::STA_OBJECT_INFORMATION_ST::_::_m_ohyObjectType_st::_m_prob1ObstacleN = 128;
        @sysvar::XCP::RadarFR::_g_PlReCoFw_PlReCoPer_ObjBypassingRunnable_ObjBypassingRunnable_m_pad_radarObjPort_par_out_local::TChangeableMemPool::_::_::_m_arrayPool::_0_::_elem::port_ens_r_obj_sensor_base::_::_m_movObjectInformation::_5_::STA_OBJECT_INFORMATION_ST::_::_m_ohyObjectType_st::_m_prob1UnknownN = 0;
        @sysvar::XCP::RadarFR::_g_PlReCoFw_PlReCoPer_ObjBypassingRunnable_ObjBypassingRunnable_m_pad_radarObjPort_par_out_local::TChangeableMemPool::_::_::_m_arrayPool::_0_::_elem::port_ens_r_obj_sensor_base::_::_m_movObjectInformation::_5_::STA_OBJECT_INFORMATION_ST::_::_m_ohyObjectType_st::_m_probObstacle_st::_m_prob1UnknownN = 0;
        @sysvar::XCP::RadarFR::_g_PlReCoFw_PlReCoPer_ObjBypassingRunnable_ObjBypassingRunnable_m_pad_radarObjPort_par_out_local::TChangeableMemPool::_::_::_m_arrayPool::_0_::_elem::port_ens_r_obj_sensor_base::_::_m_movObjectInformation::_5_::STA_OBJECT_INFORMATION_ST::_::_m_ohyObjectType_st::_m_probObstacle_st::_m_probMobile_st::_m_prob1FourPlusWheelerN = 128;
        @sysvar::XCP::RadarFR::_g_PlReCoFw_PlReCoPer_ObjBypassingRunnable_ObjBypassingRunnable_m_pad_radarObjPort_par_out_local::TChangeableMemPool::_::_::_m_arrayPool::_0_::_elem::port_ens_r_obj_sensor_base::_::_m_movObjectInformation::_5_::STA_OBJECT_INFORMATION_ST::_::_m_ohyObjectType_st::_m_probObstacle_st::_m_probMobile_st::_m_prob1PedestrianN = 0;
        @sysvar::XCP::RadarFR::_g_PlReCoFw_PlReCoPer_ObjBypassingRunnable_ObjBypassingRunnable_m_pad_radarObjPort_par_out_local::TChangeableMemPool::_::_::_m_arrayPool::_0_::_elem::port_ens_r_obj_sensor_base::_::_m_movObjectInformation::_5_::STA_OBJECT_INFORMATION_ST::_::_m_ohyObjectType_st::_m_probObstacle_st::_m_probMobile_st::_m_prob1TwoWheelerN = 0;
        @sysvar::XCP::RadarFR::_g_PlReCoFw_PlReCoPer_ObjBypassingRunnable_ObjBypassingRunnable_m_pad_radarObjPort_par_out_local::TChangeableMemPool::_::_::_m_arrayPool::_0_::_elem::port_ens_r_obj_sensor_base::_::_m_movObjectInformation::_5_::STA_OBJECT_INFORMATION_ST::_::_m_ohyObjectType_st::_m_probObstacle_st::_m_probMobile_st::_m_prob1UnknownN = 0;
        @sysvar::XCP::RadarFR::_g_PlReCoFw_PlReCoPer_ObjBypassingRunnable_ObjBypassingRunnable_m_pad_radarObjPort_par_out_local::TChangeableMemPool::_::_::_m_arrayPool::_0_::_elem::port_ens_r_obj_sensor_base::_::_m_movObjectInformation::_5_::STA_OBJECT_INFORMATION_ST::_::_m_ohyObjectType_st::_m_probObstacle_st::_m_probMobile_st::_m_probFourPlusWheeler_st::_m_prob1PassengerCarN = 0;
        @sysvar::XCP::RadarFR::_g_PlReCoFw_PlReCoPer_ObjBypassingRunnable_ObjBypassingRunnable_m_pad_radarObjPort_par_out_local::TChangeableMemPool::_::_::_m_arrayPool::_0_::_elem::port_ens_r_obj_sensor_base::_::_m_movObjectInformation::_5_::STA_OBJECT_INFORMATION_ST::_::_m_ohyObjectType_st::_m_probObstacle_st::_m_probMobile_st::_m_probFourPlusWheeler_st::_m_prob1TruckN = 128;
        @sysvar::XCP::RadarFR::_g_PlReCoFw_PlReCoPer_ObjBypassingRunnable_ObjBypassingRunnable_m_pad_radarObjPort_par_out_local::TChangeableMemPool::_::_::_m_arrayPool::_0_::_elem::port_ens_r_obj_sensor_base::_::_m_movObjectInformation::_5_::STA_OBJECT_INFORMATION_ST::_::_m_ohyObjectType_st::_m_probObstacle_st::_m_probMobile_st::_m_probFourPlusWheeler_st::_m_prob1UnknownN = 0;
        @sysvar::XCP::RadarFR::_g_PlReCoFw_PlReCoPer_ObjBypassingRunnable_ObjBypassingRunnable_m_pad_radarObjPort_par_out_local::TChangeableMemPool::_::_::_m_arrayPool::_0_::_elem::port_ens_r_obj_sensor_base::_::_m_movObjectInformation::_5_::STA_OBJECT_INFORMATION_ST::_::_m_ohyObjectType_st::_m_probObstacle_st::_m_probStationary_st::_m_prob1RoadsideBarrierN = 0;
        @sysvar::XCP::RadarFR::_g_PlReCoFw_PlReCoPer_ObjBypassingRunnable_ObjBypassingRunnable_m_pad_radarObjPort_par_out_local::TChangeableMemPool::_::_::_m_arrayPool::_0_::_elem::port_ens_r_obj_sensor_base::_::_m_movObjectInformation::_5_::STA_OBJECT_INFORMATION_ST::_::_m_ohyObjectType_st::_m_probObstacle_st::_m_probStationary_st::_m_prob1UnknownN = 0;
        @sysvar::XCP::RadarFR::_g_PlReCoFw_PlReCoPer_ObjBypassingRunnable_ObjBypassingRunnable_m_pad_radarObjPort_par_out_local::TChangeableMemPool::_::_::_m_arrayPool::_0_::_elem::port_ens_r_obj_sensor_base::_::_m_movObjectInformation::_5_::_m_dLengthN = 64;
        @sysvar::XCP::RadarFR::_g_PlReCoFw_PlReCoPer_ObjBypassingRunnable_ObjBypassingRunnable_m_pad_radarObjPort_par_out_local::TChangeableMemPool::_::_::_m_arrayPool::_0_::_elem::port_ens_r_obj_sensor_base::_::_m_movObjectInformation::_5_::_m_dWidthN = @Classe_Obj_Sim::obj_data.obj_width[5] * 128;
        break;

      case 6: //"PassengerCar"
        @sysvar::XCP::RadarFR::_g_PlReCoFw_PlReCoPer_ObjBypassingRunnable_ObjBypassingRunnable_m_pad_radarObjPort_par_out_local::TChangeableMemPool::_::_::_m_arrayPool::_0_::_elem::port_ens_r_obj_sensor_base::_::_m_movObjectInformation::_5_::STA_OBJECT_INFORMATION_ST::_::_m_ohyObjectType_st::_m_prob1NonObstacleN = 0;
        @sysvar::XCP::RadarFR::_g_PlReCoFw_PlReCoPer_ObjBypassingRunnable_ObjBypassingRunnable_m_pad_radarObjPort_par_out_local::TChangeableMemPool::_::_::_m_arrayPool::_0_::_elem::port_ens_r_obj_sensor_base::_::_m_movObjectInformation::_5_::STA_OBJECT_INFORMATION_ST::_::_m_ohyObjectType_st::_m_prob1ObstacleN = 128;
        @sysvar::XCP::RadarFR::_g_PlReCoFw_PlReCoPer_ObjBypassingRunnable_ObjBypassingRunnable_m_pad_radarObjPort_par_out_local::TChangeableMemPool::_::_::_m_arrayPool::_0_::_elem::port_ens_r_obj_sensor_base::_::_m_movObjectInformation::_5_::STA_OBJECT_INFORMATION_ST::_::_m_ohyObjectType_st::_m_prob1UnknownN = 0;
        @sysvar::XCP::RadarFR::_g_PlReCoFw_PlReCoPer_ObjBypassingRunnable_ObjBypassingRunnable_m_pad_radarObjPort_par_out_local::TChangeableMemPool::_::_::_m_arrayPool::_0_::_elem::port_ens_r_obj_sensor_base::_::_m_movObjectInformation::_5_::STA_OBJECT_INFORMATION_ST::_::_m_ohyObjectType_st::_m_probObstacle_st::_m_prob1UnknownN = 0;
        @sysvar::XCP::RadarFR::_g_PlReCoFw_PlReCoPer_ObjBypassingRunnable_ObjBypassingRunnable_m_pad_radarObjPort_par_out_local::TChangeableMemPool::_::_::_m_arrayPool::_0_::_elem::port_ens_r_obj_sensor_base::_::_m_movObjectInformation::_5_::STA_OBJECT_INFORMATION_ST::_::_m_ohyObjectType_st::_m_probObstacle_st::_m_probMobile_st::_m_prob1FourPlusWheelerN = 128;
        @sysvar::XCP::RadarFR::_g_PlReCoFw_PlReCoPer_ObjBypassingRunnable_ObjBypassingRunnable_m_pad_radarObjPort_par_out_local::TChangeableMemPool::_::_::_m_arrayPool::_0_::_elem::port_ens_r_obj_sensor_base::_::_m_movObjectInformation::_5_::STA_OBJECT_INFORMATION_ST::_::_m_ohyObjectType_st::_m_probObstacle_st::_m_probMobile_st::_m_prob1PedestrianN = 0;
        @sysvar::XCP::RadarFR::_g_PlReCoFw_PlReCoPer_ObjBypassingRunnable_ObjBypassingRunnable_m_pad_radarObjPort_par_out_local::TChangeableMemPool::_::_::_m_arrayPool::_0_::_elem::port_ens_r_obj_sensor_base::_::_m_movObjectInformation::_5_::STA_OBJECT_INFORMATION_ST::_::_m_ohyObjectType_st::_m_probObstacle_st::_m_probMobile_st::_m_prob1TwoWheelerN = 0;
        @sysvar::XCP::RadarFR::_g_PlReCoFw_PlReCoPer_ObjBypassingRunnable_ObjBypassingRunnable_m_pad_radarObjPort_par_out_local::TChangeableMemPool::_::_::_m_arrayPool::_0_::_elem::port_ens_r_obj_sensor_base::_::_m_movObjectInformation::_5_::STA_OBJECT_INFORMATION_ST::_::_m_ohyObjectType_st::_m_probObstacle_st::_m_probMobile_st::_m_prob1UnknownN = 0;
        @sysvar::XCP::RadarFR::_g_PlReCoFw_PlReCoPer_ObjBypassingRunnable_ObjBypassingRunnable_m_pad_radarObjPort_par_out_local::TChangeableMemPool::_::_::_m_arrayPool::_0_::_elem::port_ens_r_obj_sensor_base::_::_m_movObjectInformation::_5_::STA_OBJECT_INFORMATION_ST::_::_m_ohyObjectType_st::_m_probObstacle_st::_m_probMobile_st::_m_probFourPlusWheeler_st::_m_prob1PassengerCarN = 128;
        @sysvar::XCP::RadarFR::_g_PlReCoFw_PlReCoPer_ObjBypassingRunnable_ObjBypassingRunnable_m_pad_radarObjPort_par_out_local::TChangeableMemPool::_::_::_m_arrayPool::_0_::_elem::port_ens_r_obj_sensor_base::_::_m_movObjectInformation::_5_::STA_OBJECT_INFORMATION_ST::_::_m_ohyObjectType_st::_m_probObstacle_st::_m_probMobile_st::_m_probFourPlusWheeler_st::_m_prob1TruckN = 0;
        @sysvar::XCP::RadarFR::_g_PlReCoFw_PlReCoPer_ObjBypassingRunnable_ObjBypassingRunnable_m_pad_radarObjPort_par_out_local::TChangeableMemPool::_::_::_m_arrayPool::_0_::_elem::port_ens_r_obj_sensor_base::_::_m_movObjectInformation::_5_::STA_OBJECT_INFORMATION_ST::_::_m_ohyObjectType_st::_m_probObstacle_st::_m_probMobile_st::_m_probFourPlusWheeler_st::_m_prob1UnknownN = 0;
        @sysvar::XCP::RadarFR::_g_PlReCoFw_PlReCoPer_ObjBypassingRunnable_ObjBypassingRunnable_m_pad_radarObjPort_par_out_local::TChangeableMemPool::_::_::_m_arrayPool::_0_::_elem::port_ens_r_obj_sensor_base::_::_m_movObjectInformation::_5_::STA_OBJECT_INFORMATION_ST::_::_m_ohyObjectType_st::_m_probObstacle_st::_m_probStationary_st::_m_prob1RoadsideBarrierN = 0;
        @sysvar::XCP::RadarFR::_g_PlReCoFw_PlReCoPer_ObjBypassingRunnable_ObjBypassingRunnable_m_pad_radarObjPort_par_out_local::TChangeableMemPool::_::_::_m_arrayPool::_0_::_elem::port_ens_r_obj_sensor_base::_::_m_movObjectInformation::_5_::STA_OBJECT_INFORMATION_ST::_::_m_ohyObjectType_st::_m_probObstacle_st::_m_probStationary_st::_m_prob1UnknownN = 0;
        @sysvar::XCP::RadarFR::_g_PlReCoFw_PlReCoPer_ObjBypassingRunnable_ObjBypassingRunnable_m_pad_radarObjPort_par_out_local::TChangeableMemPool::_::_::_m_arrayPool::_0_::_elem::port_ens_r_obj_sensor_base::_::_m_movObjectInformation::_5_::_m_dLengthN = 64;
        @sysvar::XCP::RadarFR::_g_PlReCoFw_PlReCoPer_ObjBypassingRunnable_ObjBypassingRunnable_m_pad_radarObjPort_par_out_local::TChangeableMemPool::_::_::_m_arrayPool::_0_::_elem::port_ens_r_obj_sensor_base::_::_m_movObjectInformation::_5_::_m_dWidthN = @Classe_Obj_Sim::obj_data.obj_width[5] * 128;
        break;
    }
    break;

    case 6: //"Object-6"
    //constant
    @sysvar::XCP::RadarFR::_g_PlReCoFw_PlReCoPer_ObjBypassingRunnable_ObjBypassingRunnable_m_pad_radarObjPort_par_out_local::TChangeableMemPool::_::_::_m_arrayPool::_0_::_elem::port_ens_r_obj_sensor_base::_::_m_movObjectInformation::_6_::STA_OBJECT_INFORMATION_ST::_::_Meas_b = 1;
    @sysvar::XCP::RadarFR::_g_PlReCoFw_PlReCoPer_ObjBypassingRunnable_ObjBypassingRunnable_m_pad_radarObjPort_par_out_local::TChangeableMemPool::_::_::_m_arrayPool::_0_::_elem::port_ens_r_obj_sensor_base::_::_m_movObjectInformation::_6_::STA_OBJECT_INFORMATION_ST::_::_Measurable_b = 1;
    @sysvar::XCP::RadarFR::_g_PlReCoFw_PlReCoPer_ObjBypassingRunnable_ObjBypassingRunnable_m_pad_radarObjPort_par_out_local::TChangeableMemPool::_::_::_m_arrayPool::_0_::_elem::port_ens_r_obj_sensor_base::_::_m_movObjectInformation::_6_::STA_OBJECT_INFORMATION_ST::_::_Valid_b = 1;
    @sysvar::XCP::RadarFR::_g_PlReCoFw_PlReCoPer_ObjBypassingRunnable_ObjBypassingRunnable_m_pad_radarObjPort_par_out_local::TChangeableMemPool::_::_::_m_arrayPool::_0_::_elem::port_ens_r_obj_sensor_base::_::_m_movObjectInformation::_6_::_m_covarDxAxN = 0;
    @sysvar::XCP::RadarFR::_g_PlReCoFw_PlReCoPer_ObjBypassingRunnable_ObjBypassingRunnable_m_pad_radarObjPort_par_out_local::TChangeableMemPool::_::_::_m_arrayPool::_0_::_elem::port_ens_r_obj_sensor_base::_::_m_movObjectInformation::_6_::_m_covarDxVxN = 0;
    @sysvar::XCP::RadarFR::_g_PlReCoFw_PlReCoPer_ObjBypassingRunnable_ObjBypassingRunnable_m_pad_radarObjPort_par_out_local::TChangeableMemPool::_::_::_m_arrayPool::_0_::_elem::port_ens_r_obj_sensor_base::_::_m_movObjectInformation::_6_::_m_covarDyVyN = 0;
    @sysvar::XCP::RadarFR::_g_PlReCoFw_PlReCoPer_ObjBypassingRunnable_ObjBypassingRunnable_m_pad_radarObjPort_par_out_local::TChangeableMemPool::_::_::_m_arrayPool::_0_::_elem::port_ens_r_obj_sensor_base::_::_m_movObjectInformation::_6_::_m_covarDyWidthN = 0;
    @sysvar::XCP::RadarFR::_g_PlReCoFw_PlReCoPer_ObjBypassingRunnable_ObjBypassingRunnable_m_pad_radarObjPort_par_out_local::TChangeableMemPool::_::_::_m_arrayPool::_0_::_elem::port_ens_r_obj_sensor_base::_::_m_movObjectInformation::_6_::_m_covarVxAxN = 0;
    @sysvar::XCP::RadarFR::_g_PlReCoFw_PlReCoPer_ObjBypassingRunnable_ObjBypassingRunnable_m_pad_radarObjPort_par_out_local::TChangeableMemPool::_::_::_m_arrayPool::_0_::_elem::port_ens_r_obj_sensor_base::_::_m_movObjectInformation::_6_::_m_varAxN = 0;
    @sysvar::XCP::RadarFR::_g_PlReCoFw_PlReCoPer_ObjBypassingRunnable_ObjBypassingRunnable_m_pad_radarObjPort_par_out_local::TChangeableMemPool::_::_::_m_arrayPool::_0_::_elem::port_ens_r_obj_sensor_base::_::_m_movObjectInformation::_6_::_m_varAyN = 0;
    @sysvar::XCP::RadarFR::_g_PlReCoFw_PlReCoPer_ObjBypassingRunnable_ObjBypassingRunnable_m_pad_radarObjPort_par_out_local::TChangeableMemPool::_::_::_m_arrayPool::_0_::_elem::port_ens_r_obj_sensor_base::_::_m_movObjectInformation::_6_::_m_varVxN = 0;
    @sysvar::XCP::RadarFR::_g_PlReCoFw_PlReCoPer_ObjBypassingRunnable_ObjBypassingRunnable_m_pad_radarObjPort_par_out_local::TChangeableMemPool::_::_::_m_arrayPool::_0_::_elem::port_ens_r_obj_sensor_base::_::_m_movObjectInformation::_6_::_m_varVyN = 0;
    @sysvar::XCP::RadarFR::_g_PlReCoFw_PlReCoPer_ObjBypassingRunnable_ObjBypassingRunnable_m_pad_radarObjPort_par_out_local::TChangeableMemPool::_::_::_m_arrayPool::_0_::_elem::port_ens_r_obj_sensor_base::_::_m_movObjectInformation::_6_::STA_OBJECT_INFORMATION_ST::_::_m_varDxN = 0;
    @sysvar::XCP::RadarFR::_g_PlReCoFw_PlReCoPer_ObjBypassingRunnable_ObjBypassingRunnable_m_pad_radarObjPort_par_out_local::TChangeableMemPool::_::_::_m_arrayPool::_0_::_elem::port_ens_r_obj_sensor_base::_::_m_movObjectInformation::_6_::STA_OBJECT_INFORMATION_ST::_::_m_varDyN = 0;
    @sysvar::XCP::RadarFR::_g_PlReCoFw_PlReCoPer_ObjBypassingRunnable_ObjBypassingRunnable_m_pad_radarObjPort_par_out_local::TChangeableMemPool::_::_::_m_arrayPool::_0_::_elem::port_ens_r_obj_sensor_base::_::_m_movObjectInformation::_6_::_m_dVarLengthN = 0;
    @sysvar::XCP::RadarFR::_g_PlReCoFw_PlReCoPer_ObjBypassingRunnable_ObjBypassingRunnable_m_pad_radarObjPort_par_out_local::TChangeableMemPool::_::_::_m_arrayPool::_0_::_elem::port_ens_r_obj_sensor_base::_::_m_movObjectInformation::_6_::_m_dVarWidthN = 0;
    @sysvar::XCP::RadarFR::_g_PlReCoFw_PlReCoPer_ObjBypassingRunnable_ObjBypassingRunnable_m_pad_radarObjPort_par_out_local::TChangeableMemPool::_::_::_m_arrayPool::_0_::_elem::port_ens_r_obj_sensor_base::_::_m_movObjectInformation::_6_::STA_OBJECT_INFORMATION_ST::_::_m_wExistProbN = 64880;
    @sysvar::XCP::RadarFR::_g_PlReCoFw_PlReCoPer_ObjBypassingRunnable_ObjBypassingRunnable_m_pad_radarObjPort_par_out_local::TChangeableMemPool::_::_::_m_arrayPool::_0_::_elem::port_ens_r_obj_sensor_base::_::_m_movObjectInformation::_6_::_m_referencePtPosIndexN = 10;
    @sysvar::XCP::RadarFR::_g_PlReCoFw_PlReCoPer_ObjBypassingRunnable_ObjBypassingRunnable_m_pad_radarObjPort_par_out_local::TChangeableMemPool::_::_::_m_arrayPool::_0_::_elem::port_ens_r_obj_sensor_base::_::_m_movObjectInformation::_6_::_m_alpPiVarYawAngleN = 0;
    @sysvar::XCP::RadarFR::_g_PlReCoFw_PlReCoPer_ObjBypassingRunnable_ObjBypassingRunnable_m_pad_radarObjPort_par_out_local::TChangeableMemPool::_::_::_m_arrayPool::_0_::_elem::port_ens_r_obj_sensor_base::_::_m_movObjectInformation::_6_::_m_alpPiYawAngleN = 0;

    //target movement

    @sysvar::XCP::RadarFR::_g_PlReCoFw_PlReCoPer_ObjBypassingRunnable_ObjBypassingRunnable_m_pad_radarObjPort_par_out_local::TChangeableMemPool::_::_::_m_arrayPool::_0_::_elem::port_ens_r_obj_sensor_base::_::_m_movObjectInformation::_6_::STA_OBJECT_INFORMATION_ST::_::_m_dxN = @Classe_Obj_Sim::obj_data.obj_dx[6] * 128;
    @sysvar::XCP::RadarFR::_g_PlReCoFw_PlReCoPer_ObjBypassingRunnable_ObjBypassingRunnable_m_pad_radarObjPort_par_out_local::TChangeableMemPool::_::_::_m_arrayPool::_0_::_elem::port_ens_r_obj_sensor_base::_::_m_movObjectInformation::_6_::STA_OBJECT_INFORMATION_ST::_::_m_dyN = @Classe_Obj_Sim::obj_data.obj_dy[6] * 128;
    @sysvar::XCP::RadarFR::_g_PlReCoFw_PlReCoPer_ObjBypassingRunnable_ObjBypassingRunnable_m_pad_radarObjPort_par_out_local::TChangeableMemPool::_::_::_m_arrayPool::_0_::_elem::port_ens_r_obj_sensor_base::_::_m_movObjectInformation::_6_::STA_OBJECT_INFORMATION_ST::_::_m_dzN = 0;
    @sysvar::XCP::RadarFR::_g_PlReCoFw_PlReCoPer_ObjBypassingRunnable_ObjBypassingRunnable_m_pad_radarObjPort_par_out_local::TChangeableMemPool::_::_::_m_arrayPool::_0_::_elem::port_ens_r_obj_sensor_base::_::_m_movObjectInformation::_6_::_m_vxN = @Classe_Obj_Sim::obj_data.obj_relative_vx[6] * 256;
    @sysvar::XCP::RadarFR::_g_PlReCoFw_PlReCoPer_ObjBypassingRunnable_ObjBypassingRunnable_m_pad_radarObjPort_par_out_local::TChangeableMemPool::_::_::_m_arrayPool::_0_::_elem::port_ens_r_obj_sensor_base::_::_m_movObjectInformation::_6_::_m_vyN = @Classe_Obj_Sim::obj_data.obj_relative_vy[6] * 256;
    @sysvar::XCP::RadarFR::_g_PlReCoFw_PlReCoPer_ObjBypassingRunnable_ObjBypassingRunnable_m_pad_radarObjPort_par_out_local::TChangeableMemPool::_::_::_m_arrayPool::_0_::_elem::port_ens_r_obj_sensor_base::_::_m_movObjectInformation::_6_::_m_axN = 0;
    @sysvar::XCP::RadarFR::_g_PlReCoFw_PlReCoPer_ObjBypassingRunnable_ObjBypassingRunnable_m_pad_radarObjPort_par_out_local::TChangeableMemPool::_::_::_m_arrayPool::_0_::_elem::port_ens_r_obj_sensor_base::_::_m_movObjectInformation::_6_::_m_ayN = 0;

    //target object moving or not
    if (abs(@Classe_Obj_Sim::obj_data.obj_relative_vx[6]) != 0)
    {
      @sysvar::XCP::RadarFR::_g_PlReCoFw_PlReCoPer_ObjBypassingRunnable_ObjBypassingRunnable_m_pad_radarObjPort_par_out_local::TChangeableMemPool::_::_::_m_arrayPool::_0_::_elem::port_ens_r_obj_sensor_base::_::_m_movObjectInformation::_6_::STA_OBJECT_INFORMATION_ST::_::_m_prob1HasBeenObservedMovingN = 126;
      @sysvar::XCP::RadarFR::_g_PlReCoFw_PlReCoPer_ObjBypassingRunnable_ObjBypassingRunnable_m_pad_radarObjPort_par_out_local::TChangeableMemPool::_::_::_m_arrayPool::_0_::_elem::port_ens_r_obj_sensor_base::_::_m_movObjectInformation::_6_::STA_OBJECT_INFORMATION_ST::_::_m_prob1MovingN = 126;
      @sysvar::XCP::RadarFR::_g_PlReCoFw_PlReCoPer_ObjBypassingRunnable_ObjBypassingRunnable_m_pad_radarObjPort_par_out_local::TChangeableMemPool::_::_::_m_arrayPool::_0_::_elem::port_ens_r_obj_sensor_base::_::_m_movObjectInformation::_6_::STA_OBJECT_INFORMATION_ST::_::_m_ohyObjectType_st::_m_probObstacle_st::_m_prob1MobileN = 128;
      @sysvar::XCP::RadarFR::_g_PlReCoFw_PlReCoPer_ObjBypassingRunnable_ObjBypassingRunnable_m_pad_radarObjPort_par_out_local::TChangeableMemPool::_::_::_m_arrayPool::_0_::_elem::port_ens_r_obj_sensor_base::_::_m_movObjectInformation::_6_::STA_OBJECT_INFORMATION_ST::_::_m_ohyObjectType_st::_m_probObstacle_st::_m_prob1StationaryN = 0;
    }
    else
    {
      @sysvar::XCP::RadarFR::_g_PlReCoFw_PlReCoPer_ObjBypassingRunnable_ObjBypassingRunnable_m_pad_radarObjPort_par_out_local::TChangeableMemPool::_::_::_m_arrayPool::_0_::_elem::port_ens_r_obj_sensor_base::_::_m_movObjectInformation::_6_::STA_OBJECT_INFORMATION_ST::_::_m_prob1HasBeenObservedMovingN = 0;
      @sysvar::XCP::RadarFR::_g_PlReCoFw_PlReCoPer_ObjBypassingRunnable_ObjBypassingRunnable_m_pad_radarObjPort_par_out_local::TChangeableMemPool::_::_::_m_arrayPool::_0_::_elem::port_ens_r_obj_sensor_base::_::_m_movObjectInformation::_6_::STA_OBJECT_INFORMATION_ST::_::_m_prob1MovingN = 0;
      @sysvar::XCP::RadarFR::_g_PlReCoFw_PlReCoPer_ObjBypassingRunnable_ObjBypassingRunnable_m_pad_radarObjPort_par_out_local::TChangeableMemPool::_::_::_m_arrayPool::_0_::_elem::port_ens_r_obj_sensor_base::_::_m_movObjectInformation::_6_::STA_OBJECT_INFORMATION_ST::_::_m_ohyObjectType_st::_m_probObstacle_st::_m_prob1MobileN = 0;
      @sysvar::XCP::RadarFR::_g_PlReCoFw_PlReCoPer_ObjBypassingRunnable_ObjBypassingRunnable_m_pad_radarObjPort_par_out_local::TChangeableMemPool::_::_::_m_arrayPool::_0_::_elem::port_ens_r_obj_sensor_base::_::_m_movObjectInformation::_6_::STA_OBJECT_INFORMATION_ST::_::_m_ohyObjectType_st::_m_probObstacle_st::_m_prob1StationaryN = 128;
    }

      //object classification
    switch (@Classe_Obj_Sim::obj_data.obj_type[6])
    {
      case 0: //"Non-Obstacle"
        @sysvar::XCP::RadarFR::_g_PlReCoFw_PlReCoPer_ObjBypassingRunnable_ObjBypassingRunnable_m_pad_radarObjPort_par_out_local::TChangeableMemPool::_::_::_m_arrayPool::_0_::_elem::port_ens_r_obj_sensor_base::_::_m_movObjectInformation::_6_::STA_OBJECT_INFORMATION_ST::_::_m_ohyObjectType_st::_m_prob1NonObstacleN = 128;
        @sysvar::XCP::RadarFR::_g_PlReCoFw_PlReCoPer_ObjBypassingRunnable_ObjBypassingRunnable_m_pad_radarObjPort_par_out_local::TChangeableMemPool::_::_::_m_arrayPool::_0_::_elem::port_ens_r_obj_sensor_base::_::_m_movObjectInformation::_6_::STA_OBJECT_INFORMATION_ST::_::_m_ohyObjectType_st::_m_prob1ObstacleN = 0;
        @sysvar::XCP::RadarFR::_g_PlReCoFw_PlReCoPer_ObjBypassingRunnable_ObjBypassingRunnable_m_pad_radarObjPort_par_out_local::TChangeableMemPool::_::_::_m_arrayPool::_0_::_elem::port_ens_r_obj_sensor_base::_::_m_movObjectInformation::_6_::STA_OBJECT_INFORMATION_ST::_::_m_ohyObjectType_st::_m_prob1UnknownN = 0;
        @sysvar::XCP::RadarFR::_g_PlReCoFw_PlReCoPer_ObjBypassingRunnable_ObjBypassingRunnable_m_pad_radarObjPort_par_out_local::TChangeableMemPool::_::_::_m_arrayPool::_0_::_elem::port_ens_r_obj_sensor_base::_::_m_movObjectInformation::_6_::STA_OBJECT_INFORMATION_ST::_::_m_ohyObjectType_st::_m_probObstacle_st::_m_prob1UnknownN = 128;
        @sysvar::XCP::RadarFR::_g_PlReCoFw_PlReCoPer_ObjBypassingRunnable_ObjBypassingRunnable_m_pad_radarObjPort_par_out_local::TChangeableMemPool::_::_::_m_arrayPool::_0_::_elem::port_ens_r_obj_sensor_base::_::_m_movObjectInformation::_6_::STA_OBJECT_INFORMATION_ST::_::_m_ohyObjectType_st::_m_probObstacle_st::_m_probMobile_st::_m_prob1FourPlusWheelerN = 0;
        @sysvar::XCP::RadarFR::_g_PlReCoFw_PlReCoPer_ObjBypassingRunnable_ObjBypassingRunnable_m_pad_radarObjPort_par_out_local::TChangeableMemPool::_::_::_m_arrayPool::_0_::_elem::port_ens_r_obj_sensor_base::_::_m_movObjectInformation::_6_::STA_OBJECT_INFORMATION_ST::_::_m_ohyObjectType_st::_m_probObstacle_st::_m_probMobile_st::_m_prob1PedestrianN = 0;
        @sysvar::XCP::RadarFR::_g_PlReCoFw_PlReCoPer_ObjBypassingRunnable_ObjBypassingRunnable_m_pad_radarObjPort_par_out_local::TChangeableMemPool::_::_::_m_arrayPool::_0_::_elem::port_ens_r_obj_sensor_base::_::_m_movObjectInformation::_6_::STA_OBJECT_INFORMATION_ST::_::_m_ohyObjectType_st::_m_probObstacle_st::_m_probMobile_st::_m_prob1TwoWheelerN = 0;
        @sysvar::XCP::RadarFR::_g_PlReCoFw_PlReCoPer_ObjBypassingRunnable_ObjBypassingRunnable_m_pad_radarObjPort_par_out_local::TChangeableMemPool::_::_::_m_arrayPool::_0_::_elem::port_ens_r_obj_sensor_base::_::_m_movObjectInformation::_6_::STA_OBJECT_INFORMATION_ST::_::_m_ohyObjectType_st::_m_probObstacle_st::_m_probMobile_st::_m_prob1UnknownN = 128;
        @sysvar::XCP::RadarFR::_g_PlReCoFw_PlReCoPer_ObjBypassingRunnable_ObjBypassingRunnable_m_pad_radarObjPort_par_out_local::TChangeableMemPool::_::_::_m_arrayPool::_0_::_elem::port_ens_r_obj_sensor_base::_::_m_movObjectInformation::_6_::STA_OBJECT_INFORMATION_ST::_::_m_ohyObjectType_st::_m_probObstacle_st::_m_probMobile_st::_m_probFourPlusWheeler_st::_m_prob1PassengerCarN = 0;
        @sysvar::XCP::RadarFR::_g_PlReCoFw_PlReCoPer_ObjBypassingRunnable_ObjBypassingRunnable_m_pad_radarObjPort_par_out_local::TChangeableMemPool::_::_::_m_arrayPool::_0_::_elem::port_ens_r_obj_sensor_base::_::_m_movObjectInformation::_6_::STA_OBJECT_INFORMATION_ST::_::_m_ohyObjectType_st::_m_probObstacle_st::_m_probMobile_st::_m_probFourPlusWheeler_st::_m_prob1TruckN = 0;
        @sysvar::XCP::RadarFR::_g_PlReCoFw_PlReCoPer_ObjBypassingRunnable_ObjBypassingRunnable_m_pad_radarObjPort_par_out_local::TChangeableMemPool::_::_::_m_arrayPool::_0_::_elem::port_ens_r_obj_sensor_base::_::_m_movObjectInformation::_6_::STA_OBJECT_INFORMATION_ST::_::_m_ohyObjectType_st::_m_probObstacle_st::_m_probMobile_st::_m_probFourPlusWheeler_st::_m_prob1UnknownN = 128;
        @sysvar::XCP::RadarFR::_g_PlReCoFw_PlReCoPer_ObjBypassingRunnable_ObjBypassingRunnable_m_pad_radarObjPort_par_out_local::TChangeableMemPool::_::_::_m_arrayPool::_0_::_elem::port_ens_r_obj_sensor_base::_::_m_movObjectInformation::_6_::STA_OBJECT_INFORMATION_ST::_::_m_ohyObjectType_st::_m_probObstacle_st::_m_probStationary_st::_m_prob1RoadsideBarrierN = 0;
        @sysvar::XCP::RadarFR::_g_PlReCoFw_PlReCoPer_ObjBypassingRunnable_ObjBypassingRunnable_m_pad_radarObjPort_par_out_local::TChangeableMemPool::_::_::_m_arrayPool::_0_::_elem::port_ens_r_obj_sensor_base::_::_m_movObjectInformation::_6_::STA_OBJECT_INFORMATION_ST::_::_m_ohyObjectType_st::_m_probObstacle_st::_m_probStationary_st::_m_prob1UnknownN = 128;
        @sysvar::XCP::RadarFR::_g_PlReCoFw_PlReCoPer_ObjBypassingRunnable_ObjBypassingRunnable_m_pad_radarObjPort_par_out_local::TChangeableMemPool::_::_::_m_arrayPool::_0_::_elem::port_ens_r_obj_sensor_base::_::_m_movObjectInformation::_6_::_m_dLengthN = 64;
        @sysvar::XCP::RadarFR::_g_PlReCoFw_PlReCoPer_ObjBypassingRunnable_ObjBypassingRunnable_m_pad_radarObjPort_par_out_local::TChangeableMemPool::_::_::_m_arrayPool::_0_::_elem::port_ens_r_obj_sensor_base::_::_m_movObjectInformation::_6_::_m_dWidthN = @Classe_Obj_Sim::obj_data.obj_width[6] * 128;
        break;

      case 1: //"unknown"
        @sysvar::XCP::RadarFR::_g_PlReCoFw_PlReCoPer_ObjBypassingRunnable_ObjBypassingRunnable_m_pad_radarObjPort_par_out_local::TChangeableMemPool::_::_::_m_arrayPool::_0_::_elem::port_ens_r_obj_sensor_base::_::_m_movObjectInformation::_6_::STA_OBJECT_INFORMATION_ST::_::_m_ohyObjectType_st::_m_prob1NonObstacleN = 0;
        @sysvar::XCP::RadarFR::_g_PlReCoFw_PlReCoPer_ObjBypassingRunnable_ObjBypassingRunnable_m_pad_radarObjPort_par_out_local::TChangeableMemPool::_::_::_m_arrayPool::_0_::_elem::port_ens_r_obj_sensor_base::_::_m_movObjectInformation::_6_::STA_OBJECT_INFORMATION_ST::_::_m_ohyObjectType_st::_m_prob1ObstacleN = 0;
        @sysvar::XCP::RadarFR::_g_PlReCoFw_PlReCoPer_ObjBypassingRunnable_ObjBypassingRunnable_m_pad_radarObjPort_par_out_local::TChangeableMemPool::_::_::_m_arrayPool::_0_::_elem::port_ens_r_obj_sensor_base::_::_m_movObjectInformation::_6_::STA_OBJECT_INFORMATION_ST::_::_m_ohyObjectType_st::_m_prob1UnknownN = 128;
        @sysvar::XCP::RadarFR::_g_PlReCoFw_PlReCoPer_ObjBypassingRunnable_ObjBypassingRunnable_m_pad_radarObjPort_par_out_local::TChangeableMemPool::_::_::_m_arrayPool::_0_::_elem::port_ens_r_obj_sensor_base::_::_m_movObjectInformation::_6_::STA_OBJECT_INFORMATION_ST::_::_m_ohyObjectType_st::_m_probObstacle_st::_m_prob1UnknownN = 128;
        @sysvar::XCP::RadarFR::_g_PlReCoFw_PlReCoPer_ObjBypassingRunnable_ObjBypassingRunnable_m_pad_radarObjPort_par_out_local::TChangeableMemPool::_::_::_m_arrayPool::_0_::_elem::port_ens_r_obj_sensor_base::_::_m_movObjectInformation::_6_::STA_OBJECT_INFORMATION_ST::_::_m_ohyObjectType_st::_m_probObstacle_st::_m_probMobile_st::_m_prob1FourPlusWheelerN = 0;
        @sysvar::XCP::RadarFR::_g_PlReCoFw_PlReCoPer_ObjBypassingRunnable_ObjBypassingRunnable_m_pad_radarObjPort_par_out_local::TChangeableMemPool::_::_::_m_arrayPool::_0_::_elem::port_ens_r_obj_sensor_base::_::_m_movObjectInformation::_6_::STA_OBJECT_INFORMATION_ST::_::_m_ohyObjectType_st::_m_probObstacle_st::_m_probMobile_st::_m_prob1PedestrianN = 0;
        @sysvar::XCP::RadarFR::_g_PlReCoFw_PlReCoPer_ObjBypassingRunnable_ObjBypassingRunnable_m_pad_radarObjPort_par_out_local::TChangeableMemPool::_::_::_m_arrayPool::_0_::_elem::port_ens_r_obj_sensor_base::_::_m_movObjectInformation::_6_::STA_OBJECT_INFORMATION_ST::_::_m_ohyObjectType_st::_m_probObstacle_st::_m_probMobile_st::_m_prob1TwoWheelerN = 0;
        @sysvar::XCP::RadarFR::_g_PlReCoFw_PlReCoPer_ObjBypassingRunnable_ObjBypassingRunnable_m_pad_radarObjPort_par_out_local::TChangeableMemPool::_::_::_m_arrayPool::_0_::_elem::port_ens_r_obj_sensor_base::_::_m_movObjectInformation::_6_::STA_OBJECT_INFORMATION_ST::_::_m_ohyObjectType_st::_m_probObstacle_st::_m_probMobile_st::_m_prob1UnknownN = 128;
        @sysvar::XCP::RadarFR::_g_PlReCoFw_PlReCoPer_ObjBypassingRunnable_ObjBypassingRunnable_m_pad_radarObjPort_par_out_local::TChangeableMemPool::_::_::_m_arrayPool::_0_::_elem::port_ens_r_obj_sensor_base::_::_m_movObjectInformation::_6_::STA_OBJECT_INFORMATION_ST::_::_m_ohyObjectType_st::_m_probObstacle_st::_m_probMobile_st::_m_probFourPlusWheeler_st::_m_prob1PassengerCarN = 0;
        @sysvar::XCP::RadarFR::_g_PlReCoFw_PlReCoPer_ObjBypassingRunnable_ObjBypassingRunnable_m_pad_radarObjPort_par_out_local::TChangeableMemPool::_::_::_m_arrayPool::_0_::_elem::port_ens_r_obj_sensor_base::_::_m_movObjectInformation::_6_::STA_OBJECT_INFORMATION_ST::_::_m_ohyObjectType_st::_m_probObstacle_st::_m_probMobile_st::_m_probFourPlusWheeler_st::_m_prob1TruckN = 0;
        @sysvar::XCP::RadarFR::_g_PlReCoFw_PlReCoPer_ObjBypassingRunnable_ObjBypassingRunnable_m_pad_radarObjPort_par_out_local::TChangeableMemPool::_::_::_m_arrayPool::_0_::_elem::port_ens_r_obj_sensor_base::_::_m_movObjectInformation::_6_::STA_OBJECT_INFORMATION_ST::_::_m_ohyObjectType_st::_m_probObstacle_st::_m_probMobile_st::_m_probFourPlusWheeler_st::_m_prob1UnknownN = 128;
        @sysvar::XCP::RadarFR::_g_PlReCoFw_PlReCoPer_ObjBypassingRunnable_ObjBypassingRunnable_m_pad_radarObjPort_par_out_local::TChangeableMemPool::_::_::_m_arrayPool::_0_::_elem::port_ens_r_obj_sensor_base::_::_m_movObjectInformation::_6_::STA_OBJECT_INFORMATION_ST::_::_m_ohyObjectType_st::_m_probObstacle_st::_m_probStationary_st::_m_prob1RoadsideBarrierN = 0;
        @sysvar::XCP::RadarFR::_g_PlReCoFw_PlReCoPer_ObjBypassingRunnable_ObjBypassingRunnable_m_pad_radarObjPort_par_out_local::TChangeableMemPool::_::_::_m_arrayPool::_0_::_elem::port_ens_r_obj_sensor_base::_::_m_movObjectInformation::_6_::STA_OBJECT_INFORMATION_ST::_::_m_ohyObjectType_st::_m_probObstacle_st::_m_probStationary_st::_m_prob1UnknownN = 128;
        @sysvar::XCP::RadarFR::_g_PlReCoFw_PlReCoPer_ObjBypassingRunnable_ObjBypassingRunnable_m_pad_radarObjPort_par_out_local::TChangeableMemPool::_::_::_m_arrayPool::_0_::_elem::port_ens_r_obj_sensor_base::_::_m_movObjectInformation::_6_::_m_dLengthN = 0;
        @sysvar::XCP::RadarFR::_g_PlReCoFw_PlReCoPer_ObjBypassingRunnable_ObjBypassingRunnable_m_pad_radarObjPort_par_out_local::TChangeableMemPool::_::_::_m_arrayPool::_0_::_elem::port_ens_r_obj_sensor_base::_::_m_movObjectInformation::_6_::_m_dWidthN = @Classe_Obj_Sim::obj_data.obj_width[6] * 128;
        break;

      case 2: //"RoadSideBarrier"
        @sysvar::XCP::RadarFR::_g_PlReCoFw_PlReCoPer_ObjBypassingRunnable_ObjBypassingRunnable_m_pad_radarObjPort_par_out_local::TChangeableMemPool::_::_::_m_arrayPool::_0_::_elem::port_ens_r_obj_sensor_base::_::_m_movObjectInformation::_6_::STA_OBJECT_INFORMATION_ST::_::_m_ohyObjectType_st::_m_prob1NonObstacleN = 0;
        @sysvar::XCP::RadarFR::_g_PlReCoFw_PlReCoPer_ObjBypassingRunnable_ObjBypassingRunnable_m_pad_radarObjPort_par_out_local::TChangeableMemPool::_::_::_m_arrayPool::_0_::_elem::port_ens_r_obj_sensor_base::_::_m_movObjectInformation::_6_::STA_OBJECT_INFORMATION_ST::_::_m_ohyObjectType_st::_m_prob1ObstacleN = 128;
        @sysvar::XCP::RadarFR::_g_PlReCoFw_PlReCoPer_ObjBypassingRunnable_ObjBypassingRunnable_m_pad_radarObjPort_par_out_local::TChangeableMemPool::_::_::_m_arrayPool::_0_::_elem::port_ens_r_obj_sensor_base::_::_m_movObjectInformation::_6_::STA_OBJECT_INFORMATION_ST::_::_m_ohyObjectType_st::_m_prob1UnknownN = 0;
        @sysvar::XCP::RadarFR::_g_PlReCoFw_PlReCoPer_ObjBypassingRunnable_ObjBypassingRunnable_m_pad_radarObjPort_par_out_local::TChangeableMemPool::_::_::_m_arrayPool::_0_::_elem::port_ens_r_obj_sensor_base::_::_m_movObjectInformation::_6_::STA_OBJECT_INFORMATION_ST::_::_m_ohyObjectType_st::_m_probObstacle_st::_m_prob1MobileN = 0;
        @sysvar::XCP::RadarFR::_g_PlReCoFw_PlReCoPer_ObjBypassingRunnable_ObjBypassingRunnable_m_pad_radarObjPort_par_out_local::TChangeableMemPool::_::_::_m_arrayPool::_0_::_elem::port_ens_r_obj_sensor_base::_::_m_movObjectInformation::_6_::STA_OBJECT_INFORMATION_ST::_::_m_ohyObjectType_st::_m_probObstacle_st::_m_prob1StationaryN = 128;
        @sysvar::XCP::RadarFR::_g_PlReCoFw_PlReCoPer_ObjBypassingRunnable_ObjBypassingRunnable_m_pad_radarObjPort_par_out_local::TChangeableMemPool::_::_::_m_arrayPool::_0_::_elem::port_ens_r_obj_sensor_base::_::_m_movObjectInformation::_6_::STA_OBJECT_INFORMATION_ST::_::_m_ohyObjectType_st::_m_probObstacle_st::_m_prob1UnknownN = 0;
        @sysvar::XCP::RadarFR::_g_PlReCoFw_PlReCoPer_ObjBypassingRunnable_ObjBypassingRunnable_m_pad_radarObjPort_par_out_local::TChangeableMemPool::_::_::_m_arrayPool::_0_::_elem::port_ens_r_obj_sensor_base::_::_m_movObjectInformation::_6_::STA_OBJECT_INFORMATION_ST::_::_m_ohyObjectType_st::_m_probObstacle_st::_m_probMobile_st::_m_prob1FourPlusWheelerN = 0;
        @sysvar::XCP::RadarFR::_g_PlReCoFw_PlReCoPer_ObjBypassingRunnable_ObjBypassingRunnable_m_pad_radarObjPort_par_out_local::TChangeableMemPool::_::_::_m_arrayPool::_0_::_elem::port_ens_r_obj_sensor_base::_::_m_movObjectInformation::_6_::STA_OBJECT_INFORMATION_ST::_::_m_ohyObjectType_st::_m_probObstacle_st::_m_probMobile_st::_m_prob1PedestrianN = 0;
        @sysvar::XCP::RadarFR::_g_PlReCoFw_PlReCoPer_ObjBypassingRunnable_ObjBypassingRunnable_m_pad_radarObjPort_par_out_local::TChangeableMemPool::_::_::_m_arrayPool::_0_::_elem::port_ens_r_obj_sensor_base::_::_m_movObjectInformation::_6_::STA_OBJECT_INFORMATION_ST::_::_m_ohyObjectType_st::_m_probObstacle_st::_m_probMobile_st::_m_prob1TwoWheelerN = 0;
        @sysvar::XCP::RadarFR::_g_PlReCoFw_PlReCoPer_ObjBypassingRunnable_ObjBypassingRunnable_m_pad_radarObjPort_par_out_local::TChangeableMemPool::_::_::_m_arrayPool::_0_::_elem::port_ens_r_obj_sensor_base::_::_m_movObjectInformation::_6_::STA_OBJECT_INFORMATION_ST::_::_m_ohyObjectType_st::_m_probObstacle_st::_m_probMobile_st::_m_prob1UnknownN = 0;
        @sysvar::XCP::RadarFR::_g_PlReCoFw_PlReCoPer_ObjBypassingRunnable_ObjBypassingRunnable_m_pad_radarObjPort_par_out_local::TChangeableMemPool::_::_::_m_arrayPool::_0_::_elem::port_ens_r_obj_sensor_base::_::_m_movObjectInformation::_6_::STA_OBJECT_INFORMATION_ST::_::_m_ohyObjectType_st::_m_probObstacle_st::_m_probMobile_st::_m_probFourPlusWheeler_st::_m_prob1PassengerCarN = 0;
        @sysvar::XCP::RadarFR::_g_PlReCoFw_PlReCoPer_ObjBypassingRunnable_ObjBypassingRunnable_m_pad_radarObjPort_par_out_local::TChangeableMemPool::_::_::_m_arrayPool::_0_::_elem::port_ens_r_obj_sensor_base::_::_m_movObjectInformation::_6_::STA_OBJECT_INFORMATION_ST::_::_m_ohyObjectType_st::_m_probObstacle_st::_m_probMobile_st::_m_probFourPlusWheeler_st::_m_prob1TruckN = 0;
        @sysvar::XCP::RadarFR::_g_PlReCoFw_PlReCoPer_ObjBypassingRunnable_ObjBypassingRunnable_m_pad_radarObjPort_par_out_local::TChangeableMemPool::_::_::_m_arrayPool::_0_::_elem::port_ens_r_obj_sensor_base::_::_m_movObjectInformation::_6_::STA_OBJECT_INFORMATION_ST::_::_m_ohyObjectType_st::_m_probObstacle_st::_m_probMobile_st::_m_probFourPlusWheeler_st::_m_prob1UnknownN = 0;
        @sysvar::XCP::RadarFR::_g_PlReCoFw_PlReCoPer_ObjBypassingRunnable_ObjBypassingRunnable_m_pad_radarObjPort_par_out_local::TChangeableMemPool::_::_::_m_arrayPool::_0_::_elem::port_ens_r_obj_sensor_base::_::_m_movObjectInformation::_6_::STA_OBJECT_INFORMATION_ST::_::_m_ohyObjectType_st::_m_probObstacle_st::_m_probStationary_st::_m_prob1RoadsideBarrierN = 128;
        @sysvar::XCP::RadarFR::_g_PlReCoFw_PlReCoPer_ObjBypassingRunnable_ObjBypassingRunnable_m_pad_radarObjPort_par_out_local::TChangeableMemPool::_::_::_m_arrayPool::_0_::_elem::port_ens_r_obj_sensor_base::_::_m_movObjectInformation::_6_::STA_OBJECT_INFORMATION_ST::_::_m_ohyObjectType_st::_m_probObstacle_st::_m_probStationary_st::_m_prob1UnknownN = 0;
        @sysvar::XCP::RadarFR::_g_PlReCoFw_PlReCoPer_ObjBypassingRunnable_ObjBypassingRunnable_m_pad_radarObjPort_par_out_local::TChangeableMemPool::_::_::_m_arrayPool::_0_::_elem::port_ens_r_obj_sensor_base::_::_m_movObjectInformation::_6_::_m_dLengthN = 64;
        @sysvar::XCP::RadarFR::_g_PlReCoFw_PlReCoPer_ObjBypassingRunnable_ObjBypassingRunnable_m_pad_radarObjPort_par_out_local::TChangeableMemPool::_::_::_m_arrayPool::_0_::_elem::port_ens_r_obj_sensor_base::_::_m_movObjectInformation::_6_::_m_dWidthN = @Classe_Obj_Sim::obj_data.obj_width[6] * 128;
        break;

      case 3: //"2Wheeler"
        @sysvar::XCP::RadarFR::_g_PlReCoFw_PlReCoPer_ObjBypassingRunnable_ObjBypassingRunnable_m_pad_radarObjPort_par_out_local::TChangeableMemPool::_::_::_m_arrayPool::_0_::_elem::port_ens_r_obj_sensor_base::_::_m_movObjectInformation::_6_::STA_OBJECT_INFORMATION_ST::_::_m_ohyObjectType_st::_m_prob1NonObstacleN = 0;
        @sysvar::XCP::RadarFR::_g_PlReCoFw_PlReCoPer_ObjBypassingRunnable_ObjBypassingRunnable_m_pad_radarObjPort_par_out_local::TChangeableMemPool::_::_::_m_arrayPool::_0_::_elem::port_ens_r_obj_sensor_base::_::_m_movObjectInformation::_6_::STA_OBJECT_INFORMATION_ST::_::_m_ohyObjectType_st::_m_prob1ObstacleN = 128;
        @sysvar::XCP::RadarFR::_g_PlReCoFw_PlReCoPer_ObjBypassingRunnable_ObjBypassingRunnable_m_pad_radarObjPort_par_out_local::TChangeableMemPool::_::_::_m_arrayPool::_0_::_elem::port_ens_r_obj_sensor_base::_::_m_movObjectInformation::_6_::STA_OBJECT_INFORMATION_ST::_::_m_ohyObjectType_st::_m_prob1UnknownN = 0;
        @sysvar::XCP::RadarFR::_g_PlReCoFw_PlReCoPer_ObjBypassingRunnable_ObjBypassingRunnable_m_pad_radarObjPort_par_out_local::TChangeableMemPool::_::_::_m_arrayPool::_0_::_elem::port_ens_r_obj_sensor_base::_::_m_movObjectInformation::_6_::STA_OBJECT_INFORMATION_ST::_::_m_ohyObjectType_st::_m_probObstacle_st::_m_prob1UnknownN = 0;
        @sysvar::XCP::RadarFR::_g_PlReCoFw_PlReCoPer_ObjBypassingRunnable_ObjBypassingRunnable_m_pad_radarObjPort_par_out_local::TChangeableMemPool::_::_::_m_arrayPool::_0_::_elem::port_ens_r_obj_sensor_base::_::_m_movObjectInformation::_6_::STA_OBJECT_INFORMATION_ST::_::_m_ohyObjectType_st::_m_probObstacle_st::_m_probMobile_st::_m_prob1FourPlusWheelerN = 0;
        @sysvar::XCP::RadarFR::_g_PlReCoFw_PlReCoPer_ObjBypassingRunnable_ObjBypassingRunnable_m_pad_radarObjPort_par_out_local::TChangeableMemPool::_::_::_m_arrayPool::_0_::_elem::port_ens_r_obj_sensor_base::_::_m_movObjectInformation::_6_::STA_OBJECT_INFORMATION_ST::_::_m_ohyObjectType_st::_m_probObstacle_st::_m_probMobile_st::_m_prob1PedestrianN = 0;
        @sysvar::XCP::RadarFR::_g_PlReCoFw_PlReCoPer_ObjBypassingRunnable_ObjBypassingRunnable_m_pad_radarObjPort_par_out_local::TChangeableMemPool::_::_::_m_arrayPool::_0_::_elem::port_ens_r_obj_sensor_base::_::_m_movObjectInformation::_6_::STA_OBJECT_INFORMATION_ST::_::_m_ohyObjectType_st::_m_probObstacle_st::_m_probMobile_st::_m_prob1TwoWheelerN = 128;
        @sysvar::XCP::RadarFR::_g_PlReCoFw_PlReCoPer_ObjBypassingRunnable_ObjBypassingRunnable_m_pad_radarObjPort_par_out_local::TChangeableMemPool::_::_::_m_arrayPool::_0_::_elem::port_ens_r_obj_sensor_base::_::_m_movObjectInformation::_6_::STA_OBJECT_INFORMATION_ST::_::_m_ohyObjectType_st::_m_probObstacle_st::_m_probMobile_st::_m_prob1UnknownN = 0;
        @sysvar::XCP::RadarFR::_g_PlReCoFw_PlReCoPer_ObjBypassingRunnable_ObjBypassingRunnable_m_pad_radarObjPort_par_out_local::TChangeableMemPool::_::_::_m_arrayPool::_0_::_elem::port_ens_r_obj_sensor_base::_::_m_movObjectInformation::_6_::STA_OBJECT_INFORMATION_ST::_::_m_ohyObjectType_st::_m_probObstacle_st::_m_probMobile_st::_m_probFourPlusWheeler_st::_m_prob1PassengerCarN = 0;
        @sysvar::XCP::RadarFR::_g_PlReCoFw_PlReCoPer_ObjBypassingRunnable_ObjBypassingRunnable_m_pad_radarObjPort_par_out_local::TChangeableMemPool::_::_::_m_arrayPool::_0_::_elem::port_ens_r_obj_sensor_base::_::_m_movObjectInformation::_6_::STA_OBJECT_INFORMATION_ST::_::_m_ohyObjectType_st::_m_probObstacle_st::_m_probMobile_st::_m_probFourPlusWheeler_st::_m_prob1TruckN = 0;
        @sysvar::XCP::RadarFR::_g_PlReCoFw_PlReCoPer_ObjBypassingRunnable_ObjBypassingRunnable_m_pad_radarObjPort_par_out_local::TChangeableMemPool::_::_::_m_arrayPool::_0_::_elem::port_ens_r_obj_sensor_base::_::_m_movObjectInformation::_6_::STA_OBJECT_INFORMATION_ST::_::_m_ohyObjectType_st::_m_probObstacle_st::_m_probMobile_st::_m_probFourPlusWheeler_st::_m_prob1UnknownN = 128;
        @sysvar::XCP::RadarFR::_g_PlReCoFw_PlReCoPer_ObjBypassingRunnable_ObjBypassingRunnable_m_pad_radarObjPort_par_out_local::TChangeableMemPool::_::_::_m_arrayPool::_0_::_elem::port_ens_r_obj_sensor_base::_::_m_movObjectInformation::_6_::STA_OBJECT_INFORMATION_ST::_::_m_ohyObjectType_st::_m_probObstacle_st::_m_probStationary_st::_m_prob1RoadsideBarrierN = 0;
        @sysvar::XCP::RadarFR::_g_PlReCoFw_PlReCoPer_ObjBypassingRunnable_ObjBypassingRunnable_m_pad_radarObjPort_par_out_local::TChangeableMemPool::_::_::_m_arrayPool::_0_::_elem::port_ens_r_obj_sensor_base::_::_m_movObjectInformation::_6_::STA_OBJECT_INFORMATION_ST::_::_m_ohyObjectType_st::_m_probObstacle_st::_m_probStationary_st::_m_prob1UnknownN = 0;
        @sysvar::XCP::RadarFR::_g_PlReCoFw_PlReCoPer_ObjBypassingRunnable_ObjBypassingRunnable_m_pad_radarObjPort_par_out_local::TChangeableMemPool::_::_::_m_arrayPool::_0_::_elem::port_ens_r_obj_sensor_base::_::_m_movObjectInformation::_6_::_m_dLengthN = 64;
        @sysvar::XCP::RadarFR::_g_PlReCoFw_PlReCoPer_ObjBypassingRunnable_ObjBypassingRunnable_m_pad_radarObjPort_par_out_local::TChangeableMemPool::_::_::_m_arrayPool::_0_::_elem::port_ens_r_obj_sensor_base::_::_m_movObjectInformation::_6_::_m_dWidthN = @Classe_Obj_Sim::obj_data.obj_width[6] * 128;
        break;

      case 4: //"Pedestrian"
        @sysvar::XCP::RadarFR::_g_PlReCoFw_PlReCoPer_ObjBypassingRunnable_ObjBypassingRunnable_m_pad_radarObjPort_par_out_local::TChangeableMemPool::_::_::_m_arrayPool::_0_::_elem::port_ens_r_obj_sensor_base::_::_m_movObjectInformation::_6_::STA_OBJECT_INFORMATION_ST::_::_m_ohyObjectType_st::_m_prob1NonObstacleN = 0;
        @sysvar::XCP::RadarFR::_g_PlReCoFw_PlReCoPer_ObjBypassingRunnable_ObjBypassingRunnable_m_pad_radarObjPort_par_out_local::TChangeableMemPool::_::_::_m_arrayPool::_0_::_elem::port_ens_r_obj_sensor_base::_::_m_movObjectInformation::_6_::STA_OBJECT_INFORMATION_ST::_::_m_ohyObjectType_st::_m_prob1ObstacleN = 128;
        @sysvar::XCP::RadarFR::_g_PlReCoFw_PlReCoPer_ObjBypassingRunnable_ObjBypassingRunnable_m_pad_radarObjPort_par_out_local::TChangeableMemPool::_::_::_m_arrayPool::_0_::_elem::port_ens_r_obj_sensor_base::_::_m_movObjectInformation::_6_::STA_OBJECT_INFORMATION_ST::_::_m_ohyObjectType_st::_m_prob1UnknownN = 0;
        @sysvar::XCP::RadarFR::_g_PlReCoFw_PlReCoPer_ObjBypassingRunnable_ObjBypassingRunnable_m_pad_radarObjPort_par_out_local::TChangeableMemPool::_::_::_m_arrayPool::_0_::_elem::port_ens_r_obj_sensor_base::_::_m_movObjectInformation::_6_::STA_OBJECT_INFORMATION_ST::_::_m_ohyObjectType_st::_m_probObstacle_st::_m_prob1UnknownN = 0;
        @sysvar::XCP::RadarFR::_g_PlReCoFw_PlReCoPer_ObjBypassingRunnable_ObjBypassingRunnable_m_pad_radarObjPort_par_out_local::TChangeableMemPool::_::_::_m_arrayPool::_0_::_elem::port_ens_r_obj_sensor_base::_::_m_movObjectInformation::_6_::STA_OBJECT_INFORMATION_ST::_::_m_ohyObjectType_st::_m_probObstacle_st::_m_probMobile_st::_m_prob1FourPlusWheelerN = 0;
        @sysvar::XCP::RadarFR::_g_PlReCoFw_PlReCoPer_ObjBypassingRunnable_ObjBypassingRunnable_m_pad_radarObjPort_par_out_local::TChangeableMemPool::_::_::_m_arrayPool::_0_::_elem::port_ens_r_obj_sensor_base::_::_m_movObjectInformation::_6_::STA_OBJECT_INFORMATION_ST::_::_m_ohyObjectType_st::_m_probObstacle_st::_m_probMobile_st::_m_prob1PedestrianN = 128;
        @sysvar::XCP::RadarFR::_g_PlReCoFw_PlReCoPer_ObjBypassingRunnable_ObjBypassingRunnable_m_pad_radarObjPort_par_out_local::TChangeableMemPool::_::_::_m_arrayPool::_0_::_elem::port_ens_r_obj_sensor_base::_::_m_movObjectInformation::_6_::STA_OBJECT_INFORMATION_ST::_::_m_ohyObjectType_st::_m_probObstacle_st::_m_probMobile_st::_m_prob1TwoWheelerN = 0;
        @sysvar::XCP::RadarFR::_g_PlReCoFw_PlReCoPer_ObjBypassingRunnable_ObjBypassingRunnable_m_pad_radarObjPort_par_out_local::TChangeableMemPool::_::_::_m_arrayPool::_0_::_elem::port_ens_r_obj_sensor_base::_::_m_movObjectInformation::_6_::STA_OBJECT_INFORMATION_ST::_::_m_ohyObjectType_st::_m_probObstacle_st::_m_probMobile_st::_m_prob1UnknownN = 0;
        @sysvar::XCP::RadarFR::_g_PlReCoFw_PlReCoPer_ObjBypassingRunnable_ObjBypassingRunnable_m_pad_radarObjPort_par_out_local::TChangeableMemPool::_::_::_m_arrayPool::_0_::_elem::port_ens_r_obj_sensor_base::_::_m_movObjectInformation::_6_::STA_OBJECT_INFORMATION_ST::_::_m_ohyObjectType_st::_m_probObstacle_st::_m_probMobile_st::_m_probFourPlusWheeler_st::_m_prob1PassengerCarN = 0;
        @sysvar::XCP::RadarFR::_g_PlReCoFw_PlReCoPer_ObjBypassingRunnable_ObjBypassingRunnable_m_pad_radarObjPort_par_out_local::TChangeableMemPool::_::_::_m_arrayPool::_0_::_elem::port_ens_r_obj_sensor_base::_::_m_movObjectInformation::_6_::STA_OBJECT_INFORMATION_ST::_::_m_ohyObjectType_st::_m_probObstacle_st::_m_probMobile_st::_m_probFourPlusWheeler_st::_m_prob1TruckN = 0;
        @sysvar::XCP::RadarFR::_g_PlReCoFw_PlReCoPer_ObjBypassingRunnable_ObjBypassingRunnable_m_pad_radarObjPort_par_out_local::TChangeableMemPool::_::_::_m_arrayPool::_0_::_elem::port_ens_r_obj_sensor_base::_::_m_movObjectInformation::_6_::STA_OBJECT_INFORMATION_ST::_::_m_ohyObjectType_st::_m_probObstacle_st::_m_probMobile_st::_m_probFourPlusWheeler_st::_m_prob1UnknownN = 128;
        @sysvar::XCP::RadarFR::_g_PlReCoFw_PlReCoPer_ObjBypassingRunnable_ObjBypassingRunnable_m_pad_radarObjPort_par_out_local::TChangeableMemPool::_::_::_m_arrayPool::_0_::_elem::port_ens_r_obj_sensor_base::_::_m_movObjectInformation::_6_::STA_OBJECT_INFORMATION_ST::_::_m_ohyObjectType_st::_m_probObstacle_st::_m_probStationary_st::_m_prob1RoadsideBarrierN = 0;
        @sysvar::XCP::RadarFR::_g_PlReCoFw_PlReCoPer_ObjBypassingRunnable_ObjBypassingRunnable_m_pad_radarObjPort_par_out_local::TChangeableMemPool::_::_::_m_arrayPool::_0_::_elem::port_ens_r_obj_sensor_base::_::_m_movObjectInformation::_6_::STA_OBJECT_INFORMATION_ST::_::_m_ohyObjectType_st::_m_probObstacle_st::_m_probStationary_st::_m_prob1UnknownN = 0;
        @sysvar::XCP::RadarFR::_g_PlReCoFw_PlReCoPer_ObjBypassingRunnable_ObjBypassingRunnable_m_pad_radarObjPort_par_out_local::TChangeableMemPool::_::_::_m_arrayPool::_0_::_elem::port_ens_r_obj_sensor_base::_::_m_movObjectInformation::_6_::_m_dLengthN = 64;
        @sysvar::XCP::RadarFR::_g_PlReCoFw_PlReCoPer_ObjBypassingRunnable_ObjBypassingRunnable_m_pad_radarObjPort_par_out_local::TChangeableMemPool::_::_::_m_arrayPool::_0_::_elem::port_ens_r_obj_sensor_base::_::_m_movObjectInformation::_6_::_m_dWidthN = @Classe_Obj_Sim::obj_data.obj_width[6] * 128;
        break;

      case 5: //"Truck"
        @sysvar::XCP::RadarFR::_g_PlReCoFw_PlReCoPer_ObjBypassingRunnable_ObjBypassingRunnable_m_pad_radarObjPort_par_out_local::TChangeableMemPool::_::_::_m_arrayPool::_0_::_elem::port_ens_r_obj_sensor_base::_::_m_movObjectInformation::_6_::STA_OBJECT_INFORMATION_ST::_::_m_ohyObjectType_st::_m_prob1NonObstacleN = 0;
        @sysvar::XCP::RadarFR::_g_PlReCoFw_PlReCoPer_ObjBypassingRunnable_ObjBypassingRunnable_m_pad_radarObjPort_par_out_local::TChangeableMemPool::_::_::_m_arrayPool::_0_::_elem::port_ens_r_obj_sensor_base::_::_m_movObjectInformation::_6_::STA_OBJECT_INFORMATION_ST::_::_m_ohyObjectType_st::_m_prob1ObstacleN = 128;
        @sysvar::XCP::RadarFR::_g_PlReCoFw_PlReCoPer_ObjBypassingRunnable_ObjBypassingRunnable_m_pad_radarObjPort_par_out_local::TChangeableMemPool::_::_::_m_arrayPool::_0_::_elem::port_ens_r_obj_sensor_base::_::_m_movObjectInformation::_6_::STA_OBJECT_INFORMATION_ST::_::_m_ohyObjectType_st::_m_prob1UnknownN = 0;
        @sysvar::XCP::RadarFR::_g_PlReCoFw_PlReCoPer_ObjBypassingRunnable_ObjBypassingRunnable_m_pad_radarObjPort_par_out_local::TChangeableMemPool::_::_::_m_arrayPool::_0_::_elem::port_ens_r_obj_sensor_base::_::_m_movObjectInformation::_6_::STA_OBJECT_INFORMATION_ST::_::_m_ohyObjectType_st::_m_probObstacle_st::_m_prob1UnknownN = 0;
        @sysvar::XCP::RadarFR::_g_PlReCoFw_PlReCoPer_ObjBypassingRunnable_ObjBypassingRunnable_m_pad_radarObjPort_par_out_local::TChangeableMemPool::_::_::_m_arrayPool::_0_::_elem::port_ens_r_obj_sensor_base::_::_m_movObjectInformation::_6_::STA_OBJECT_INFORMATION_ST::_::_m_ohyObjectType_st::_m_probObstacle_st::_m_probMobile_st::_m_prob1FourPlusWheelerN = 128;
        @sysvar::XCP::RadarFR::_g_PlReCoFw_PlReCoPer_ObjBypassingRunnable_ObjBypassingRunnable_m_pad_radarObjPort_par_out_local::TChangeableMemPool::_::_::_m_arrayPool::_0_::_elem::port_ens_r_obj_sensor_base::_::_m_movObjectInformation::_6_::STA_OBJECT_INFORMATION_ST::_::_m_ohyObjectType_st::_m_probObstacle_st::_m_probMobile_st::_m_prob1PedestrianN = 0;
        @sysvar::XCP::RadarFR::_g_PlReCoFw_PlReCoPer_ObjBypassingRunnable_ObjBypassingRunnable_m_pad_radarObjPort_par_out_local::TChangeableMemPool::_::_::_m_arrayPool::_0_::_elem::port_ens_r_obj_sensor_base::_::_m_movObjectInformation::_6_::STA_OBJECT_INFORMATION_ST::_::_m_ohyObjectType_st::_m_probObstacle_st::_m_probMobile_st::_m_prob1TwoWheelerN = 0;
        @sysvar::XCP::RadarFR::_g_PlReCoFw_PlReCoPer_ObjBypassingRunnable_ObjBypassingRunnable_m_pad_radarObjPort_par_out_local::TChangeableMemPool::_::_::_m_arrayPool::_0_::_elem::port_ens_r_obj_sensor_base::_::_m_movObjectInformation::_6_::STA_OBJECT_INFORMATION_ST::_::_m_ohyObjectType_st::_m_probObstacle_st::_m_probMobile_st::_m_prob1UnknownN = 0;
        @sysvar::XCP::RadarFR::_g_PlReCoFw_PlReCoPer_ObjBypassingRunnable_ObjBypassingRunnable_m_pad_radarObjPort_par_out_local::TChangeableMemPool::_::_::_m_arrayPool::_0_::_elem::port_ens_r_obj_sensor_base::_::_m_movObjectInformation::_6_::STA_OBJECT_INFORMATION_ST::_::_m_ohyObjectType_st::_m_probObstacle_st::_m_probMobile_st::_m_probFourPlusWheeler_st::_m_prob1PassengerCarN = 0;
        @sysvar::XCP::RadarFR::_g_PlReCoFw_PlReCoPer_ObjBypassingRunnable_ObjBypassingRunnable_m_pad_radarObjPort_par_out_local::TChangeableMemPool::_::_::_m_arrayPool::_0_::_elem::port_ens_r_obj_sensor_base::_::_m_movObjectInformation::_6_::STA_OBJECT_INFORMATION_ST::_::_m_ohyObjectType_st::_m_probObstacle_st::_m_probMobile_st::_m_probFourPlusWheeler_st::_m_prob1TruckN = 128;
        @sysvar::XCP::RadarFR::_g_PlReCoFw_PlReCoPer_ObjBypassingRunnable_ObjBypassingRunnable_m_pad_radarObjPort_par_out_local::TChangeableMemPool::_::_::_m_arrayPool::_0_::_elem::port_ens_r_obj_sensor_base::_::_m_movObjectInformation::_6_::STA_OBJECT_INFORMATION_ST::_::_m_ohyObjectType_st::_m_probObstacle_st::_m_probMobile_st::_m_probFourPlusWheeler_st::_m_prob1UnknownN = 0;
        @sysvar::XCP::RadarFR::_g_PlReCoFw_PlReCoPer_ObjBypassingRunnable_ObjBypassingRunnable_m_pad_radarObjPort_par_out_local::TChangeableMemPool::_::_::_m_arrayPool::_0_::_elem::port_ens_r_obj_sensor_base::_::_m_movObjectInformation::_6_::STA_OBJECT_INFORMATION_ST::_::_m_ohyObjectType_st::_m_probObstacle_st::_m_probStationary_st::_m_prob1RoadsideBarrierN = 0;
        @sysvar::XCP::RadarFR::_g_PlReCoFw_PlReCoPer_ObjBypassingRunnable_ObjBypassingRunnable_m_pad_radarObjPort_par_out_local::TChangeableMemPool::_::_::_m_arrayPool::_0_::_elem::port_ens_r_obj_sensor_base::_::_m_movObjectInformation::_6_::STA_OBJECT_INFORMATION_ST::_::_m_ohyObjectType_st::_m_probObstacle_st::_m_probStationary_st::_m_prob1UnknownN = 0;
        @sysvar::XCP::RadarFR::_g_PlReCoFw_PlReCoPer_ObjBypassingRunnable_ObjBypassingRunnable_m_pad_radarObjPort_par_out_local::TChangeableMemPool::_::_::_m_arrayPool::_0_::_elem::port_ens_r_obj_sensor_base::_::_m_movObjectInformation::_6_::_m_dLengthN = 64;
        @sysvar::XCP::RadarFR::_g_PlReCoFw_PlReCoPer_ObjBypassingRunnable_ObjBypassingRunnable_m_pad_radarObjPort_par_out_local::TChangeableMemPool::_::_::_m_arrayPool::_0_::_elem::port_ens_r_obj_sensor_base::_::_m_movObjectInformation::_6_::_m_dWidthN = @Classe_Obj_Sim::obj_data.obj_width[6] * 128;
        break;

      case 6: //"PassengerCar"
        @sysvar::XCP::RadarFR::_g_PlReCoFw_PlReCoPer_ObjBypassingRunnable_ObjBypassingRunnable_m_pad_radarObjPort_par_out_local::TChangeableMemPool::_::_::_m_arrayPool::_0_::_elem::port_ens_r_obj_sensor_base::_::_m_movObjectInformation::_6_::STA_OBJECT_INFORMATION_ST::_::_m_ohyObjectType_st::_m_prob1NonObstacleN = 0;
        @sysvar::XCP::RadarFR::_g_PlReCoFw_PlReCoPer_ObjBypassingRunnable_ObjBypassingRunnable_m_pad_radarObjPort_par_out_local::TChangeableMemPool::_::_::_m_arrayPool::_0_::_elem::port_ens_r_obj_sensor_base::_::_m_movObjectInformation::_6_::STA_OBJECT_INFORMATION_ST::_::_m_ohyObjectType_st::_m_prob1ObstacleN = 128;
        @sysvar::XCP::RadarFR::_g_PlReCoFw_PlReCoPer_ObjBypassingRunnable_ObjBypassingRunnable_m_pad_radarObjPort_par_out_local::TChangeableMemPool::_::_::_m_arrayPool::_0_::_elem::port_ens_r_obj_sensor_base::_::_m_movObjectInformation::_6_::STA_OBJECT_INFORMATION_ST::_::_m_ohyObjectType_st::_m_prob1UnknownN = 0;
        @sysvar::XCP::RadarFR::_g_PlReCoFw_PlReCoPer_ObjBypassingRunnable_ObjBypassingRunnable_m_pad_radarObjPort_par_out_local::TChangeableMemPool::_::_::_m_arrayPool::_0_::_elem::port_ens_r_obj_sensor_base::_::_m_movObjectInformation::_6_::STA_OBJECT_INFORMATION_ST::_::_m_ohyObjectType_st::_m_probObstacle_st::_m_prob1UnknownN = 0;
        @sysvar::XCP::RadarFR::_g_PlReCoFw_PlReCoPer_ObjBypassingRunnable_ObjBypassingRunnable_m_pad_radarObjPort_par_out_local::TChangeableMemPool::_::_::_m_arrayPool::_0_::_elem::port_ens_r_obj_sensor_base::_::_m_movObjectInformation::_6_::STA_OBJECT_INFORMATION_ST::_::_m_ohyObjectType_st::_m_probObstacle_st::_m_probMobile_st::_m_prob1FourPlusWheelerN = 128;
        @sysvar::XCP::RadarFR::_g_PlReCoFw_PlReCoPer_ObjBypassingRunnable_ObjBypassingRunnable_m_pad_radarObjPort_par_out_local::TChangeableMemPool::_::_::_m_arrayPool::_0_::_elem::port_ens_r_obj_sensor_base::_::_m_movObjectInformation::_6_::STA_OBJECT_INFORMATION_ST::_::_m_ohyObjectType_st::_m_probObstacle_st::_m_probMobile_st::_m_prob1PedestrianN = 0;
        @sysvar::XCP::RadarFR::_g_PlReCoFw_PlReCoPer_ObjBypassingRunnable_ObjBypassingRunnable_m_pad_radarObjPort_par_out_local::TChangeableMemPool::_::_::_m_arrayPool::_0_::_elem::port_ens_r_obj_sensor_base::_::_m_movObjectInformation::_6_::STA_OBJECT_INFORMATION_ST::_::_m_ohyObjectType_st::_m_probObstacle_st::_m_probMobile_st::_m_prob1TwoWheelerN = 0;
        @sysvar::XCP::RadarFR::_g_PlReCoFw_PlReCoPer_ObjBypassingRunnable_ObjBypassingRunnable_m_pad_radarObjPort_par_out_local::TChangeableMemPool::_::_::_m_arrayPool::_0_::_elem::port_ens_r_obj_sensor_base::_::_m_movObjectInformation::_6_::STA_OBJECT_INFORMATION_ST::_::_m_ohyObjectType_st::_m_probObstacle_st::_m_probMobile_st::_m_prob1UnknownN = 0;
        @sysvar::XCP::RadarFR::_g_PlReCoFw_PlReCoPer_ObjBypassingRunnable_ObjBypassingRunnable_m_pad_radarObjPort_par_out_local::TChangeableMemPool::_::_::_m_arrayPool::_0_::_elem::port_ens_r_obj_sensor_base::_::_m_movObjectInformation::_6_::STA_OBJECT_INFORMATION_ST::_::_m_ohyObjectType_st::_m_probObstacle_st::_m_probMobile_st::_m_probFourPlusWheeler_st::_m_prob1PassengerCarN = 128;
        @sysvar::XCP::RadarFR::_g_PlReCoFw_PlReCoPer_ObjBypassingRunnable_ObjBypassingRunnable_m_pad_radarObjPort_par_out_local::TChangeableMemPool::_::_::_m_arrayPool::_0_::_elem::port_ens_r_obj_sensor_base::_::_m_movObjectInformation::_6_::STA_OBJECT_INFORMATION_ST::_::_m_ohyObjectType_st::_m_probObstacle_st::_m_probMobile_st::_m_probFourPlusWheeler_st::_m_prob1TruckN = 0;
        @sysvar::XCP::RadarFR::_g_PlReCoFw_PlReCoPer_ObjBypassingRunnable_ObjBypassingRunnable_m_pad_radarObjPort_par_out_local::TChangeableMemPool::_::_::_m_arrayPool::_0_::_elem::port_ens_r_obj_sensor_base::_::_m_movObjectInformation::_6_::STA_OBJECT_INFORMATION_ST::_::_m_ohyObjectType_st::_m_probObstacle_st::_m_probMobile_st::_m_probFourPlusWheeler_st::_m_prob1UnknownN = 0;
        @sysvar::XCP::RadarFR::_g_PlReCoFw_PlReCoPer_ObjBypassingRunnable_ObjBypassingRunnable_m_pad_radarObjPort_par_out_local::TChangeableMemPool::_::_::_m_arrayPool::_0_::_elem::port_ens_r_obj_sensor_base::_::_m_movObjectInformation::_6_::STA_OBJECT_INFORMATION_ST::_::_m_ohyObjectType_st::_m_probObstacle_st::_m_probStationary_st::_m_prob1RoadsideBarrierN = 0;
        @sysvar::XCP::RadarFR::_g_PlReCoFw_PlReCoPer_ObjBypassingRunnable_ObjBypassingRunnable_m_pad_radarObjPort_par_out_local::TChangeableMemPool::_::_::_m_arrayPool::_0_::_elem::port_ens_r_obj_sensor_base::_::_m_movObjectInformation::_6_::STA_OBJECT_INFORMATION_ST::_::_m_ohyObjectType_st::_m_probObstacle_st::_m_probStationary_st::_m_prob1UnknownN = 0;
        @sysvar::XCP::RadarFR::_g_PlReCoFw_PlReCoPer_ObjBypassingRunnable_ObjBypassingRunnable_m_pad_radarObjPort_par_out_local::TChangeableMemPool::_::_::_m_arrayPool::_0_::_elem::port_ens_r_obj_sensor_base::_::_m_movObjectInformation::_6_::_m_dLengthN = 64;
        @sysvar::XCP::RadarFR::_g_PlReCoFw_PlReCoPer_ObjBypassingRunnable_ObjBypassingRunnable_m_pad_radarObjPort_par_out_local::TChangeableMemPool::_::_::_m_arrayPool::_0_::_elem::port_ens_r_obj_sensor_base::_::_m_movObjectInformation::_6_::_m_dWidthN = @Classe_Obj_Sim::obj_data.obj_width[6] * 128;
        break;
    }
    break;

    case 7: //"Object-7"
    //constant
    @sysvar::XCP::RadarFR::_g_PlReCoFw_PlReCoPer_ObjBypassingRunnable_ObjBypassingRunnable_m_pad_radarObjPort_par_out_local::TChangeableMemPool::_::_::_m_arrayPool::_0_::_elem::port_ens_r_obj_sensor_base::_::_m_movObjectInformation::_7_::STA_OBJECT_INFORMATION_ST::_::_Meas_b = 1;
    @sysvar::XCP::RadarFR::_g_PlReCoFw_PlReCoPer_ObjBypassingRunnable_ObjBypassingRunnable_m_pad_radarObjPort_par_out_local::TChangeableMemPool::_::_::_m_arrayPool::_0_::_elem::port_ens_r_obj_sensor_base::_::_m_movObjectInformation::_7_::STA_OBJECT_INFORMATION_ST::_::_Measurable_b = 1;
    @sysvar::XCP::RadarFR::_g_PlReCoFw_PlReCoPer_ObjBypassingRunnable_ObjBypassingRunnable_m_pad_radarObjPort_par_out_local::TChangeableMemPool::_::_::_m_arrayPool::_0_::_elem::port_ens_r_obj_sensor_base::_::_m_movObjectInformation::_7_::STA_OBJECT_INFORMATION_ST::_::_Valid_b = 1;
    @sysvar::XCP::RadarFR::_g_PlReCoFw_PlReCoPer_ObjBypassingRunnable_ObjBypassingRunnable_m_pad_radarObjPort_par_out_local::TChangeableMemPool::_::_::_m_arrayPool::_0_::_elem::port_ens_r_obj_sensor_base::_::_m_movObjectInformation::_7_::_m_covarDxAxN = 0;
    @sysvar::XCP::RadarFR::_g_PlReCoFw_PlReCoPer_ObjBypassingRunnable_ObjBypassingRunnable_m_pad_radarObjPort_par_out_local::TChangeableMemPool::_::_::_m_arrayPool::_0_::_elem::port_ens_r_obj_sensor_base::_::_m_movObjectInformation::_7_::_m_covarDxVxN = 0;
    @sysvar::XCP::RadarFR::_g_PlReCoFw_PlReCoPer_ObjBypassingRunnable_ObjBypassingRunnable_m_pad_radarObjPort_par_out_local::TChangeableMemPool::_::_::_m_arrayPool::_0_::_elem::port_ens_r_obj_sensor_base::_::_m_movObjectInformation::_7_::_m_covarDyVyN = 0;
    @sysvar::XCP::RadarFR::_g_PlReCoFw_PlReCoPer_ObjBypassingRunnable_ObjBypassingRunnable_m_pad_radarObjPort_par_out_local::TChangeableMemPool::_::_::_m_arrayPool::_0_::_elem::port_ens_r_obj_sensor_base::_::_m_movObjectInformation::_7_::_m_covarDyWidthN = 0;
    @sysvar::XCP::RadarFR::_g_PlReCoFw_PlReCoPer_ObjBypassingRunnable_ObjBypassingRunnable_m_pad_radarObjPort_par_out_local::TChangeableMemPool::_::_::_m_arrayPool::_0_::_elem::port_ens_r_obj_sensor_base::_::_m_movObjectInformation::_7_::_m_covarVxAxN = 0;
    @sysvar::XCP::RadarFR::_g_PlReCoFw_PlReCoPer_ObjBypassingRunnable_ObjBypassingRunnable_m_pad_radarObjPort_par_out_local::TChangeableMemPool::_::_::_m_arrayPool::_0_::_elem::port_ens_r_obj_sensor_base::_::_m_movObjectInformation::_7_::_m_varAxN = 0;
    @sysvar::XCP::RadarFR::_g_PlReCoFw_PlReCoPer_ObjBypassingRunnable_ObjBypassingRunnable_m_pad_radarObjPort_par_out_local::TChangeableMemPool::_::_::_m_arrayPool::_0_::_elem::port_ens_r_obj_sensor_base::_::_m_movObjectInformation::_7_::_m_varAyN = 0;
    @sysvar::XCP::RadarFR::_g_PlReCoFw_PlReCoPer_ObjBypassingRunnable_ObjBypassingRunnable_m_pad_radarObjPort_par_out_local::TChangeableMemPool::_::_::_m_arrayPool::_0_::_elem::port_ens_r_obj_sensor_base::_::_m_movObjectInformation::_7_::_m_varVxN = 0;
    @sysvar::XCP::RadarFR::_g_PlReCoFw_PlReCoPer_ObjBypassingRunnable_ObjBypassingRunnable_m_pad_radarObjPort_par_out_local::TChangeableMemPool::_::_::_m_arrayPool::_0_::_elem::port_ens_r_obj_sensor_base::_::_m_movObjectInformation::_7_::_m_varVyN = 0;
    @sysvar::XCP::RadarFR::_g_PlReCoFw_PlReCoPer_ObjBypassingRunnable_ObjBypassingRunnable_m_pad_radarObjPort_par_out_local::TChangeableMemPool::_::_::_m_arrayPool::_0_::_elem::port_ens_r_obj_sensor_base::_::_m_movObjectInformation::_7_::STA_OBJECT_INFORMATION_ST::_::_m_varDxN = 0;
    @sysvar::XCP::RadarFR::_g_PlReCoFw_PlReCoPer_ObjBypassingRunnable_ObjBypassingRunnable_m_pad_radarObjPort_par_out_local::TChangeableMemPool::_::_::_m_arrayPool::_0_::_elem::port_ens_r_obj_sensor_base::_::_m_movObjectInformation::_7_::STA_OBJECT_INFORMATION_ST::_::_m_varDyN = 0;
    @sysvar::XCP::RadarFR::_g_PlReCoFw_PlReCoPer_ObjBypassingRunnable_ObjBypassingRunnable_m_pad_radarObjPort_par_out_local::TChangeableMemPool::_::_::_m_arrayPool::_0_::_elem::port_ens_r_obj_sensor_base::_::_m_movObjectInformation::_7_::_m_dVarLengthN = 0;
    @sysvar::XCP::RadarFR::_g_PlReCoFw_PlReCoPer_ObjBypassingRunnable_ObjBypassingRunnable_m_pad_radarObjPort_par_out_local::TChangeableMemPool::_::_::_m_arrayPool::_0_::_elem::port_ens_r_obj_sensor_base::_::_m_movObjectInformation::_7_::_m_dVarWidthN = 0;
    @sysvar::XCP::RadarFR::_g_PlReCoFw_PlReCoPer_ObjBypassingRunnable_ObjBypassingRunnable_m_pad_radarObjPort_par_out_local::TChangeableMemPool::_::_::_m_arrayPool::_0_::_elem::port_ens_r_obj_sensor_base::_::_m_movObjectInformation::_7_::STA_OBJECT_INFORMATION_ST::_::_m_wExistProbN = 64880;
    @sysvar::XCP::RadarFR::_g_PlReCoFw_PlReCoPer_ObjBypassingRunnable_ObjBypassingRunnable_m_pad_radarObjPort_par_out_local::TChangeableMemPool::_::_::_m_arrayPool::_0_::_elem::port_ens_r_obj_sensor_base::_::_m_movObjectInformation::_7_::_m_referencePtPosIndexN = 10;
    @sysvar::XCP::RadarFR::_g_PlReCoFw_PlReCoPer_ObjBypassingRunnable_ObjBypassingRunnable_m_pad_radarObjPort_par_out_local::TChangeableMemPool::_::_::_m_arrayPool::_0_::_elem::port_ens_r_obj_sensor_base::_::_m_movObjectInformation::_7_::_m_alpPiVarYawAngleN = 0;
    @sysvar::XCP::RadarFR::_g_PlReCoFw_PlReCoPer_ObjBypassingRunnable_ObjBypassingRunnable_m_pad_radarObjPort_par_out_local::TChangeableMemPool::_::_::_m_arrayPool::_0_::_elem::port_ens_r_obj_sensor_base::_::_m_movObjectInformation::_7_::_m_alpPiYawAngleN = 0;

    //target movement

    @sysvar::XCP::RadarFR::_g_PlReCoFw_PlReCoPer_ObjBypassingRunnable_ObjBypassingRunnable_m_pad_radarObjPort_par_out_local::TChangeableMemPool::_::_::_m_arrayPool::_0_::_elem::port_ens_r_obj_sensor_base::_::_m_movObjectInformation::_7_::STA_OBJECT_INFORMATION_ST::_::_m_dxN = @Classe_Obj_Sim::obj_data.obj_dx[7] * 128;
    @sysvar::XCP::RadarFR::_g_PlReCoFw_PlReCoPer_ObjBypassingRunnable_ObjBypassingRunnable_m_pad_radarObjPort_par_out_local::TChangeableMemPool::_::_::_m_arrayPool::_0_::_elem::port_ens_r_obj_sensor_base::_::_m_movObjectInformation::_7_::STA_OBJECT_INFORMATION_ST::_::_m_dyN = @Classe_Obj_Sim::obj_data.obj_dy[7] * 128;
    @sysvar::XCP::RadarFR::_g_PlReCoFw_PlReCoPer_ObjBypassingRunnable_ObjBypassingRunnable_m_pad_radarObjPort_par_out_local::TChangeableMemPool::_::_::_m_arrayPool::_0_::_elem::port_ens_r_obj_sensor_base::_::_m_movObjectInformation::_7_::STA_OBJECT_INFORMATION_ST::_::_m_dzN = 0;
    @sysvar::XCP::RadarFR::_g_PlReCoFw_PlReCoPer_ObjBypassingRunnable_ObjBypassingRunnable_m_pad_radarObjPort_par_out_local::TChangeableMemPool::_::_::_m_arrayPool::_0_::_elem::port_ens_r_obj_sensor_base::_::_m_movObjectInformation::_7_::_m_vxN = @Classe_Obj_Sim::obj_data.obj_relative_vx[7] * 256;
    @sysvar::XCP::RadarFR::_g_PlReCoFw_PlReCoPer_ObjBypassingRunnable_ObjBypassingRunnable_m_pad_radarObjPort_par_out_local::TChangeableMemPool::_::_::_m_arrayPool::_0_::_elem::port_ens_r_obj_sensor_base::_::_m_movObjectInformation::_7_::_m_vyN = @Classe_Obj_Sim::obj_data.obj_relative_vy[7] * 256;
    @sysvar::XCP::RadarFR::_g_PlReCoFw_PlReCoPer_ObjBypassingRunnable_ObjBypassingRunnable_m_pad_radarObjPort_par_out_local::TChangeableMemPool::_::_::_m_arrayPool::_0_::_elem::port_ens_r_obj_sensor_base::_::_m_movObjectInformation::_7_::_m_axN = 0;
    @sysvar::XCP::RadarFR::_g_PlReCoFw_PlReCoPer_ObjBypassingRunnable_ObjBypassingRunnable_m_pad_radarObjPort_par_out_local::TChangeableMemPool::_::_::_m_arrayPool::_0_::_elem::port_ens_r_obj_sensor_base::_::_m_movObjectInformation::_7_::_m_ayN = 0;

    //target object moving or not
    if (abs(@Classe_Obj_Sim::obj_data.obj_relative_vx[7]) != 0)
    {
      @sysvar::XCP::RadarFR::_g_PlReCoFw_PlReCoPer_ObjBypassingRunnable_ObjBypassingRunnable_m_pad_radarObjPort_par_out_local::TChangeableMemPool::_::_::_m_arrayPool::_0_::_elem::port_ens_r_obj_sensor_base::_::_m_movObjectInformation::_7_::STA_OBJECT_INFORMATION_ST::_::_m_prob1HasBeenObservedMovingN = 126;
      @sysvar::XCP::RadarFR::_g_PlReCoFw_PlReCoPer_ObjBypassingRunnable_ObjBypassingRunnable_m_pad_radarObjPort_par_out_local::TChangeableMemPool::_::_::_m_arrayPool::_0_::_elem::port_ens_r_obj_sensor_base::_::_m_movObjectInformation::_7_::STA_OBJECT_INFORMATION_ST::_::_m_prob1MovingN = 126;
      @sysvar::XCP::RadarFR::_g_PlReCoFw_PlReCoPer_ObjBypassingRunnable_ObjBypassingRunnable_m_pad_radarObjPort_par_out_local::TChangeableMemPool::_::_::_m_arrayPool::_0_::_elem::port_ens_r_obj_sensor_base::_::_m_movObjectInformation::_7_::STA_OBJECT_INFORMATION_ST::_::_m_ohyObjectType_st::_m_probObstacle_st::_m_prob1MobileN = 128;
      @sysvar::XCP::RadarFR::_g_PlReCoFw_PlReCoPer_ObjBypassingRunnable_ObjBypassingRunnable_m_pad_radarObjPort_par_out_local::TChangeableMemPool::_::_::_m_arrayPool::_0_::_elem::port_ens_r_obj_sensor_base::_::_m_movObjectInformation::_7_::STA_OBJECT_INFORMATION_ST::_::_m_ohyObjectType_st::_m_probObstacle_st::_m_prob1StationaryN = 0;
    }
    else
    {
      @sysvar::XCP::RadarFR::_g_PlReCoFw_PlReCoPer_ObjBypassingRunnable_ObjBypassingRunnable_m_pad_radarObjPort_par_out_local::TChangeableMemPool::_::_::_m_arrayPool::_0_::_elem::port_ens_r_obj_sensor_base::_::_m_movObjectInformation::_7_::STA_OBJECT_INFORMATION_ST::_::_m_prob1HasBeenObservedMovingN = 0;
      @sysvar::XCP::RadarFR::_g_PlReCoFw_PlReCoPer_ObjBypassingRunnable_ObjBypassingRunnable_m_pad_radarObjPort_par_out_local::TChangeableMemPool::_::_::_m_arrayPool::_0_::_elem::port_ens_r_obj_sensor_base::_::_m_movObjectInformation::_7_::STA_OBJECT_INFORMATION_ST::_::_m_prob1MovingN = 0;
      @sysvar::XCP::RadarFR::_g_PlReCoFw_PlReCoPer_ObjBypassingRunnable_ObjBypassingRunnable_m_pad_radarObjPort_par_out_local::TChangeableMemPool::_::_::_m_arrayPool::_0_::_elem::port_ens_r_obj_sensor_base::_::_m_movObjectInformation::_7_::STA_OBJECT_INFORMATION_ST::_::_m_ohyObjectType_st::_m_probObstacle_st::_m_prob1MobileN = 0;
      @sysvar::XCP::RadarFR::_g_PlReCoFw_PlReCoPer_ObjBypassingRunnable_ObjBypassingRunnable_m_pad_radarObjPort_par_out_local::TChangeableMemPool::_::_::_m_arrayPool::_0_::_elem::port_ens_r_obj_sensor_base::_::_m_movObjectInformation::_7_::STA_OBJECT_INFORMATION_ST::_::_m_ohyObjectType_st::_m_probObstacle_st::_m_prob1StationaryN = 128;
    }

      //object classification
    switch (@Classe_Obj_Sim::obj_data.obj_type[7])
    {
      case 0: //"Non-Obstacle"
        @sysvar::XCP::RadarFR::_g_PlReCoFw_PlReCoPer_ObjBypassingRunnable_ObjBypassingRunnable_m_pad_radarObjPort_par_out_local::TChangeableMemPool::_::_::_m_arrayPool::_0_::_elem::port_ens_r_obj_sensor_base::_::_m_movObjectInformation::_7_::STA_OBJECT_INFORMATION_ST::_::_m_ohyObjectType_st::_m_prob1NonObstacleN = 128;
        @sysvar::XCP::RadarFR::_g_PlReCoFw_PlReCoPer_ObjBypassingRunnable_ObjBypassingRunnable_m_pad_radarObjPort_par_out_local::TChangeableMemPool::_::_::_m_arrayPool::_0_::_elem::port_ens_r_obj_sensor_base::_::_m_movObjectInformation::_7_::STA_OBJECT_INFORMATION_ST::_::_m_ohyObjectType_st::_m_prob1ObstacleN = 0;
        @sysvar::XCP::RadarFR::_g_PlReCoFw_PlReCoPer_ObjBypassingRunnable_ObjBypassingRunnable_m_pad_radarObjPort_par_out_local::TChangeableMemPool::_::_::_m_arrayPool::_0_::_elem::port_ens_r_obj_sensor_base::_::_m_movObjectInformation::_7_::STA_OBJECT_INFORMATION_ST::_::_m_ohyObjectType_st::_m_prob1UnknownN = 0;
        @sysvar::XCP::RadarFR::_g_PlReCoFw_PlReCoPer_ObjBypassingRunnable_ObjBypassingRunnable_m_pad_radarObjPort_par_out_local::TChangeableMemPool::_::_::_m_arrayPool::_0_::_elem::port_ens_r_obj_sensor_base::_::_m_movObjectInformation::_7_::STA_OBJECT_INFORMATION_ST::_::_m_ohyObjectType_st::_m_probObstacle_st::_m_prob1UnknownN = 128;
        @sysvar::XCP::RadarFR::_g_PlReCoFw_PlReCoPer_ObjBypassingRunnable_ObjBypassingRunnable_m_pad_radarObjPort_par_out_local::TChangeableMemPool::_::_::_m_arrayPool::_0_::_elem::port_ens_r_obj_sensor_base::_::_m_movObjectInformation::_7_::STA_OBJECT_INFORMATION_ST::_::_m_ohyObjectType_st::_m_probObstacle_st::_m_probMobile_st::_m_prob1FourPlusWheelerN = 0;
        @sysvar::XCP::RadarFR::_g_PlReCoFw_PlReCoPer_ObjBypassingRunnable_ObjBypassingRunnable_m_pad_radarObjPort_par_out_local::TChangeableMemPool::_::_::_m_arrayPool::_0_::_elem::port_ens_r_obj_sensor_base::_::_m_movObjectInformation::_7_::STA_OBJECT_INFORMATION_ST::_::_m_ohyObjectType_st::_m_probObstacle_st::_m_probMobile_st::_m_prob1PedestrianN = 0;
        @sysvar::XCP::RadarFR::_g_PlReCoFw_PlReCoPer_ObjBypassingRunnable_ObjBypassingRunnable_m_pad_radarObjPort_par_out_local::TChangeableMemPool::_::_::_m_arrayPool::_0_::_elem::port_ens_r_obj_sensor_base::_::_m_movObjectInformation::_7_::STA_OBJECT_INFORMATION_ST::_::_m_ohyObjectType_st::_m_probObstacle_st::_m_probMobile_st::_m_prob1TwoWheelerN = 0;
        @sysvar::XCP::RadarFR::_g_PlReCoFw_PlReCoPer_ObjBypassingRunnable_ObjBypassingRunnable_m_pad_radarObjPort_par_out_local::TChangeableMemPool::_::_::_m_arrayPool::_0_::_elem::port_ens_r_obj_sensor_base::_::_m_movObjectInformation::_7_::STA_OBJECT_INFORMATION_ST::_::_m_ohyObjectType_st::_m_probObstacle_st::_m_probMobile_st::_m_prob1UnknownN = 128;
        @sysvar::XCP::RadarFR::_g_PlReCoFw_PlReCoPer_ObjBypassingRunnable_ObjBypassingRunnable_m_pad_radarObjPort_par_out_local::TChangeableMemPool::_::_::_m_arrayPool::_0_::_elem::port_ens_r_obj_sensor_base::_::_m_movObjectInformation::_7_::STA_OBJECT_INFORMATION_ST::_::_m_ohyObjectType_st::_m_probObstacle_st::_m_probMobile_st::_m_probFourPlusWheeler_st::_m_prob1PassengerCarN = 0;
        @sysvar::XCP::RadarFR::_g_PlReCoFw_PlReCoPer_ObjBypassingRunnable_ObjBypassingRunnable_m_pad_radarObjPort_par_out_local::TChangeableMemPool::_::_::_m_arrayPool::_0_::_elem::port_ens_r_obj_sensor_base::_::_m_movObjectInformation::_7_::STA_OBJECT_INFORMATION_ST::_::_m_ohyObjectType_st::_m_probObstacle_st::_m_probMobile_st::_m_probFourPlusWheeler_st::_m_prob1TruckN = 0;
        @sysvar::XCP::RadarFR::_g_PlReCoFw_PlReCoPer_ObjBypassingRunnable_ObjBypassingRunnable_m_pad_radarObjPort_par_out_local::TChangeableMemPool::_::_::_m_arrayPool::_0_::_elem::port_ens_r_obj_sensor_base::_::_m_movObjectInformation::_7_::STA_OBJECT_INFORMATION_ST::_::_m_ohyObjectType_st::_m_probObstacle_st::_m_probMobile_st::_m_probFourPlusWheeler_st::_m_prob1UnknownN = 128;
        @sysvar::XCP::RadarFR::_g_PlReCoFw_PlReCoPer_ObjBypassingRunnable_ObjBypassingRunnable_m_pad_radarObjPort_par_out_local::TChangeableMemPool::_::_::_m_arrayPool::_0_::_elem::port_ens_r_obj_sensor_base::_::_m_movObjectInformation::_7_::STA_OBJECT_INFORMATION_ST::_::_m_ohyObjectType_st::_m_probObstacle_st::_m_probStationary_st::_m_prob1RoadsideBarrierN = 0;
        @sysvar::XCP::RadarFR::_g_PlReCoFw_PlReCoPer_ObjBypassingRunnable_ObjBypassingRunnable_m_pad_radarObjPort_par_out_local::TChangeableMemPool::_::_::_m_arrayPool::_0_::_elem::port_ens_r_obj_sensor_base::_::_m_movObjectInformation::_7_::STA_OBJECT_INFORMATION_ST::_::_m_ohyObjectType_st::_m_probObstacle_st::_m_probStationary_st::_m_prob1UnknownN = 128;
        @sysvar::XCP::RadarFR::_g_PlReCoFw_PlReCoPer_ObjBypassingRunnable_ObjBypassingRunnable_m_pad_radarObjPort_par_out_local::TChangeableMemPool::_::_::_m_arrayPool::_0_::_elem::port_ens_r_obj_sensor_base::_::_m_movObjectInformation::_7_::_m_dLengthN = 64;
        @sysvar::XCP::RadarFR::_g_PlReCoFw_PlReCoPer_ObjBypassingRunnable_ObjBypassingRunnable_m_pad_radarObjPort_par_out_local::TChangeableMemPool::_::_::_m_arrayPool::_0_::_elem::port_ens_r_obj_sensor_base::_::_m_movObjectInformation::_7_::_m_dWidthN = @Classe_Obj_Sim::obj_data.obj_width[7] * 128;
        break;

      case 1: //"unknown"
        @sysvar::XCP::RadarFR::_g_PlReCoFw_PlReCoPer_ObjBypassingRunnable_ObjBypassingRunnable_m_pad_radarObjPort_par_out_local::TChangeableMemPool::_::_::_m_arrayPool::_0_::_elem::port_ens_r_obj_sensor_base::_::_m_movObjectInformation::_7_::STA_OBJECT_INFORMATION_ST::_::_m_ohyObjectType_st::_m_prob1NonObstacleN = 0;
        @sysvar::XCP::RadarFR::_g_PlReCoFw_PlReCoPer_ObjBypassingRunnable_ObjBypassingRunnable_m_pad_radarObjPort_par_out_local::TChangeableMemPool::_::_::_m_arrayPool::_0_::_elem::port_ens_r_obj_sensor_base::_::_m_movObjectInformation::_7_::STA_OBJECT_INFORMATION_ST::_::_m_ohyObjectType_st::_m_prob1ObstacleN = 0;
        @sysvar::XCP::RadarFR::_g_PlReCoFw_PlReCoPer_ObjBypassingRunnable_ObjBypassingRunnable_m_pad_radarObjPort_par_out_local::TChangeableMemPool::_::_::_m_arrayPool::_0_::_elem::port_ens_r_obj_sensor_base::_::_m_movObjectInformation::_7_::STA_OBJECT_INFORMATION_ST::_::_m_ohyObjectType_st::_m_prob1UnknownN = 128;
        @sysvar::XCP::RadarFR::_g_PlReCoFw_PlReCoPer_ObjBypassingRunnable_ObjBypassingRunnable_m_pad_radarObjPort_par_out_local::TChangeableMemPool::_::_::_m_arrayPool::_0_::_elem::port_ens_r_obj_sensor_base::_::_m_movObjectInformation::_7_::STA_OBJECT_INFORMATION_ST::_::_m_ohyObjectType_st::_m_probObstacle_st::_m_prob1UnknownN = 128;
        @sysvar::XCP::RadarFR::_g_PlReCoFw_PlReCoPer_ObjBypassingRunnable_ObjBypassingRunnable_m_pad_radarObjPort_par_out_local::TChangeableMemPool::_::_::_m_arrayPool::_0_::_elem::port_ens_r_obj_sensor_base::_::_m_movObjectInformation::_7_::STA_OBJECT_INFORMATION_ST::_::_m_ohyObjectType_st::_m_probObstacle_st::_m_probMobile_st::_m_prob1FourPlusWheelerN = 0;
        @sysvar::XCP::RadarFR::_g_PlReCoFw_PlReCoPer_ObjBypassingRunnable_ObjBypassingRunnable_m_pad_radarObjPort_par_out_local::TChangeableMemPool::_::_::_m_arrayPool::_0_::_elem::port_ens_r_obj_sensor_base::_::_m_movObjectInformation::_7_::STA_OBJECT_INFORMATION_ST::_::_m_ohyObjectType_st::_m_probObstacle_st::_m_probMobile_st::_m_prob1PedestrianN = 0;
        @sysvar::XCP::RadarFR::_g_PlReCoFw_PlReCoPer_ObjBypassingRunnable_ObjBypassingRunnable_m_pad_radarObjPort_par_out_local::TChangeableMemPool::_::_::_m_arrayPool::_0_::_elem::port_ens_r_obj_sensor_base::_::_m_movObjectInformation::_7_::STA_OBJECT_INFORMATION_ST::_::_m_ohyObjectType_st::_m_probObstacle_st::_m_probMobile_st::_m_prob1TwoWheelerN = 0;
        @sysvar::XCP::RadarFR::_g_PlReCoFw_PlReCoPer_ObjBypassingRunnable_ObjBypassingRunnable_m_pad_radarObjPort_par_out_local::TChangeableMemPool::_::_::_m_arrayPool::_0_::_elem::port_ens_r_obj_sensor_base::_::_m_movObjectInformation::_7_::STA_OBJECT_INFORMATION_ST::_::_m_ohyObjectType_st::_m_probObstacle_st::_m_probMobile_st::_m_prob1UnknownN = 128;
        @sysvar::XCP::RadarFR::_g_PlReCoFw_PlReCoPer_ObjBypassingRunnable_ObjBypassingRunnable_m_pad_radarObjPort_par_out_local::TChangeableMemPool::_::_::_m_arrayPool::_0_::_elem::port_ens_r_obj_sensor_base::_::_m_movObjectInformation::_7_::STA_OBJECT_INFORMATION_ST::_::_m_ohyObjectType_st::_m_probObstacle_st::_m_probMobile_st::_m_probFourPlusWheeler_st::_m_prob1PassengerCarN = 0;
        @sysvar::XCP::RadarFR::_g_PlReCoFw_PlReCoPer_ObjBypassingRunnable_ObjBypassingRunnable_m_pad_radarObjPort_par_out_local::TChangeableMemPool::_::_::_m_arrayPool::_0_::_elem::port_ens_r_obj_sensor_base::_::_m_movObjectInformation::_7_::STA_OBJECT_INFORMATION_ST::_::_m_ohyObjectType_st::_m_probObstacle_st::_m_probMobile_st::_m_probFourPlusWheeler_st::_m_prob1TruckN = 0;
        @sysvar::XCP::RadarFR::_g_PlReCoFw_PlReCoPer_ObjBypassingRunnable_ObjBypassingRunnable_m_pad_radarObjPort_par_out_local::TChangeableMemPool::_::_::_m_arrayPool::_0_::_elem::port_ens_r_obj_sensor_base::_::_m_movObjectInformation::_7_::STA_OBJECT_INFORMATION_ST::_::_m_ohyObjectType_st::_m_probObstacle_st::_m_probMobile_st::_m_probFourPlusWheeler_st::_m_prob1UnknownN = 128;
        @sysvar::XCP::RadarFR::_g_PlReCoFw_PlReCoPer_ObjBypassingRunnable_ObjBypassingRunnable_m_pad_radarObjPort_par_out_local::TChangeableMemPool::_::_::_m_arrayPool::_0_::_elem::port_ens_r_obj_sensor_base::_::_m_movObjectInformation::_7_::STA_OBJECT_INFORMATION_ST::_::_m_ohyObjectType_st::_m_probObstacle_st::_m_probStationary_st::_m_prob1RoadsideBarrierN = 0;
        @sysvar::XCP::RadarFR::_g_PlReCoFw_PlReCoPer_ObjBypassingRunnable_ObjBypassingRunnable_m_pad_radarObjPort_par_out_local::TChangeableMemPool::_::_::_m_arrayPool::_0_::_elem::port_ens_r_obj_sensor_base::_::_m_movObjectInformation::_7_::STA_OBJECT_INFORMATION_ST::_::_m_ohyObjectType_st::_m_probObstacle_st::_m_probStationary_st::_m_prob1UnknownN = 128;
        @sysvar::XCP::RadarFR::_g_PlReCoFw_PlReCoPer_ObjBypassingRunnable_ObjBypassingRunnable_m_pad_radarObjPort_par_out_local::TChangeableMemPool::_::_::_m_arrayPool::_0_::_elem::port_ens_r_obj_sensor_base::_::_m_movObjectInformation::_7_::_m_dLengthN = 0;
        @sysvar::XCP::RadarFR::_g_PlReCoFw_PlReCoPer_ObjBypassingRunnable_ObjBypassingRunnable_m_pad_radarObjPort_par_out_local::TChangeableMemPool::_::_::_m_arrayPool::_0_::_elem::port_ens_r_obj_sensor_base::_::_m_movObjectInformation::_7_::_m_dWidthN = @Classe_Obj_Sim::obj_data.obj_width[7] * 128;
        break;

      case 2: //"RoadSideBarrier"
        @sysvar::XCP::RadarFR::_g_PlReCoFw_PlReCoPer_ObjBypassingRunnable_ObjBypassingRunnable_m_pad_radarObjPort_par_out_local::TChangeableMemPool::_::_::_m_arrayPool::_0_::_elem::port_ens_r_obj_sensor_base::_::_m_movObjectInformation::_7_::STA_OBJECT_INFORMATION_ST::_::_m_ohyObjectType_st::_m_prob1NonObstacleN = 0;
        @sysvar::XCP::RadarFR::_g_PlReCoFw_PlReCoPer_ObjBypassingRunnable_ObjBypassingRunnable_m_pad_radarObjPort_par_out_local::TChangeableMemPool::_::_::_m_arrayPool::_0_::_elem::port_ens_r_obj_sensor_base::_::_m_movObjectInformation::_7_::STA_OBJECT_INFORMATION_ST::_::_m_ohyObjectType_st::_m_prob1ObstacleN = 128;
        @sysvar::XCP::RadarFR::_g_PlReCoFw_PlReCoPer_ObjBypassingRunnable_ObjBypassingRunnable_m_pad_radarObjPort_par_out_local::TChangeableMemPool::_::_::_m_arrayPool::_0_::_elem::port_ens_r_obj_sensor_base::_::_m_movObjectInformation::_7_::STA_OBJECT_INFORMATION_ST::_::_m_ohyObjectType_st::_m_prob1UnknownN = 0;
        @sysvar::XCP::RadarFR::_g_PlReCoFw_PlReCoPer_ObjBypassingRunnable_ObjBypassingRunnable_m_pad_radarObjPort_par_out_local::TChangeableMemPool::_::_::_m_arrayPool::_0_::_elem::port_ens_r_obj_sensor_base::_::_m_movObjectInformation::_7_::STA_OBJECT_INFORMATION_ST::_::_m_ohyObjectType_st::_m_probObstacle_st::_m_prob1MobileN = 0;
        @sysvar::XCP::RadarFR::_g_PlReCoFw_PlReCoPer_ObjBypassingRunnable_ObjBypassingRunnable_m_pad_radarObjPort_par_out_local::TChangeableMemPool::_::_::_m_arrayPool::_0_::_elem::port_ens_r_obj_sensor_base::_::_m_movObjectInformation::_7_::STA_OBJECT_INFORMATION_ST::_::_m_ohyObjectType_st::_m_probObstacle_st::_m_prob1StationaryN = 128;
        @sysvar::XCP::RadarFR::_g_PlReCoFw_PlReCoPer_ObjBypassingRunnable_ObjBypassingRunnable_m_pad_radarObjPort_par_out_local::TChangeableMemPool::_::_::_m_arrayPool::_0_::_elem::port_ens_r_obj_sensor_base::_::_m_movObjectInformation::_7_::STA_OBJECT_INFORMATION_ST::_::_m_ohyObjectType_st::_m_probObstacle_st::_m_prob1UnknownN = 0;
        @sysvar::XCP::RadarFR::_g_PlReCoFw_PlReCoPer_ObjBypassingRunnable_ObjBypassingRunnable_m_pad_radarObjPort_par_out_local::TChangeableMemPool::_::_::_m_arrayPool::_0_::_elem::port_ens_r_obj_sensor_base::_::_m_movObjectInformation::_7_::STA_OBJECT_INFORMATION_ST::_::_m_ohyObjectType_st::_m_probObstacle_st::_m_probMobile_st::_m_prob1FourPlusWheelerN = 0;
        @sysvar::XCP::RadarFR::_g_PlReCoFw_PlReCoPer_ObjBypassingRunnable_ObjBypassingRunnable_m_pad_radarObjPort_par_out_local::TChangeableMemPool::_::_::_m_arrayPool::_0_::_elem::port_ens_r_obj_sensor_base::_::_m_movObjectInformation::_7_::STA_OBJECT_INFORMATION_ST::_::_m_ohyObjectType_st::_m_probObstacle_st::_m_probMobile_st::_m_prob1PedestrianN = 0;
        @sysvar::XCP::RadarFR::_g_PlReCoFw_PlReCoPer_ObjBypassingRunnable_ObjBypassingRunnable_m_pad_radarObjPort_par_out_local::TChangeableMemPool::_::_::_m_arrayPool::_0_::_elem::port_ens_r_obj_sensor_base::_::_m_movObjectInformation::_7_::STA_OBJECT_INFORMATION_ST::_::_m_ohyObjectType_st::_m_probObstacle_st::_m_probMobile_st::_m_prob1TwoWheelerN = 0;
        @sysvar::XCP::RadarFR::_g_PlReCoFw_PlReCoPer_ObjBypassingRunnable_ObjBypassingRunnable_m_pad_radarObjPort_par_out_local::TChangeableMemPool::_::_::_m_arrayPool::_0_::_elem::port_ens_r_obj_sensor_base::_::_m_movObjectInformation::_7_::STA_OBJECT_INFORMATION_ST::_::_m_ohyObjectType_st::_m_probObstacle_st::_m_probMobile_st::_m_prob1UnknownN = 0;
        @sysvar::XCP::RadarFR::_g_PlReCoFw_PlReCoPer_ObjBypassingRunnable_ObjBypassingRunnable_m_pad_radarObjPort_par_out_local::TChangeableMemPool::_::_::_m_arrayPool::_0_::_elem::port_ens_r_obj_sensor_base::_::_m_movObjectInformation::_7_::STA_OBJECT_INFORMATION_ST::_::_m_ohyObjectType_st::_m_probObstacle_st::_m_probMobile_st::_m_probFourPlusWheeler_st::_m_prob1PassengerCarN = 0;
        @sysvar::XCP::RadarFR::_g_PlReCoFw_PlReCoPer_ObjBypassingRunnable_ObjBypassingRunnable_m_pad_radarObjPort_par_out_local::TChangeableMemPool::_::_::_m_arrayPool::_0_::_elem::port_ens_r_obj_sensor_base::_::_m_movObjectInformation::_7_::STA_OBJECT_INFORMATION_ST::_::_m_ohyObjectType_st::_m_probObstacle_st::_m_probMobile_st::_m_probFourPlusWheeler_st::_m_prob1TruckN = 0;
        @sysvar::XCP::RadarFR::_g_PlReCoFw_PlReCoPer_ObjBypassingRunnable_ObjBypassingRunnable_m_pad_radarObjPort_par_out_local::TChangeableMemPool::_::_::_m_arrayPool::_0_::_elem::port_ens_r_obj_sensor_base::_::_m_movObjectInformation::_7_::STA_OBJECT_INFORMATION_ST::_::_m_ohyObjectType_st::_m_probObstacle_st::_m_probMobile_st::_m_probFourPlusWheeler_st::_m_prob1UnknownN = 0;
        @sysvar::XCP::RadarFR::_g_PlReCoFw_PlReCoPer_ObjBypassingRunnable_ObjBypassingRunnable_m_pad_radarObjPort_par_out_local::TChangeableMemPool::_::_::_m_arrayPool::_0_::_elem::port_ens_r_obj_sensor_base::_::_m_movObjectInformation::_7_::STA_OBJECT_INFORMATION_ST::_::_m_ohyObjectType_st::_m_probObstacle_st::_m_probStationary_st::_m_prob1RoadsideBarrierN = 128;
        @sysvar::XCP::RadarFR::_g_PlReCoFw_PlReCoPer_ObjBypassingRunnable_ObjBypassingRunnable_m_pad_radarObjPort_par_out_local::TChangeableMemPool::_::_::_m_arrayPool::_0_::_elem::port_ens_r_obj_sensor_base::_::_m_movObjectInformation::_7_::STA_OBJECT_INFORMATION_ST::_::_m_ohyObjectType_st::_m_probObstacle_st::_m_probStationary_st::_m_prob1UnknownN = 0;
        @sysvar::XCP::RadarFR::_g_PlReCoFw_PlReCoPer_ObjBypassingRunnable_ObjBypassingRunnable_m_pad_radarObjPort_par_out_local::TChangeableMemPool::_::_::_m_arrayPool::_0_::_elem::port_ens_r_obj_sensor_base::_::_m_movObjectInformation::_7_::_m_dLengthN = 64;
        @sysvar::XCP::RadarFR::_g_PlReCoFw_PlReCoPer_ObjBypassingRunnable_ObjBypassingRunnable_m_pad_radarObjPort_par_out_local::TChangeableMemPool::_::_::_m_arrayPool::_0_::_elem::port_ens_r_obj_sensor_base::_::_m_movObjectInformation::_7_::_m_dWidthN = @Classe_Obj_Sim::obj_data.obj_width[7] * 128;
        break;

      case 3: //"2Wheeler"
        @sysvar::XCP::RadarFR::_g_PlReCoFw_PlReCoPer_ObjBypassingRunnable_ObjBypassingRunnable_m_pad_radarObjPort_par_out_local::TChangeableMemPool::_::_::_m_arrayPool::_0_::_elem::port_ens_r_obj_sensor_base::_::_m_movObjectInformation::_7_::STA_OBJECT_INFORMATION_ST::_::_m_ohyObjectType_st::_m_prob1NonObstacleN = 0;
        @sysvar::XCP::RadarFR::_g_PlReCoFw_PlReCoPer_ObjBypassingRunnable_ObjBypassingRunnable_m_pad_radarObjPort_par_out_local::TChangeableMemPool::_::_::_m_arrayPool::_0_::_elem::port_ens_r_obj_sensor_base::_::_m_movObjectInformation::_7_::STA_OBJECT_INFORMATION_ST::_::_m_ohyObjectType_st::_m_prob1ObstacleN = 128;
        @sysvar::XCP::RadarFR::_g_PlReCoFw_PlReCoPer_ObjBypassingRunnable_ObjBypassingRunnable_m_pad_radarObjPort_par_out_local::TChangeableMemPool::_::_::_m_arrayPool::_0_::_elem::port_ens_r_obj_sensor_base::_::_m_movObjectInformation::_7_::STA_OBJECT_INFORMATION_ST::_::_m_ohyObjectType_st::_m_prob1UnknownN = 0;
        @sysvar::XCP::RadarFR::_g_PlReCoFw_PlReCoPer_ObjBypassingRunnable_ObjBypassingRunnable_m_pad_radarObjPort_par_out_local::TChangeableMemPool::_::_::_m_arrayPool::_0_::_elem::port_ens_r_obj_sensor_base::_::_m_movObjectInformation::_7_::STA_OBJECT_INFORMATION_ST::_::_m_ohyObjectType_st::_m_probObstacle_st::_m_prob1UnknownN = 0;
        @sysvar::XCP::RadarFR::_g_PlReCoFw_PlReCoPer_ObjBypassingRunnable_ObjBypassingRunnable_m_pad_radarObjPort_par_out_local::TChangeableMemPool::_::_::_m_arrayPool::_0_::_elem::port_ens_r_obj_sensor_base::_::_m_movObjectInformation::_7_::STA_OBJECT_INFORMATION_ST::_::_m_ohyObjectType_st::_m_probObstacle_st::_m_probMobile_st::_m_prob1FourPlusWheelerN = 0;
        @sysvar::XCP::RadarFR::_g_PlReCoFw_PlReCoPer_ObjBypassingRunnable_ObjBypassingRunnable_m_pad_radarObjPort_par_out_local::TChangeableMemPool::_::_::_m_arrayPool::_0_::_elem::port_ens_r_obj_sensor_base::_::_m_movObjectInformation::_7_::STA_OBJECT_INFORMATION_ST::_::_m_ohyObjectType_st::_m_probObstacle_st::_m_probMobile_st::_m_prob1PedestrianN = 0;
        @sysvar::XCP::RadarFR::_g_PlReCoFw_PlReCoPer_ObjBypassingRunnable_ObjBypassingRunnable_m_pad_radarObjPort_par_out_local::TChangeableMemPool::_::_::_m_arrayPool::_0_::_elem::port_ens_r_obj_sensor_base::_::_m_movObjectInformation::_7_::STA_OBJECT_INFORMATION_ST::_::_m_ohyObjectType_st::_m_probObstacle_st::_m_probMobile_st::_m_prob1TwoWheelerN = 128;
        @sysvar::XCP::RadarFR::_g_PlReCoFw_PlReCoPer_ObjBypassingRunnable_ObjBypassingRunnable_m_pad_radarObjPort_par_out_local::TChangeableMemPool::_::_::_m_arrayPool::_0_::_elem::port_ens_r_obj_sensor_base::_::_m_movObjectInformation::_7_::STA_OBJECT_INFORMATION_ST::_::_m_ohyObjectType_st::_m_probObstacle_st::_m_probMobile_st::_m_prob1UnknownN = 0;
        @sysvar::XCP::RadarFR::_g_PlReCoFw_PlReCoPer_ObjBypassingRunnable_ObjBypassingRunnable_m_pad_radarObjPort_par_out_local::TChangeableMemPool::_::_::_m_arrayPool::_0_::_elem::port_ens_r_obj_sensor_base::_::_m_movObjectInformation::_7_::STA_OBJECT_INFORMATION_ST::_::_m_ohyObjectType_st::_m_probObstacle_st::_m_probMobile_st::_m_probFourPlusWheeler_st::_m_prob1PassengerCarN = 0;
        @sysvar::XCP::RadarFR::_g_PlReCoFw_PlReCoPer_ObjBypassingRunnable_ObjBypassingRunnable_m_pad_radarObjPort_par_out_local::TChangeableMemPool::_::_::_m_arrayPool::_0_::_elem::port_ens_r_obj_sensor_base::_::_m_movObjectInformation::_7_::STA_OBJECT_INFORMATION_ST::_::_m_ohyObjectType_st::_m_probObstacle_st::_m_probMobile_st::_m_probFourPlusWheeler_st::_m_prob1TruckN = 0;
        @sysvar::XCP::RadarFR::_g_PlReCoFw_PlReCoPer_ObjBypassingRunnable_ObjBypassingRunnable_m_pad_radarObjPort_par_out_local::TChangeableMemPool::_::_::_m_arrayPool::_0_::_elem::port_ens_r_obj_sensor_base::_::_m_movObjectInformation::_7_::STA_OBJECT_INFORMATION_ST::_::_m_ohyObjectType_st::_m_probObstacle_st::_m_probMobile_st::_m_probFourPlusWheeler_st::_m_prob1UnknownN = 128;
        @sysvar::XCP::RadarFR::_g_PlReCoFw_PlReCoPer_ObjBypassingRunnable_ObjBypassingRunnable_m_pad_radarObjPort_par_out_local::TChangeableMemPool::_::_::_m_arrayPool::_0_::_elem::port_ens_r_obj_sensor_base::_::_m_movObjectInformation::_7_::STA_OBJECT_INFORMATION_ST::_::_m_ohyObjectType_st::_m_probObstacle_st::_m_probStationary_st::_m_prob1RoadsideBarrierN = 0;
        @sysvar::XCP::RadarFR::_g_PlReCoFw_PlReCoPer_ObjBypassingRunnable_ObjBypassingRunnable_m_pad_radarObjPort_par_out_local::TChangeableMemPool::_::_::_m_arrayPool::_0_::_elem::port_ens_r_obj_sensor_base::_::_m_movObjectInformation::_7_::STA_OBJECT_INFORMATION_ST::_::_m_ohyObjectType_st::_m_probObstacle_st::_m_probStationary_st::_m_prob1UnknownN = 0;
        @sysvar::XCP::RadarFR::_g_PlReCoFw_PlReCoPer_ObjBypassingRunnable_ObjBypassingRunnable_m_pad_radarObjPort_par_out_local::TChangeableMemPool::_::_::_m_arrayPool::_0_::_elem::port_ens_r_obj_sensor_base::_::_m_movObjectInformation::_7_::_m_dLengthN = 64;
        @sysvar::XCP::RadarFR::_g_PlReCoFw_PlReCoPer_ObjBypassingRunnable_ObjBypassingRunnable_m_pad_radarObjPort_par_out_local::TChangeableMemPool::_::_::_m_arrayPool::_0_::_elem::port_ens_r_obj_sensor_base::_::_m_movObjectInformation::_7_::_m_dWidthN = @Classe_Obj_Sim::obj_data.obj_width[7] * 128;
        break;

      case 4: //"Pedestrian"
        @sysvar::XCP::RadarFR::_g_PlReCoFw_PlReCoPer_ObjBypassingRunnable_ObjBypassingRunnable_m_pad_radarObjPort_par_out_local::TChangeableMemPool::_::_::_m_arrayPool::_0_::_elem::port_ens_r_obj_sensor_base::_::_m_movObjectInformation::_7_::STA_OBJECT_INFORMATION_ST::_::_m_ohyObjectType_st::_m_prob1NonObstacleN = 0;
        @sysvar::XCP::RadarFR::_g_PlReCoFw_PlReCoPer_ObjBypassingRunnable_ObjBypassingRunnable_m_pad_radarObjPort_par_out_local::TChangeableMemPool::_::_::_m_arrayPool::_0_::_elem::port_ens_r_obj_sensor_base::_::_m_movObjectInformation::_7_::STA_OBJECT_INFORMATION_ST::_::_m_ohyObjectType_st::_m_prob1ObstacleN = 128;
        @sysvar::XCP::RadarFR::_g_PlReCoFw_PlReCoPer_ObjBypassingRunnable_ObjBypassingRunnable_m_pad_radarObjPort_par_out_local::TChangeableMemPool::_::_::_m_arrayPool::_0_::_elem::port_ens_r_obj_sensor_base::_::_m_movObjectInformation::_7_::STA_OBJECT_INFORMATION_ST::_::_m_ohyObjectType_st::_m_prob1UnknownN = 0;
        @sysvar::XCP::RadarFR::_g_PlReCoFw_PlReCoPer_ObjBypassingRunnable_ObjBypassingRunnable_m_pad_radarObjPort_par_out_local::TChangeableMemPool::_::_::_m_arrayPool::_0_::_elem::port_ens_r_obj_sensor_base::_::_m_movObjectInformation::_7_::STA_OBJECT_INFORMATION_ST::_::_m_ohyObjectType_st::_m_probObstacle_st::_m_prob1UnknownN = 0;
        @sysvar::XCP::RadarFR::_g_PlReCoFw_PlReCoPer_ObjBypassingRunnable_ObjBypassingRunnable_m_pad_radarObjPort_par_out_local::TChangeableMemPool::_::_::_m_arrayPool::_0_::_elem::port_ens_r_obj_sensor_base::_::_m_movObjectInformation::_7_::STA_OBJECT_INFORMATION_ST::_::_m_ohyObjectType_st::_m_probObstacle_st::_m_probMobile_st::_m_prob1FourPlusWheelerN = 0;
        @sysvar::XCP::RadarFR::_g_PlReCoFw_PlReCoPer_ObjBypassingRunnable_ObjBypassingRunnable_m_pad_radarObjPort_par_out_local::TChangeableMemPool::_::_::_m_arrayPool::_0_::_elem::port_ens_r_obj_sensor_base::_::_m_movObjectInformation::_7_::STA_OBJECT_INFORMATION_ST::_::_m_ohyObjectType_st::_m_probObstacle_st::_m_probMobile_st::_m_prob1PedestrianN = 128;
        @sysvar::XCP::RadarFR::_g_PlReCoFw_PlReCoPer_ObjBypassingRunnable_ObjBypassingRunnable_m_pad_radarObjPort_par_out_local::TChangeableMemPool::_::_::_m_arrayPool::_0_::_elem::port_ens_r_obj_sensor_base::_::_m_movObjectInformation::_7_::STA_OBJECT_INFORMATION_ST::_::_m_ohyObjectType_st::_m_probObstacle_st::_m_probMobile_st::_m_prob1TwoWheelerN = 0;
        @sysvar::XCP::RadarFR::_g_PlReCoFw_PlReCoPer_ObjBypassingRunnable_ObjBypassingRunnable_m_pad_radarObjPort_par_out_local::TChangeableMemPool::_::_::_m_arrayPool::_0_::_elem::port_ens_r_obj_sensor_base::_::_m_movObjectInformation::_7_::STA_OBJECT_INFORMATION_ST::_::_m_ohyObjectType_st::_m_probObstacle_st::_m_probMobile_st::_m_prob1UnknownN = 0;
        @sysvar::XCP::RadarFR::_g_PlReCoFw_PlReCoPer_ObjBypassingRunnable_ObjBypassingRunnable_m_pad_radarObjPort_par_out_local::TChangeableMemPool::_::_::_m_arrayPool::_0_::_elem::port_ens_r_obj_sensor_base::_::_m_movObjectInformation::_7_::STA_OBJECT_INFORMATION_ST::_::_m_ohyObjectType_st::_m_probObstacle_st::_m_probMobile_st::_m_probFourPlusWheeler_st::_m_prob1PassengerCarN = 0;
        @sysvar::XCP::RadarFR::_g_PlReCoFw_PlReCoPer_ObjBypassingRunnable_ObjBypassingRunnable_m_pad_radarObjPort_par_out_local::TChangeableMemPool::_::_::_m_arrayPool::_0_::_elem::port_ens_r_obj_sensor_base::_::_m_movObjectInformation::_7_::STA_OBJECT_INFORMATION_ST::_::_m_ohyObjectType_st::_m_probObstacle_st::_m_probMobile_st::_m_probFourPlusWheeler_st::_m_prob1TruckN = 0;
        @sysvar::XCP::RadarFR::_g_PlReCoFw_PlReCoPer_ObjBypassingRunnable_ObjBypassingRunnable_m_pad_radarObjPort_par_out_local::TChangeableMemPool::_::_::_m_arrayPool::_0_::_elem::port_ens_r_obj_sensor_base::_::_m_movObjectInformation::_7_::STA_OBJECT_INFORMATION_ST::_::_m_ohyObjectType_st::_m_probObstacle_st::_m_probMobile_st::_m_probFourPlusWheeler_st::_m_prob1UnknownN = 128;
        @sysvar::XCP::RadarFR::_g_PlReCoFw_PlReCoPer_ObjBypassingRunnable_ObjBypassingRunnable_m_pad_radarObjPort_par_out_local::TChangeableMemPool::_::_::_m_arrayPool::_0_::_elem::port_ens_r_obj_sensor_base::_::_m_movObjectInformation::_7_::STA_OBJECT_INFORMATION_ST::_::_m_ohyObjectType_st::_m_probObstacle_st::_m_probStationary_st::_m_prob1RoadsideBarrierN = 0;
        @sysvar::XCP::RadarFR::_g_PlReCoFw_PlReCoPer_ObjBypassingRunnable_ObjBypassingRunnable_m_pad_radarObjPort_par_out_local::TChangeableMemPool::_::_::_m_arrayPool::_0_::_elem::port_ens_r_obj_sensor_base::_::_m_movObjectInformation::_7_::STA_OBJECT_INFORMATION_ST::_::_m_ohyObjectType_st::_m_probObstacle_st::_m_probStationary_st::_m_prob1UnknownN = 0;
        @sysvar::XCP::RadarFR::_g_PlReCoFw_PlReCoPer_ObjBypassingRunnable_ObjBypassingRunnable_m_pad_radarObjPort_par_out_local::TChangeableMemPool::_::_::_m_arrayPool::_0_::_elem::port_ens_r_obj_sensor_base::_::_m_movObjectInformation::_7_::_m_dLengthN = 64;
        @sysvar::XCP::RadarFR::_g_PlReCoFw_PlReCoPer_ObjBypassingRunnable_ObjBypassingRunnable_m_pad_radarObjPort_par_out_local::TChangeableMemPool::_::_::_m_arrayPool::_0_::_elem::port_ens_r_obj_sensor_base::_::_m_movObjectInformation::_7_::_m_dWidthN = @Classe_Obj_Sim::obj_data.obj_width[7] * 128;
        break;

      case 5: //"Truck"
        @sysvar::XCP::RadarFR::_g_PlReCoFw_PlReCoPer_ObjBypassingRunnable_ObjBypassingRunnable_m_pad_radarObjPort_par_out_local::TChangeableMemPool::_::_::_m_arrayPool::_0_::_elem::port_ens_r_obj_sensor_base::_::_m_movObjectInformation::_7_::STA_OBJECT_INFORMATION_ST::_::_m_ohyObjectType_st::_m_prob1NonObstacleN = 0;
        @sysvar::XCP::RadarFR::_g_PlReCoFw_PlReCoPer_ObjBypassingRunnable_ObjBypassingRunnable_m_pad_radarObjPort_par_out_local::TChangeableMemPool::_::_::_m_arrayPool::_0_::_elem::port_ens_r_obj_sensor_base::_::_m_movObjectInformation::_7_::STA_OBJECT_INFORMATION_ST::_::_m_ohyObjectType_st::_m_prob1ObstacleN = 128;
        @sysvar::XCP::RadarFR::_g_PlReCoFw_PlReCoPer_ObjBypassingRunnable_ObjBypassingRunnable_m_pad_radarObjPort_par_out_local::TChangeableMemPool::_::_::_m_arrayPool::_0_::_elem::port_ens_r_obj_sensor_base::_::_m_movObjectInformation::_7_::STA_OBJECT_INFORMATION_ST::_::_m_ohyObjectType_st::_m_prob1UnknownN = 0;
        @sysvar::XCP::RadarFR::_g_PlReCoFw_PlReCoPer_ObjBypassingRunnable_ObjBypassingRunnable_m_pad_radarObjPort_par_out_local::TChangeableMemPool::_::_::_m_arrayPool::_0_::_elem::port_ens_r_obj_sensor_base::_::_m_movObjectInformation::_7_::STA_OBJECT_INFORMATION_ST::_::_m_ohyObjectType_st::_m_probObstacle_st::_m_prob1UnknownN = 0;
        @sysvar::XCP::RadarFR::_g_PlReCoFw_PlReCoPer_ObjBypassingRunnable_ObjBypassingRunnable_m_pad_radarObjPort_par_out_local::TChangeableMemPool::_::_::_m_arrayPool::_0_::_elem::port_ens_r_obj_sensor_base::_::_m_movObjectInformation::_7_::STA_OBJECT_INFORMATION_ST::_::_m_ohyObjectType_st::_m_probObstacle_st::_m_probMobile_st::_m_prob1FourPlusWheelerN = 128;
        @sysvar::XCP::RadarFR::_g_PlReCoFw_PlReCoPer_ObjBypassingRunnable_ObjBypassingRunnable_m_pad_radarObjPort_par_out_local::TChangeableMemPool::_::_::_m_arrayPool::_0_::_elem::port_ens_r_obj_sensor_base::_::_m_movObjectInformation::_7_::STA_OBJECT_INFORMATION_ST::_::_m_ohyObjectType_st::_m_probObstacle_st::_m_probMobile_st::_m_prob1PedestrianN = 0;
        @sysvar::XCP::RadarFR::_g_PlReCoFw_PlReCoPer_ObjBypassingRunnable_ObjBypassingRunnable_m_pad_radarObjPort_par_out_local::TChangeableMemPool::_::_::_m_arrayPool::_0_::_elem::port_ens_r_obj_sensor_base::_::_m_movObjectInformation::_7_::STA_OBJECT_INFORMATION_ST::_::_m_ohyObjectType_st::_m_probObstacle_st::_m_probMobile_st::_m_prob1TwoWheelerN = 0;
        @sysvar::XCP::RadarFR::_g_PlReCoFw_PlReCoPer_ObjBypassingRunnable_ObjBypassingRunnable_m_pad_radarObjPort_par_out_local::TChangeableMemPool::_::_::_m_arrayPool::_0_::_elem::port_ens_r_obj_sensor_base::_::_m_movObjectInformation::_7_::STA_OBJECT_INFORMATION_ST::_::_m_ohyObjectType_st::_m_probObstacle_st::_m_probMobile_st::_m_prob1UnknownN = 0;
        @sysvar::XCP::RadarFR::_g_PlReCoFw_PlReCoPer_ObjBypassingRunnable_ObjBypassingRunnable_m_pad_radarObjPort_par_out_local::TChangeableMemPool::_::_::_m_arrayPool::_0_::_elem::port_ens_r_obj_sensor_base::_::_m_movObjectInformation::_7_::STA_OBJECT_INFORMATION_ST::_::_m_ohyObjectType_st::_m_probObstacle_st::_m_probMobile_st::_m_probFourPlusWheeler_st::_m_prob1PassengerCarN = 0;
        @sysvar::XCP::RadarFR::_g_PlReCoFw_PlReCoPer_ObjBypassingRunnable_ObjBypassingRunnable_m_pad_radarObjPort_par_out_local::TChangeableMemPool::_::_::_m_arrayPool::_0_::_elem::port_ens_r_obj_sensor_base::_::_m_movObjectInformation::_7_::STA_OBJECT_INFORMATION_ST::_::_m_ohyObjectType_st::_m_probObstacle_st::_m_probMobile_st::_m_probFourPlusWheeler_st::_m_prob1TruckN = 128;
        @sysvar::XCP::RadarFR::_g_PlReCoFw_PlReCoPer_ObjBypassingRunnable_ObjBypassingRunnable_m_pad_radarObjPort_par_out_local::TChangeableMemPool::_::_::_m_arrayPool::_0_::_elem::port_ens_r_obj_sensor_base::_::_m_movObjectInformation::_7_::STA_OBJECT_INFORMATION_ST::_::_m_ohyObjectType_st::_m_probObstacle_st::_m_probMobile_st::_m_probFourPlusWheeler_st::_m_prob1UnknownN = 0;
        @sysvar::XCP::RadarFR::_g_PlReCoFw_PlReCoPer_ObjBypassingRunnable_ObjBypassingRunnable_m_pad_radarObjPort_par_out_local::TChangeableMemPool::_::_::_m_arrayPool::_0_::_elem::port_ens_r_obj_sensor_base::_::_m_movObjectInformation::_7_::STA_OBJECT_INFORMATION_ST::_::_m_ohyObjectType_st::_m_probObstacle_st::_m_probStationary_st::_m_prob1RoadsideBarrierN = 0;
        @sysvar::XCP::RadarFR::_g_PlReCoFw_PlReCoPer_ObjBypassingRunnable_ObjBypassingRunnable_m_pad_radarObjPort_par_out_local::TChangeableMemPool::_::_::_m_arrayPool::_0_::_elem::port_ens_r_obj_sensor_base::_::_m_movObjectInformation::_7_::STA_OBJECT_INFORMATION_ST::_::_m_ohyObjectType_st::_m_probObstacle_st::_m_probStationary_st::_m_prob1UnknownN = 0;
        @sysvar::XCP::RadarFR::_g_PlReCoFw_PlReCoPer_ObjBypassingRunnable_ObjBypassingRunnable_m_pad_radarObjPort_par_out_local::TChangeableMemPool::_::_::_m_arrayPool::_0_::_elem::port_ens_r_obj_sensor_base::_::_m_movObjectInformation::_7_::_m_dLengthN = 64;
        @sysvar::XCP::RadarFR::_g_PlReCoFw_PlReCoPer_ObjBypassingRunnable_ObjBypassingRunnable_m_pad_radarObjPort_par_out_local::TChangeableMemPool::_::_::_m_arrayPool::_0_::_elem::port_ens_r_obj_sensor_base::_::_m_movObjectInformation::_7_::_m_dWidthN = @Classe_Obj_Sim::obj_data.obj_width[7] * 128;
        break;

      case 6: //"PassengerCar"
        @sysvar::XCP::RadarFR::_g_PlReCoFw_PlReCoPer_ObjBypassingRunnable_ObjBypassingRunnable_m_pad_radarObjPort_par_out_local::TChangeableMemPool::_::_::_m_arrayPool::_0_::_elem::port_ens_r_obj_sensor_base::_::_m_movObjectInformation::_7_::STA_OBJECT_INFORMATION_ST::_::_m_ohyObjectType_st::_m_prob1NonObstacleN = 0;
        @sysvar::XCP::RadarFR::_g_PlReCoFw_PlReCoPer_ObjBypassingRunnable_ObjBypassingRunnable_m_pad_radarObjPort_par_out_local::TChangeableMemPool::_::_::_m_arrayPool::_0_::_elem::port_ens_r_obj_sensor_base::_::_m_movObjectInformation::_7_::STA_OBJECT_INFORMATION_ST::_::_m_ohyObjectType_st::_m_prob1ObstacleN = 128;
        @sysvar::XCP::RadarFR::_g_PlReCoFw_PlReCoPer_ObjBypassingRunnable_ObjBypassingRunnable_m_pad_radarObjPort_par_out_local::TChangeableMemPool::_::_::_m_arrayPool::_0_::_elem::port_ens_r_obj_sensor_base::_::_m_movObjectInformation::_7_::STA_OBJECT_INFORMATION_ST::_::_m_ohyObjectType_st::_m_prob1UnknownN = 0;
        @sysvar::XCP::RadarFR::_g_PlReCoFw_PlReCoPer_ObjBypassingRunnable_ObjBypassingRunnable_m_pad_radarObjPort_par_out_local::TChangeableMemPool::_::_::_m_arrayPool::_0_::_elem::port_ens_r_obj_sensor_base::_::_m_movObjectInformation::_7_::STA_OBJECT_INFORMATION_ST::_::_m_ohyObjectType_st::_m_probObstacle_st::_m_prob1UnknownN = 0;
        @sysvar::XCP::RadarFR::_g_PlReCoFw_PlReCoPer_ObjBypassingRunnable_ObjBypassingRunnable_m_pad_radarObjPort_par_out_local::TChangeableMemPool::_::_::_m_arrayPool::_0_::_elem::port_ens_r_obj_sensor_base::_::_m_movObjectInformation::_7_::STA_OBJECT_INFORMATION_ST::_::_m_ohyObjectType_st::_m_probObstacle_st::_m_probMobile_st::_m_prob1FourPlusWheelerN = 128;
        @sysvar::XCP::RadarFR::_g_PlReCoFw_PlReCoPer_ObjBypassingRunnable_ObjBypassingRunnable_m_pad_radarObjPort_par_out_local::TChangeableMemPool::_::_::_m_arrayPool::_0_::_elem::port_ens_r_obj_sensor_base::_::_m_movObjectInformation::_7_::STA_OBJECT_INFORMATION_ST::_::_m_ohyObjectType_st::_m_probObstacle_st::_m_probMobile_st::_m_prob1PedestrianN = 0;
        @sysvar::XCP::RadarFR::_g_PlReCoFw_PlReCoPer_ObjBypassingRunnable_ObjBypassingRunnable_m_pad_radarObjPort_par_out_local::TChangeableMemPool::_::_::_m_arrayPool::_0_::_elem::port_ens_r_obj_sensor_base::_::_m_movObjectInformation::_7_::STA_OBJECT_INFORMATION_ST::_::_m_ohyObjectType_st::_m_probObstacle_st::_m_probMobile_st::_m_prob1TwoWheelerN = 0;
        @sysvar::XCP::RadarFR::_g_PlReCoFw_PlReCoPer_ObjBypassingRunnable_ObjBypassingRunnable_m_pad_radarObjPort_par_out_local::TChangeableMemPool::_::_::_m_arrayPool::_0_::_elem::port_ens_r_obj_sensor_base::_::_m_movObjectInformation::_7_::STA_OBJECT_INFORMATION_ST::_::_m_ohyObjectType_st::_m_probObstacle_st::_m_probMobile_st::_m_prob1UnknownN = 0;
        @sysvar::XCP::RadarFR::_g_PlReCoFw_PlReCoPer_ObjBypassingRunnable_ObjBypassingRunnable_m_pad_radarObjPort_par_out_local::TChangeableMemPool::_::_::_m_arrayPool::_0_::_elem::port_ens_r_obj_sensor_base::_::_m_movObjectInformation::_7_::STA_OBJECT_INFORMATION_ST::_::_m_ohyObjectType_st::_m_probObstacle_st::_m_probMobile_st::_m_probFourPlusWheeler_st::_m_prob1PassengerCarN = 128;
        @sysvar::XCP::RadarFR::_g_PlReCoFw_PlReCoPer_ObjBypassingRunnable_ObjBypassingRunnable_m_pad_radarObjPort_par_out_local::TChangeableMemPool::_::_::_m_arrayPool::_0_::_elem::port_ens_r_obj_sensor_base::_::_m_movObjectInformation::_7_::STA_OBJECT_INFORMATION_ST::_::_m_ohyObjectType_st::_m_probObstacle_st::_m_probMobile_st::_m_probFourPlusWheeler_st::_m_prob1TruckN = 0;
        @sysvar::XCP::RadarFR::_g_PlReCoFw_PlReCoPer_ObjBypassingRunnable_ObjBypassingRunnable_m_pad_radarObjPort_par_out_local::TChangeableMemPool::_::_::_m_arrayPool::_0_::_elem::port_ens_r_obj_sensor_base::_::_m_movObjectInformation::_7_::STA_OBJECT_INFORMATION_ST::_::_m_ohyObjectType_st::_m_probObstacle_st::_m_probMobile_st::_m_probFourPlusWheeler_st::_m_prob1UnknownN = 0;
        @sysvar::XCP::RadarFR::_g_PlReCoFw_PlReCoPer_ObjBypassingRunnable_ObjBypassingRunnable_m_pad_radarObjPort_par_out_local::TChangeableMemPool::_::_::_m_arrayPool::_0_::_elem::port_ens_r_obj_sensor_base::_::_m_movObjectInformation::_7_::STA_OBJECT_INFORMATION_ST::_::_m_ohyObjectType_st::_m_probObstacle_st::_m_probStationary_st::_m_prob1RoadsideBarrierN = 0;
        @sysvar::XCP::RadarFR::_g_PlReCoFw_PlReCoPer_ObjBypassingRunnable_ObjBypassingRunnable_m_pad_radarObjPort_par_out_local::TChangeableMemPool::_::_::_m_arrayPool::_0_::_elem::port_ens_r_obj_sensor_base::_::_m_movObjectInformation::_7_::STA_OBJECT_INFORMATION_ST::_::_m_ohyObjectType_st::_m_probObstacle_st::_m_probStationary_st::_m_prob1UnknownN = 0;
        @sysvar::XCP::RadarFR::_g_PlReCoFw_PlReCoPer_ObjBypassingRunnable_ObjBypassingRunnable_m_pad_radarObjPort_par_out_local::TChangeableMemPool::_::_::_m_arrayPool::_0_::_elem::port_ens_r_obj_sensor_base::_::_m_movObjectInformation::_7_::_m_dLengthN = 64;
        @sysvar::XCP::RadarFR::_g_PlReCoFw_PlReCoPer_ObjBypassingRunnable_ObjBypassingRunnable_m_pad_radarObjPort_par_out_local::TChangeableMemPool::_::_::_m_arrayPool::_0_::_elem::port_ens_r_obj_sensor_base::_::_m_movObjectInformation::_7_::_m_dWidthN = @Classe_Obj_Sim::obj_data.obj_width[7] * 128;
        break;
    }
    break;

    case 8: //"Object-8"
    //constant
    @sysvar::XCP::RadarFR::_g_PlReCoFw_PlReCoPer_ObjBypassingRunnable_ObjBypassingRunnable_m_pad_radarObjPort_par_out_local::TChangeableMemPool::_::_::_m_arrayPool::_0_::_elem::port_ens_r_obj_sensor_base::_::_m_movObjectInformation::_8_::STA_OBJECT_INFORMATION_ST::_::_Meas_b = 1;
    @sysvar::XCP::RadarFR::_g_PlReCoFw_PlReCoPer_ObjBypassingRunnable_ObjBypassingRunnable_m_pad_radarObjPort_par_out_local::TChangeableMemPool::_::_::_m_arrayPool::_0_::_elem::port_ens_r_obj_sensor_base::_::_m_movObjectInformation::_8_::STA_OBJECT_INFORMATION_ST::_::_Measurable_b = 1;
    @sysvar::XCP::RadarFR::_g_PlReCoFw_PlReCoPer_ObjBypassingRunnable_ObjBypassingRunnable_m_pad_radarObjPort_par_out_local::TChangeableMemPool::_::_::_m_arrayPool::_0_::_elem::port_ens_r_obj_sensor_base::_::_m_movObjectInformation::_8_::STA_OBJECT_INFORMATION_ST::_::_Valid_b = 1;
    @sysvar::XCP::RadarFR::_g_PlReCoFw_PlReCoPer_ObjBypassingRunnable_ObjBypassingRunnable_m_pad_radarObjPort_par_out_local::TChangeableMemPool::_::_::_m_arrayPool::_0_::_elem::port_ens_r_obj_sensor_base::_::_m_movObjectInformation::_8_::_m_covarDxAxN = 0;
    @sysvar::XCP::RadarFR::_g_PlReCoFw_PlReCoPer_ObjBypassingRunnable_ObjBypassingRunnable_m_pad_radarObjPort_par_out_local::TChangeableMemPool::_::_::_m_arrayPool::_0_::_elem::port_ens_r_obj_sensor_base::_::_m_movObjectInformation::_8_::_m_covarDxVxN = 0;
    @sysvar::XCP::RadarFR::_g_PlReCoFw_PlReCoPer_ObjBypassingRunnable_ObjBypassingRunnable_m_pad_radarObjPort_par_out_local::TChangeableMemPool::_::_::_m_arrayPool::_0_::_elem::port_ens_r_obj_sensor_base::_::_m_movObjectInformation::_8_::_m_covarDyVyN = 0;
    @sysvar::XCP::RadarFR::_g_PlReCoFw_PlReCoPer_ObjBypassingRunnable_ObjBypassingRunnable_m_pad_radarObjPort_par_out_local::TChangeableMemPool::_::_::_m_arrayPool::_0_::_elem::port_ens_r_obj_sensor_base::_::_m_movObjectInformation::_8_::_m_covarDyWidthN = 0;
    @sysvar::XCP::RadarFR::_g_PlReCoFw_PlReCoPer_ObjBypassingRunnable_ObjBypassingRunnable_m_pad_radarObjPort_par_out_local::TChangeableMemPool::_::_::_m_arrayPool::_0_::_elem::port_ens_r_obj_sensor_base::_::_m_movObjectInformation::_8_::_m_covarVxAxN = 0;
    @sysvar::XCP::RadarFR::_g_PlReCoFw_PlReCoPer_ObjBypassingRunnable_ObjBypassingRunnable_m_pad_radarObjPort_par_out_local::TChangeableMemPool::_::_::_m_arrayPool::_0_::_elem::port_ens_r_obj_sensor_base::_::_m_movObjectInformation::_8_::_m_varAxN = 0;
    @sysvar::XCP::RadarFR::_g_PlReCoFw_PlReCoPer_ObjBypassingRunnable_ObjBypassingRunnable_m_pad_radarObjPort_par_out_local::TChangeableMemPool::_::_::_m_arrayPool::_0_::_elem::port_ens_r_obj_sensor_base::_::_m_movObjectInformation::_8_::_m_varAyN = 0;
    @sysvar::XCP::RadarFR::_g_PlReCoFw_PlReCoPer_ObjBypassingRunnable_ObjBypassingRunnable_m_pad_radarObjPort_par_out_local::TChangeableMemPool::_::_::_m_arrayPool::_0_::_elem::port_ens_r_obj_sensor_base::_::_m_movObjectInformation::_8_::_m_varVxN = 0;
    @sysvar::XCP::RadarFR::_g_PlReCoFw_PlReCoPer_ObjBypassingRunnable_ObjBypassingRunnable_m_pad_radarObjPort_par_out_local::TChangeableMemPool::_::_::_m_arrayPool::_0_::_elem::port_ens_r_obj_sensor_base::_::_m_movObjectInformation::_8_::_m_varVyN = 0;
    @sysvar::XCP::RadarFR::_g_PlReCoFw_PlReCoPer_ObjBypassingRunnable_ObjBypassingRunnable_m_pad_radarObjPort_par_out_local::TChangeableMemPool::_::_::_m_arrayPool::_0_::_elem::port_ens_r_obj_sensor_base::_::_m_movObjectInformation::_8_::STA_OBJECT_INFORMATION_ST::_::_m_varDxN = 0;
    @sysvar::XCP::RadarFR::_g_PlReCoFw_PlReCoPer_ObjBypassingRunnable_ObjBypassingRunnable_m_pad_radarObjPort_par_out_local::TChangeableMemPool::_::_::_m_arrayPool::_0_::_elem::port_ens_r_obj_sensor_base::_::_m_movObjectInformation::_8_::STA_OBJECT_INFORMATION_ST::_::_m_varDyN = 0;
    @sysvar::XCP::RadarFR::_g_PlReCoFw_PlReCoPer_ObjBypassingRunnable_ObjBypassingRunnable_m_pad_radarObjPort_par_out_local::TChangeableMemPool::_::_::_m_arrayPool::_0_::_elem::port_ens_r_obj_sensor_base::_::_m_movObjectInformation::_8_::_m_dVarLengthN = 0;
    @sysvar::XCP::RadarFR::_g_PlReCoFw_PlReCoPer_ObjBypassingRunnable_ObjBypassingRunnable_m_pad_radarObjPort_par_out_local::TChangeableMemPool::_::_::_m_arrayPool::_0_::_elem::port_ens_r_obj_sensor_base::_::_m_movObjectInformation::_8_::_m_dVarWidthN = 0;
    @sysvar::XCP::RadarFR::_g_PlReCoFw_PlReCoPer_ObjBypassingRunnable_ObjBypassingRunnable_m_pad_radarObjPort_par_out_local::TChangeableMemPool::_::_::_m_arrayPool::_0_::_elem::port_ens_r_obj_sensor_base::_::_m_movObjectInformation::_8_::STA_OBJECT_INFORMATION_ST::_::_m_wExistProbN = 64880;
    @sysvar::XCP::RadarFR::_g_PlReCoFw_PlReCoPer_ObjBypassingRunnable_ObjBypassingRunnable_m_pad_radarObjPort_par_out_local::TChangeableMemPool::_::_::_m_arrayPool::_0_::_elem::port_ens_r_obj_sensor_base::_::_m_movObjectInformation::_8_::_m_referencePtPosIndexN = 10;
    @sysvar::XCP::RadarFR::_g_PlReCoFw_PlReCoPer_ObjBypassingRunnable_ObjBypassingRunnable_m_pad_radarObjPort_par_out_local::TChangeableMemPool::_::_::_m_arrayPool::_0_::_elem::port_ens_r_obj_sensor_base::_::_m_movObjectInformation::_8_::_m_alpPiVarYawAngleN = 0;
    @sysvar::XCP::RadarFR::_g_PlReCoFw_PlReCoPer_ObjBypassingRunnable_ObjBypassingRunnable_m_pad_radarObjPort_par_out_local::TChangeableMemPool::_::_::_m_arrayPool::_0_::_elem::port_ens_r_obj_sensor_base::_::_m_movObjectInformation::_8_::_m_alpPiYawAngleN = 0;

    //target movement

    @sysvar::XCP::RadarFR::_g_PlReCoFw_PlReCoPer_ObjBypassingRunnable_ObjBypassingRunnable_m_pad_radarObjPort_par_out_local::TChangeableMemPool::_::_::_m_arrayPool::_0_::_elem::port_ens_r_obj_sensor_base::_::_m_movObjectInformation::_8_::STA_OBJECT_INFORMATION_ST::_::_m_dxN = @Classe_Obj_Sim::obj_data.obj_dx[8] * 128;
    @sysvar::XCP::RadarFR::_g_PlReCoFw_PlReCoPer_ObjBypassingRunnable_ObjBypassingRunnable_m_pad_radarObjPort_par_out_local::TChangeableMemPool::_::_::_m_arrayPool::_0_::_elem::port_ens_r_obj_sensor_base::_::_m_movObjectInformation::_8_::STA_OBJECT_INFORMATION_ST::_::_m_dyN = @Classe_Obj_Sim::obj_data.obj_dy[8] * 128;
    @sysvar::XCP::RadarFR::_g_PlReCoFw_PlReCoPer_ObjBypassingRunnable_ObjBypassingRunnable_m_pad_radarObjPort_par_out_local::TChangeableMemPool::_::_::_m_arrayPool::_0_::_elem::port_ens_r_obj_sensor_base::_::_m_movObjectInformation::_8_::STA_OBJECT_INFORMATION_ST::_::_m_dzN = 0;
    @sysvar::XCP::RadarFR::_g_PlReCoFw_PlReCoPer_ObjBypassingRunnable_ObjBypassingRunnable_m_pad_radarObjPort_par_out_local::TChangeableMemPool::_::_::_m_arrayPool::_0_::_elem::port_ens_r_obj_sensor_base::_::_m_movObjectInformation::_8_::_m_vxN = @Classe_Obj_Sim::obj_data.obj_relative_vx[8] * 256;
    @sysvar::XCP::RadarFR::_g_PlReCoFw_PlReCoPer_ObjBypassingRunnable_ObjBypassingRunnable_m_pad_radarObjPort_par_out_local::TChangeableMemPool::_::_::_m_arrayPool::_0_::_elem::port_ens_r_obj_sensor_base::_::_m_movObjectInformation::_8_::_m_vyN = @Classe_Obj_Sim::obj_data.obj_relative_vy[8] * 256;
    @sysvar::XCP::RadarFR::_g_PlReCoFw_PlReCoPer_ObjBypassingRunnable_ObjBypassingRunnable_m_pad_radarObjPort_par_out_local::TChangeableMemPool::_::_::_m_arrayPool::_0_::_elem::port_ens_r_obj_sensor_base::_::_m_movObjectInformation::_8_::_m_axN = 0;
    @sysvar::XCP::RadarFR::_g_PlReCoFw_PlReCoPer_ObjBypassingRunnable_ObjBypassingRunnable_m_pad_radarObjPort_par_out_local::TChangeableMemPool::_::_::_m_arrayPool::_0_::_elem::port_ens_r_obj_sensor_base::_::_m_movObjectInformation::_8_::_m_ayN = 0;

    //target object moving or not
    if (abs(@Classe_Obj_Sim::obj_data.obj_relative_vx[8]) != 0)
    {
      @sysvar::XCP::RadarFR::_g_PlReCoFw_PlReCoPer_ObjBypassingRunnable_ObjBypassingRunnable_m_pad_radarObjPort_par_out_local::TChangeableMemPool::_::_::_m_arrayPool::_0_::_elem::port_ens_r_obj_sensor_base::_::_m_movObjectInformation::_8_::STA_OBJECT_INFORMATION_ST::_::_m_prob1HasBeenObservedMovingN = 126;
      @sysvar::XCP::RadarFR::_g_PlReCoFw_PlReCoPer_ObjBypassingRunnable_ObjBypassingRunnable_m_pad_radarObjPort_par_out_local::TChangeableMemPool::_::_::_m_arrayPool::_0_::_elem::port_ens_r_obj_sensor_base::_::_m_movObjectInformation::_8_::STA_OBJECT_INFORMATION_ST::_::_m_prob1MovingN = 126;
      @sysvar::XCP::RadarFR::_g_PlReCoFw_PlReCoPer_ObjBypassingRunnable_ObjBypassingRunnable_m_pad_radarObjPort_par_out_local::TChangeableMemPool::_::_::_m_arrayPool::_0_::_elem::port_ens_r_obj_sensor_base::_::_m_movObjectInformation::_8_::STA_OBJECT_INFORMATION_ST::_::_m_ohyObjectType_st::_m_probObstacle_st::_m_prob1MobileN = 128;
      @sysvar::XCP::RadarFR::_g_PlReCoFw_PlReCoPer_ObjBypassingRunnable_ObjBypassingRunnable_m_pad_radarObjPort_par_out_local::TChangeableMemPool::_::_::_m_arrayPool::_0_::_elem::port_ens_r_obj_sensor_base::_::_m_movObjectInformation::_8_::STA_OBJECT_INFORMATION_ST::_::_m_ohyObjectType_st::_m_probObstacle_st::_m_prob1StationaryN = 0;
    }
    else
    {
      @sysvar::XCP::RadarFR::_g_PlReCoFw_PlReCoPer_ObjBypassingRunnable_ObjBypassingRunnable_m_pad_radarObjPort_par_out_local::TChangeableMemPool::_::_::_m_arrayPool::_0_::_elem::port_ens_r_obj_sensor_base::_::_m_movObjectInformation::_8_::STA_OBJECT_INFORMATION_ST::_::_m_prob1HasBeenObservedMovingN = 0;
      @sysvar::XCP::RadarFR::_g_PlReCoFw_PlReCoPer_ObjBypassingRunnable_ObjBypassingRunnable_m_pad_radarObjPort_par_out_local::TChangeableMemPool::_::_::_m_arrayPool::_0_::_elem::port_ens_r_obj_sensor_base::_::_m_movObjectInformation::_8_::STA_OBJECT_INFORMATION_ST::_::_m_prob1MovingN = 0;
      @sysvar::XCP::RadarFR::_g_PlReCoFw_PlReCoPer_ObjBypassingRunnable_ObjBypassingRunnable_m_pad_radarObjPort_par_out_local::TChangeableMemPool::_::_::_m_arrayPool::_0_::_elem::port_ens_r_obj_sensor_base::_::_m_movObjectInformation::_8_::STA_OBJECT_INFORMATION_ST::_::_m_ohyObjectType_st::_m_probObstacle_st::_m_prob1MobileN = 0;
      @sysvar::XCP::RadarFR::_g_PlReCoFw_PlReCoPer_ObjBypassingRunnable_ObjBypassingRunnable_m_pad_radarObjPort_par_out_local::TChangeableMemPool::_::_::_m_arrayPool::_0_::_elem::port_ens_r_obj_sensor_base::_::_m_movObjectInformation::_8_::STA_OBJECT_INFORMATION_ST::_::_m_ohyObjectType_st::_m_probObstacle_st::_m_prob1StationaryN = 128;
    }

      //object classification
    switch (@Classe_Obj_Sim::obj_data.obj_type[8])
    {
      case 0: //"Non-Obstacle"
        @sysvar::XCP::RadarFR::_g_PlReCoFw_PlReCoPer_ObjBypassingRunnable_ObjBypassingRunnable_m_pad_radarObjPort_par_out_local::TChangeableMemPool::_::_::_m_arrayPool::_0_::_elem::port_ens_r_obj_sensor_base::_::_m_movObjectInformation::_8_::STA_OBJECT_INFORMATION_ST::_::_m_ohyObjectType_st::_m_prob1NonObstacleN = 128;
        @sysvar::XCP::RadarFR::_g_PlReCoFw_PlReCoPer_ObjBypassingRunnable_ObjBypassingRunnable_m_pad_radarObjPort_par_out_local::TChangeableMemPool::_::_::_m_arrayPool::_0_::_elem::port_ens_r_obj_sensor_base::_::_m_movObjectInformation::_8_::STA_OBJECT_INFORMATION_ST::_::_m_ohyObjectType_st::_m_prob1ObstacleN = 0;
        @sysvar::XCP::RadarFR::_g_PlReCoFw_PlReCoPer_ObjBypassingRunnable_ObjBypassingRunnable_m_pad_radarObjPort_par_out_local::TChangeableMemPool::_::_::_m_arrayPool::_0_::_elem::port_ens_r_obj_sensor_base::_::_m_movObjectInformation::_8_::STA_OBJECT_INFORMATION_ST::_::_m_ohyObjectType_st::_m_prob1UnknownN = 0;
        @sysvar::XCP::RadarFR::_g_PlReCoFw_PlReCoPer_ObjBypassingRunnable_ObjBypassingRunnable_m_pad_radarObjPort_par_out_local::TChangeableMemPool::_::_::_m_arrayPool::_0_::_elem::port_ens_r_obj_sensor_base::_::_m_movObjectInformation::_8_::STA_OBJECT_INFORMATION_ST::_::_m_ohyObjectType_st::_m_probObstacle_st::_m_prob1UnknownN = 128;
        @sysvar::XCP::RadarFR::_g_PlReCoFw_PlReCoPer_ObjBypassingRunnable_ObjBypassingRunnable_m_pad_radarObjPort_par_out_local::TChangeableMemPool::_::_::_m_arrayPool::_0_::_elem::port_ens_r_obj_sensor_base::_::_m_movObjectInformation::_8_::STA_OBJECT_INFORMATION_ST::_::_m_ohyObjectType_st::_m_probObstacle_st::_m_probMobile_st::_m_prob1FourPlusWheelerN = 0;
        @sysvar::XCP::RadarFR::_g_PlReCoFw_PlReCoPer_ObjBypassingRunnable_ObjBypassingRunnable_m_pad_radarObjPort_par_out_local::TChangeableMemPool::_::_::_m_arrayPool::_0_::_elem::port_ens_r_obj_sensor_base::_::_m_movObjectInformation::_8_::STA_OBJECT_INFORMATION_ST::_::_m_ohyObjectType_st::_m_probObstacle_st::_m_probMobile_st::_m_prob1PedestrianN = 0;
        @sysvar::XCP::RadarFR::_g_PlReCoFw_PlReCoPer_ObjBypassingRunnable_ObjBypassingRunnable_m_pad_radarObjPort_par_out_local::TChangeableMemPool::_::_::_m_arrayPool::_0_::_elem::port_ens_r_obj_sensor_base::_::_m_movObjectInformation::_8_::STA_OBJECT_INFORMATION_ST::_::_m_ohyObjectType_st::_m_probObstacle_st::_m_probMobile_st::_m_prob1TwoWheelerN = 0;
        @sysvar::XCP::RadarFR::_g_PlReCoFw_PlReCoPer_ObjBypassingRunnable_ObjBypassingRunnable_m_pad_radarObjPort_par_out_local::TChangeableMemPool::_::_::_m_arrayPool::_0_::_elem::port_ens_r_obj_sensor_base::_::_m_movObjectInformation::_8_::STA_OBJECT_INFORMATION_ST::_::_m_ohyObjectType_st::_m_probObstacle_st::_m_probMobile_st::_m_prob1UnknownN = 128;
        @sysvar::XCP::RadarFR::_g_PlReCoFw_PlReCoPer_ObjBypassingRunnable_ObjBypassingRunnable_m_pad_radarObjPort_par_out_local::TChangeableMemPool::_::_::_m_arrayPool::_0_::_elem::port_ens_r_obj_sensor_base::_::_m_movObjectInformation::_8_::STA_OBJECT_INFORMATION_ST::_::_m_ohyObjectType_st::_m_probObstacle_st::_m_probMobile_st::_m_probFourPlusWheeler_st::_m_prob1PassengerCarN = 0;
        @sysvar::XCP::RadarFR::_g_PlReCoFw_PlReCoPer_ObjBypassingRunnable_ObjBypassingRunnable_m_pad_radarObjPort_par_out_local::TChangeableMemPool::_::_::_m_arrayPool::_0_::_elem::port_ens_r_obj_sensor_base::_::_m_movObjectInformation::_8_::STA_OBJECT_INFORMATION_ST::_::_m_ohyObjectType_st::_m_probObstacle_st::_m_probMobile_st::_m_probFourPlusWheeler_st::_m_prob1TruckN = 0;
        @sysvar::XCP::RadarFR::_g_PlReCoFw_PlReCoPer_ObjBypassingRunnable_ObjBypassingRunnable_m_pad_radarObjPort_par_out_local::TChangeableMemPool::_::_::_m_arrayPool::_0_::_elem::port_ens_r_obj_sensor_base::_::_m_movObjectInformation::_8_::STA_OBJECT_INFORMATION_ST::_::_m_ohyObjectType_st::_m_probObstacle_st::_m_probMobile_st::_m_probFourPlusWheeler_st::_m_prob1UnknownN = 128;
        @sysvar::XCP::RadarFR::_g_PlReCoFw_PlReCoPer_ObjBypassingRunnable_ObjBypassingRunnable_m_pad_radarObjPort_par_out_local::TChangeableMemPool::_::_::_m_arrayPool::_0_::_elem::port_ens_r_obj_sensor_base::_::_m_movObjectInformation::_8_::STA_OBJECT_INFORMATION_ST::_::_m_ohyObjectType_st::_m_probObstacle_st::_m_probStationary_st::_m_prob1RoadsideBarrierN = 0;
        @sysvar::XCP::RadarFR::_g_PlReCoFw_PlReCoPer_ObjBypassingRunnable_ObjBypassingRunnable_m_pad_radarObjPort_par_out_local::TChangeableMemPool::_::_::_m_arrayPool::_0_::_elem::port_ens_r_obj_sensor_base::_::_m_movObjectInformation::_8_::STA_OBJECT_INFORMATION_ST::_::_m_ohyObjectType_st::_m_probObstacle_st::_m_probStationary_st::_m_prob1UnknownN = 128;
        @sysvar::XCP::RadarFR::_g_PlReCoFw_PlReCoPer_ObjBypassingRunnable_ObjBypassingRunnable_m_pad_radarObjPort_par_out_local::TChangeableMemPool::_::_::_m_arrayPool::_0_::_elem::port_ens_r_obj_sensor_base::_::_m_movObjectInformation::_8_::_m_dLengthN = 64;
        @sysvar::XCP::RadarFR::_g_PlReCoFw_PlReCoPer_ObjBypassingRunnable_ObjBypassingRunnable_m_pad_radarObjPort_par_out_local::TChangeableMemPool::_::_::_m_arrayPool::_0_::_elem::port_ens_r_obj_sensor_base::_::_m_movObjectInformation::_8_::_m_dWidthN = @Classe_Obj_Sim::obj_data.obj_width[8] * 128;
        break;

      case 1: //"unknown"
        @sysvar::XCP::RadarFR::_g_PlReCoFw_PlReCoPer_ObjBypassingRunnable_ObjBypassingRunnable_m_pad_radarObjPort_par_out_local::TChangeableMemPool::_::_::_m_arrayPool::_0_::_elem::port_ens_r_obj_sensor_base::_::_m_movObjectInformation::_8_::STA_OBJECT_INFORMATION_ST::_::_m_ohyObjectType_st::_m_prob1NonObstacleN = 0;
        @sysvar::XCP::RadarFR::_g_PlReCoFw_PlReCoPer_ObjBypassingRunnable_ObjBypassingRunnable_m_pad_radarObjPort_par_out_local::TChangeableMemPool::_::_::_m_arrayPool::_0_::_elem::port_ens_r_obj_sensor_base::_::_m_movObjectInformation::_8_::STA_OBJECT_INFORMATION_ST::_::_m_ohyObjectType_st::_m_prob1ObstacleN = 0;
        @sysvar::XCP::RadarFR::_g_PlReCoFw_PlReCoPer_ObjBypassingRunnable_ObjBypassingRunnable_m_pad_radarObjPort_par_out_local::TChangeableMemPool::_::_::_m_arrayPool::_0_::_elem::port_ens_r_obj_sensor_base::_::_m_movObjectInformation::_8_::STA_OBJECT_INFORMATION_ST::_::_m_ohyObjectType_st::_m_prob1UnknownN = 128;
        @sysvar::XCP::RadarFR::_g_PlReCoFw_PlReCoPer_ObjBypassingRunnable_ObjBypassingRunnable_m_pad_radarObjPort_par_out_local::TChangeableMemPool::_::_::_m_arrayPool::_0_::_elem::port_ens_r_obj_sensor_base::_::_m_movObjectInformation::_8_::STA_OBJECT_INFORMATION_ST::_::_m_ohyObjectType_st::_m_probObstacle_st::_m_prob1UnknownN = 128;
        @sysvar::XCP::RadarFR::_g_PlReCoFw_PlReCoPer_ObjBypassingRunnable_ObjBypassingRunnable_m_pad_radarObjPort_par_out_local::TChangeableMemPool::_::_::_m_arrayPool::_0_::_elem::port_ens_r_obj_sensor_base::_::_m_movObjectInformation::_8_::STA_OBJECT_INFORMATION_ST::_::_m_ohyObjectType_st::_m_probObstacle_st::_m_probMobile_st::_m_prob1FourPlusWheelerN = 0;
        @sysvar::XCP::RadarFR::_g_PlReCoFw_PlReCoPer_ObjBypassingRunnable_ObjBypassingRunnable_m_pad_radarObjPort_par_out_local::TChangeableMemPool::_::_::_m_arrayPool::_0_::_elem::port_ens_r_obj_sensor_base::_::_m_movObjectInformation::_8_::STA_OBJECT_INFORMATION_ST::_::_m_ohyObjectType_st::_m_probObstacle_st::_m_probMobile_st::_m_prob1PedestrianN = 0;
        @sysvar::XCP::RadarFR::_g_PlReCoFw_PlReCoPer_ObjBypassingRunnable_ObjBypassingRunnable_m_pad_radarObjPort_par_out_local::TChangeableMemPool::_::_::_m_arrayPool::_0_::_elem::port_ens_r_obj_sensor_base::_::_m_movObjectInformation::_8_::STA_OBJECT_INFORMATION_ST::_::_m_ohyObjectType_st::_m_probObstacle_st::_m_probMobile_st::_m_prob1TwoWheelerN = 0;
        @sysvar::XCP::RadarFR::_g_PlReCoFw_PlReCoPer_ObjBypassingRunnable_ObjBypassingRunnable_m_pad_radarObjPort_par_out_local::TChangeableMemPool::_::_::_m_arrayPool::_0_::_elem::port_ens_r_obj_sensor_base::_::_m_movObjectInformation::_8_::STA_OBJECT_INFORMATION_ST::_::_m_ohyObjectType_st::_m_probObstacle_st::_m_probMobile_st::_m_prob1UnknownN = 128;
        @sysvar::XCP::RadarFR::_g_PlReCoFw_PlReCoPer_ObjBypassingRunnable_ObjBypassingRunnable_m_pad_radarObjPort_par_out_local::TChangeableMemPool::_::_::_m_arrayPool::_0_::_elem::port_ens_r_obj_sensor_base::_::_m_movObjectInformation::_8_::STA_OBJECT_INFORMATION_ST::_::_m_ohyObjectType_st::_m_probObstacle_st::_m_probMobile_st::_m_probFourPlusWheeler_st::_m_prob1PassengerCarN = 0;
        @sysvar::XCP::RadarFR::_g_PlReCoFw_PlReCoPer_ObjBypassingRunnable_ObjBypassingRunnable_m_pad_radarObjPort_par_out_local::TChangeableMemPool::_::_::_m_arrayPool::_0_::_elem::port_ens_r_obj_sensor_base::_::_m_movObjectInformation::_8_::STA_OBJECT_INFORMATION_ST::_::_m_ohyObjectType_st::_m_probObstacle_st::_m_probMobile_st::_m_probFourPlusWheeler_st::_m_prob1TruckN = 0;
        @sysvar::XCP::RadarFR::_g_PlReCoFw_PlReCoPer_ObjBypassingRunnable_ObjBypassingRunnable_m_pad_radarObjPort_par_out_local::TChangeableMemPool::_::_::_m_arrayPool::_0_::_elem::port_ens_r_obj_sensor_base::_::_m_movObjectInformation::_8_::STA_OBJECT_INFORMATION_ST::_::_m_ohyObjectType_st::_m_probObstacle_st::_m_probMobile_st::_m_probFourPlusWheeler_st::_m_prob1UnknownN = 128;
        @sysvar::XCP::RadarFR::_g_PlReCoFw_PlReCoPer_ObjBypassingRunnable_ObjBypassingRunnable_m_pad_radarObjPort_par_out_local::TChangeableMemPool::_::_::_m_arrayPool::_0_::_elem::port_ens_r_obj_sensor_base::_::_m_movObjectInformation::_8_::STA_OBJECT_INFORMATION_ST::_::_m_ohyObjectType_st::_m_probObstacle_st::_m_probStationary_st::_m_prob1RoadsideBarrierN = 0;
        @sysvar::XCP::RadarFR::_g_PlReCoFw_PlReCoPer_ObjBypassingRunnable_ObjBypassingRunnable_m_pad_radarObjPort_par_out_local::TChangeableMemPool::_::_::_m_arrayPool::_0_::_elem::port_ens_r_obj_sensor_base::_::_m_movObjectInformation::_8_::STA_OBJECT_INFORMATION_ST::_::_m_ohyObjectType_st::_m_probObstacle_st::_m_probStationary_st::_m_prob1UnknownN = 128;
        @sysvar::XCP::RadarFR::_g_PlReCoFw_PlReCoPer_ObjBypassingRunnable_ObjBypassingRunnable_m_pad_radarObjPort_par_out_local::TChangeableMemPool::_::_::_m_arrayPool::_0_::_elem::port_ens_r_obj_sensor_base::_::_m_movObjectInformation::_8_::_m_dLengthN = 0;
        @sysvar::XCP::RadarFR::_g_PlReCoFw_PlReCoPer_ObjBypassingRunnable_ObjBypassingRunnable_m_pad_radarObjPort_par_out_local::TChangeableMemPool::_::_::_m_arrayPool::_0_::_elem::port_ens_r_obj_sensor_base::_::_m_movObjectInformation::_8_::_m_dWidthN = @Classe_Obj_Sim::obj_data.obj_width[8] * 128;
        break;

      case 2: //"RoadSideBarrier"
        @sysvar::XCP::RadarFR::_g_PlReCoFw_PlReCoPer_ObjBypassingRunnable_ObjBypassingRunnable_m_pad_radarObjPort_par_out_local::TChangeableMemPool::_::_::_m_arrayPool::_0_::_elem::port_ens_r_obj_sensor_base::_::_m_movObjectInformation::_8_::STA_OBJECT_INFORMATION_ST::_::_m_ohyObjectType_st::_m_prob1NonObstacleN = 0;
        @sysvar::XCP::RadarFR::_g_PlReCoFw_PlReCoPer_ObjBypassingRunnable_ObjBypassingRunnable_m_pad_radarObjPort_par_out_local::TChangeableMemPool::_::_::_m_arrayPool::_0_::_elem::port_ens_r_obj_sensor_base::_::_m_movObjectInformation::_8_::STA_OBJECT_INFORMATION_ST::_::_m_ohyObjectType_st::_m_prob1ObstacleN = 128;
        @sysvar::XCP::RadarFR::_g_PlReCoFw_PlReCoPer_ObjBypassingRunnable_ObjBypassingRunnable_m_pad_radarObjPort_par_out_local::TChangeableMemPool::_::_::_m_arrayPool::_0_::_elem::port_ens_r_obj_sensor_base::_::_m_movObjectInformation::_8_::STA_OBJECT_INFORMATION_ST::_::_m_ohyObjectType_st::_m_prob1UnknownN = 0;
        @sysvar::XCP::RadarFR::_g_PlReCoFw_PlReCoPer_ObjBypassingRunnable_ObjBypassingRunnable_m_pad_radarObjPort_par_out_local::TChangeableMemPool::_::_::_m_arrayPool::_0_::_elem::port_ens_r_obj_sensor_base::_::_m_movObjectInformation::_8_::STA_OBJECT_INFORMATION_ST::_::_m_ohyObjectType_st::_m_probObstacle_st::_m_prob1MobileN = 0;
        @sysvar::XCP::RadarFR::_g_PlReCoFw_PlReCoPer_ObjBypassingRunnable_ObjBypassingRunnable_m_pad_radarObjPort_par_out_local::TChangeableMemPool::_::_::_m_arrayPool::_0_::_elem::port_ens_r_obj_sensor_base::_::_m_movObjectInformation::_8_::STA_OBJECT_INFORMATION_ST::_::_m_ohyObjectType_st::_m_probObstacle_st::_m_prob1StationaryN = 128;
        @sysvar::XCP::RadarFR::_g_PlReCoFw_PlReCoPer_ObjBypassingRunnable_ObjBypassingRunnable_m_pad_radarObjPort_par_out_local::TChangeableMemPool::_::_::_m_arrayPool::_0_::_elem::port_ens_r_obj_sensor_base::_::_m_movObjectInformation::_8_::STA_OBJECT_INFORMATION_ST::_::_m_ohyObjectType_st::_m_probObstacle_st::_m_prob1UnknownN = 0;
        @sysvar::XCP::RadarFR::_g_PlReCoFw_PlReCoPer_ObjBypassingRunnable_ObjBypassingRunnable_m_pad_radarObjPort_par_out_local::TChangeableMemPool::_::_::_m_arrayPool::_0_::_elem::port_ens_r_obj_sensor_base::_::_m_movObjectInformation::_8_::STA_OBJECT_INFORMATION_ST::_::_m_ohyObjectType_st::_m_probObstacle_st::_m_probMobile_st::_m_prob1FourPlusWheelerN = 0;
        @sysvar::XCP::RadarFR::_g_PlReCoFw_PlReCoPer_ObjBypassingRunnable_ObjBypassingRunnable_m_pad_radarObjPort_par_out_local::TChangeableMemPool::_::_::_m_arrayPool::_0_::_elem::port_ens_r_obj_sensor_base::_::_m_movObjectInformation::_8_::STA_OBJECT_INFORMATION_ST::_::_m_ohyObjectType_st::_m_probObstacle_st::_m_probMobile_st::_m_prob1PedestrianN = 0;
        @sysvar::XCP::RadarFR::_g_PlReCoFw_PlReCoPer_ObjBypassingRunnable_ObjBypassingRunnable_m_pad_radarObjPort_par_out_local::TChangeableMemPool::_::_::_m_arrayPool::_0_::_elem::port_ens_r_obj_sensor_base::_::_m_movObjectInformation::_8_::STA_OBJECT_INFORMATION_ST::_::_m_ohyObjectType_st::_m_probObstacle_st::_m_probMobile_st::_m_prob1TwoWheelerN = 0;
        @sysvar::XCP::RadarFR::_g_PlReCoFw_PlReCoPer_ObjBypassingRunnable_ObjBypassingRunnable_m_pad_radarObjPort_par_out_local::TChangeableMemPool::_::_::_m_arrayPool::_0_::_elem::port_ens_r_obj_sensor_base::_::_m_movObjectInformation::_8_::STA_OBJECT_INFORMATION_ST::_::_m_ohyObjectType_st::_m_probObstacle_st::_m_probMobile_st::_m_prob1UnknownN = 0;
        @sysvar::XCP::RadarFR::_g_PlReCoFw_PlReCoPer_ObjBypassingRunnable_ObjBypassingRunnable_m_pad_radarObjPort_par_out_local::TChangeableMemPool::_::_::_m_arrayPool::_0_::_elem::port_ens_r_obj_sensor_base::_::_m_movObjectInformation::_8_::STA_OBJECT_INFORMATION_ST::_::_m_ohyObjectType_st::_m_probObstacle_st::_m_probMobile_st::_m_probFourPlusWheeler_st::_m_prob1PassengerCarN = 0;
        @sysvar::XCP::RadarFR::_g_PlReCoFw_PlReCoPer_ObjBypassingRunnable_ObjBypassingRunnable_m_pad_radarObjPort_par_out_local::TChangeableMemPool::_::_::_m_arrayPool::_0_::_elem::port_ens_r_obj_sensor_base::_::_m_movObjectInformation::_8_::STA_OBJECT_INFORMATION_ST::_::_m_ohyObjectType_st::_m_probObstacle_st::_m_probMobile_st::_m_probFourPlusWheeler_st::_m_prob1TruckN = 0;
        @sysvar::XCP::RadarFR::_g_PlReCoFw_PlReCoPer_ObjBypassingRunnable_ObjBypassingRunnable_m_pad_radarObjPort_par_out_local::TChangeableMemPool::_::_::_m_arrayPool::_0_::_elem::port_ens_r_obj_sensor_base::_::_m_movObjectInformation::_8_::STA_OBJECT_INFORMATION_ST::_::_m_ohyObjectType_st::_m_probObstacle_st::_m_probMobile_st::_m_probFourPlusWheeler_st::_m_prob1UnknownN = 0;
        @sysvar::XCP::RadarFR::_g_PlReCoFw_PlReCoPer_ObjBypassingRunnable_ObjBypassingRunnable_m_pad_radarObjPort_par_out_local::TChangeableMemPool::_::_::_m_arrayPool::_0_::_elem::port_ens_r_obj_sensor_base::_::_m_movObjectInformation::_8_::STA_OBJECT_INFORMATION_ST::_::_m_ohyObjectType_st::_m_probObstacle_st::_m_probStationary_st::_m_prob1RoadsideBarrierN = 128;
        @sysvar::XCP::RadarFR::_g_PlReCoFw_PlReCoPer_ObjBypassingRunnable_ObjBypassingRunnable_m_pad_radarObjPort_par_out_local::TChangeableMemPool::_::_::_m_arrayPool::_0_::_elem::port_ens_r_obj_sensor_base::_::_m_movObjectInformation::_8_::STA_OBJECT_INFORMATION_ST::_::_m_ohyObjectType_st::_m_probObstacle_st::_m_probStationary_st::_m_prob1UnknownN = 0;
        @sysvar::XCP::RadarFR::_g_PlReCoFw_PlReCoPer_ObjBypassingRunnable_ObjBypassingRunnable_m_pad_radarObjPort_par_out_local::TChangeableMemPool::_::_::_m_arrayPool::_0_::_elem::port_ens_r_obj_sensor_base::_::_m_movObjectInformation::_8_::_m_dLengthN = 64;
        @sysvar::XCP::RadarFR::_g_PlReCoFw_PlReCoPer_ObjBypassingRunnable_ObjBypassingRunnable_m_pad_radarObjPort_par_out_local::TChangeableMemPool::_::_::_m_arrayPool::_0_::_elem::port_ens_r_obj_sensor_base::_::_m_movObjectInformation::_8_::_m_dWidthN = @Classe_Obj_Sim::obj_data.obj_width[8] * 128;
        break;

      case 3: //"2Wheeler"
        @sysvar::XCP::RadarFR::_g_PlReCoFw_PlReCoPer_ObjBypassingRunnable_ObjBypassingRunnable_m_pad_radarObjPort_par_out_local::TChangeableMemPool::_::_::_m_arrayPool::_0_::_elem::port_ens_r_obj_sensor_base::_::_m_movObjectInformation::_8_::STA_OBJECT_INFORMATION_ST::_::_m_ohyObjectType_st::_m_prob1NonObstacleN = 0;
        @sysvar::XCP::RadarFR::_g_PlReCoFw_PlReCoPer_ObjBypassingRunnable_ObjBypassingRunnable_m_pad_radarObjPort_par_out_local::TChangeableMemPool::_::_::_m_arrayPool::_0_::_elem::port_ens_r_obj_sensor_base::_::_m_movObjectInformation::_8_::STA_OBJECT_INFORMATION_ST::_::_m_ohyObjectType_st::_m_prob1ObstacleN = 128;
        @sysvar::XCP::RadarFR::_g_PlReCoFw_PlReCoPer_ObjBypassingRunnable_ObjBypassingRunnable_m_pad_radarObjPort_par_out_local::TChangeableMemPool::_::_::_m_arrayPool::_0_::_elem::port_ens_r_obj_sensor_base::_::_m_movObjectInformation::_8_::STA_OBJECT_INFORMATION_ST::_::_m_ohyObjectType_st::_m_prob1UnknownN = 0;
        @sysvar::XCP::RadarFR::_g_PlReCoFw_PlReCoPer_ObjBypassingRunnable_ObjBypassingRunnable_m_pad_radarObjPort_par_out_local::TChangeableMemPool::_::_::_m_arrayPool::_0_::_elem::port_ens_r_obj_sensor_base::_::_m_movObjectInformation::_8_::STA_OBJECT_INFORMATION_ST::_::_m_ohyObjectType_st::_m_probObstacle_st::_m_prob1UnknownN = 0;
        @sysvar::XCP::RadarFR::_g_PlReCoFw_PlReCoPer_ObjBypassingRunnable_ObjBypassingRunnable_m_pad_radarObjPort_par_out_local::TChangeableMemPool::_::_::_m_arrayPool::_0_::_elem::port_ens_r_obj_sensor_base::_::_m_movObjectInformation::_8_::STA_OBJECT_INFORMATION_ST::_::_m_ohyObjectType_st::_m_probObstacle_st::_m_probMobile_st::_m_prob1FourPlusWheelerN = 0;
        @sysvar::XCP::RadarFR::_g_PlReCoFw_PlReCoPer_ObjBypassingRunnable_ObjBypassingRunnable_m_pad_radarObjPort_par_out_local::TChangeableMemPool::_::_::_m_arrayPool::_0_::_elem::port_ens_r_obj_sensor_base::_::_m_movObjectInformation::_8_::STA_OBJECT_INFORMATION_ST::_::_m_ohyObjectType_st::_m_probObstacle_st::_m_probMobile_st::_m_prob1PedestrianN = 0;
        @sysvar::XCP::RadarFR::_g_PlReCoFw_PlReCoPer_ObjBypassingRunnable_ObjBypassingRunnable_m_pad_radarObjPort_par_out_local::TChangeableMemPool::_::_::_m_arrayPool::_0_::_elem::port_ens_r_obj_sensor_base::_::_m_movObjectInformation::_8_::STA_OBJECT_INFORMATION_ST::_::_m_ohyObjectType_st::_m_probObstacle_st::_m_probMobile_st::_m_prob1TwoWheelerN = 128;
        @sysvar::XCP::RadarFR::_g_PlReCoFw_PlReCoPer_ObjBypassingRunnable_ObjBypassingRunnable_m_pad_radarObjPort_par_out_local::TChangeableMemPool::_::_::_m_arrayPool::_0_::_elem::port_ens_r_obj_sensor_base::_::_m_movObjectInformation::_8_::STA_OBJECT_INFORMATION_ST::_::_m_ohyObjectType_st::_m_probObstacle_st::_m_probMobile_st::_m_prob1UnknownN = 0;
        @sysvar::XCP::RadarFR::_g_PlReCoFw_PlReCoPer_ObjBypassingRunnable_ObjBypassingRunnable_m_pad_radarObjPort_par_out_local::TChangeableMemPool::_::_::_m_arrayPool::_0_::_elem::port_ens_r_obj_sensor_base::_::_m_movObjectInformation::_8_::STA_OBJECT_INFORMATION_ST::_::_m_ohyObjectType_st::_m_probObstacle_st::_m_probMobile_st::_m_probFourPlusWheeler_st::_m_prob1PassengerCarN = 0;
        @sysvar::XCP::RadarFR::_g_PlReCoFw_PlReCoPer_ObjBypassingRunnable_ObjBypassingRunnable_m_pad_radarObjPort_par_out_local::TChangeableMemPool::_::_::_m_arrayPool::_0_::_elem::port_ens_r_obj_sensor_base::_::_m_movObjectInformation::_8_::STA_OBJECT_INFORMATION_ST::_::_m_ohyObjectType_st::_m_probObstacle_st::_m_probMobile_st::_m_probFourPlusWheeler_st::_m_prob1TruckN = 0;
        @sysvar::XCP::RadarFR::_g_PlReCoFw_PlReCoPer_ObjBypassingRunnable_ObjBypassingRunnable_m_pad_radarObjPort_par_out_local::TChangeableMemPool::_::_::_m_arrayPool::_0_::_elem::port_ens_r_obj_sensor_base::_::_m_movObjectInformation::_8_::STA_OBJECT_INFORMATION_ST::_::_m_ohyObjectType_st::_m_probObstacle_st::_m_probMobile_st::_m_probFourPlusWheeler_st::_m_prob1UnknownN = 128;
        @sysvar::XCP::RadarFR::_g_PlReCoFw_PlReCoPer_ObjBypassingRunnable_ObjBypassingRunnable_m_pad_radarObjPort_par_out_local::TChangeableMemPool::_::_::_m_arrayPool::_0_::_elem::port_ens_r_obj_sensor_base::_::_m_movObjectInformation::_8_::STA_OBJECT_INFORMATION_ST::_::_m_ohyObjectType_st::_m_probObstacle_st::_m_probStationary_st::_m_prob1RoadsideBarrierN = 0;
        @sysvar::XCP::RadarFR::_g_PlReCoFw_PlReCoPer_ObjBypassingRunnable_ObjBypassingRunnable_m_pad_radarObjPort_par_out_local::TChangeableMemPool::_::_::_m_arrayPool::_0_::_elem::port_ens_r_obj_sensor_base::_::_m_movObjectInformation::_8_::STA_OBJECT_INFORMATION_ST::_::_m_ohyObjectType_st::_m_probObstacle_st::_m_probStationary_st::_m_prob1UnknownN = 0;
        @sysvar::XCP::RadarFR::_g_PlReCoFw_PlReCoPer_ObjBypassingRunnable_ObjBypassingRunnable_m_pad_radarObjPort_par_out_local::TChangeableMemPool::_::_::_m_arrayPool::_0_::_elem::port_ens_r_obj_sensor_base::_::_m_movObjectInformation::_8_::_m_dLengthN = 64;
        @sysvar::XCP::RadarFR::_g_PlReCoFw_PlReCoPer_ObjBypassingRunnable_ObjBypassingRunnable_m_pad_radarObjPort_par_out_local::TChangeableMemPool::_::_::_m_arrayPool::_0_::_elem::port_ens_r_obj_sensor_base::_::_m_movObjectInformation::_8_::_m_dWidthN = @Classe_Obj_Sim::obj_data.obj_width[8] * 128;
        break;

      case 4: //"Pedestrian"
        @sysvar::XCP::RadarFR::_g_PlReCoFw_PlReCoPer_ObjBypassingRunnable_ObjBypassingRunnable_m_pad_radarObjPort_par_out_local::TChangeableMemPool::_::_::_m_arrayPool::_0_::_elem::port_ens_r_obj_sensor_base::_::_m_movObjectInformation::_8_::STA_OBJECT_INFORMATION_ST::_::_m_ohyObjectType_st::_m_prob1NonObstacleN = 0;
        @sysvar::XCP::RadarFR::_g_PlReCoFw_PlReCoPer_ObjBypassingRunnable_ObjBypassingRunnable_m_pad_radarObjPort_par_out_local::TChangeableMemPool::_::_::_m_arrayPool::_0_::_elem::port_ens_r_obj_sensor_base::_::_m_movObjectInformation::_8_::STA_OBJECT_INFORMATION_ST::_::_m_ohyObjectType_st::_m_prob1ObstacleN = 128;
        @sysvar::XCP::RadarFR::_g_PlReCoFw_PlReCoPer_ObjBypassingRunnable_ObjBypassingRunnable_m_pad_radarObjPort_par_out_local::TChangeableMemPool::_::_::_m_arrayPool::_0_::_elem::port_ens_r_obj_sensor_base::_::_m_movObjectInformation::_8_::STA_OBJECT_INFORMATION_ST::_::_m_ohyObjectType_st::_m_prob1UnknownN = 0;
        @sysvar::XCP::RadarFR::_g_PlReCoFw_PlReCoPer_ObjBypassingRunnable_ObjBypassingRunnable_m_pad_radarObjPort_par_out_local::TChangeableMemPool::_::_::_m_arrayPool::_0_::_elem::port_ens_r_obj_sensor_base::_::_m_movObjectInformation::_8_::STA_OBJECT_INFORMATION_ST::_::_m_ohyObjectType_st::_m_probObstacle_st::_m_prob1UnknownN = 0;
        @sysvar::XCP::RadarFR::_g_PlReCoFw_PlReCoPer_ObjBypassingRunnable_ObjBypassingRunnable_m_pad_radarObjPort_par_out_local::TChangeableMemPool::_::_::_m_arrayPool::_0_::_elem::port_ens_r_obj_sensor_base::_::_m_movObjectInformation::_8_::STA_OBJECT_INFORMATION_ST::_::_m_ohyObjectType_st::_m_probObstacle_st::_m_probMobile_st::_m_prob1FourPlusWheelerN = 0;
        @sysvar::XCP::RadarFR::_g_PlReCoFw_PlReCoPer_ObjBypassingRunnable_ObjBypassingRunnable_m_pad_radarObjPort_par_out_local::TChangeableMemPool::_::_::_m_arrayPool::_0_::_elem::port_ens_r_obj_sensor_base::_::_m_movObjectInformation::_8_::STA_OBJECT_INFORMATION_ST::_::_m_ohyObjectType_st::_m_probObstacle_st::_m_probMobile_st::_m_prob1PedestrianN = 128;
        @sysvar::XCP::RadarFR::_g_PlReCoFw_PlReCoPer_ObjBypassingRunnable_ObjBypassingRunnable_m_pad_radarObjPort_par_out_local::TChangeableMemPool::_::_::_m_arrayPool::_0_::_elem::port_ens_r_obj_sensor_base::_::_m_movObjectInformation::_8_::STA_OBJECT_INFORMATION_ST::_::_m_ohyObjectType_st::_m_probObstacle_st::_m_probMobile_st::_m_prob1TwoWheelerN = 0;
        @sysvar::XCP::RadarFR::_g_PlReCoFw_PlReCoPer_ObjBypassingRunnable_ObjBypassingRunnable_m_pad_radarObjPort_par_out_local::TChangeableMemPool::_::_::_m_arrayPool::_0_::_elem::port_ens_r_obj_sensor_base::_::_m_movObjectInformation::_8_::STA_OBJECT_INFORMATION_ST::_::_m_ohyObjectType_st::_m_probObstacle_st::_m_probMobile_st::_m_prob1UnknownN = 0;
        @sysvar::XCP::RadarFR::_g_PlReCoFw_PlReCoPer_ObjBypassingRunnable_ObjBypassingRunnable_m_pad_radarObjPort_par_out_local::TChangeableMemPool::_::_::_m_arrayPool::_0_::_elem::port_ens_r_obj_sensor_base::_::_m_movObjectInformation::_8_::STA_OBJECT_INFORMATION_ST::_::_m_ohyObjectType_st::_m_probObstacle_st::_m_probMobile_st::_m_probFourPlusWheeler_st::_m_prob1PassengerCarN = 0;
        @sysvar::XCP::RadarFR::_g_PlReCoFw_PlReCoPer_ObjBypassingRunnable_ObjBypassingRunnable_m_pad_radarObjPort_par_out_local::TChangeableMemPool::_::_::_m_arrayPool::_0_::_elem::port_ens_r_obj_sensor_base::_::_m_movObjectInformation::_8_::STA_OBJECT_INFORMATION_ST::_::_m_ohyObjectType_st::_m_probObstacle_st::_m_probMobile_st::_m_probFourPlusWheeler_st::_m_prob1TruckN = 0;
        @sysvar::XCP::RadarFR::_g_PlReCoFw_PlReCoPer_ObjBypassingRunnable_ObjBypassingRunnable_m_pad_radarObjPort_par_out_local::TChangeableMemPool::_::_::_m_arrayPool::_0_::_elem::port_ens_r_obj_sensor_base::_::_m_movObjectInformation::_8_::STA_OBJECT_INFORMATION_ST::_::_m_ohyObjectType_st::_m_probObstacle_st::_m_probMobile_st::_m_probFourPlusWheeler_st::_m_prob1UnknownN = 128;
        @sysvar::XCP::RadarFR::_g_PlReCoFw_PlReCoPer_ObjBypassingRunnable_ObjBypassingRunnable_m_pad_radarObjPort_par_out_local::TChangeableMemPool::_::_::_m_arrayPool::_0_::_elem::port_ens_r_obj_sensor_base::_::_m_movObjectInformation::_8_::STA_OBJECT_INFORMATION_ST::_::_m_ohyObjectType_st::_m_probObstacle_st::_m_probStationary_st::_m_prob1RoadsideBarrierN = 0;
        @sysvar::XCP::RadarFR::_g_PlReCoFw_PlReCoPer_ObjBypassingRunnable_ObjBypassingRunnable_m_pad_radarObjPort_par_out_local::TChangeableMemPool::_::_::_m_arrayPool::_0_::_elem::port_ens_r_obj_sensor_base::_::_m_movObjectInformation::_8_::STA_OBJECT_INFORMATION_ST::_::_m_ohyObjectType_st::_m_probObstacle_st::_m_probStationary_st::_m_prob1UnknownN = 0;
        @sysvar::XCP::RadarFR::_g_PlReCoFw_PlReCoPer_ObjBypassingRunnable_ObjBypassingRunnable_m_pad_radarObjPort_par_out_local::TChangeableMemPool::_::_::_m_arrayPool::_0_::_elem::port_ens_r_obj_sensor_base::_::_m_movObjectInformation::_8_::_m_dLengthN = 64;
        @sysvar::XCP::RadarFR::_g_PlReCoFw_PlReCoPer_ObjBypassingRunnable_ObjBypassingRunnable_m_pad_radarObjPort_par_out_local::TChangeableMemPool::_::_::_m_arrayPool::_0_::_elem::port_ens_r_obj_sensor_base::_::_m_movObjectInformation::_8_::_m_dWidthN = @Classe_Obj_Sim::obj_data.obj_width[8] * 128;
        break;

      case 5: //"Truck"
        @sysvar::XCP::RadarFR::_g_PlReCoFw_PlReCoPer_ObjBypassingRunnable_ObjBypassingRunnable_m_pad_radarObjPort_par_out_local::TChangeableMemPool::_::_::_m_arrayPool::_0_::_elem::port_ens_r_obj_sensor_base::_::_m_movObjectInformation::_8_::STA_OBJECT_INFORMATION_ST::_::_m_ohyObjectType_st::_m_prob1NonObstacleN = 0;
        @sysvar::XCP::RadarFR::_g_PlReCoFw_PlReCoPer_ObjBypassingRunnable_ObjBypassingRunnable_m_pad_radarObjPort_par_out_local::TChangeableMemPool::_::_::_m_arrayPool::_0_::_elem::port_ens_r_obj_sensor_base::_::_m_movObjectInformation::_8_::STA_OBJECT_INFORMATION_ST::_::_m_ohyObjectType_st::_m_prob1ObstacleN = 128;
        @sysvar::XCP::RadarFR::_g_PlReCoFw_PlReCoPer_ObjBypassingRunnable_ObjBypassingRunnable_m_pad_radarObjPort_par_out_local::TChangeableMemPool::_::_::_m_arrayPool::_0_::_elem::port_ens_r_obj_sensor_base::_::_m_movObjectInformation::_8_::STA_OBJECT_INFORMATION_ST::_::_m_ohyObjectType_st::_m_prob1UnknownN = 0;
        @sysvar::XCP::RadarFR::_g_PlReCoFw_PlReCoPer_ObjBypassingRunnable_ObjBypassingRunnable_m_pad_radarObjPort_par_out_local::TChangeableMemPool::_::_::_m_arrayPool::_0_::_elem::port_ens_r_obj_sensor_base::_::_m_movObjectInformation::_8_::STA_OBJECT_INFORMATION_ST::_::_m_ohyObjectType_st::_m_probObstacle_st::_m_prob1UnknownN = 0;
        @sysvar::XCP::RadarFR::_g_PlReCoFw_PlReCoPer_ObjBypassingRunnable_ObjBypassingRunnable_m_pad_radarObjPort_par_out_local::TChangeableMemPool::_::_::_m_arrayPool::_0_::_elem::port_ens_r_obj_sensor_base::_::_m_movObjectInformation::_8_::STA_OBJECT_INFORMATION_ST::_::_m_ohyObjectType_st::_m_probObstacle_st::_m_probMobile_st::_m_prob1FourPlusWheelerN = 128;
        @sysvar::XCP::RadarFR::_g_PlReCoFw_PlReCoPer_ObjBypassingRunnable_ObjBypassingRunnable_m_pad_radarObjPort_par_out_local::TChangeableMemPool::_::_::_m_arrayPool::_0_::_elem::port_ens_r_obj_sensor_base::_::_m_movObjectInformation::_8_::STA_OBJECT_INFORMATION_ST::_::_m_ohyObjectType_st::_m_probObstacle_st::_m_probMobile_st::_m_prob1PedestrianN = 0;
        @sysvar::XCP::RadarFR::_g_PlReCoFw_PlReCoPer_ObjBypassingRunnable_ObjBypassingRunnable_m_pad_radarObjPort_par_out_local::TChangeableMemPool::_::_::_m_arrayPool::_0_::_elem::port_ens_r_obj_sensor_base::_::_m_movObjectInformation::_8_::STA_OBJECT_INFORMATION_ST::_::_m_ohyObjectType_st::_m_probObstacle_st::_m_probMobile_st::_m_prob1TwoWheelerN = 0;
        @sysvar::XCP::RadarFR::_g_PlReCoFw_PlReCoPer_ObjBypassingRunnable_ObjBypassingRunnable_m_pad_radarObjPort_par_out_local::TChangeableMemPool::_::_::_m_arrayPool::_0_::_elem::port_ens_r_obj_sensor_base::_::_m_movObjectInformation::_8_::STA_OBJECT_INFORMATION_ST::_::_m_ohyObjectType_st::_m_probObstacle_st::_m_probMobile_st::_m_prob1UnknownN = 0;
        @sysvar::XCP::RadarFR::_g_PlReCoFw_PlReCoPer_ObjBypassingRunnable_ObjBypassingRunnable_m_pad_radarObjPort_par_out_local::TChangeableMemPool::_::_::_m_arrayPool::_0_::_elem::port_ens_r_obj_sensor_base::_::_m_movObjectInformation::_8_::STA_OBJECT_INFORMATION_ST::_::_m_ohyObjectType_st::_m_probObstacle_st::_m_probMobile_st::_m_probFourPlusWheeler_st::_m_prob1PassengerCarN = 0;
        @sysvar::XCP::RadarFR::_g_PlReCoFw_PlReCoPer_ObjBypassingRunnable_ObjBypassingRunnable_m_pad_radarObjPort_par_out_local::TChangeableMemPool::_::_::_m_arrayPool::_0_::_elem::port_ens_r_obj_sensor_base::_::_m_movObjectInformation::_8_::STA_OBJECT_INFORMATION_ST::_::_m_ohyObjectType_st::_m_probObstacle_st::_m_probMobile_st::_m_probFourPlusWheeler_st::_m_prob1TruckN = 128;
        @sysvar::XCP::RadarFR::_g_PlReCoFw_PlReCoPer_ObjBypassingRunnable_ObjBypassingRunnable_m_pad_radarObjPort_par_out_local::TChangeableMemPool::_::_::_m_arrayPool::_0_::_elem::port_ens_r_obj_sensor_base::_::_m_movObjectInformation::_8_::STA_OBJECT_INFORMATION_ST::_::_m_ohyObjectType_st::_m_probObstacle_st::_m_probMobile_st::_m_probFourPlusWheeler_st::_m_prob1UnknownN = 0;
        @sysvar::XCP::RadarFR::_g_PlReCoFw_PlReCoPer_ObjBypassingRunnable_ObjBypassingRunnable_m_pad_radarObjPort_par_out_local::TChangeableMemPool::_::_::_m_arrayPool::_0_::_elem::port_ens_r_obj_sensor_base::_::_m_movObjectInformation::_8_::STA_OBJECT_INFORMATION_ST::_::_m_ohyObjectType_st::_m_probObstacle_st::_m_probStationary_st::_m_prob1RoadsideBarrierN = 0;
        @sysvar::XCP::RadarFR::_g_PlReCoFw_PlReCoPer_ObjBypassingRunnable_ObjBypassingRunnable_m_pad_radarObjPort_par_out_local::TChangeableMemPool::_::_::_m_arrayPool::_0_::_elem::port_ens_r_obj_sensor_base::_::_m_movObjectInformation::_8_::STA_OBJECT_INFORMATION_ST::_::_m_ohyObjectType_st::_m_probObstacle_st::_m_probStationary_st::_m_prob1UnknownN = 0;
        @sysvar::XCP::RadarFR::_g_PlReCoFw_PlReCoPer_ObjBypassingRunnable_ObjBypassingRunnable_m_pad_radarObjPort_par_out_local::TChangeableMemPool::_::_::_m_arrayPool::_0_::_elem::port_ens_r_obj_sensor_base::_::_m_movObjectInformation::_8_::_m_dLengthN = 64;
        @sysvar::XCP::RadarFR::_g_PlReCoFw_PlReCoPer_ObjBypassingRunnable_ObjBypassingRunnable_m_pad_radarObjPort_par_out_local::TChangeableMemPool::_::_::_m_arrayPool::_0_::_elem::port_ens_r_obj_sensor_base::_::_m_movObjectInformation::_8_::_m_dWidthN = @Classe_Obj_Sim::obj_data.obj_width[8] * 128;
        break;

      case 6: //"PassengerCar"
        @sysvar::XCP::RadarFR::_g_PlReCoFw_PlReCoPer_ObjBypassingRunnable_ObjBypassingRunnable_m_pad_radarObjPort_par_out_local::TChangeableMemPool::_::_::_m_arrayPool::_0_::_elem::port_ens_r_obj_sensor_base::_::_m_movObjectInformation::_8_::STA_OBJECT_INFORMATION_ST::_::_m_ohyObjectType_st::_m_prob1NonObstacleN = 0;
        @sysvar::XCP::RadarFR::_g_PlReCoFw_PlReCoPer_ObjBypassingRunnable_ObjBypassingRunnable_m_pad_radarObjPort_par_out_local::TChangeableMemPool::_::_::_m_arrayPool::_0_::_elem::port_ens_r_obj_sensor_base::_::_m_movObjectInformation::_8_::STA_OBJECT_INFORMATION_ST::_::_m_ohyObjectType_st::_m_prob1ObstacleN = 128;
        @sysvar::XCP::RadarFR::_g_PlReCoFw_PlReCoPer_ObjBypassingRunnable_ObjBypassingRunnable_m_pad_radarObjPort_par_out_local::TChangeableMemPool::_::_::_m_arrayPool::_0_::_elem::port_ens_r_obj_sensor_base::_::_m_movObjectInformation::_8_::STA_OBJECT_INFORMATION_ST::_::_m_ohyObjectType_st::_m_prob1UnknownN = 0;
        @sysvar::XCP::RadarFR::_g_PlReCoFw_PlReCoPer_ObjBypassingRunnable_ObjBypassingRunnable_m_pad_radarObjPort_par_out_local::TChangeableMemPool::_::_::_m_arrayPool::_0_::_elem::port_ens_r_obj_sensor_base::_::_m_movObjectInformation::_8_::STA_OBJECT_INFORMATION_ST::_::_m_ohyObjectType_st::_m_probObstacle_st::_m_prob1UnknownN = 0;
        @sysvar::XCP::RadarFR::_g_PlReCoFw_PlReCoPer_ObjBypassingRunnable_ObjBypassingRunnable_m_pad_radarObjPort_par_out_local::TChangeableMemPool::_::_::_m_arrayPool::_0_::_elem::port_ens_r_obj_sensor_base::_::_m_movObjectInformation::_8_::STA_OBJECT_INFORMATION_ST::_::_m_ohyObjectType_st::_m_probObstacle_st::_m_probMobile_st::_m_prob1FourPlusWheelerN = 128;
        @sysvar::XCP::RadarFR::_g_PlReCoFw_PlReCoPer_ObjBypassingRunnable_ObjBypassingRunnable_m_pad_radarObjPort_par_out_local::TChangeableMemPool::_::_::_m_arrayPool::_0_::_elem::port_ens_r_obj_sensor_base::_::_m_movObjectInformation::_8_::STA_OBJECT_INFORMATION_ST::_::_m_ohyObjectType_st::_m_probObstacle_st::_m_probMobile_st::_m_prob1PedestrianN = 0;
        @sysvar::XCP::RadarFR::_g_PlReCoFw_PlReCoPer_ObjBypassingRunnable_ObjBypassingRunnable_m_pad_radarObjPort_par_out_local::TChangeableMemPool::_::_::_m_arrayPool::_0_::_elem::port_ens_r_obj_sensor_base::_::_m_movObjectInformation::_8_::STA_OBJECT_INFORMATION_ST::_::_m_ohyObjectType_st::_m_probObstacle_st::_m_probMobile_st::_m_prob1TwoWheelerN = 0;
        @sysvar::XCP::RadarFR::_g_PlReCoFw_PlReCoPer_ObjBypassingRunnable_ObjBypassingRunnable_m_pad_radarObjPort_par_out_local::TChangeableMemPool::_::_::_m_arrayPool::_0_::_elem::port_ens_r_obj_sensor_base::_::_m_movObjectInformation::_8_::STA_OBJECT_INFORMATION_ST::_::_m_ohyObjectType_st::_m_probObstacle_st::_m_probMobile_st::_m_prob1UnknownN = 0;
        @sysvar::XCP::RadarFR::_g_PlReCoFw_PlReCoPer_ObjBypassingRunnable_ObjBypassingRunnable_m_pad_radarObjPort_par_out_local::TChangeableMemPool::_::_::_m_arrayPool::_0_::_elem::port_ens_r_obj_sensor_base::_::_m_movObjectInformation::_8_::STA_OBJECT_INFORMATION_ST::_::_m_ohyObjectType_st::_m_probObstacle_st::_m_probMobile_st::_m_probFourPlusWheeler_st::_m_prob1PassengerCarN = 128;
        @sysvar::XCP::RadarFR::_g_PlReCoFw_PlReCoPer_ObjBypassingRunnable_ObjBypassingRunnable_m_pad_radarObjPort_par_out_local::TChangeableMemPool::_::_::_m_arrayPool::_0_::_elem::port_ens_r_obj_sensor_base::_::_m_movObjectInformation::_8_::STA_OBJECT_INFORMATION_ST::_::_m_ohyObjectType_st::_m_probObstacle_st::_m_probMobile_st::_m_probFourPlusWheeler_st::_m_prob1TruckN = 0;
        @sysvar::XCP::RadarFR::_g_PlReCoFw_PlReCoPer_ObjBypassingRunnable_ObjBypassingRunnable_m_pad_radarObjPort_par_out_local::TChangeableMemPool::_::_::_m_arrayPool::_0_::_elem::port_ens_r_obj_sensor_base::_::_m_movObjectInformation::_8_::STA_OBJECT_INFORMATION_ST::_::_m_ohyObjectType_st::_m_probObstacle_st::_m_probMobile_st::_m_probFourPlusWheeler_st::_m_prob1UnknownN = 0;
        @sysvar::XCP::RadarFR::_g_PlReCoFw_PlReCoPer_ObjBypassingRunnable_ObjBypassingRunnable_m_pad_radarObjPort_par_out_local::TChangeableMemPool::_::_::_m_arrayPool::_0_::_elem::port_ens_r_obj_sensor_base::_::_m_movObjectInformation::_8_::STA_OBJECT_INFORMATION_ST::_::_m_ohyObjectType_st::_m_probObstacle_st::_m_probStationary_st::_m_prob1RoadsideBarrierN = 0;
        @sysvar::XCP::RadarFR::_g_PlReCoFw_PlReCoPer_ObjBypassingRunnable_ObjBypassingRunnable_m_pad_radarObjPort_par_out_local::TChangeableMemPool::_::_::_m_arrayPool::_0_::_elem::port_ens_r_obj_sensor_base::_::_m_movObjectInformation::_8_::STA_OBJECT_INFORMATION_ST::_::_m_ohyObjectType_st::_m_probObstacle_st::_m_probStationary_st::_m_prob1UnknownN = 0;
        @sysvar::XCP::RadarFR::_g_PlReCoFw_PlReCoPer_ObjBypassingRunnable_ObjBypassingRunnable_m_pad_radarObjPort_par_out_local::TChangeableMemPool::_::_::_m_arrayPool::_0_::_elem::port_ens_r_obj_sensor_base::_::_m_movObjectInformation::_8_::_m_dLengthN = 64;
        @sysvar::XCP::RadarFR::_g_PlReCoFw_PlReCoPer_ObjBypassingRunnable_ObjBypassingRunnable_m_pad_radarObjPort_par_out_local::TChangeableMemPool::_::_::_m_arrayPool::_0_::_elem::port_ens_r_obj_sensor_base::_::_m_movObjectInformation::_8_::_m_dWidthN = @Classe_Obj_Sim::obj_data.obj_width[8] * 128;
        break;
    }
    break;
  }
}