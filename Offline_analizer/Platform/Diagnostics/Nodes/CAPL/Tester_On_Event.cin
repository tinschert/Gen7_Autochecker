/*@!Encoding:1252*/
/**
 * @file Tester_On_Event.cin
 * @author ADAS_HIL_TEAM
 * @date 08-21-2023
 * @brief 
 *
 * ################################################################
 * C O P Y R I G H T S
 * ----------------------------------------------------------------
 * Copyright (c) 2023 by Robert Bosch GmbH. All rights reserved.
 
 * The reproduction, distribution and utilization of this file as
 * well as the communication of its contents to others without express
 * authorization is prohibited. Offenders will be held liable for the
 * payment of damages. All rights reserved in the event of the grant
 * of a patent, utility model or design.
 *
 * ################################################################
*/

variables
{
  msTimer tSwitchOffRxLEDTester1;
  msTimer tSwitchOffTxLEDTester1;
  msTimer tSwitchOffErrLEDTester1;
  msTimer tFlashRxLEDTester1;
  msTimer tFlashTxLEDTester1;
  msTimer tFlashErrLEDTester1;
  long gHandleTester1;

  long gECUAddress_Tester1 = 0;
  long gTargetAddress_Tester1 = 0;
  long gTxIdentifier_Tester1 = 0;
  long gRxIdentifier_Tester1 = 0;
}

on timer tSwitchOffRxLEDTester1
{
  // Switch off led for RcvdData
  cancelTimer(tFlashRxLEDTester1);
  @sysvar::DIAG_TESTER::GeneralSettings::sysDataReceivedInd = 0;
}

on timer tSwitchOffTxLEDTester1
{
  cancelTimer(tFlashTxLEDTester1);
  @sysvar::DIAG_TESTER::GeneralSettings::sysDataTransmittedConf = 0;
}

on timer tSwitchOffErrLEDTester1
{
  cancelTimer(tFlashErrLEDTester1);
  @sysvar::DIAG_TESTER::GeneralSettings::sysErrorInd = 0;
}

on timer tFlashRxLEDTester1
{
  // toggle Rx LED
  @sysvar::DIAG_TESTER::GeneralSettings::sysDataReceivedInd = @sysvar::DIAG_TESTER::GeneralSettings::sysDataReceivedInd ? 0 : 1;
}

on timer tFlashTxLEDTester1
{
  // toggle Tx LED
  @sysvar::DIAG_TESTER::GeneralSettings::sysDataTransmittedConf = @sysvar::DIAG_TESTER::GeneralSettings::sysDataTransmittedConf ? 0 : 1;
}

on timer tFlashErrLEDTester1
{
  // toggle Err LED
  @sysvar::DIAG_TESTER::GeneralSettings::sysErrorInd = @sysvar::DIAG_TESTER::GeneralSettings::sysErrorInd ? 0 : 1;
}

on sysVar sysvar::DIAG_TESTER::GeneralSettings::sysTxIdentifier
{
  long addressingMode;
  long extIdFlag;
  
  extIdFlag = 0;

  if (@this == gTxIdentifier_Tester1) {
    //change has already been done in Init function
    return;
  }

  gTxIdentifier_Tester1 = @this;
  addressingMode = CanTpGetAddressingMode(gHandleTester1);

  if (addressingMode == kNormal ||
      addressingMode == kExtendedFree ||
      addressingMode == kMixed11Bit)
  {
    if (@sysvar::DIAG_TESTER::GeneralSettings::sysUseExtId) {
      extIdFlag = 0x80000000;
    }
    CanTpSetTxIdentifier(gHandleTester1, extIdFlag | @this);
    write( "%s, connection %d: Tx Id = 0x%x", gECU, kIdTester1,
                  CanTpGetTxIdentifier(gHandleTester1));
  }
}

on sysVar sysvar::DIAG_TESTER::GeneralSettings::sysTargetAddress
{
  long addressingMode;

  if (@this == gTargetAddress_Tester1) {
    //change has already been done in Init function
    return;
  }

  gTargetAddress_Tester1 = @this;
  addressingMode = CanTpGetAddressingMode(gHandleTester1);

  if (addressingMode == kExtendedBased ||
      addressingMode == kExtendedFree ||
      addressingMode == kNormalFixed ||
      addressingMode == kMixed)
  {
    CanTpSetTargetAddress(gHandleTester1, @this);
    write("%s, connection %d: Target address = 0x%x", gECU, kIdTester1,
                  CanTpGetTargetAddress(gHandleTester1));
  }
}

on sysVar sysvar::DIAG_TESTER::GeneralSettings::sysRxIdentifier
{
  long addressingMode;
  long extIdFlag;
  
  extIdFlag = 0;

  if (@this == gRxIdentifier_Tester1) {
    //change has already been done in Init function
    return;
  }

  gRxIdentifier_Tester1 = @this;
  addressingMode = CanTpGetAddressingMode(gHandleTester1);

  if (addressingMode == kNormal ||
      addressingMode == kExtendedFree ||
      addressingMode == kMixed11Bit)
  {
    if (@sysvar::DIAG_TESTER::GeneralSettings::sysUseExtId) {
      extIdFlag = 0x80000000;
    }
    CanTpSetRxIdentifier(gHandleTester1, extIdFlag | @this);
    write( "%s, connection %d: Rx Id = 0x%x", gECU, kIdTester1,
                  CanTpGetRxIdentifier(gHandleTester1));
  }
}

on sysVar sysvar::DIAG_TESTER::GeneralSettings::sysECUAddress
{
  long addressingMode;

  if (@this == gECUAddress_Tester1) {
    //change has already been done in Init function
    return;
  }

  gECUAddress_Tester1 = @this;
  addressingMode = CanTpGetAddressingMode(gHandleTester1);

  if (addressingMode == kExtendedBased ||
      addressingMode == kExtendedFree ||
      addressingMode == kNormalFixed ||
      addressingMode == kMixed)
  {
    CanTpSetEcuAddress(gHandleTester1, @this);
    write("%s, connection %d: ECU address = 0x%02x", gECU, kIdTester1,
                  CanTpGetEcuAddress(gHandleTester1));
  }
}

on sysVar sysvar::DIAG_TESTER::GeneralSettings::sysAddrMode
{
  InitTester1();
}

on sysVar sysvar::DIAG_TESTER::GeneralSettings::sysBaseAddress
{
  long addressingMode;

  addressingMode = CanTpGetAddressingMode(gHandleTester1);
  if (addressingMode == kExtendedBased)
  {
    CanTpSetBaseIdentifier(gHandleTester1, @this);
    write("%s, connection %d: Base address = 0x%x",
                  gECU, kIdTester1, CanTpGetBaseIdentifier(gHandleTester1));
  }
}

on sysVar sysvar::DIAG_TESTER::GeneralSettings::sysAddrExtension
{
  long addressingMode;

  addressingMode = CanTpGetAddressingMode(gHandleTester1);
  if (addressingMode == kMixed || addressingMode == kMixed11Bit)
  {
    CanTpSetAddressExtension(gHandleTester1, @this);
    write("%s, connection %d: Address extension = %d",
                  gECU, kIdTester1, CanTpGetAddressExtension(gHandleTester1));
  }
}

on sysVar sysvar::DIAG_TESTER::GeneralSettings::sysUseExtId
{
  InitTester1();
}

on sysVar sysvar::DIAG_TESTER::GeneralSettings::sysUseFC
{
  CanTpUseFlowControlFrames(gHandleTester1, @this);
  write("%s, connection %d: Use flow control = %d",
                gECU, kIdTester1, CanTpIsUseFlowControlFrames(gHandleTester1));
}

on sysVar sysvar::DIAG_TESTER::GeneralSettings::sysBlockSize
{
  CanTpSetBlockSize(gHandleTester1, @this);
  write("%s, connection %d: Block size = %d",
                gECU, kIdTester1, CanTpGetBlockSize(gHandleTester1));
}

on sysVar sysvar::DIAG_TESTER::GeneralSettings::sysSTmin
{
  CanTpSetSTmin(gHandleTester1, @this);
  write("%s, connection %d: ST min = %d",
                gECU, kIdTester1, CanTpGetSTmin(gHandleTester1));
}

on sysVar sysvar::DIAG_TESTER::GeneralSettings::sysFlowControlDelay
{
  CanTpSetFlowControlDelay(gHandleTester1, @this);
  write("%s, connection %d: Flow control delay = %d ms",
                gECU, kIdTester1, @this);
}

on sysVar sysvar::DIAG_TESTER::GeneralSettings::sysUseFCBlockSize
{
  CanTpUseFlowControlBlockSize(gHandleTester1, @this);
  write("%s, connection %d: Use FC block size setting in panel = %d",
                gECU, kIdTester1, @this);
  write("%s, connection %d: Use FC block size = %d",
                gECU, kIdTester1, CanTpIsUseFlowControlBlockSize(gHandleTester1));
}

on sysVar sysvar::DIAG_TESTER::GeneralSettings::sysStartSN
{
  CanTpSetFirstSequenceNumber(gHandleTester1, @this);
  write("%s, connection %d: Start SN = %d",
                gECU, kIdTester1, CanTpGetFirstSequenceNumber(gHandleTester1));
}

on sysVar sysvar::DIAG_TESTER::GeneralSettings::sysMaxReceiveLength
{
  CanTpSetMaximumReceiveLength(gHandleTester1, @this);
  write("%s, connection %d: Max. receiver length = %d",
                gECU, kIdTester1, CanTpGetMaximumReceiveLength(gHandleTester1));
}

on sysVar sysvar::DIAG_TESTER::GeneralSettings::sysPaddingValue
{
  CanTpSetPadding(gHandleTester1, @this);
  write("%s, connection %d: Padding value = %d",
                gECU, kIdTester1, CanTpGetPadding(gHandleTester1));
}

on sysVar sysvar::DIAG_TESTER::GeneralSettings::sysBitRateSwitch
{
 
  if( 1 != gbCANFDactive)
  {
    writeDbgLevel( 0, "%s, sysCANFDactive: Cannot configure CAN FD since not active", gECU);
    return;
  }

  CanTpSetBitRateSwitch(gHandleTester1, @this);
  write("%s, connection %d: CAN FD bit rate switch = %d",
                gECU, kIdTester1, @this);
}

on sysVar sysvar::DIAG_TESTER::GeneralSettings::sysMaxFDFrameLen
{
  if( 1 != gbCANFDactive)
  {
    writeDbgLevel( 0, "%s, sysMaxFDFrameLen: Cannot configure CAN FD since not active", gECU);
    return;
  }

  CanTpSetMaxCANFDFrameLength(gHandleTester1, @this);
  if( @this > 0)
    write("%s, connection %d: Max CAN FD frame length = %d",
                  gECU, kIdTester1, @this);
  else
    write("%s, connection %d: Activating CAN 2.0",
                  gECU, kIdTester1);
  
  {
    // Update padding value since the default may have changed
    long paddingValue;
    paddingValue = CanTpGetPadding( gHandleTester1); // same default for all configurations
    writeDbgLevel( 1, "%s, connection %d: Padding value = %d"
    , gECU, kIdTester1, paddingValue);
    @sysvar::DIAG_TESTER::GeneralSettings::sysPaddingValue = paddingValue;
  }
}

on sysVar sysvar::DIAG_TESTER::GeneralSettings::sysSendData
{
  // Prevent from sending when button is released
  if (@this == 0)
      return;

  DirectTxDataLen = GetDataToTransmit(TxDataBuffer);
  StartDiagService( DIRECT_RQ );

}

on sysVar sysvar::DIAG_TESTER::GeneralSettings::sysResetToDefaultSettings
{
  if (@this > 0) {
    ResetToDefaultSettingsTester1();
  }
}

on sysVar sysvar::DIAG_TESTER::sysClearData
{
  if (@this)
  {
     ClearReceivedData();
  }
}

on sysVar sysvar::DIAG_TESTER::sysFillData
{
  long i, txCount;
  byte sendString[kBufferSizeJumbo];
  
  // No action if button is released

  if (@this==0)
      return;

  txCount = @sysvar::DIAG_TESTER::sysNoOfBytesToFill;

  // don't write over array limits
  // limit size to prevent extremely long transfers

  if( txCount>kBufferSizeJumbo)
  {
    txCount=kBufferSizeJumbo;
    @sysvar::DIAG_TESTER::sysNoOfBytesToFill = txCount;
    write("%s: Length of data string to be sent is limited to %d bytes",
                  gECU, kBufferSizeJumbo);
  }

  for( i=0; i<txCount; i++ )
  {
    sendString[i] = '0'+i%75;
  }

  sysSetVariableData(sysvar::DIAG_TESTER::sysDataToTransmit, sendString, txCount);
}

on sysvar sysvar::DIAG_TESTER::sysDataToTransmit
{
  byte sendString[kBufferSizeJumbo];
  
  long copiedBytes;

  if (sysGetVariableArrayLength(this) >= elcount( sendString)) {
    write("%s: Data string to be sent is too large (%d), truncated to %d bytes",
                  gECU, sysGetVariableArrayLength(this), kBufferSizeJumbo);
    sysGetVariableData(this, sendString, copiedBytes);
    sysSetVariableData(this, sendString, elcount( sendString));
    // sysVar handler will be called again
  } else {
    sysGetVariableData(this, sendString, copiedBytes);
    @sysvar::DIAG_TESTER::sysNoOfBytesToSend = copiedBytes;
  }
}

on sysVar sysvar::sysDbgLevel
{
  setwriteDbgLevel(@this);
}

on sysVar sysvar::sysTPVerboseLevel
{
  CanTpSetVerbosity(@this);
}


