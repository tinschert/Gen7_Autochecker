/*@!Encoding:1252*/
/**
 * @file Tester_On_Fuction.cin
 * @author ADAS_HIL_TEAM
 * @date 08-21-2023
 * @brief 
 *
 * ################################################################
 * C O P Y R I G H T S
 * ----------------------------------------------------------------
 * Copyright (c) 2023 by Robert Bosch GmbH. All rights reserved.
 
 * The reproduction, distribution and utilization of this file as
 * well as the communication of its contents to others without express
 * authorization is prohibited. Offenders will be held liable for the
 * payment of damages. All rights reserved in the event of the grant
 * of a patent, utility model or design.
 *
 * ################################################################
*/

includes
{
  #include "Tester_On_Event.cin"//FD3
}

variables
{
  char gECU[10] = "DIAG_TESTER";

  enum AddressModes { kNormal = 0,
                      kExtendedBased = 1,
                      kNormalFixed = 2,
                      kMixed = 3,
                      kMixed11Bit = 4,
                      kExtendedFree = 5
                    };

  const     kBufferSizeJumbo = 256 * 1024;  // Jumbo frames
  const int kDuration_RxLEDOn_ms = 2000;
  const int kDuration_TxLEDOn_ms = 2000;
  const int kDuration_ErrLEDOn_ms = 4000;
  const int kDuration_RxLEDFlashOff_ms = 30000;
  const int kDuration_TxLEDFlashOff_ms = 30000;
  const int kDuration_LEDFlash_ms = 400;
  const int kIdTester1 = 1;
  const int kIdConn2 = 2;
  
  BYTE gbCANFDactive = 0;
 
}

on start
{
  long dbHandle;
  dbHandle = CanTpGetDBConnection();
  if (dbHandle > 0) {
    CanTpCloseConnection(dbHandle);
  }

  setwriteDbgLevel(@sysvar::sysDbgLevel);
  CanTpSetVerbosity(@sysvar::sysTPVerboseLevel);
  
  //InitTester1();

  {
    // Check if CAN FD is active for this bus
    CANSettings arbitration;//abrSettings
    CANSettings data;//dbrSettings
    canFdGetConfiguration( 1, arbitration, data);//channel 1
    gbCANFDactive = ((arbitration.flags & 0x100) != 0 ? 1 : 0);
  }
  
  if( 0 == gbCANFDactive)
  {
    // Disable CAN FD controls when CAN FD is not active
    enableControl( "GeneralConnectionSettings", "cboGeneral_CANFDFrameLen", 0);
    enableControl( "GeneralConnectionSettings", "chkGeneral_CANFDBRS", 0);
    enableControl( "Settings_DIAG_TESTER_Tester1", "cboCANFD_DIAG_TESTER_Tester1", 0);
    enableControl( "Settings_DIAG_TESTER_Tester1", "chkCANFDBRS_DIAG_TESTER_Tester1", 0);
  }
  
  InitTester1();//FD3
}

CanTp_SendCon(long connHandle, dword count)
{
  byte connId;

  if (connHandle == gHandleTester1) {
    connId = kIdTester1;
    SendConTester1();
  } 

  write("%s, connection %d: Send confirmation for %d data bytes",
                gECU, connId, count);
}

CanTp_ReceptionInd(long connHandle, byte data[])
{
  // Output of Source Address
  long rxCount;
  byte connId;

  rxCount = elcount(data);

  if (connHandle == gHandleTester1) {
    connId = kIdTester1;
    ReceptionIndTester1();
  } 

  /* Print message to write window */
  write("%s, connection %d: Reception indication for %d bytes",gECU, connId, rxCount);

  // put data to panel
  SetDataReceived(data, rxCount);

}

CanTp_ErrorInd(long connHandle, long error)
{
  byte connId;

  if (connHandle == gHandleTester1) {
    connId = kIdTester1;
    ErrorIndTester1();
  } 

  switch (error)
  {
    case 1:     
        write("%s, connection %d: Error (%d): Timeout while waiting for CF", gECU, connId, error); 
				sysSetVariableString(sysvar::DIAG_TESTER::sysDataToTransmit_Status, "Timeout while waiting for CF");
				sysSetVariableFloat(sysvar::DIAG_TESTER::sysDataReceived_Time, OSEKTL_GetTimeoutCF());//Pending
				break;
    case 2:    
        write("%s, connection %d: Error (%d): Timeout while waiting for FC", gECU, connId, error);
				sysSetVariableString(sysvar::DIAG_TESTER::sysDataToTransmit_Status,"Timeout while waiting for FC");
				sysSetVariableFloat(sysvar::DIAG_TESTER::sysDataReceived_Time, OSEKTL_GetTimeoutFC());//Pending
				break;
    case 3:    
        write("%s, connection %d: Error (%d): Undefined error", gECU, connId, error);     
				sysSetVariableString(sysvar::DIAG_TESTER::sysDataToTransmit_Status,"Undefined error");
				break;
    case 4:    
        write("%s, connection %d: Error (%d): TP DLL is busy; only one transmission at the same time", gECU, connId, error);     
				sysSetVariableString(sysvar::DIAG_TESTER::sysDataToTransmit_Status,"TP_DLL busy");
				break;
    case 5:    
        write("%s, connection %d: Error (%d): Unexpected PDU received", gECU, connId, error);     
				sysSetVariableString(sysvar::DIAG_TESTER::sysDataToTransmit_Status,"Unexpected PDU received");
				break;
    case 6:    
        write("%s, connection %d: Error (%d): Timeout while trying to send a CAN message", gECU, connId, error);     
				sysSetVariableString(sysvar::DIAG_TESTER::sysDataToTransmit_Status,"Timeout while trying to send a CAN frame");
				break;
    case 7:    
        write("%s, connection %d: Error (%d): Too many wait frames sent", gECU, connId, error);     
				sysSetVariableString(sysvar::DIAG_TESTER::sysDataToTransmit_Status,"Too many wait frames sent");
				break;
    case 8:    
        write("%s, connection %d: Error (%d): Receiver buffer overflow", gECU, connId, error);     
				sysSetVariableString(sysvar::DIAG_TESTER::sysDataToTransmit_Status,"Receiver buffer overflow");
				break;
    case 9:    
        write("%s, connection %d: Error (%d): Wrong parameter", gECU, connId, error);     
				sysSetVariableString(sysvar::DIAG_TESTER::sysDataToTransmit_Status,"Wrong parameter");
				break;
    case 10:    
        write("%s, connection %d: Error (%d): Invalid status in FC frame", gECU, connId, error);     
				sysSetVariableString(sysvar::DIAG_TESTER::sysDataToTransmit_Status,"Invalid status in FC frame");
				break;
    default:    
        write("%s, connection %d: Error (%d): Unknown error", gECU, connId, error);     
				sysSetVariableString(sysvar::DIAG_TESTER::sysDataToTransmit_Status,"Unknown error");
				break;
  }
}

CanTp_FirstFrameInd(long connHandle, dword length)
{
  byte connId;

  if (connHandle == gHandleTester1) {
    connId = kIdTester1;
    setTimerCyclic(tFlashRxLEDTester1, kDuration_LEDFlash_ms);
    setTimer(tSwitchOffRxLEDTester1, kDuration_RxLEDFlashOff_ms);
  } 

  ClearReceivedData();

  write("%s, connection %d: FF indication",
         gECU, connId);
}

void SetDataReceived(byte data[], long rxCount)
{
  int i;
  long copiedBytes;
  rxCount = _min( kBufferSizeJumbo, rxCount);
  memcpy( RxDataBuffer, data, rxCount);
  RxDataBuffer[rxCount] = 0;
  
  if (RxDataBuffer[0]!=127) // response different than Response Pending
	{  
            TxLength=0;
  }
  //to save the RxDataBuffer into ErrValue[] for EnvSetReadDTC
  for (i=0;i<rxCount;i++)
  {
          ErrValue[i]=RxDataBuffer[i];
  }
  //Convert binary ErrValue[] to string ErrString[]
  FillErrString(rxCount);

  RespTime += timeNow();
  RespTime /= 100;

  if(RxDataBuffer[0] != 0x7E)
  {
  //      write("DATA Ind for MPC");		//debugging
          sysSetVariableFloat(sysvar::DIAG_TESTER::sysDataReceived_Time, RespTime);
          sysSetVariableData(sysvar::DIAG_TESTER::sysDataReceived, RxDataBuffer, rxCount);
          @sysvar::DIAG_TESTER::sysNoOfBytesReceived = rxCount;
          sysGetVariableData(sysvar::DIAG_TESTER::sysDataReceived,TxDataBuffer,copiedBytes);     
   EvaluateRxData( rxCount );
   ReceiveBufferLength = rxCount;
   MyEvaluateResponse();
   }

}

long GetDataToTransmit(byte data[])
{
  byte sendString[kBufferSizeJumbo];
  long copiedBytes;
  long count;

  count = 0;
  if (sysGetVariableData(sysvar::DIAG_TESTER::sysDataToTransmit, sendString, copiedBytes) == 0) {
    count=copiedBytes;
    memcpy( data, sendString, count);
  }

  return count;
}

void ClearReceivedData()
{
    long size = 0;
    byte empty_buffer[1] = 0;
    sysSetVariableData(sysvar::DIAG_TESTER::sysDataReceived, empty_buffer, size);
    sysSetVariableData(sysvar::DIAG_TESTER::sysDataToTransmit, empty_buffer, size);
    @sysvar::DIAG_TESTER::sysNoOfBytesReceived = 0;
    @sysvar::DIAG_TESTER::sysNoOfBytesToSend = 0;
}

InitTester1()
{
  long connHandle;
  long addressingMode;
  long extIdFlag;
  
  extIdFlag = 0;

  if (gHandleTester1 > 0) {
    CanTpCloseConnection(gHandleTester1);
  }

  gHandleTester1 = CanTpCreateConnection(@sysvar::DIAG_TESTER::GeneralSettings::sysAddrMode);
  connHandle = gHandleTester1;

  /* Addressing */
  addressingMode = CanTpGetAddressingMode(connHandle);

  switch (addressingMode) {
    case kNormal:        write("%s, connection %d: Addressing mode = Normal", gECU, kIdTester1); break;
    case kExtendedBased: write("%s, connection %d: Addressing mode = Extended (based)", gECU, kIdTester1); break;
    case kNormalFixed:   write("%s, connection %d: Addressing mode = NormalFixed", gECU, kIdTester1); break;
    case kMixed:         write("%s, connection %d: Addressing mode = Mixed", gECU, kIdTester1); break;
    case kMixed11Bit:    write("%s, connection %d: Addressing mode = Mixed (11 bit)", gECU, kIdTester1); break;
    case kExtendedFree:  write("%s, connection %d: Addressing mode = Extended (free)", gECU, kIdTester1); break;
  }

  if (addressingMode == kMixed || addressingMode == kMixed11Bit)
  {
    CanTpSetAddressExtension(connHandle, @sysvar::DIAG_TESTER::GeneralSettings::sysAddrExtension);
  }

  if (addressingMode == kExtendedBased)
  {
    CanTpSetBaseIdentifier(connHandle, @sysvar::DIAG_TESTER::GeneralSettings::sysBaseAddress);
  }


  if (addressingMode == kExtendedBased ||
      addressingMode == kExtendedFree ||
      addressingMode == kNormalFixed ||
      addressingMode == kMixed)
  {
    CanTpSetEcuAddress(connHandle, @sysvar::DIAG_TESTER::GeneralSettings::sysECUAddress);
    CanTpSetTargetAddress(connHandle, @sysvar::DIAG_TESTER::GeneralSettings::sysTargetAddress);
    write("%s, connection %d: ECU address = 0x%02x", gECU, kIdTester1,
                  CanTpGetEcuAddress(connHandle));
    write("%s, connection %d: Target address = 0x%x", gECU, kIdTester1,
                  CanTpGetTargetAddress(connHandle));
  }

  if (addressingMode == kNormal ||
      addressingMode == kExtendedFree ||
      addressingMode == kMixed11Bit)
  {
    if (@sysvar::DIAG_TESTER::GeneralSettings::sysUseExtId) {
      extIdFlag = 0x80000000;
    }
    CanTpSetRxIdentifier(connHandle, extIdFlag | @sysvar::DIAG_TESTER::GeneralSettings::sysRxIdentifier);
    CanTpSetTxIdentifier(connHandle, extIdFlag | @sysvar::DIAG_TESTER::GeneralSettings::sysTxIdentifier);
    write( "%s, connection %d: Rx Id = 0x%x", gECU, kIdTester1,
                  CanTpGetRxIdentifier(connHandle));
    write( "%s, connection %d: Tx Id = 0x%x", gECU, kIdTester1,
                  CanTpGetTxIdentifier(connHandle));
  }

  gECUAddress_Tester1 = @sysvar::DIAG_TESTER::GeneralSettings::sysECUAddress;
  gTargetAddress_Tester1 = @sysvar::DIAG_TESTER::GeneralSettings::sysTargetAddress;
  gTxIdentifier_Tester1 = @sysvar::DIAG_TESTER::GeneralSettings::sysTxIdentifier;
  gRxIdentifier_Tester1 = @sysvar::DIAG_TESTER::GeneralSettings::sysRxIdentifier;
  write("%s, connection %d: Base address = 0x%x",
                gECU, kIdTester1, CanTpGetBaseIdentifier(connHandle));
  write("%s, connection %d: Address extension = %d",
                gECU, kIdTester1, CanTpGetAddressExtension(connHandle));
  write("%s, connection %d: Use extended IDs = %d",gECU, kIdTester1,
                @sysvar::DIAG_TESTER::GeneralSettings::sysUseExtId);

  /* Flow Control */
  CanTpUseFlowControlFrames(connHandle, @sysvar::DIAG_TESTER::GeneralSettings::sysUseFC);
  write("%s, connection %d: Use flow control = %d",
                gECU, kIdTester1, CanTpIsUseFlowControlFrames(connHandle));
  CanTpSetBlockSize(connHandle, @sysvar::DIAG_TESTER::GeneralSettings::sysBlockSize);
  write("%s, connection %d: Block size = %d",
                gECU, kIdTester1, CanTpGetBlockSize(connHandle));
  CanTpSetSTmin(connHandle, @sysvar::DIAG_TESTER::GeneralSettings::sysSTmin);
  write("%s, connection %d: ST min = %d",
                gECU, kIdTester1, CanTpGetSTmin(connHandle));
  CanTpSetFlowControlDelay(connHandle, @sysvar::DIAG_TESTER::GeneralSettings::sysFlowControlDelay);
  write("%s, connection %d: Flow control delay = %d ms",
                gECU, kIdTester1, @sysvar::DIAG_TESTER::GeneralSettings::sysFlowControlDelay);
  CanTpUseFlowControlBlockSize(connHandle, @sysvar::DIAG_TESTER::GeneralSettings::sysUseFCBlockSize);
  write("%s, connection %d: Use FC block size = %d",
                gECU, kIdTester1, CanTpIsUseFlowControlBlockSize(connHandle));

  /* Other settings */
  CanTpSetFirstSequenceNumber(connHandle, @sysvar::DIAG_TESTER::GeneralSettings::sysStartSN);
  write("%s, connection %d: Start SN = %d",
                gECU, kIdTester1, CanTpGetFirstSequenceNumber(connHandle));
  CanTpSetPadding(connHandle, @sysvar::DIAG_TESTER::GeneralSettings::sysPaddingValue);
  write("%s, connection %d: Padding value = %d",
                gECU, kIdTester1, CanTpGetPadding(connHandle));
  CanTpSetMaximumReceiveLength(connHandle, @sysvar::DIAG_TESTER::GeneralSettings::sysMaxReceiveLength);
  write("%s, connection %d: Max. receiver length = %d",
                gECU, kIdTester1, CanTpGetMaximumReceiveLength(connHandle));

  /* CAN FD */

  if( 1 == gbCANFDactive)
  {
    CanTpSetMaxCANFDFrameLength( connHandle, @sysvar::DIAG_TESTER::GeneralSettings::sysMaxFDFrameLen);
    write("%s, connection %d: Max. CAN FD frame length = %d",
                  gECU, kIdTester1, @sysvar::DIAG_TESTER::GeneralSettings::sysMaxFDFrameLen);

    CanTpSetBitRateSwitch( connHandle, @sysvar::DIAG_TESTER::GeneralSettings::sysBitRateSwitch);
    write("%s, connection %d: Bit rate switch = %d",
                  gECU, kIdTester1, @sysvar::DIAG_TESTER::GeneralSettings::sysBitRateSwitch);
  }
//  CanTpWriteConnectionSettings(connHandle);
}

void ResetToDefaultSettingsTester1()
{
  //addressing
  @sysvar::DIAG_TESTER::GeneralSettings::sysAddrMode =         @sysvar::DIAG_TESTER::DefaultSettings::sysAddrMode;
  @sysvar::DIAG_TESTER::GeneralSettings::sysBaseAddress =      @sysvar::DIAG_TESTER::DefaultSettings::sysBaseAddress;
  @sysvar::DIAG_TESTER::GeneralSettings::sysAddrExtension =    @sysvar::DIAG_TESTER::DefaultSettings::sysAddrExtension;
  @sysvar::DIAG_TESTER::GeneralSettings::sysUseExtId =         @sysvar::DIAG_TESTER::DefaultSettings::sysUseExtId;

  // flow control
  @sysvar::DIAG_TESTER::GeneralSettings::sysUseFC =            @sysvar::DIAG_TESTER::DefaultSettings::sysUseFC;
  @sysvar::DIAG_TESTER::GeneralSettings::sysBlockSize =        @sysvar::DIAG_TESTER::DefaultSettings::sysBlockSize;
  @sysvar::DIAG_TESTER::GeneralSettings::sysSTmin =            @sysvar::DIAG_TESTER::DefaultSettings::sysSTmin;
  @sysvar::DIAG_TESTER::GeneralSettings::sysFlowControlDelay = @sysvar::DIAG_TESTER::DefaultSettings::sysFlowControlDelay;
  @sysvar::DIAG_TESTER::GeneralSettings::sysUseFCBlockSize =   @sysvar::DIAG_TESTER::DefaultSettings::sysUseFCBlockSize;

  // miscellaneous
  @sysvar::DIAG_TESTER::GeneralSettings::sysStartSN =          @sysvar::DIAG_TESTER::DefaultSettings::sysStartSN;
  @sysvar::DIAG_TESTER::GeneralSettings::sysMaxReceiveLength = @sysvar::DIAG_TESTER::DefaultSettings::sysMaxReceiveLength;
  @sysvar::DIAG_TESTER::GeneralSettings::sysPaddingValue =     @sysvar::DIAG_TESTER::DefaultSettings::sysPaddingValue;
  @sysvar::DIAG_TESTER::GeneralSettings::sysMaxFDFrameLen =    @sysvar::DIAG_TESTER::DefaultSettings::sysMaxFDFrameLen;
  @sysvar::DIAG_TESTER::GeneralSettings::sysBitRateSwitch =    @sysvar::DIAG_TESTER::DefaultSettings::sysBitRateSwitch;
}

void ErrorIndTester1()
{
  @sysvar::DIAG_TESTER::GeneralSettings::sysErrorInd = 1;
  setTimerCyclic(tFlashErrLEDTester1, kDuration_LEDFlash_ms);
  setTimer(tSwitchOffErrLEDTester1, kDuration_ErrLEDOn_ms);
  cancelTimer(tFlashRxLEDTester1);
  cancelTimer(tFlashTxLEDTester1);
  @sysvar::DIAG_TESTER::GeneralSettings::sysDataReceivedInd = 0;
  @sysvar::DIAG_TESTER::GeneralSettings::sysDataTransmittedConf = 0;
}

void ReceptionIndTester1()
{
  @sysvar::DIAG_TESTER::GeneralSettings::sysDataReceivedInd = 1;
  cancelTimer(tFlashRxLEDTester1);
  setTimer(tSwitchOffRxLEDTester1, kDuration_RxLEDOn_ms);
}

void SendConTester1()
{
  @sysvar::DIAG_TESTER::GeneralSettings::sysDataTransmittedConf = 1;
  cancelTimer(tFlashTxLEDTester1);
  setTimer(tSwitchOffTxLEDTester1, kDuration_TxLEDOn_ms);
}
