/*@!Encoding:1252*/
/**
 * @file cm_target_ctrl.cin
 * @author ADAS_HIL_TEAM
 * @date 09-11-2023
 * @brief 
 *
 * ################################################################
 * C O P Y R I G H T S
 * ----------------------------------------------------------------
 * Copyright (c) 2023 by Robert Bosch GmbH. All rights reserved.
 
 * The reproduction, distribution and utilization of this file as
 * well as the communication of its contents to others without express
 * authorization is prohibited. Offenders will be held liable for the
 * payment of damages. All rights reserved in the event of the grant
 * of a patent, utility model or design.
 *
 * ################################################################
*/

includes
{
}

variables
{
  mstimer trigger_tgt_collision_cross_tmr;
  mstimer trigger_tgt_collision_turncross_tmr;
  mstimer trigger_tgt_collision_turnlong_tmr;
  mstimer trigger_tgt_collision_oncoming_tmr;
  mstimer trigger_tgt_collision_blindspot_tmr;
  
  const long MAX_NBR_OF_TARGET_OBJ = 11;
  
  char g_cm_dva_long_vel_ctrl[MAX_NBR_OF_TARGET_OBJ][64] = {
    "RB.TrafficObj.object0.LongVel",
    "RB.TrafficObj.object1.LongVel",
    "RB.TrafficObj.object2.LongVel",
    "RB.TrafficObj.object3.LongVel",
    "RB.TrafficObj.object4.LongVel",
    "RB.TrafficObj.object5.LongVel",
    "RB.TrafficObj.object6.LongVel",
    "RB.TrafficObj.object7.LongVel",
    "RB.TrafficObj.object8.LongVel",
    "RB.TrafficObj.object9.LongVel",
    "RB.TrafficObj.object10.LongVel"
  };
  
  char g_cm_dva_lat_offset_ctrl[MAX_NBR_OF_TARGET_OBJ][64] = {
    "RB.TrafficObj.object0.tRoad",
    "RB.TrafficObj.object1.tRoad",
    "RB.TrafficObj.object2.tRoad",
    "RB.TrafficObj.object3.tRoad",
    "RB.TrafficObj.object4.tRoad",
    "RB.TrafficObj.object5.tRoad",
    "RB.TrafficObj.object6.tRoad",
    "RB.TrafficObj.object7.tRoad",
    "RB.TrafficObj.object8.tRoad",
    "RB.TrafficObj.object9.tRoad",
    "RB.TrafficObj.object10.tRoad"
  };
  
  char g_cm_dva_long_offset_ctrl[MAX_NBR_OF_TARGET_OBJ][64] = {
    "RB.TrafficObj.object0.sRoad",
    "RB.TrafficObj.object1.sRoad",
    "RB.TrafficObj.object2.sRoad",
    "RB.TrafficObj.object3.sRoad",
    "RB.TrafficObj.object4.sRoad",
    "RB.TrafficObj.object5.sRoad",
    "RB.TrafficObj.object6.sRoad",
    "RB.TrafficObj.object7.sRoad",
    "RB.TrafficObj.object8.sRoad",
    "RB.TrafficObj.object9.sRoad",
    "RB.TrafficObj.object10.sRoad"
  };
  
  char g_cm_dva_obj_target_pos_x[MAX_NBR_OF_TARGET_OBJ][64] = {
    "RB.TrafficObj.object0.dtx",
    "RB.TrafficObj.object1.dtx",
    "RB.TrafficObj.object2.dtx",
    "RB.TrafficObj.object3.dtx",
    "RB.TrafficObj.object4.dtx",
    "RB.TrafficObj.object5.dtx",
    "RB.TrafficObj.object6.dtx",
    "RB.TrafficObj.object7.dtx",
    "RB.TrafficObj.object8.dtx",
    "RB.TrafficObj.object9.dtx",
    "RB.TrafficObj.object10.dtx"
  };
  
  char g_cm_dva_obj_target_pos_y[MAX_NBR_OF_TARGET_OBJ][64] = {
    "RB.TrafficObj.object0.dty",
    "RB.TrafficObj.object1.dty",
    "RB.TrafficObj.object2.dty",
    "RB.TrafficObj.object3.dty",
    "RB.TrafficObj.object4.dty",
    "RB.TrafficObj.object5.dty",
    "RB.TrafficObj.object6.dty",
    "RB.TrafficObj.object7.dty",
    "RB.TrafficObj.object8.dty",
    "RB.TrafficObj.object9.dty",
    "RB.TrafficObj.object10.dty"
  };
  
  char g_cm_dva_obj_target_pos_z[MAX_NBR_OF_TARGET_OBJ][64] = {
    "RB.TrafficObj.object0.dtz",
    "RB.TrafficObj.object1.dtz",
    "RB.TrafficObj.object2.dtz",
    "RB.TrafficObj.object3.dtz",
    "RB.TrafficObj.object4.dtz",
    "RB.TrafficObj.object5.dtz",
    "RB.TrafficObj.object6.dtz",
    "RB.TrafficObj.object7.dtz",
    "RB.TrafficObj.object8.dtz",
    "RB.TrafficObj.object9.dtz",
    "RB.TrafficObj.object10.dtz"
  };
  
  char g_cm_dva_obj_target_rot_z[MAX_NBR_OF_TARGET_OBJ][64] = {
    "RB.TrafficObj.object0.drz",
    "RB.TrafficObj.object1.drz",
    "RB.TrafficObj.object2.drz",
    "RB.TrafficObj.object3.drz",
    "RB.TrafficObj.object4.drz",
    "RB.TrafficObj.object5.drz",
    "RB.TrafficObj.object6.drz",
    "RB.TrafficObj.object7.drz",
    "RB.TrafficObj.object8.drz",
    "RB.TrafficObj.object9.drz",
    "RB.TrafficObj.object10.drz"
  };

  char g_cm_dva_obj_target_steering_wheel_angle[MAX_NBR_OF_TARGET_OBJ][64] = {
    "RB.TrafficObj.object0.SteerAng",
    "RB.TrafficObj.object1.SteerAng",
    "RB.TrafficObj.object2.SteerAng",
    "RB.TrafficObj.object3.SteerAng",
    "RB.TrafficObj.object4.SteerAng",
    "RB.TrafficObj.object5.SteerAng",
    "RB.TrafficObj.object6.SteerAng",
    "RB.TrafficObj.object7.SteerAng",
    "RB.TrafficObj.object8.SteerAng",
    "RB.TrafficObj.object9.SteerAng",
    "RB.TrafficObj.object10.SteerAng"
  };
  
  char g_cm_dva_obj_long_maneuver_step_id[MAX_NBR_OF_TARGET_OBJ][64] = {
    "RB.TrafficObj.object0.Long.StepIdx",
    "RB.TrafficObj.object1.Long.StepIdx",
    "RB.TrafficObj.object2.Long.StepIdx",
    "RB.TrafficObj.object3.Long.StepIdx",
    "RB.TrafficObj.object4.Long.StepIdx",
    "RB.TrafficObj.object5.Long.StepIdx",
    "RB.TrafficObj.object6.Long.StepIdx",
    "RB.TrafficObj.object7.Long.StepIdx",
    "RB.TrafficObj.object8.Long.StepIdx",
    "RB.TrafficObj.object9.Long.StepIdx",
    "RB.TrafficObj.object10.Long.StepIdx"
  };
  
  char g_cm_dva_obj_lat_maneuver_step_id[MAX_NBR_OF_TARGET_OBJ][64] = {
    "RB.TrafficObj.object0.Lat.StepIdx",
    "RB.TrafficObj.object1.Lat.StepIdx",
    "RB.TrafficObj.object2.Lat.StepIdx",
    "RB.TrafficObj.object3.Lat.StepIdx",
    "RB.TrafficObj.object4.Lat.StepIdx",
    "RB.TrafficObj.object5.Lat.StepIdx",
    "RB.TrafficObj.object6.Lat.StepIdx",
    "RB.TrafficObj.object7.Lat.StepIdx",
    "RB.TrafficObj.object8.Lat.StepIdx",
    "RB.TrafficObj.object9.Lat.StepIdx",
    "RB.TrafficObj.object10.Lat.StepIdx"
  };
  
  char g_cm_dva_obj_dil_status[MAX_NBR_OF_TARGET_OBJ][64] = {
    "RB.TrafficObj.object0.DILStatus",
    "RB.TrafficObj.object1.DILStatus",
    "RB.TrafficObj.object2.DILStatus",
    "RB.TrafficObj.object3.DILStatus",
    "RB.TrafficObj.object4.DILStatus",
    "RB.TrafficObj.object5.DILStatus",
    "RB.TrafficObj.object6.DILStatus",
    "RB.TrafficObj.object7.DILStatus",
    "RB.TrafficObj.object8.DILStatus",
    "RB.TrafficObj.object9.DILStatus",
    "RB.TrafficObj.object10.DILStatus"
  };
  
  char g_cm_dva_obj_ind_light[MAX_NBR_OF_TARGET_OBJ][64] = {
    "RB.TrafficObj.object0.IndLight",
    "RB.TrafficObj.object1.IndLight",
    "RB.TrafficObj.object2.IndLight",
    "RB.TrafficObj.object3.IndLight",
    "RB.TrafficObj.object4.IndLight",
    "RB.TrafficObj.object5.IndLight",
    "RB.TrafficObj.object6.IndLight",
    "RB.TrafficObj.object7.IndLight",
    "RB.TrafficObj.object8.IndLight",
    "RB.TrafficObj.object9.IndLight",
    "RB.TrafficObj.object10.IndLight"
  };
  
  char g_cm_dva_obj_low_beam[MAX_NBR_OF_TARGET_OBJ][64] = {
    "RB.TrafficObj.object0.LowBeam",
    "RB.TrafficObj.object1.LowBeam",
    "RB.TrafficObj.object2.LowBeam",
    "RB.TrafficObj.object3.LowBeam",
    "RB.TrafficObj.object4.LowBeam",
    "RB.TrafficObj.object5.LowBeam",
    "RB.TrafficObj.object6.LowBeam",
    "RB.TrafficObj.object7.LowBeam",
    "RB.TrafficObj.object8.LowBeam",
    "RB.TrafficObj.object9.LowBeam",
    "RB.TrafficObj.object10.LowBeam"
  };
  
  char g_cm_dva_obj_high_beam[MAX_NBR_OF_TARGET_OBJ][64] = {
    "RB.TrafficObj.object0.HighBeam",
    "RB.TrafficObj.object1.HighBeam",
    "RB.TrafficObj.object2.HighBeam",
    "RB.TrafficObj.object3.HighBeam",
    "RB.TrafficObj.object4.HighBeam",
    "RB.TrafficObj.object5.HighBeam",
    "RB.TrafficObj.object6.HighBeam",
    "RB.TrafficObj.object7.HighBeam",
    "RB.TrafficObj.object8.HighBeam",
    "RB.TrafficObj.object9.HighBeam",
    "RB.TrafficObj.object10.HighBeam"
  };
  
  struct{
    long pos_x;
    long pos_y;
    long pos_z;
    long rot_z;
    long steer_wheel_angle;
  }g_target_ctrl_status[MAX_NBR_OF_TARGET_OBJ];
  
  float RADIAN_IN_DEGREE = 180/PI;
}

on sysvar hil_ctrl::trigger_tgt_collision_cross
{
    switch (@this)
    {
    case 0:
      setTimerCyclic(trigger_tgt_collision_cross_tmr,20);
      break;
    case 255:
      canceltimer(trigger_tgt_collision_cross_tmr);
      break;
    }
}

on timer trigger_tgt_collision_cross_tmr
{
  @Classe_Obj_Sim::obj_ctrl.obj_target_v_long[0] = calc_vel_tgt_cross(@CarMaker::RB::TrafficObj::object0::rel_dy, @CarMaker::RB::TrafficObj::object0::rel_vx, @CarMaker::RB::TrafficObj::object0::rel_dx - 5);
}

on sysvar hil_ctrl::trigger_tgt_collision_turncross
{
    switch (@this)
    {
    case 0:
      setTimerCyclic(trigger_tgt_collision_turncross_tmr,20);
      break;
    case 255:
      canceltimer(trigger_tgt_collision_turncross_tmr);
      break;
    }
}

on timer trigger_tgt_collision_turncross_tmr
{
   @Classe_Obj_Sim::obj_ctrl.obj_target_v_long[0] = calc_vel_tgt_turncross(@Classe_Obj_Sim::obj_ctrl.obj_target_pos_x[0], @Classe_Obj_Sim::obj_ctrl.obj_target_pos_y[0], @hil_hvm::velocity_x);
}

on sysvar hil_ctrl::trigger_tgt_collision_turnlong
{
    switch (@this)
    {
    case 0:
      setTimerCyclic(trigger_tgt_collision_turnlong_tmr,20);
      break;
    case 255:
      canceltimer(trigger_tgt_collision_turnlong_tmr);
      break;
    }
}

on timer trigger_tgt_collision_turnlong_tmr
{
   @Classe_Obj_Sim::obj_ctrl.obj_target_v_long[0] = calc_vel_tgt_turnlong(@CarMaker::Vhcl::Distance, @Classe_Obj_Sim::obj_ctrl.obj_v_long[0], @hil_hvm::velocity_x, @Classe_Obj_Sim::obj_ctrl.obj_target_pos_x[0]-4);
}

on timer trigger_tgt_collision_oncoming_tmr
{
   @Classe_Obj_Sim::obj_ctrl.obj_target_v_long[0] = calc_vel_tgt_oncoming(@CarMaker::Vhcl::Distance, @Classe_Obj_Sim::obj_ctrl.obj_v_long[0], @hil_hvm::velocity_x, @Classe_Obj_Sim::obj_ctrl.obj_target_pos_x[0]-4);
}

on sysvar hil_ctrl::trigger_tgt_collision_oncoming
{
    switch (@this)
    {
    case 0:
      setTimerCyclic(trigger_tgt_collision_oncoming_tmr,20);
      break;
    case 255:
      canceltimer(trigger_tgt_collision_oncoming_tmr);
      break;
    }
}

on timer trigger_tgt_collision_blindspot_tmr
{
   @Classe_Obj_Sim::obj_ctrl.obj_target_v_long[0] = calc_vel_tgt_blindspot(@hil_hvm::velocity_x);
   @Classe_Obj_Sim::obj_ctrl.obj_target_v_long[2] = calc_vel_tgt_blindspot(@hil_hvm::velocity_x);
}

on sysvar hil_ctrl::trigger_tgt_collision_blindspot
{
    switch (@this)
    {
    case 0:
      setTimerCyclic(trigger_tgt_collision_blindspot_tmr,20);
      break;
    case 255:
      canceltimer(trigger_tgt_collision_blindspot_tmr);
      break;
    }
}

/**
  * Calculation of target velocity for target crossing
  * Collision for AEB
  */
double calc_vel_tgt_cross(double dy_tgt, double vx_relative_tgt, double dx_tgt)
{
  double v_tgt = 0;
  
  v_tgt = (dy_tgt * vx_relative_tgt) / dx_tgt;
  v_tgt = abs(v_tgt * 3.6); // used absolute velocity to match carmaker orientation path
  return v_tgt;
}

/**
  * Calculation of target velocity for ego turn target crossing
  * Collision for AEB
  */
double calc_vel_tgt_turncross(double dx_tgt, double dy_tgt, double v_ego)
{
  double v_tgt = 0;
  
//  v_tgt = ((dx_tgt-dx_crossing) * vy_relative_tgt) / dy_tgt;
  v_tgt = (((v_ego/3.6)*2.5) / (sqrt((dx_tgt*dx_tgt)+(dy_tgt*dy_tgt))));
  v_tgt = v_tgt * 3.6;
  return v_tgt;
}


/**
  * Calculation of target velocity for ego turn target long
  * Collision for AEB
  */
double calc_vel_tgt_turnlong(double travelled_dist_ego, double vx_relative_tgt, double v_ego, double tgt_dx)
{
  double v_tgt = 0;
  
  v_tgt = ((110- (220- tgt_dx - travelled_dist_ego)) * (v_ego/3.6)) / (110 - travelled_dist_ego);
  v_tgt = v_tgt * 3.6;
  return v_tgt;
}

/**
  * Calculation of target velocity for target oncoming
  * Collision for AEB
  */
double calc_vel_tgt_oncoming(double travelled_dist_ego, double vx_relative_tgt, double v_ego, double tgt_dx)
{
  double v_tgt = 0;
  
    v_tgt = ((110- (220- tgt_dx - travelled_dist_ego)) * (v_ego/3.6)) / (110 - travelled_dist_ego);
  
  v_tgt = v_tgt * 3.6;
  return v_tgt;
}

double calc_vel_tgt_blindspot(double v_ego)
{
  double v_tgt = 0;
  
  v_tgt = v_ego;
  
  return v_tgt;
}

void cm_target_ctrl_on()
{
  long obj_id;
  long nbr_of_obj;
  
  nbr_of_obj = _min(MAX_NBR_OF_TARGET_OBJ, @Classe_Obj_Sim::obj_ctrl.nbr_of_obj);
  
  for(obj_id=0;obj_id<nbr_of_obj;obj_id++)
  {
    cm_target_ctrl_velocity_ctrl(obj_id);
    cm_target_ctrl_light_ctrl(obj_id);
    cm_target_ctrl_lane_lat_offset_ctrl(obj_id);
    cm_target_ctrl_lane_long_offset_ctrl(obj_id);
    cm_target_ctrl_manuever_lat_ctrl(obj_id);
    cm_target_ctrl_manuever_long_ctrl(obj_id);
    cm_target_ctrl_position_ctrl(obj_id);
    cm_target_ctrl_rotation_ctrl(obj_id);
    cm_target_ctrl_steering_wheel_angle_ctrl(obj_id);
    // DIL ctrl
    CarMaker_WriteAbs(g_cm_dva_obj_dil_status[obj_id], 5, @Classe_Obj_Sim::obj_ctrl.dil_ctrl_is_on[obj_id]);
  }
}

void cm_target_ctrl_velocity_ctrl(long obj_id)
{
  if(@Classe_Obj_Sim::obj_ctrl.ctrl_status_velocity[obj_id] == 1)
  {
    CarMaker_WriteAbs(g_cm_dva_long_vel_ctrl[obj_id], 5, @Classe_Obj_Sim::obj_ctrl.obj_v_long[obj_id]/3.6);
  }
}

void cm_target_ctrl_light_ctrl(long obj_id)
{
  if(@Classe_Obj_Sim::obj_ctrl.obj_light_ctrl[obj_id] == 1)
  {
    CarMaker_WriteAbs(g_cm_dva_obj_low_beam[obj_id], 5, @Classe_Obj_Sim::obj_ctrl.obj_low_beam[obj_id]);
    CarMaker_WriteAbs(g_cm_dva_obj_high_beam[obj_id], 5, @Classe_Obj_Sim::obj_ctrl.obj_high_beam[obj_id]);
    CarMaker_WriteAbs(g_cm_dva_obj_ind_light[obj_id], 5, @Classe_Obj_Sim::obj_ctrl.obj_indicator_light[obj_id]);
  }
}

void cm_target_ctrl_lane_lat_offset_ctrl(long obj_id)
{
  if(@Classe_Obj_Sim::obj_ctrl.ctrl_status_lane_lat_offset[obj_id] == 1)
  {
    CarMaker_WriteAbs(g_cm_dva_lat_offset_ctrl[obj_id], 5, @Classe_Obj_Sim::obj_ctrl.obj_lane_lat_offset[obj_id]);
  }
}

void cm_target_ctrl_lane_long_offset_ctrl(long obj_id)
{
  if(@Classe_Obj_Sim::obj_ctrl.ctrl_status_lane_long_offset[obj_id] == 1)
  {
    CarMaker_WriteAbs(g_cm_dva_long_offset_ctrl[obj_id], 5, @Classe_Obj_Sim::obj_ctrl.obj_lane_long_offset[obj_id]);
  }
}

void cm_target_ctrl_manuever_long_ctrl(long obj_id)
{
  if(@Classe_Obj_Sim::obj_ctrl.ctrl_status_maneveur_long[obj_id] == 1)
  {
    CarMaker_WriteAbs(g_cm_dva_obj_long_maneuver_step_id[obj_id], 5, @Classe_Obj_Sim::obj_ctrl.obj_maneuver_long_step_id[obj_id]);
  }
}

void cm_target_ctrl_manuever_lat_ctrl(long obj_id)
{
  if(@Classe_Obj_Sim::obj_ctrl.ctrl_status_maneveur_lat[obj_id] == 1)
  {
    CarMaker_WriteAbs(g_cm_dva_obj_lat_maneuver_step_id[obj_id], 5, @Classe_Obj_Sim::obj_ctrl.obj_maneuver_lat_step_id[obj_id]);
  }
}

void cm_target_ctrl_position_ctrl(long obj_id)
{
  if(@Classe_Obj_Sim::obj_ctrl.ctrl_status_pos_x[obj_id] == 1)
  {
    CarMaker_WriteAbs(g_cm_dva_obj_target_pos_x[obj_id], -1, @Classe_Obj_Sim::obj_ctrl.obj_target_pos_x[obj_id]);
    g_target_ctrl_status[obj_id].pos_x = 1;
  }
  else
  {
    if(g_target_ctrl_status[obj_id].pos_x == 1)
    {
      CarMaker_WriteAbs(g_cm_dva_obj_target_pos_x[obj_id], 0, @Classe_Obj_Sim::obj_ctrl.obj_target_pos_x[obj_id]);
    }
    g_target_ctrl_status[obj_id].pos_x = 0;
  }

  if(@Classe_Obj_Sim::obj_ctrl.ctrl_status_pos_y[obj_id] == 1)
  {
    CarMaker_WriteAbs(g_cm_dva_obj_target_pos_y[obj_id], -1, @Classe_Obj_Sim::obj_ctrl.obj_target_pos_y[obj_id]);
    g_target_ctrl_status[obj_id].pos_y = 1;
  }
  else
  {
    if(g_target_ctrl_status[obj_id].pos_y == 1)
    {
      CarMaker_WriteAbs(g_cm_dva_obj_target_pos_y[obj_id], 0, @Classe_Obj_Sim::obj_ctrl.obj_target_pos_y[obj_id]);
    }
    g_target_ctrl_status[obj_id].pos_y = 0;
  }
  
  if(@Classe_Obj_Sim::obj_ctrl.ctrl_status_pos_z[obj_id] == 1)
  {
    CarMaker_WriteAbs(g_cm_dva_obj_target_pos_z[obj_id], -1, @Classe_Obj_Sim::obj_ctrl.obj_target_pos_z[obj_id]);
    g_target_ctrl_status[obj_id].pos_z = 1;
  }
  else
  {
    if(g_target_ctrl_status[obj_id].pos_z == 1)
    {
      CarMaker_WriteAbs(g_cm_dva_obj_target_pos_z[obj_id], 0, @Classe_Obj_Sim::obj_ctrl.obj_target_pos_z[obj_id]);
    }
    g_target_ctrl_status[obj_id].pos_z = 0;
  }
}

void cm_target_ctrl_rotation_ctrl(long obj_id)
{
  if(@Classe_Obj_Sim::obj_ctrl.ctrl_status_rot_z[obj_id] == 1)
  {
    CarMaker_WriteAbs(g_cm_dva_obj_target_rot_z[obj_id], -1, @Classe_Obj_Sim::obj_ctrl.obj_target_rot_z[obj_id] / RADIAN_IN_DEGREE);
    g_target_ctrl_status[obj_id].rot_z = 1;
  }
  else
  {
    if(g_target_ctrl_status[obj_id].rot_z == 1)
    {
      CarMaker_WriteAbs(g_cm_dva_obj_target_rot_z[obj_id], 0, @Classe_Obj_Sim::obj_ctrl.obj_target_rot_z[obj_id] / RADIAN_IN_DEGREE);
    }
    g_target_ctrl_status[obj_id].rot_z = 0;
  }
}

void cm_target_ctrl_steering_wheel_angle_ctrl(long obj_id)
{
  if(@Classe_Obj_Sim::obj_ctrl.ctrl_status_tgt_steering_wheel_angle[obj_id] == 1)
  {
    CarMaker_WriteAbs(g_cm_dva_obj_target_steering_wheel_angle[obj_id], -1, @Classe_Obj_Sim::obj_ctrl.par_swa_rwa_factor * @Classe_Obj_Sim::obj_ctrl.obj_tgt_steering_wheel_angle[obj_id] / RADIAN_IN_DEGREE);
    g_target_ctrl_status[obj_id].steer_wheel_angle = 1;
  }
  else
  {
    if(g_target_ctrl_status[obj_id].steer_wheel_angle == 1)
    {
      CarMaker_WriteAbs(g_cm_dva_obj_target_steering_wheel_angle[obj_id], 0, @Classe_Obj_Sim::obj_ctrl.par_swa_rwa_factor * @Classe_Obj_Sim::obj_ctrl.obj_tgt_steering_wheel_angle[obj_id] / RADIAN_IN_DEGREE);
    }
    g_target_ctrl_status[obj_id].steer_wheel_angle = 0;
  }
}