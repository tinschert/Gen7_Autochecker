/*@!Encoding:1252*/
/**
 * @file copy_cm_project.can
 * @author ADAS_HIL_TEAM
 * @date 08-21-2023
 * @brief 
 *
 * ################################################################
 * C O P Y R I G H T S
 * ----------------------------------------------------------------
 * Copyright (c) 2023 by Robert Bosch GmbH. All rights reserved.
 
 * The reproduction, distribution and utilization of this file as
 * well as the communication of its contents to others without express
 * authorization is prohibited. Offenders will be held liable for the
 * payment of damages. All rights reserved in the event of the grant
 * of a patent, utility model or design.
 *
 * ################################################################
*/

includes
{
}

variables
{
  char absfilePath[256];
  char absdirPath[256];
  msTimer cf_modify_tmr, copy_tmr, cm_tmr, mvnx_fvideo_tmr, mvnx_svs_tmr, mvnx_status_timer, cm_runtime_error_tmr, mvnx_fps_timer, copy_from_shared;
  int wait_time = 1000; 
  int bufferLength = 256;
  char buf[256];
  char buf_cm[256];
  char buf_mvnx_fv[256];
  char buf_mvnx_svs[256];
  char buf_mvnx_status[256];
  char buf_cm_error_message[256];
  char buf_mvnx_fps[256];
  char buf_copy_back[256];
  char params[256];
  char cm_error_buf[256];
  int64 buf_svs_sensors, buf_uss_sensor;
  dword fh,fh_modify,fh_cm, fh_mvnx_fv, fh_mvnx_svs, fh_mvnx_status, fh_error_log, fh_fps_status, fh_copy_repo;
  long status, status_cm, status_mvnx_fv, status_mvnx_svs, status_mvnx, status_fps_mvnx, status_copy_from_rt;
  long timeout_max = 600000; // Copy timer timeout to 10 minutes
  long timeout_apps = 600000; // Timeout for starting MovieNX/CarMaker (10 min)
  long check_timeout = 0;
}


on sysvar hil_ctrl::hil_mode
{
    if (@hil_ctrl::simulated_bus_mode==0)
    {
      write("Execution with RT Rack");
      if (@this == Carmaker && @hil_ctrl::init_rbs==0)
        {	
		      sysGetVariableLongLong(sysVar::hil_ctrl::svs_cameras_sim,buf_svs_sensors);          
          sysGetVariableLongLong(sysVar::hil_ctrl::ultrasonic_sensors_sim,buf_uss_sensor);
          snprintf(params,elcount(params),"%d %d", buf_svs_sensors, buf_uss_sensor);
            
          getAbsFilePath("Platform\\Classe\\Scripts\\CarMaker_scripts\\modify_carfiles.bat", absfilePath, 256);
          getAbsFilePath("Platform\\Classe\\Scripts\\CarMaker_scripts", absdirPath, 256);
          write("Command to be called is :: %s %s %s", absfilePath, params, absdirPath); 
          sysExec(absfilePath, params, absdirPath);
          setTimerCyclic(cf_modify_tmr,wait_time,wait_time);
          
          getAbsFilePath("Platform\\Classe\\Scripts\\CarMaker_scripts\\start_client.bat check_connection", absfilePath, 256);
          getAbsFilePath("Platform\\Classe\\Scripts\\CarMaker_scripts", absdirPath, 256);
          sysExec(absfilePath, absdirPath);		     
          setTimerCyclic(mvnx_status_timer,wait_time,wait_time);
          getAbsFilePath("Platform\\Classe\\Scripts\\CarMaker_scripts\\copy_Carmker_project.bat", absfilePath, 256);
          getAbsFilePath("Platform\\Classe\\Scripts\\CarMaker_scripts", absdirPath, 256);
          sysExec(absfilePath, absdirPath);
          setTimerCyclic(copy_tmr,wait_time,wait_time);
          setTimerCyclic(cm_tmr,wait_time,wait_time);
        } 
    }
    else if (@hil_ctrl::simulated_bus_mode==1)
    {
      if (@this == Carmaker && @hil_ctrl::init_rbs==0)
        {	
        write("Execution without RT Rack");
        setTimerCyclic(copy_tmr,wait_time,wait_time);
        setTimerCyclic(cm_tmr,wait_time,wait_time);
        }
    }
}

on preStop
{
    if (@hil_ctrl::simulated_bus_mode==0 && @hil_ctrl::abort_msg_movienx == 1)
    {
      getAbsFilePath("Platform\\Classe\\Scripts\\CarMaker_scripts\\start_client.bat terminate_movienx all_instances", absfilePath, 256);
      getAbsFilePath("Platform\\Classe\\Scripts\\CarMaker_scripts", absdirPath, 256);
      sysExec(absfilePath, absdirPath);      
    }
}

on timer cf_modify_tmr
{
  if (@hil_ctrl::simulated_bus_mode==0)
  {
      fh_modify = openFileRead("D:\\CarMaker_Shared\\cf_modify_done.txt",0);
      fileGetString(buf,bufferLength,fh);
      fileClose(fh_modify);
      check_timeout += wait_time;
      if (check_timeout >= timeout_max)
      {
         writeLineEx(1,3,"Modifying Carfiles failed!!!Timeout of 0 mins exceeded.");
         sysSetVariableString(sysvar::hil_ctrl::abort_message, "Carmakersensorsetupdateerror");
      }
      
      strtol(buf, 0, status);
      switch (status)
      {
        case 1:
          write("Modifying Carfiles succesfully");
          cancelTimer(cf_modify_tmr);
          status = 0; // reseting the variable to avoid false runs
          break;
        case 2:
          writeLineEx(1,3,"Error Accessing the Carfiles. Permission deined");
          cancelTimer(cf_modify_tmr);
          sysSetVariableString(sysvar::hil_ctrl::abort_message, "Carmakersensorsetupdateerror");
          break;
        case 3:
          writeLineEx(1,3,"Modifying Carfiles failed!!!.");
          cancelTimer(cf_modify_tmr);
          sysSetVariableString(sysvar::hil_ctrl::abort_message, "Carmakersensorsetupdateerror");
          break;  
      }
  }
}

on timer copy_tmr
{
  

  if (@hil_ctrl::simulated_bus_mode==0)
  {
      fh = openFileRead("D:\\CarMaker_Shared\\done.txt",0);
      fileGetString(buf,bufferLength,fh);
      fileClose(fh);
      check_timeout += wait_time;
      if (check_timeout >= timeout_max)
      {
         write("Copying CarMaker project failed!!!Timeout of 10 mins exceeded.");
         sysSetVariableString(sysvar::hil_ctrl::abort_message, "Carmakercopyfoldererror");
      }
      
      strtol(buf, 0, status);
      switch (status)
      {
        case 1:
          write("CarMaker project copied succesfully");
          cancelTimer(copy_tmr);
          @hil_ctrl::copy_cm_done = 1;
          status = 0; // reseting the variable to avoid false runs
          break;
        case 2:
          writeLineEx(1,3,"Error copying CarMaker project.Permission deined");
          cancelTimer(copy_tmr);
          sysSetVariableString(sysvar::hil_ctrl::abort_message, "Carmakercopyfoldererror");
          break;
        case 3:
          writeLineEx(1,3,"Copying CarMaker project failed!!!.");
          cancelTimer(copy_tmr);
          sysSetVariableString(sysvar::hil_ctrl::abort_message, "Carmakercopyfoldererror");
          break;  
      }
  }
  else
  {
    @hil_ctrl::copy_cm_done = 1;
    cancelTimer(copy_tmr);
  }
}

on sysvar hil_ctrl::load_cm_done
{
  if (@hil_ctrl::simulated_bus_mode==0)
  {
    if ((@this == 1) && (@hil_ctrl::fvideo_sim == 2) && (@hil_ctrl::movienx_fvideo_done == 0)) //Start MovieNX for front video if conditions met only once.
    {
      start_fvideo_render();
    }
    else if ((@this == 1) && (@hil_ctrl::svs_cameras_sim == 1) && (@hil_ctrl::movienx_svs_done == 0)) //Start MovieNX for SVS if conditions met only once.
    {
      start_svs_vib();
    }
    else
    {
      if (@hil_ctrl::load_cm_done == 1) @hil_ctrl::cm_ready_to_start = 1;
      else {
        @hil_ctrl::cm_ready_to_start = 0;
      }
        
    }
  }
  else
  {
    if (@hil_ctrl::load_cm_done == 1) @hil_ctrl::cm_ready_to_start = 1;
      else {
        @hil_ctrl::cm_ready_to_start = 0;
      }
  }
}

on sysvar hil_ctrl::movienx_fvideo_done
{
  canceltimer(mvnx_fvideo_tmr);
  if ((@this == 1) &&  (@hil_ctrl::svs_cameras_sim == 1) && (@hil_ctrl::movienx_svs_done == 0)) //Start MovieNX for SVS if conditions met only once.
  {
    start_svs_vib();    
  }
  else if (@this == 2)
  {
    @hil_ctrl::cm_ready_to_start = 2; 
  }
  else if (((@hil_ctrl::svs_cameras_sim != 1)) && @hil_ctrl::hil_mode ==  Carmaker)
  {
    @hil_ctrl::cm_ready_to_start = 1;
  }
  
}

on sysvar hil_ctrl::movienx_svs_done
{
  canceltimer(mvnx_svs_tmr);
  if (@this ==1)
  {    
   @hil_ctrl::cm_ready_to_start = 1;
  }
  else if (@this == 2)
  {
   @hil_ctrl::cm_ready_to_start = 2; 
  }
}

void start_fvideo_render() 
{
    if (@hil_ctrl::simulated_bus_mode==0)
    {
      getAbsFilePath("Platform\\Classe\\Scripts\\CarMaker_scripts\\start_client.bat movienx_fvideo", absfilePath, 256);
      getAbsFilePath("Platform\\Classe\\Scripts\\CarMaker_scripts", absdirPath, 256);
      sysExec(absfilePath, absdirPath);
      setTimerCyclic(mvnx_fvideo_tmr,wait_time,wait_time);
    }    
 }
  
void start_svs_vib()

{
    if (@hil_ctrl::simulated_bus_mode==0)
    {
      getAbsFilePath("Platform\\Classe\\Scripts\\CarMaker_scripts\\start_client.bat movienx_svs", absfilePath, 256);
      getAbsFilePath("Platform\\Classe\\Scripts\\CarMaker_scripts", absdirPath, 256);
      sysExec(absfilePath, absdirPath);
      setTimerCyclic(mvnx_svs_tmr,wait_time,wait_time);
    }    
}

on sysvar hil_ctrl::fvideo_sim
{
  if (@this == 0)
  {
    if (@hil_ctrl::simulated_bus_mode==0)
    {
      getAbsFilePath("Platform\\Classe\\Scripts\\CarMaker_scripts\\start_client.bat terminate_movienx fvideo", absfilePath, 256);
      getAbsFilePath("Platform\\Classe\\Scripts\\CarMaker_scripts", absdirPath, 256);
      sysExec(absfilePath, absdirPath);
      @hil_ctrl::movienx_fvideo_done = 0;
    }
  }
}

on sysvar hil_ctrl::svs_cameras_sim
{
  if (@this == 0)
  {
    if (@hil_ctrl::simulated_bus_mode==0)
    {
      getAbsFilePath("Platform\\Classe\\Scripts\\CarMaker_scripts\\start_client.bat terminate_movienx svs", absfilePath, 256);
      getAbsFilePath("Platform\\Classe\\Scripts\\CarMaker_scripts", absdirPath, 256);
      sysExec(absfilePath, absdirPath);
      @hil_ctrl::movienx_svs_done = 0;
    }
  }
}


on timer cm_tmr
{
  if (@hil_ctrl::simulated_bus_mode==0)
  {
    fh_cm = openFileRead("D:\\CarMaker_Shared\\cm_status.txt", 0);
    fileGetString(buf_cm,bufferLength,fh_cm);
    fileClose(fh_cm);
    check_timeout += wait_time;
    if (check_timeout >= timeout_apps)
    {
       writeLineEx(1,3,"Starting CarMaker failed!!!Timeout exceeded.");
       sysSetVariableString(sysvar::hil_ctrl::abort_message, "Carmakerstarterror");
    }
    
    strtol(buf_cm, 0, status_cm);
    switch (status_cm)
    {
      case 1:
        write("CarMaker app starting on RT Rack.");
        cancelTimer(cm_tmr);
        @hil_ctrl::cm_app_started = 1;
        check_timeout = 0; // reseting the variable to avoid false runs
        status_cm = 0; // reseting the variable to avoid false runs
        break;
      case 2:
        writeLineEx(1,3,"CM on RT Rack was unable to start");
        cancelTimer(cm_tmr);
        sysSetVariableString(sysvar::hil_ctrl::abort_message, "Carmakerstarterror");
        break;
    }
  }
  else
  {
    check_timeout += wait_time;
    if (check_timeout >= 30000)
    {
      @hil_ctrl::cm_app_started = 1;
      cancelTimer(cm_tmr);
      check_timeout = 0;
    }
  }
}

on timer mvnx_fvideo_tmr
{
  if (@hil_ctrl::simulated_bus_mode==0)
  {
    fh_mvnx_fv = openFileRead("D:\\CarMaker_Shared\\movienx_fvideo_status.txt", 0);
    fileGetString(buf_mvnx_fv,bufferLength,fh_mvnx_fv);
    fileClose(fh_mvnx_fv);
    check_timeout += wait_time;
    if (check_timeout >= timeout_apps)
    {
       writeLineEx(1,3,"MovieNX Fvideo failed!!!Timeout exceeded.");
      cancelTimer(mvnx_fvideo_tmr); 
      sysSetVariableString(sysvar::hil_ctrl::abort_message, "MovieNXerror");
    }
    
    strtol(buf_mvnx_fv, 0, status_mvnx_fv);
    switch (status_mvnx_fv)
    {
      case 1:
        write("Movienx FVideo app started on Rendering PC.");
        cancelTimer(mvnx_fvideo_tmr);
        @hil_ctrl::movienx_fvideo_done = 1;
        break;
      case 2:
        writeLineEx(1,3,"MovieNX Fvideo was unable to start");
        cancelTimer(mvnx_fvideo_tmr);
        sysSetVariableString(sysvar::hil_ctrl::abort_message, "MovieNXerror");
        break;
    }
  }
}

on timer mvnx_svs_tmr
{
  if (@hil_ctrl::simulated_bus_mode==0)
  {
    fh_mvnx_svs = openFileRead("D:\\CarMaker_Shared\\movienx_svs_status.txt", 0);
    fileGetString(buf_mvnx_svs,bufferLength,fh_mvnx_svs);
    fileClose(fh_mvnx_svs);
    check_timeout += wait_time;
    if (check_timeout >= timeout_apps)
    {
      writeLineEx(1,3,"MovieNX SVS failed!!!Timeout exceeded.");
      cancelTimer(mvnx_svs_tmr); 
      sysSetVariableString(sysvar::hil_ctrl::abort_message, "MovieNXRSIerror");
    }
    
    strtol(buf_mvnx_svs, 0, status_mvnx_svs);
    switch (status_mvnx_svs)
    {
      case 1:
        write("Movienx SVS app started on Rendering PC.");
        cancelTimer(mvnx_svs_tmr);
        @hil_ctrl::movienx_svs_done = 1;
        break;
      case 2:
        writeLineEx(1,3,"MovieNX SVS was unable to start");
        cancelTimer(mvnx_svs_tmr);
        sysSetVariableString(sysvar::hil_ctrl::abort_message, "MovieNXRSIerror");
        break;
    }
  }
}

on timer mvnx_status_timer
{
  if (@hil_ctrl::simulated_bus_mode==0)
  {
   
    fh_mvnx_status = openFileRead("D:\\CarMaker_Shared\\rendering_pc_status.txt", 0);
    fileGetString(buf_mvnx_status,bufferLength,fh_mvnx_status);
    fileClose(fh_mvnx_status);
    strtol(buf_mvnx_status, 0, status_mvnx);
    switch (status_mvnx)
    {
      case 1:
        write("Rendering PC up and RPYC server running.");
        cancelTimer(mvnx_status_timer);
        @hil_ctrl::abort_msg_movienx = 1;
        getAbsFilePath("Platform\\Classe\\Scripts\\CarMaker_scripts\\start_client.bat terminate_movienx all_instances", absfilePath, 256);
			  getAbsFilePath("Platform\\Classe\\Scripts\\CarMaker_scripts", absdirPath, 256);
			  sysExec(absfilePath, absdirPath); 
        break;
      case 2:
        writeLineEx(1,2,"No communication with Rendering PC or RPYC is down.");
		    cancelTimer(mvnx_status_timer);
        @hil_ctrl::abort_msg_movienx = 2;
        break;
	    case 3:
        writeLineEx(1,3,"Wrong RPYC server version detected.");
		    cancelTimer(mvnx_status_timer);
        @hil_ctrl::abort_msg_movienx = 3;
        sysSetVariableString(sysvar::hil_ctrl::abort_message, "RenderingPCnotavailable");
        break;
    }
  }
}

on sysvar hil_ctrl::cm_runtime_error
{
  if (@this ==1)
  {    
   setTimer(cm_runtime_error_tmr, wait_time);
  }
}

on timer cm_runtime_error_tmr
{
	fh_error_log = openFileRead("D:\\CarMaker_Shared\\error_log.txt", 0);
	fileGetString(buf_cm_error_message,bufferLength,fh_error_log);
	writeLineEx(1,3, "%s", buf_cm_error_message);
  @hil_ctrl::cm_runtime_error = 0;
}

on sysvar Customer_specific::cm_stopsim
{
  if (@this ==1)
  {    
//   setTimer(mvnx_fps_timer, wait_time);
  }
}
on timer mvnx_fps_timer
{
  if (@hil_ctrl::simulated_bus_mode==0)
  {
    fh_fps_status = openFileRead("D:\\CarMaker_Shared\\movienx_fps_status.txt", 0);
    fileGetString(buf_mvnx_fps,bufferLength,fh_fps_status);
    fileClose(fh_fps_status);
    strtol(buf_mvnx_fps, 0, status_fps_mvnx);
	if (status_fps_mvnx == 1)
	{	
		cancelTimer(mvnx_status_timer);
    sysSetVariableString(sysvar::hil_ctrl::abort_message, "MovieNXperformanceerror");
		writeLineEx(1,3, "MovieNX fps dropped below 30 frames for more that three frames.");		
	}
  }
}

on sysvar hil_ctrl::copy_project_from_shared
{
	if (@this ==1)
  {    
   setTimerCyclic(copy_from_shared, wait_time, wait_time); //timer checks first and second copy
  }	
}

on timer copy_from_shared
{	
	if (@hil_ctrl::simulated_bus_mode==0)
  {
    fh_copy_repo = openFileRead("D:\\CarMaker_Shared\\copy_back_to_repo_status.txt", 0);
    fileGetString(buf_copy_back,bufferLength,fh_copy_repo);
    fileClose(fh_copy_repo);
    
    strtol(buf_copy_back, 0, status_copy_from_rt);
    switch (status_copy_from_rt)
    {
      case 1:
//        cancelTimer(copy_from_shared); // Start copy on GUI PC - Timer keep running
		    getAbsFilePath("Platform\\Classe\\Scripts\\CarMaker_scripts\\copy_project_back.bat local", absfilePath, 256);
		    getAbsFilePath("Platform\\Classe\\Scripts\\CarMaker_scripts", absdirPath, 256);
		    sysExec(absfilePath, absdirPath);
        break;
      case 2:
        write("Copy project from RT Rack back to repo was successful.");
        cancelTimer(copy_from_shared);
        @hil_ctrl::copy_project_from_shared = 0;
        break;  
      case 3:
        writeLineEx(1,3,"Copy project from RT Rack back to repo was unsuccessful!!!");
        cancelTimer(copy_from_shared);
        sysSetVariableString(sysvar::hil_ctrl::abort_message, "Carmakercopyfoldererror");
        break;
    }
  }
	
}