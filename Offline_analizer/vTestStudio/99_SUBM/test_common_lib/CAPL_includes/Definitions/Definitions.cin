/*@!Encoding:1252*/

/**
 * @copyright  (C) 2020 Robert Bosch GmbH.\n
 * The reproduction, distribution and utilization of this file as well as
 * the communication of its contents to others without express authorization
 * is prohibited.\n
 * Offenders will be held liable for the payment of damages.\n
 * All rights reserved in the event of the grant of a patent, utility model or design.
 *
 * @file         Diagnostics.cin
 *                                            
 * @author       Manfred Rast(CC-DA/EAD2)
 * @date         27.05.2020
 * @version      0.1
 *
 * @brief Common definitions.
 *
 * @details ToDo
 *
 */

variables
{

  //! @enum def_truefalse
  /**
  * Enumeration for boolean type.
  */
  enum def_truefalse
  {
    def_FALSE = 0,
    def_TRUE = 1
  };

  //! @enum def_verdict
  /**
  * Enumeration for test verdict.
  */
  enum def_verdict
  {
    def_PASS = 0,
    def_FAIL = 1
  };  

}

