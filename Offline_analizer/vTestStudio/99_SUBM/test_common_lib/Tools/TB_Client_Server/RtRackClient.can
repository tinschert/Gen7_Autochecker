/*@!Encoding:1252*/

/**
 * @copyright  (C) 2020-2020 Robert Bosch GmbH.\n
 * The reproduction, distribution and utilization of this file as well as
 * the communication of its contents to others without express authorization
 * is prohibited.\n
 * Offenders will be held liable for the payment of damages.\n
 * All rights reserved in the event of the grant of a patent, utility model or design.
 *
 * @file         RtRackClient.cAn
 *                                            
 * @author       Manfred Rast (CC-DA/EAD2)
 * @date         08.09.2020
 * @version      0.2
 *
 * @brief Provide functions to execute commands on a remote server.
 *
 * @details TODO
 *
 */

includes
{
  
  #include "RtRackClient.cin"
}

variables
{
}

