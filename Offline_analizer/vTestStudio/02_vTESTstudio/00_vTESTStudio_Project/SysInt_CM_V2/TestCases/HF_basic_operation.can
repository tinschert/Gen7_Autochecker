/*@!Encoding:1252*/
/**
 * @file HF_basic_operation.can
 * @author ADAS_HIL_TEAM
 * @date 22-10-2023
 * @brief 
 *
 * ################################################################
 * C O P Y R I G H T S
 * ----------------------------------------------------------------
 * Copyright (c) 2023 by Robert Bosch GmbH. All rights reserved.
 
 * The reproduction, distribution and utilization of this file as
 * well as the communication of its contents to others without express
 * authorization is prohibited. Offenders will be held liable for the
 * payment of damages. All rights reserved in the event of the grant
 * of a patent, utility model or design.
 *
 * ################################################################
*/

includes
{
  
}

variables
{

}

export testcase HF_basic_operation(int config, double ego_speed, double tgt_speed)
{
  /* ----------------------------------------------------------------------------------------------------------------------------------------------------- */
  testStep("Test Step 1","Activate LKS");
  
  Set_Ego_Vehicle(ego_speed);
  Activate_ACC_Cus();
  Set_HandsOn_Cus();
  Check_ACC_Status_Active_Cus(config);
  Activate_LKS_Cus();
  Check_LKS_Status_ActiveControl_Cus(config);
  
  /* ----------------------------------------------------------------------------------------------------------------------------------------------------- */
  testStep("Test Step 2","Driver HandsOff");
  
  Set_HandsOff_Cus();
  Check_HF_conditions_fulfilled(config);

  /* ----------------------------------------------------------------------------------------------------------------------------------------------------- */
  testStep("Test Step 3","Check HF state and other signals");
  
  Check_HF_Status_Cus(config);
}