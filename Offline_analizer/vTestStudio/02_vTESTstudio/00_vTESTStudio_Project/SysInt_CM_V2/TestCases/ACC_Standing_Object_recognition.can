/*@!Encoding:1252*/
/**
 * @file ACC_Smoke_Test.can
 * @author ADAS_HIL_TEAM
 * @date 22-07-2024
 * @brief 
 *
 * ################################################################
 * C O P Y R I G H T S
 * ----------------------------------------------------------------
 * Copyright (c) 2023 by Robert Bosch GmbH. All rights reserved.
 
 * The reproduction, distribution and utilization of this file as well as the communication of its contents to others without express authorization is prohibited. 
 * Offenders will be held liable for the payment of damages. All rights reserved in the event of the grant of a patent, utility model or design.
 *
 * ################################################################
*/

includes
{
}

variables
{
  int i;
}

export testcase ACC_Standing_Object_recognition(int config, double ego_speed, double tgt_speed)
{
  /* ----------------------------------------------------------------------------------------------------------------------------------------------------- */
  testStep("Test Step 1","Set to Activate ACC"); 
  Set_Target_Vehicle_EgoLane_Stationary(tgt_speed);
  Set_Ego_Vehicle(ego_speed);
  Activate_ACC_Cus();
  Check_ACC_Status_Active_Cus(config);
  testWaitForSignalInRange(sysvar::hil_hvm::velocity_x, 39,41,25000);//check 40kph
  
  /* ----------------------------------------------------------------------------------------------------------------------------------------------------- */  
  
  testStep("Test Step 2"," Approach a standing vehicle");
 
  testWaitForTimeout(2000); // wait for second Check 
  testWaitForSignalInRange(sysvar::hil_hvm::velocity_x, 39,41,25000);//check 40kph 
  testWaitForTimeout(500);
  
  /* ----------------------------------------------------------------------------------------------------------------------------------------------------- */
  
  testStep("Test Step 3","Approach ACC object to standstill");
  
  testWaitForSignalInRange(sysvar::hil_hvm::velocity_x, 0.00,1.00,25000);  //check 0kph
  Check_ACC_targetobject_dx(config);  // Check Target Object distance
  testWaitForTimeout(500);
  testStepPass();
  
  /* ----------------------------------------------------------------------------------------------------------------------------------------------------- */
}
