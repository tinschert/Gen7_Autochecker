/*@!Encoding:1252*/
/**
 * @file ALC_basic_operation_steering_override.can
 * @author ADAS_HIL_TEAM
 * @date 26-09-2023
 * @brief 
 *
 * ################################################################
 * C O P Y R I G H T S
 * ----------------------------------------------------------------
 * Copyright (c) 2023 by Robert Bosch GmbH. All rights reserved.
 
 * The reproduction, distribution and utilization of this file as
 * well as the communication of its contents to others without express
 * authorization is prohibited. Offenders will be held liable for the
 * payment of damages. All rights reserved in the event of the grant
 * of a patent, utility model or design.
 *
 * ################################################################
*/

includes
{
  
}

variables
{

}

export testcase LKA_basic_operation(int config, double ego_speed, double tgt_speed)
{
  /* ----------------------------------------------------------------------------------------------------------------------------------------------------- */
  testStep("Test Step 1","Activate LKA");
  
  Set_Ego_Vehicle(ego_speed);
  Set_Target_Vehicle_EgoLane(tgt_speed);
  testWaitForSignalInRange(sysvar::hil_hvm::velocity_x, ego_speed-1,ego_speed+1,25000);
  Activate_LKA_ELK_Cus();
  
  /* ----------------------------------------------------------------------------------------------------------------------------------------------------- */
  testStep("Test Step 2","Steer the vehicle to left and check LKA activation");
  
  @hil_drv::steering_wheel_angle_req = -5;
  Check_LKA_Status_Cus(config);
}