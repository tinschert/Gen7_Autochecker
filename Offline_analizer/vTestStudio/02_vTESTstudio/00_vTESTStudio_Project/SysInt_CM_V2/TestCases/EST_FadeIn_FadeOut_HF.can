/*@!Encoding:1252*/
/**
 * @file EST_FadeIn_FadeOut_HF.can
 * @author ADAS_HIL_TEAM
 * @date 12-12-2024
 * @brief 
 *
 * ################################################################
 * C O P Y R I G H T S
 * ----------------------------------------------------------------
 * Copyright (c) 2024 by Robert Bosch GmbH. All rights reserved.
 
 * The reproduction, distribution and utilization of this file as well as the communication of its contents to others without express authorization is prohibited. 
 * Offenders will be held liable for the payment of damages. All rights reserved in the event of the grant of a patent, utility model or design.
 *
 * ################################################################
*/
 
includes
{
  
}

variables
{
  int counter;
}

export testcase EST_FadeIn_FadeOut_HF(int config, double ego_speed, double tgt_speed)
{
  /* ----------------------------------------------------------------------------------------------------------------------------------------------------- */
  testStep("Test Step 1","Activate HF");
  
  Set_Ego_Vehicle(ego_speed);
  Activate_ACC_Cus();
  Set_HandsOn_Cus();
  Check_ACC_Status_Active_Cus(config);
  Activate_LKS_Cus();
  Check_LKS_Status_ActiveControl_Cus(config);
  Set_HandsOff_Cus();
  Check_HF_conditions_fulfilled(config);
  Check_HF_Status_Cus(config); 
  
 /* ----------------------------------------------------------------------------------------------------------------------------------------------------- */
  testStep("Test Step 2","Trigger EST via Driver Distraction");
  
  
  
 /* ----------------------------------------------------------------------------------------------------------------------------------------------------- */
  testStep("Test Step 3","Vehicle decelerating during EST activation");
  
  Check_EST_Status_Active_Cus(config);
 
  /* ----------------------------------------------------------------------------------------------------------------------------------------------------- */
  testStep("Test Step 4","Override EST via manual intervention");
 
  Check_EST_Status_FadeOut_Cus(config);   //Set gas pedal kickdown and check EST in FadeOut
  Check_EST_InterventionCounter_Reset_Cus(config);   //Intervention Counter to reset to 0
}