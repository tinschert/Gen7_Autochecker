/*@!Encoding:1252*/
/**
 * @file LKS_basic_operation.can
 * @author ADAS_HIL_TEAM
 * @date 26-09-2023
 * @brief 
 *
 * ################################################################
 * C O P Y R I G H T S
 * ----------------------------------------------------------------
 * Copyright (c) 2023 by Robert Bosch GmbH. All rights reserved.
 
 * The reproduction, distribution and utilization of this file as
 * well as the communication of its contents to others without express
 * authorization is prohibited. Offenders will be held liable for the
 * payment of damages. All rights reserved in the event of the grant
 * of a patent, utility model or design.
 *
 * ################################################################
*/

includes
{
  
}

variables
{

}

export testcase LKS_basic_operation(int config, double ego_speed, double tgt_speed)
{
  /* ----------------------------------------------------------------------------------------------------------------------------------------------------- */
  testStep("Test Step 1","Activate ACC");
  
  Set_Ego_Vehicle(ego_speed);
  Activate_ACC_Cus();
  Check_ACC_Status_Active_Cus(config);
  
  /* ----------------------------------------------------------------------------------------------------------------------------------------------------- */
  testStep("Test Step 2","Activate LKS");
  
  Activate_LKS_Cus();
  Check_LKS_Status_ActiveControl_Cus(config);

  /* ----------------------------------------------------------------------------------------------------------------------------------------------------- */
  testStep("Test Step 3","Check Steering Torque boundaries");
  
  
  
  /* ----------------------------------------------------------------------------------------------------------------------------------------------------- */
  testStep("Test Step 4","Check angle interface (optional)");

}