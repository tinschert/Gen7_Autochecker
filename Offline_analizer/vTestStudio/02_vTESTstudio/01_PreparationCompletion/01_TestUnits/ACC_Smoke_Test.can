/*@!Encoding:1252*/
/**
 * @file ACC_Smoke_Test.can
 * @author ADAS_HIL_TEAM
 * @date 05-06-2023
 * @brief 
 *
 * ################################################################
 * C O P Y R I G H T S
 * ----------------------------------------------------------------
 * Copyright (c) 2023 by Robert Bosch GmbH. All rights reserved.
 
 * The reproduction, distribution and utilization of this file as
 * well as the communication of its contents to others without express
 * authorization is prohibited. Offenders will be held liable for the
 * payment of damages. All rights reserved in the event of the grant
 * of a patent, utility model or design.
 *
 * ################################################################
*/

includes
{
  //#include "common_test_functions.cin"
}

variables
{
  int i;
  long result1;
  long result2;
  long result3;
  long result4;
}

export testcase ACC_Smoke_Test(int config, double ego_speed, double tgt_speed)
{
  
  testStep("Test case","Start");
  Set_Ego_Vehicle(ego_speed);
  testWaitForTimeout(2000);
  Activate_ACC_Cus();
  Check_ACC_Status_Cus();
  for(i = 0; i < 4; i++) //set ACC Speed to 70kph
  {
    ShortPress_ACC_SetPlus_Cus();
  }
  // Check following Mode ACC set to 50 kph and obj_target speed 40kph
  testStep("Check Following", "ACC");
  testWaitForTimeout(1000); 
  result1= testWaitForSignalInRange(sysvar::hil_hvm::velocity_x, 39,41,25000);//check 40kph
  EvaluateResult(result1);
  testWaitForTimeout(2000); // wait for second Check 
  //write ("check following Mode done");
  
  // Check Stop and go 
  testStep("Check Stop", "ACC");
  result2 = testWaitForSignalInRange(sysvar::hil_hvm::velocity_x, 0.00,1.00,25000);  //check 0kph
  EvaluateResult(result2);
  // write ("check Stop done");
  testWaitForTimeout(500);
  // write ("check 50kph");
  testStep("Check Acceleration after Stop", "ACC");
  result3 = testWaitForSignalInRange(sysvar::hil_hvm::velocity_x, 39,41,25000); //check 50kph
  EvaluateResult(result3);
  testWaitForTimeout(2000);
  testStep("Check Setspeed without Target", "ACC");
  result4 = testWaitForSignalInRange(sysvar::hil_hvm::velocity_x, 65,70,25000); //check 50kph
  EvaluateResult(result4);
  // write ("check 50kph done");
  testWaitForTimeout(100);
  // write ("ACC test done");
  testStep("ACC Testcase are done", "ACC");
}
