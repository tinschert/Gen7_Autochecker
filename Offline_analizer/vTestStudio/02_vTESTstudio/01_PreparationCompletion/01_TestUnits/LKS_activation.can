/*@!Encoding:1252*/
/**
 * @file ALC_activation.can
 * @author ADAS_HIL_TEAM
 * @date 05-06-2023
 * @brief 
 *
 * ################################################################
 * C O P Y R I G H T S
 * ----------------------------------------------------------------
 * Copyright (c) 2023 by Robert Bosch GmbH. All rights reserved.
 
 * The reproduction, distribution and utilization of this file as
 * well as the communication of its contents to others without express
 * authorization is prohibited. Offenders will be held liable for the
 * payment of damages. All rights reserved in the event of the grant
 * of a patent, utility model or design.
 *
 * ################################################################
*/

includes
{
 // #include "common_test_functions.cin"
}

variables
{
  int i;
}

export testcase LKS_activation(int config, double ego_speed, double tgt_speed)
{
  testStep("Test case","Start");
  Set_Ego_Vehicle(ego_speed);
 //  @Classe_Obj_Sim::obj_ctrl.obj_target_v_long[0] = tgt_speed;
  Activate_ACC_Cus();
  Set_HandsOn_Cus();
  //Check_ACC_Status_Cus();
  Activate_LKS_Cus();
  Check_LKS_Status_Cus(config);
  $CAN_MPC3::Vehicle_CAN_15::ACC_MainSwitch = 0; 
  testWaitForTimeout(200);
}
