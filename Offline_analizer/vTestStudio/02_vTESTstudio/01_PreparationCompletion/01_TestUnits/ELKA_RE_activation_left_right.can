/*@!Encoding:1252*/
/**
 * @file ELKA_RE_activation_left_right.can
 * @author ADAS_HIL_TEAM
 * @date 09-01-2023
 * @brief 
 *
 * ################################################################
 * C O P Y R I G H T S
 * ----------------------------------------------------------------
 * Copyright (c) 2023 by Robert Bosch GmbH. All rights reserved.
 
 * The reproduction, distribution and utilization of this file as
 * well as the communication of its contents to others without express
 * authorization is prohibited. Offenders will be held liable for the
 * payment of damages. All rights reserved in the event of the grant
 * of a patent, utility model or design.
 *
 * ################################################################
*/

includes
{
 // #include "common_test_functions.cin"
}

variables
{
}

export testcase ELKA_RE_activation_left_right(int config, double ego_speed, double tgt_speed)
{
  testStep("Test case","Start");
  Set_Ego_Vehicle(ego_speed);
  Activate_LKA_ELK_Cus();
  @hil_drv::steering_wheel_angle_req = +5;
  Check_ELKA_RoadEdge_Status_Cus(config);
}