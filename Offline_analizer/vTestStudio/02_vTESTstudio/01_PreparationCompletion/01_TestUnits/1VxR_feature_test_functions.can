/*@!Encoding:1252*/
/**
 * @file feature_test_functions.can
 * @author ADAS_HIL_TEAM
 * @date 30-01-2024
 * @brief Definition of all the feature test functions currently used in System Integration Test Catalogue
 *
 * ################################################################
 * C O P Y R I G H T S
 * ----------------------------------------------------------------
 * Copyright (c) 2023 by Robert Bosch GmbH. All rights reserved.
 
 * The reproduction, distribution and utilization of this file as
 * well as the communication of its contents to others without express
 * authorization is prohibited. Offenders will be held liable for the
 * payment of damages. All rights reserved in the event of the grant
 * of a patent, utility model or design.
 *
 * ################################################################
*/

includes
{
  
}

variables
{
  
}

// Driver Functions //
//*********************************************************************************************************************************


export testfunction Set_Indicate_Left()
{
  @hil_drv::indicator_light = @hil_drv::indicator_light::leftturn; // left indicator
  testWaitForTimeout(2000);
}

export testfunction Set_Indicator_Inactive()
{
  @hil_drv::indicator_light = @hil_drv::indicator_light::not_active;
  testWaitForTimeout(2000);
}
  
export testfunction Set_Ego_Vehicle(double ego_speed)
{
  @hil_drv::target_velocity = ego_speed;
  testWaitForSignalInRange(sysvar::hil_hvm::velocity_x, ego_speed-1,ego_speed+1,25000);
  testWaitForTimeout(500);  
}

export testfunction Set_HandsOn_Cus()
{
  $HODDetnSts_h8HSC8 = 2; // valid contact detected
  $HODTchZone1Sts_h8HSC8 = 1; //hand detected
  $DrvrDstcnStsHSC4 = 1; // no distraction
  $DrvrGazeRgnHSC4 = 1; // driver side of windscreen
  $DMSStsHSC4 = 2; // active
  $DrvrPrstHSC4 = 2; // driver presence

}

export testfunction Set_HandsOff_Cus()
{
  $HODDetnSts_h8HSC8 = 0; // valid contact detected
  $HODTchZone1Sts_h8HSC8 = 0; //hand detected
  $HODTchZone1Val_h8HSC8 = 0; // 
  testWaitForTimeout(2000);
}

//AEB Smoke Test
//*********************************************************************************************************************************

export testfunction PreConditionsAEB()
{
  testStep("Pre-cond AEB","Start");
  $ESP_SysSts_EPB = Released;
  @hil_drv::gear_req = @hil_drv::gear_req::drive;
}

export testfunction PostConditionsAEB()
{
  testStep("Post-cond AEB","Start");
  if (@hil_drv::DIL_mode == steeringwheel_g29)
  {
    @hil_drv::target_velocity = 0;
    testWaitForSignalInRange(sysvar::hil_hvm::velocity_x, 0,0.5,25000);
  }
  else
  {
    testWaitForTimeout(10000);
  }

  //return xcp params, reset ECU?
}

export testfunction Set_Ego_Vehicle_AEB(double ego_speed, double tgt_speed)
{
  @hil_drv::target_velocity = ego_speed;
  @Classe_Obj_Sim::obj_ctrl.obj_target_v_long[0] = tgt_speed;
  @Classe_Obj_Sim::obj_ctrl.ctrl_status_velocity[0] = 1;
  testWaitForSignalInRange(sysvar::hil_hvm::velocity_x, ego_speed-1,ego_speed+1,25000);
}

export testfunction Check_AEB_Turn_Status_Cus(int config)
{
if (config == 2) // Phi Variants
  {
    testWaitForSignalMatch(CAN_MPC3::VMC_01::AEB_Verz_Anf_Freigabe, 1, 30000);
    switch($CAN_MPC3::VMC_01::AEB_Verz_Anf_Freigabe)
    {
      case 1:
        TestStepPass("Test case","AEB Active"); break;
        
      default:
          TestStepFail("Test case", "AEB was not activated"); break;
    }
    testWaitForTimeout(500);
  }

else
  {
    testStepFail("Variant not supported");
  }
}

export testfunction Check_AEB_TIPL_Long_Status_Cus(int config)
{
  if (config == 2) // 1VxR Variants
  {
    testWaitForSignalMatch(CAN_MPC3::VMC_01::AEB_Verz_Anf_Freigabe, 1, 30000);
    switch($CAN_MPC3::VMC_01::AEB_Verz_Anf_Freigabe)
    {
      case 1:
        TestStepPass("Test case","AEB Active"); break;
      default:
        TestStepFail("Test case", "AEB was not active"); break;
    }
    testWaitForTimeout(500);
  }

  else
    {
      testStepFail("No variant selected");
    }
}


export testfunction Check_AES_Status_Cus(int config)
{
  testStepFail("Variant not supported");
}
// ** AEB Pre-conditions used in CLASSE SysInt Test Cataog ** //
// ** Planned implementation to merge with existing feature test functions - AEB Smoke Test ** //
// ** Do not Remove ** //

export testfunction PreConditionAEB_Activation()
{
  testStep("Pre-cond AEB activation","Start");
}  

export testfunction PostConditionAEB_Deactivation()
{
  testStep("Post-cond AEB deactivation","Start");
} 


//ACC Smoke Test
//*********************************************************************************************************************************

export testfunction PreConditions_ACC()
{
  testStep("Pre-cond ACC","Start");
  $ESP_SysSts_EPB = Released;
  @hil_drv::gear_req = @hil_drv::gear_req::drive;
 
  testWaitForTimeout(500);

  if (@hil_adas::hmi_display_adas_acc_status == @hil_adas::hmi_display_adas_acc_status::passive)
  {
    TestStepPass("Pre-cond ACC","ACC ready ");
  }
  else
  {
   TestStepFail("Pre-cond ACC","ACC not ready");
  }
}

export testfunction PostConditions_ACC()
{
  testStep("Post-cond ACC","Start");
  $CAN_MPC3::Vehicle_CAN_15::ACC_MainSwitch = 0; 
  testWaitForTimeout(200);
  if (@hil_drv::DIL_mode == steeringwheel_g29)
  {
    @hil_drv::target_velocity = 0;
    testWaitForSignalInRange(sysvar::hil_hvm::velocity_x, 0,0.5,25000);
  }
  else
  {
    testWaitForTimeout(10000);
  }
}

export testfunction Activate_ACC_Cus()
{
  $CAN_MPC3::Vehicle_CAN_15::ACC_MainSwitch = 1; 
  testWaitForTimeout(200);
  @hil_drv::hmi_btn_cc = @hil_drv::hmi_btn_cc::activate; //Set ACC aktive
  testWaitForTimeout(500);
  @hil_drv::hmi_btn_cc = @hil_drv::hmi_btn_cc::not_pressed;
  testWaitForTimeout(500);
}

export testfunction Check_ACC_Status_Cus()
{
 if (@hil_adas::hmi_display_adas_acc_status == @hil_adas::hmi_display_adas_acc_status::active) //Check Status ACC
  {
  TestStepPass();//TestStepPass("ACC is active");
  }
  else
  {
   TestStepFail();//TestStepFail("ACC is not active"); 
  }
  testWaitForTimeout(200); 
}

export testfunction ShortPress_ACC_SetPlus_Cus()
{
  @hil_drv::hmi_btn_cc = @hil_drv::hmi_btn_cc::set_plus; // set ACC +10 kph
  testWaitForTimeout(1000);
  @hil_drv::hmi_btn_cc = @hil_drv::hmi_btn_cc::not_pressed;
  testWaitForTimeout(300);  
}
  
//LKA Smoke Test
//*********************************************************************************************************************************

export testfunction PreConditions_LKA()
{
  testStep("Pre-cond LKA","Start");
  $ESP_SysSts_EPB = Released;
  @hil_drv::gear_req = @hil_drv::gear_req::drive;
  testWaitForTimeout(500);
}

export testfunction PostConditions_LKA()
{
  testStep("Post-cond LKA","Start");
  @hil_drv::hmi_btn_adas_lka = @hil_drv::hmi_btn_adas_lka::pressed_off; // pressed button LKA to switch off
  testWaitForTimeout(500);
  @hil_drv::hmi_btn_adas_lka = @hil_drv::hmi_btn_adas_lka::not_pressed; // button released
  testWaitForTimeout(500);
  if (@hil_drv::DIL_mode == steeringwheel_g29)
  {
    @hil_drv::target_velocity = 0;
    testWaitForSignalInRange(sysvar::hil_hvm::velocity_x, 0,0.5,25000);
  }
  else
  {
    testWaitForTimeout(2000);
  }
}

export testfunction Activate_LKA_ELK_Cus()
{
  @hil_drv::hmi_btn_adas_lka = @hil_drv::hmi_btn_adas_lka::pressed_on;  // pressed button LKA to switch ON
  testWaitForTimeout(500);
  @hil_drv::hmi_btn_adas_lka = @hil_drv::hmi_btn_adas_lka::not_pressed;  // button released
  testWaitForTimeout(500);
}

export testfunction Check_ELKA_Oncoming_Status_Cus(int config)
{
if (config == 2) // Phi Variants
  {
    testWaitForSignalMatch(CAN_MPC3::LANE_01::ElkoFeatureStatus, 2, 30000);
    switch($CAN_MPC3::LANE_01::ElkoFeatureStatus)
    {
      case 2:
        TestStepPass("Test case","ELK Oncoming active"); break;
      default:
        TestStepFail("Test case","ELK_OT not active"); break;
    }
    testWaitForTimeout(500);
  }
  
else testStepFail("Variant not supported");
}

export testfunction Check_ELKA_RoadEdge_Status_Cus(int config)
{
  if (config == 2) // Phi Variants
    {
      testWaitForSignalMatch(CAN_MPC3::LANE_01::ElkreFeatureStatus, 2, 30000);
      switch($CAN_MPC3::LANE_01::ElkreFeatureStatus)
      {
        case 2:
          TestStepPass("Test case","ELK RoadEdge active"); break;
        default:
          TestStepFail("Test case","ELK RE not active"); break;
      }
      testWaitForTimeout(500);
    }
  
  else testStepFail("Variant not supported");
}

export testfunction Check_LKA_Status_Cus(int config)
{
  if (config == 2) // Phi Variants
    {
      testWaitForSignalMatch(CAN_MPC3::LANE_01::RdpFeatureStatus, 2, 30000);
      switch($CAN_MPC3::LANE_01::RdpFeatureStatus)
      {
        case 2:
          TestStepPass("Test case","LKA active"); break;
        default:
          TestStepFail("Test case","LKA not active"); break;
      }
      testWaitForTimeout(2000);
    }
  else testStepFail("Variant not supported");
}

export testfunction Check_LKS_Status_Cus(int config)
{
  if (config == 2) // Phi Variants
    {
      testWaitForSignalMatch(CAN_MPC3::LANE_01::LksFeatureStatus, 2, 30000);
      switch($CAN_MPC3::LANE_01::LksFeatureStatus)
      {
        case 2:
          TestStepPass("Test case","LKS active"); break;
        default: 
            TestStepFail("Test case","LKS not active"); break;
      }
      testWaitForTimeout(500);
    }
  else testStepFail("Variant not supported");
}
//TSR Smoke Test
//*********************************************************************************************************************************

export testfunction PreConditionsTSR()
{
  testStep("Pre-cond TSR","Start");
  $ESP_SysSts_EPB = Released;
  @hil_drv::gear_req = @hil_drv::gear_req::drive;
  testWaitForTimeout(500);
}

export testfunction PostConditionsTSR()
{
  testStep("Post-cond TSR","Start");
  @hil_drv::target_velocity = 0;
  testWaitForSignalInRange(sysvar::hil_hvm::velocity_x, 0,0.5,25000);
  
}

//RCTA Smoke Test
//*********************************************************************************************************************************

export testfunction PreConditionsRCTA()
{
  testStep("Pre-cond RCTA","Start");
  $ESP_SysSts_EPB = Released;
  @hil_drv::gear_req = @hil_drv::gear_req::reverse;
  testWaitForTimeout(500);
}

export testfunction PostConditionsRCTA()
{
  testStep("Post-cond RCTA","Start");
  if (@hil_drv::DIL_mode == steeringwheel_g29)
  {
    @hil_drv::target_velocity = 0;
    testWaitForSignalInRange(sysvar::hil_hvm::velocity_x, 0,0.5,25000);
  }
  else
  {
    testWaitForTimeout(10000);
  }
  //return xcp params, reset ECU?
}

//ALC Smoke Test
//*********************************************************************************************************************************


export testfunction PreConditions_ALC()
{
  testStep("Pre-cond ACC","Start");
  $ESP_SysSts_EPB = Released;
  @hil_drv::gear_req = @hil_drv::gear_req::drive;
  testWaitForTimeout(500);
}

export testfunction PostConditions_ALC()
{
  testStep("Post-cond ACC","Start");
  @hil_drv::indicator_light = @hil_drv::indicator_light::not_active;
  testWaitForTimeout(200);
  @hil_drv::hmi_btn_adas_lks = @hil_drv::hmi_btn_adas_lks::pressed_off; // pressed button LKS to switch off
  testWaitForTimeout(1000); // short push on the button
  @hil_drv::hmi_btn_adas_lks = @hil_drv::hmi_btn_adas_lks::not_pressed; // button released
  testWaitForTimeout(500);
  if (@hil_drv::DIL_mode == steeringwheel_g29)
  {
    @hil_drv::target_velocity = 0;
    testWaitForSignalInRange(sysvar::hil_hvm::velocity_x, 0,0.5,25000);
  }
  else
  {
    //@hil_drv::gear_req = @hil_drv::gear_req::park;
    testWaitForTimeout(1000);
  }
}

export testfunction PostConditions_LKS()
{
  $CAN_MPC3::LANE_02::LksStatus = 0;
  testWaitForTimeout(500);
}

export testfunction Activate_LKS_Cus()
{
  $CAN_MPC3::LANE_02::LksStatus = 1;
  testWaitForTimeout(500);
  @hil_drv::hmi_btn_adas_lks = @hil_drv::hmi_btn_adas_lks::pressed_on; // pressed button LKS to switch ON
  testWaitForTimeout(500); // short push on the button
  @hil_drv::hmi_btn_adas_lks = @hil_drv::hmi_btn_adas_lks::not_pressed; // button released
  testWaitForTimeout(3000);
}

export testfunction Check_ALC_Status_Cus(int config)
{
  testStepFail("Variant not supported");
}
  
//HF_EST Smoke Test
//*********************************************************************************************************************************

export testfunction Check_HF_Status_Cus(int config)
{
  testStepFail("Variant not supported");
}

export testfunction Check_EST_Status_Cus(int config)
{
  testStepFail("Variant not supported");
}

export testfunction Set_DriverDistraction_Cus()
{
  $DrvrDstcnStsHSC4 = 1; // no distraction
  $EyeOnRoadHSC4 = 3; // eyes off road
  testWaitForTimeout(15000);
  $DrvrDstcnStsHSC4 = 4; // high level distraction
  $EyeOnRoadHSC4 = 1; // eyes on road
}