/*@!Encoding:1252*/
/**
 * @file ACC_target_overtaking_ego_10m_cut.can
 * @author ADAS_HIL_TEAM
 * @date 10-16-2023
 * @brief 
 *
 * ################################################################
 * C O P Y R I G H T S
 * ----------------------------------------------------------------
 * Copyright (c) 2023 by Robert Bosch GmbH. All rights reserved.
 
 * The reproduction, distribution and utilization of this file as
 * well as the communication of its contents to others without express
 * authorization is prohibited. Offenders will be held liable for the
 * payment of damages. All rights reserved in the event of the grant
 * of a patent, utility model or design.
 *
 * ################################################################
*/

includes
{
  //#include "common_test_functions.cin"
}

variables
{
  int i;
}

export testcase ACC_target_overtaking_ego_10m_cut(int config, double ego_speed, double tgt_speed)
{

  testStep("Test case","Start");
  @hil_drv::target_velocity = ego_speed;
  @Classe_Obj_Sim::obj_ctrl.obj_target_v_long[0] = tgt_speed;
  @Classe_Obj_Sim::obj_ctrl.ctrl_status_velocity[0] = 1;
  @Classe_Obj_Sim::obj_ctrl.obj_target_lane_lat_offset[0] = 0;
  @Classe_Obj_Sim::obj_ctrl.ctrl_status_lane_lat_offset[0] = 1;
  @Classe_Obj_Sim::obj_ctrl.par_lane_offset_timeconstraint = 1; // set to 1 sec the time to change the lane
  testWaitForSignalInRange(sysvar::hil_hvm::velocity_x, ego_speed-1,ego_speed+1,25000);
  testWaitForSignalInRange(sysvar::CarMaker::RB::TrafficObj::object0::dtx, -10,-1,30000);
  @Classe_Obj_Sim::obj_ctrl.obj_target_lane_lat_offset[0] = 3.5;
  testWaitForSignalInRange(sysvar::CarMaker::RB::TrafficObj::object0::dtx, 10,20,30000);
  @Classe_Obj_Sim::obj_ctrl.obj_target_lane_lat_offset[0] = 0;
  Activate_ACC_Cus(); 
  Check_ACC_Status_Cus();
  ShortPress_ACC_SetPlus_Cus(); 
}