/*@!Encoding:1252*/
/**
 * @file ELKA_oncoming_left.can
 * @author ADAS_HIL_TEAM
 * @date 05-06-2023
 * @brief 
 *
 * ################################################################
 * C O P Y R I G H T S
 * ----------------------------------------------------------------
 * Copyright (c) 2023 by Robert Bosch GmbH. All rights reserved.
 
 * The reproduction, distribution and utilization of this file as
 * well as the communication of its contents to others without express
 * authorization is prohibited. Offenders will be held liable for the
 * payment of damages. All rights reserved in the event of the grant
 * of a patent, utility model or design.
 *
 * ################################################################
*/

includes
{
 // #include "common_test_functions.cin"
}

variables
{
}

export testcase ELKA_oncoming_left(int config, double ego_speed, double tgt_speed)
{
  testStep("Test case","Start");
  @hil_drv::target_velocity = ego_speed;
  @Classe_Obj_Sim::obj_ctrl.obj_target_v_long[0] = tgt_speed;
  @Classe_Obj_Sim::obj_ctrl.ctrl_status_velocity[0] = 1;
  testWaitForSignalInRange(sysvar::hil_hvm::velocity_x, ego_speed-1,ego_speed+1,25000);
  Activate_LKA_ELK_Cus();
  testWaitForSignalInRange(sysvar::CarMaker::RB::TrafficObj::object0::rel_dx, 0,170,25000);
  @hil_ctrl::trigger_tgt_collision_oncoming = 0;
  testWaitForTimeout(500);
  @hil_drv::steering_wheel_angle_req = -5;
  Check_ELKA_Oncoming_Status_Cus(config);
}